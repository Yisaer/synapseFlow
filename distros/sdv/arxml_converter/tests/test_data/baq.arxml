[part 8 of 11: packages /SoAdRoutingGroups to /DataTypes/ApplicationDataTypes]
AUTOSAR XML (schema 00048)
package /SoAdRoutingGroups
  70 x so ad routing group:
    SoAdRG_eHMI_ParkingUI_VLAN62: event-group-control-type=ACTIVATION-UNICAST
    SoAdRG_eHMI_ParkingUI_Eventgroup_VLAN62_eHMI_ParkingUI: event-group-control-type=ACTIVATION-UNICAST
    SoAdRG_eHMI_ADASSetting_VLAN62: event-group-control-type=ACTIVATION-UNICAST
    SoAdRG_eHMI_ADASSetting_Eventgroup_VLAN62_eHMI_ADASSetting: event-group-control-type=ACTIVATION-UNICAST
    SoAdRG_eHMI_DVRSet_VLAN62: event-group-control-type=ACTIVATION-UNICAST
    SoAdRG_eHMI_DVRSet_EventGroup_VLAN62_eHMI_DVRSet: event-group-control-type=ACTIVATION-AND-TRIGGER-UNICAST
    SoAdRG_TBOX_TimeManagement_VLAN62: event-group-control-type=ACTIVATION-UNICAST
    SoAdRG_TBOX_TimeManagement_EventGroup_VLAN62_TBOX_TimeManagement: event-group-control-type=ACTIVATION-UNICAST
    SoAdRG_TBOX_ResSwtSts_VLAN62: event-group-control-type=ACTIVATION-UNICAST
    SoAdRG_TBOX_ResSwtSts_EventGroup_VLAN62_TBOX_ResSwtSts: event-group-control-type=ACTIVATION-AND-TRIGGER-UNICAST
    SoAdRG_TBOX_SystemInfo_VLAN62: event-group-control-type=ACTIVATION-UNICAST
    SoAdRG_TBOXSystemInfo_EventGroup_VLAN62_TBOX_SystemInfo: event-group-control-type=ACTIVATION-UNICAST
    SoAdRG_TBOX_BEICALL_VLAN62: event-group-control-type=ACTIVATION-UNICAST
    SoAdRG_BEICALL_EventGroup_VLAN62_TBOX_BEICALL: event-group-control-type=ACTIVATION-AND-TRIGGER-UNICAST
    SoAdRG_TBOX_USBUpdate_VLAN62: event-group-control-type=ACTIVATION-UNICAST
    SoAdRG_USBUpdate_EventGroup_VLAN62_TBOX_USBUpdate: event-group-control-type=ACTIVATION-UNICAST
    SoAdRG_TBOX_USBTBOXlog_VLAN62: event-group-control-type=ACTIVATION-UNICAST
    SoAdRG_TBOX_GNSSInfo_VLAN62: event-group-control-type=ACTIVATION-UNICAST
    SoAdRG_GNSSInfo_EventGroup_VLAN62_TBOX_GNSSInfo: event-group-control-type=ACTIVATION-UNICAST
    SoAdRG_ICC_Android_OutService_VLAN62: event-group-control-type=ACTIVATION-UNICAST
    SoAdRG_ICC_Android_OutService_EventGroup_VLAN62_ICC_Android_OutService: event-group-control-type=ACTIVATION-AND-TRIGGER-UNICAST
    SoAdRG_ICC_Aom_VLAN62: event-group-control-type=ACTIVATION-UNICAST
    SoAdRG_ICC_Aom_Eventgroup_VLAN62_ICC_Aom: event-group-control-type=ACTIVATION-UNICAST
    SoAdRG_ICC_SDmapInfo_VLAN62: event-group-control-type=ACTIVATION-UNICAST
    SoAdRG_ICC_SDmapInfo_EventGroup_VLAN62_ICC_SDmapInfo: event-group-control-type=ACTIVATION-AND-TRIGGER-UNICAST
    SoAdRG_ICC_SDmapInfo_2_VLAN62: event-group-control-type=ACTIVATION-UNICAST
    SoAdRG_ICC_SDmapInfo_2_EventGroup_VLAN62_ICC_SDmapInfo_2: event-group-control-type=ACTIVATION-AND-TRIGGER-UNICAST
    SoAdRG_ADCC_DrivingHmiEnv_VLAN62: event-group-control-type=ACTIVATION-UNICAST
    SoAdRG_ADCC_DrivingHmiEnv_Eventgroup_VLAN62_ADCC_DrivingHmiEnv: event-group-control-type=ACTIVATION-UNICAST
    SoAdRG_ADCC_SensorInfo_VLAN62: event-group-control-type=ACTIVATION-UNICAST
    SoAdRG_ADCC_SensorInfo_Eventgroup_VLAN62_ADCC_SensorInfo: event-group-control-type=ACTIVATION-UNICAST
    SoAdRG_ADCC_DrivingFuncInfo_VLAN62: event-group-control-type=ACTIVATION-UNICAST
    SoAdRG_ADCC_DrivingFuncInfo_Eventgroup_VLAN62_ADCC_DrivingFuncInfo: event-group-control-type=ACTIVATION-AND-TRIGGER-UNICAST
    SoAdRG_ADCC_ParkingFuncInfo_VLAN62: event-group-control-type=ACTIVATION-UNICAST
    SoAdRG_ADAS_ParkingFuncInfo_Eventgroup_VLAN62_ADCC_ParkingFuncInfo: event-group-control-type=ACTIVATION-AND-TRIGGER-UNICAST
    SoAdRG_ADCC_ParkingHmiEnv_VLAN62: event-group-control-type=ACTIVATION-UNICAST
    SoAdRG_ADCC_ParkingHmiEnv_Eventgroup_VLAN62_ADCC_ParkingHmiEnv: event-group-control-type=ACTIVATION-AND-TRIGGER-UNICAST
    SoAdRG_ADCC_AomMMSt_VLAN62: event-group-control-type=ACTIVATION-UNICAST
    SoAdRG_ADCC_AomMMSt_Eventgroup_VLAN62_ADCC_AomMMSt: event-group-control-type=ACTIVATION-AND-TRIGGER-UNICAST
    SoAdRG_ADCC_AomDB_VLAN62: event-group-control-type=ACTIVATION-UNICAST
    SoAdRG_ADCC_RtMM_VLAN62: event-group-control-type=ACTIVATION-UNICAST
    SoAdRG_ADCC_RtMM_Eventgroup_VLAN62_ADCC_RtMM: event-group-control-type=ACTIVATION-AND-TRIGGER-UNICAST
    SoAdRG_FCM_DrivingHmiEnv_VLAN62: event-group-control-type=ACTIVATION-UNICAST
    SoAdRG_FCM_DrivingHmiEnv_Eventgroup_VLAN62_FCM_DrivingHmiEnv: event-group-control-type=ACTIVATION-UNICAST
    SoAdRG_FCM_ActiveSafetyInfo_VLAN62: event-group-control-type=ACTIVATION-UNICAST
    SoAdRG_FCM_ActiveSafetyInfo_Eventgroup_VLAN62_FCM_ActiveSafetyInfo: event-group-control-type=ACTIVATION-UNICAST
    SoAdRG_FCM_DrivingFuncInfo_VLAN62: event-group-control-type=ACTIVATION-UNICAST
    SoAdRG_FCM_DrivingFuncInfo_Eventgroup_VLAN62_FCM_DrivingFuncInfo: event-group-control-type=ACTIVATION-UNICAST
    SoAdRG_FCM_DVRSts_VLAN62: event-group-control-type=ACTIVATION-UNICAST
    SoAdRG_FCM_DVRSts_Eventgroup_VLAN62_FCM_DVRSts: event-group-control-type=ACTIVATION-AND-TRIGGER-UNICAST
    SoAdRG_FCM_UUID_VLAN62: event-group-control-type=ACTIVATION-UNICAST
    SoAdRG_LCM_ICC_Data_VLAN62: event-group-control-type=ACTIVATION-UNICAST
    SoAdRG_LCM_ICC_Data_Eventgroup_VLAN62_LCM_ICC_Data: event-group-control-type=ACTIVATION-UNICAST
    SoAdRG_LCM_ADCC_RawData_VLAN62: event-group-control-type=ACTIVATION-UNICAST
    SoAdRG_LCM_ADCC_RawData_Eventgroup_VLAN62_LCM_ADCC_RawData: event-group-control-type=ACTIVATION-UNICAST
    SoAdRG_ADCC_ActiveSafetyInfo_VLAN62: event-group-control-type=ACTIVATION-UNICAST
    SoAdRG_ADCC_ActiveSafetyInfo_Eventgroup_VLAN62_ADCC_ActiveSafetyInfo: event-group-control-type=ACTIVATION-UNICAST
    SoAdRG_ADCC_UUID_VLAN62: event-group-control-type=ACTIVATION-UNICAST
    SoAdRG_FCM_SensorInfo_VLAN62: event-group-control-type=ACTIVATION-UNICAST
    SoAdRG_FCM_SensorInfo_Eventgroup_VLAN62_FCM_SensorInfo: event-group-control-type=ACTIVATION-UNICAST
    SoAdRG_TBOX_SystemInfo_ICC_VLAN62: event-group-control-type=ACTIVATION-UNICAST
    SoAdRG_TBOXSystemInfo_EventGroup_VLAN62_TBOX_SystemInfo_ICC: event-group-control-type=ACTIVATION-UNICAST
    SoAdRG_ADCC_DVRSts_VLAN62: event-group-control-type=ACTIVATION-UNICAST
    SoAdRG_ADCC_DVRSts_Eventgroup_VLAN62_ADCC_DVRSts: event-group-control-type=ACTIVATION-AND-TRIGGER-UNICAST
    SoAdRG_ADAS_DataInLoop_VLAN62: event-group-control-type=ACTIVATION-UNICAST
    SoAdRG_DataInLoop_Eventgroup_VLAN62_ADAS_DataInLoop: event-group-control-type=ACTIVATION-UNICAST
    SoAdRG_IVI_UnixTimestamp_VLAN62: event-group-control-type=ACTIVATION-UNICAST
    SoAdRG_UnixTimestamp_Eventgroup_VLAN62_IVI_UnixTimestamp: event-group-control-type=ACTIVATION-UNICAST
    SoAdRG_ADAS_GNSSInfo_VLAN62: event-group-control-type=ACTIVATION-UNICAST
    SoAdRG_ADAS_GNSSInfo_Eventgroup_VLAN62_ADAS_GNSSInfo: event-group-control-type=ACTIVATION-UNICAST
package /DataTypes/ApplicationDataTypes
  app type ADT_ADAS_enum_HPARequestAPAUI: category=VALUE, compu {phys=raw for raw 0..255}, range phys 0..255
  app type ADT_ICC_int16_SpeedLimit: category=VALUE, compu {phys=raw for raw 0..32767}, range phys 0..32767
  application array data type ADT_TLAInfo_arr_Reserved: category=ARRAY
    element ADT_TLAInfo_arr_Reserved: category=VALUE, type=ADT_Reserved_uint8_Type, array-size-semantics=FIXED-SIZE, max-number-of-elements=30
  application record data type ADT_ADAS_strt_DrivingTrajectoryPointList: category=STRUCTURE  # 引导面/引导线行点
    application record element DTE_DrivingTrajectoryPointNum: category=VALUE, type=ADT_ADAS_val_DrivingTrajectoryPointNum  # 轨迹形点个数
    application record element DTE_DrivingTrajectoryPointList: category=ARRAY, type=ADT_ADAS_arr_DrivingTrajectoryPointList  # 轨迹形点数组
  app type ADT_ADAS_Seg_FormOfWay: category=VALUE, compu {phys=raw for raw 0..15}, range phys 0..15
  app type ADT_Gen_int32_ManeuverID: category=VALUE, compu {phys=raw for raw 0..2147483647}, range phys 0..2147483647
  application array data type ADT_Countdown_arr_Reserved: category=ARRAY
    element ADT_Countdown_arr_Reserved: category=VALUE, type=ADT_Reserved_int32_Type, array-size-semantics=FIXED-SIZE, max-number-of-elements=20
  app type ADT_ICC_string_Name: category=STRING, sw-text-props={array-size-semantics=VARIABLE-SIZE, sw-max-text-size=1000, base-type=UTF_8}
  application record data type ADT_ADAS_strt_HPAStaticObject: category=STRUCTURE
    12 x application record element:
      DTE_objectId: category=VALUE, type=ADT_Gen_val_ID  # 目标id
      DTE_objectType: category=VALUE, type=ADT_ADAS_enum_StaticObjectType  # 目标类型
      DTE_objectPoseX: category=VALUE, type=ADT_Gen_val_Coordinate_X  # 目标位置X坐标
      DTE_objectPoseY: category=VALUE, type=ADT_Gen_val_Coordinate_Y  # 目标位置Y坐标
      DTE_objectPoseZ: category=VALUE, type=ADT_Gen_val_Coordinate_Z  # 目标位置Z坐标
      DTE_objectYaw: category=VALUE, type=ADT_Gen_val_Yaw  # 目标位姿
      DTE_objectLength: category=VALUE, type=ADT_Gen_val_Length  # 目标长度
      DTE_objecWidth: category=VALUE, type=ADT_Gen_val_Width  # 目标宽度
      DTE_timestampnSec: category=VALUE, type=ADT_ADAS_val_timestampnSec  # 时间戳-纳秒
      DTE_laneID: category=VALUE, type=ADT_ADAS_val_laneID  # 目标所属车道ID
      DTE_HPAobjectFloor: category=VALUE, type=ADT_ADAS_enum_HPAFloor  # 目标所属楼层
      DTE_HPAStaticObjectReserved: category=ARRAY, type=ADT_HPAStaticObject_arr_Reserved  # 预留
  application array data type ADT_CongestionExtend_arr_Reserved: category=ARRAY
    element ADT_CongestionExtend_arr_Reserved: category=VALUE, type=ADT_Reserved_int32_Type, array-size-semantics=FIXED-SIZE, max-number-of-elements=15
  app type ADT_ADAS_enum_OCCType: category=VALUE, compu {phys=raw for raw 0..255}, range phys 0..255  # OCC类型
  application array data type ADT_ServiceAreaInfo_arr_Reserved: category=ARRAY  # 预留
    element ADT_ServiceAreaInfo_arr_Reserved: category=VALUE, type=ADT_Reserved_int32_Type, array-size-semantics=FIXED-SIZE, max-number-of-elements=100
  app type ADT_PermissionId: category=VALUE, compu {phys=raw for raw 0..4294967295}, range phys 0..4294967295  # 权限ID
  application record data type ADT_Strt_SatelInfo: category=STRUCTURE  # 卫星信息 satellites information
    11 x application record element:
      DTE_SatelIdNrInfo: category=VALUE, type=ADT_Enum_SatelIdNrInfo  # 卫星标识号信息 Satellite identification number information
      DTE_SatelTypeInfo: category=VALUE, type=ADT_Enum_SatelTypeInfo  # 卫星类型信息 Satellite type information
      DTE_Ephemeris: category=VALUE, type=ADT_Bool_Ephemeris  # 是否有星历信息 Is there any ephemeris information
      DTE_Almanac: category=VALUE, type=ADT_Bool_Almanac  # 是否有历书信息 Is there any almanac information
      DTE_PrevPosnUesdInfo: category=VALUE, type=ADT_Bool_PrevPosnUesdInfo  # 是否在前次定位中使用过信息 Was the information used in the previous positioning
      DTE_SNRInfo: category=VALUE, type=ADT_Enum_SNRInfo  # 信噪比信息 Signal-to-noise ratio information
      DTE_ElevnInfo: category=VALUE, type=ADT_Enum_ElevnInfo  # 仰角信息 Elevation information
      DTE_AziInfo: category=VALUE, type=ADT_Enum_AziInfo  # 方位角信息 Azimuth information
      DTE_CarrierInfo: category=VALUE, type=ADT_Enum_CarrierInfo  # 载波频率信息 Carrier frequency information
      DTE_CarrierFrq: category=VALUE, type=ADT_Bool_CarrierFrq  # 载波频率是否有效信息 Information on whether the carrier frequency is valid
      DTE_SatelInfoResd: category=ARRAY, type=ADT_Arr_SatelInfoResd  # 预留 Reserved
  application array data type ADT_ADAS_arr_VPAParkingLotInfo: category=ARRAY, dynamic-array-size-profile=VSA_LINEAR
    element ADT_ADAS_arr_VPAParkingLotInfo: category=STRUCTURE, type=ADT_ADAS_strt_VPAParkingLotBaseData, array-size-handling=ALL-INDICES-SAME-ARRAY-SIZE, array-size-semantics=VARIABLE-SIZE, max-number-of-elements=100
  app type ADT_ICC_int32_WeatherID: category=VALUE, compu {phys=raw for raw 0..2147483647}, range phys 0..2147483647  # 天气 ID
  app type ADT_ADAS_arr_MNPMemRoutesNum: category=VALUE, compu {phys=raw for raw 0..20}, range phys 0..20  # 已记忆路线数量
  application record data type ADT_RequestVhrCompLogReportEnableCfg: category=STRUCTURE  # 部件日志主动上报开关配置--请求
    application record element DTE_vhrCompID: category=STRING, type=ADT_VhrCompID  # 部件ID
    application record element DTE_vhrReportEnable: category=VALUE, type=ADT_vhrReportEnable  # 日志上报使能开关
  application record data type ADT_ADAS_strt_RoadMarkerSupplement: category=STRUCTURE
    6 x application record element:
      DTE_RoadMarkerPose3X: category=VALUE, type=ADT_Gen_val_Coordinate_X  # 路面标记点3X坐标
      DTE_RoadMarkerPose3Y: category=VALUE, type=ADT_Gen_val_Coordinate_Y  # 路面标记点3Y坐标
      DTE_RoadMarkerPose4X: category=VALUE, type=ADT_Gen_val_Coordinate_X  # 路面标记点4X坐标
      DTE_RoadMarkerPose4Y: category=VALUE, type=ADT_Gen_val_Coordinate_Y  # 路面标记点4Y坐标
      DTE_RoadMarkerColor: category=VALUE, type=ADT_ADAS_enum_RoadMarkerColor  # 路面标记颜色
      DTE_RoadMarkerSupplementReserved: category=ARRAY, type=ADT_RoadMarkerSupplement_arr_Reserved  # 预留
  6 x app type:
    ADT_Dbl_VDOPInfo: category=VALUE, compu {phys=raw for raw 0..100}, range phys 0..100  # 垂直精度因子信息 Vertical dilution of precision information
    ADT_ADAS_enum_MRASts: category=VALUE, compu {phys=raw for raw 0..255}, range phys 0..255
    ADT_Enum_TBOXOTAState: category=VALUE, compu {0=ReportOTAStateNoResp, 1=ReportOTAStateResp}, range phys 0..255  # 响应收到发送OTA状态给TBOX
    ADT_TotalStep: category=VALUE, compu {phys=raw for raw 0..255}, range phys 0..255  # 诊断步骤总数
    ADT_ICC_enum_ApaOperationId: category=VALUE, compu {phys=raw for raw 0..255}, range phys 0..255
    ADT_ICC_string_Affect: category=STRING, sw-text-props={array-size-semantics=VARIABLE-SIZE, sw-max-text-size=1000, base-type=UTF_8}
  application array data type ADT_Traffic3DSign_arr_Reserved: category=ARRAY
    element ADT_Traffic3DSign_arr_Reserved: category=VALUE, type=ADT_Reserved_uint8_Type, array-size-semantics=FIXED-SIZE, max-number-of-elements=10
  app type ADT_PermissionConfigState: category=VALUE, compu {phys=raw for raw 0..1}, range phys 0..1  # 权限的开关值
  app type ADT_ICC_enum_HNOACruiseSpdOffsetMod: category=VALUE, compu {phys=raw for raw 0..255}, range phys 0..255  # 设定车速偏移方式
  application array data type ADT_ADAS_arr_LinePoint: category=ARRAY, dynamic-array-size-profile=VSA_LINEAR  # 车道线形点数组
    element ADT_ADAS_arr_LinePoint: category=STRUCTURE, type=ADT_ADAS_strt_LinePoint, array-size-handling=ALL-INDICES-SAME-ARRAY-SIZE, array-size-semantics=VARIABLE-SIZE, max-number-of-elements=300
  application record data type ADT_Struct_SIMCardinfo: category=STRUCTURE  # SIM卡信息
    4 x application record element:
      DTE_Network: category=VALUE, type=ADT_Enum_Network  # 网络
      DTE_SIM_ICCID: category=STRING, type=ADT_StrVar_SIM_ICCID  # 20位数字组成的集成电路卡识别码
      DTE_SIM_IMSI: category=STRING, type=ADT_StrVar_SIM_IMSI  # 15位的国际移动用户识别码
      DTE_MSISDN: category=STRING, type=ADT_StrVar_MSISDN  # 15位移动电话号码
  app type ADT_StrVar_TBOXOTARemoteInstall: category=STRING, sw-text-props={array-size-semantics=VARIABLE-SIZE, sw-max-text-size=16, base-type=UTF_8}  # OTA立即升级
  application record data type ADT_ICC_strt_ApaRpaFcnOperating_2: category=STRUCTURE
    7 x application record element:
      DTE_ApaOperationId: category=VALUE, type=ADT_ICC_enum_ApaOperationId  # APA功能操作指令
      DTE_ApaModeReq: category=VALUE, type=ADT_ICC_enum_ApaModeReq  # APA模式选择指令
      DTE_ApaSelectSlotID: category=VALUE, type=ADT_ICC_uint16_SelectSlotID  # APA选择车位ID
      DTE_ApaPocDirection: category=VALUE, type=ADT_ICC_enum_ApaPocDirection  # APA泊出方向指令
      DTE_ApaFreeSlotInfo: category=STRUCTURE, type=ADT_ICC_strt_ApaFreeSlotInfo  # APA自选车位信息
      DTE_APARoad_Class: category=VALUE, type=ADT_ICC_enum_APARoad_Class  # 道路等级
      DTE_ApaRpaFcnReserved: category=ARRAY, type=ADT_ApaRpaFcn_arr_Reserved  # 预留
  app type ADT_ADAS_ProfLong_CtrlPoint: category=VALUE, compu {phys=raw for raw 0..1}, range phys 0..1
  app type ADT_ADAS_enum_VPAPauseInd: category=VALUE, compu {phys=raw for raw 0..255}, range phys 0..255
  application array data type ADT_ADAS_arr_LaneLineData_2: category=ARRAY, dynamic-array-size-profile=VSA_LINEAR  # 车道线信息数组
    element ADT_ADAS_arr_LaneLineData_2: category=STRUCTURE, type=ADT_ADAS_strt_LaneLine_2, array-size-handling=ALL-INDICES-SAME-ARRAY-SIZE, array-size-semantics=VARIABLE-SIZE, max-number-of-elements=24
  application record data type ADT_ADAS_strt_HpaEndPos: category=STRUCTURE
    5 x application record element, all with category=STRUCTURE, type=ADT_ADAS_strt_SlotPoint:
      DTE_EndPosCenterPoint  # 终点车位的中心点
      DTE_EndSlotPoint0Top1  # 终点车位顶点1
      DTE_EndSlotPoint1Top2  # 终点车位顶点2
      DTE_EndSlotPoint2Bottom1  # 终点车位顶点3
      DTE_EndSlotPoint3Bottom2  # 终点车位顶点4
  app type ADT_ICC_enum_NavCountryCodeInfo: category=VALUE, compu {phys=raw for raw 0..255}, range phys 0..255  # 导航国家代码
  application record data type ADT_Struct_TBOXVersionInfo: category=STRUCTURE  # TBOX版本信息
    8 x application record element, all with category=STRING:
      DTE_TBoxVersion: type=ADT_StrVar_TBoxVersion  # TBOX版本号
      DTE_ECUHardwareNumber: type=ADT_StrVar_ECUHardwareNumber  # ECU硬件号
      DTE_ECUSoftwareNumber: type=ADT_StrVar_ECUSoftwareNumber  # ECU软件号
      DTE_ProductID: type=ADT_StrVar_ProductID  # TBOX产品唯一ID
      DTE_HardwareVersion: type=ADT_StrVar_HardwareVersion  # 硬件版本号
      DTE_MCUVersion: type=ADT_StrVar_MCUVersion  # MCU版本号
      DTE_ARMVersion: type=ADT_StrVar_ARMVersion  # ARM版本号
      DTE_ModemVersion: type=ADT_StrVar_ModemVersion  # Modem版本号
  application array data type ADT_Arr_SatelInfoResd: category=ARRAY  # 预留 Reserved
    element ADT_Arr_SatelInfoResd: category=VALUE, type=ADT_Reserved_uint8_Type, array-size-semantics=FIXED-SIZE, max-number-of-elements=10
  app type ADT_Gen_val_Length: category=VALUE, compu {phys=raw for raw 0..65535; unit cm}, range phys 0..65535  # 长
  application array data type ADT_ADSHMINotificationMessage: category=ARRAY, dynamic-array-size-profile=VSA_LINEAR  # ADS HMI数据通道通知
    element ADT_ADSHMINotificationMessage: category=VALUE, type=ADT_ADSHMIBasicElement, array-size-handling=ALL-INDICES-SAME-ARRAY-SIZE, array-size-semantics=VARIABLE-SIZE, max-number-of-elements=1048576
  4 x app type:
    ADT_StrVar_BleSlaverRearMac: category=STRING, sw-text-props={array-size-semantics=VARIABLE-SIZE, sw-max-text-size=24, base-type=UTF_8}  # 蓝牙后从模块MAC 地址
    ADT_StrVar_PhoneNumber: category=STRING, sw-text-props={array-size-semantics=VARIABLE-SIZE, sw-max-text-size=15, base-type=UTF_8}
    ADT_ICC_enum_FSRASpdSetMod: category=VALUE, compu {phys=raw for raw 0..255}, range phys 0..255  # 巡航速度调整方式设置（无开关）
    ADT_ADAS_enum_SglSendMode: category=VALUE, compu {phys=raw for raw 0..255}, range phys 0..255  # 发送模式 Transmission mode
  application array data type ADT_ADAS_arr_HPASpeedBumpInfo: category=ARRAY, dynamic-array-size-profile=VSA_LINEAR
    element ADT_ADAS_arr_HPASpeedBumpInfo: category=STRUCTURE, type=ADT_ADAS_strt_SpeedBumpInfo, array-size-handling=ALL-INDICES-SAME-ARRAY-SIZE, array-size-semantics=VARIABLE-SIZE, max-number-of-elements=10
  4 x app type:
    ADT_Str_ProductID: category=STRING, sw-text-props={array-size-semantics=VARIABLE-SIZE, sw-max-text-size=40, base-type=UTF_8}  # ADAS产品唯一ID（产品序列号/唯一码） ADAS Product Unique ID (Product Serial Number/Unique Code)
    ADT_ICC_enum_FCTAWarnType: category=VALUE, compu {phys=raw for raw 0..255}, range phys 0..255  # FCTA报警方式
    ADT_ICC_int32_AlertLevel: category=VALUE, compu {phys=raw for raw 0..2147483647}, range phys 0..2147483647  # 预警等级
    ADT_ICC_string_WeatherName: category=STRING, sw-text-props={array-size-semantics=VARIABLE-SIZE, sw-max-text-size=200, base-type=UTF_8}  # 天气名称
  application array data type ADT_ICC_arr_BackLaneTypes: category=ARRAY, dynamic-array-size-profile=VSA_LINEAR
    element ADT_ICC_arr_BackLaneTypes: category=STRUCTURE, type=ADT_ICC_strt_LaneCategoryType, array-size-handling=ALL-INDICES-SAME-ARRAY-SIZE, array-size-semantics=VARIABLE-SIZE, max-number-of-elements=32
  application record data type ADT_ICC_strt_LaneAction: category=STRUCTURE
    application record element DTE_LaneAction: category=VALUE, type=ADT_ICC_int32_LaneAction  # 车道信息
  6 x app type, all with category=VALUE:
    ADT_ADAS_Seg_FuncRoadClass: compu {phys=raw for raw 0..7}, range phys 0..7
    ADT_Reserved_uint8_Type: compu {phys=raw for raw 0..255}, range phys 0..255  # 预留
    ADT_ICC_enum_MNPMemRouteCompleteBtnSt: compu {phys=raw for raw 0..255}, range phys 0..255  # 路线记忆结束按钮
    ADT_ADAS_enum_ApaRpaSts: compu {phys=raw for raw 0..255}, range phys 0..255
    ADT_ADAS_enum_GoNotifier: compu {phys=raw for raw 0..255}, range phys 0..255
    ADT_ICC_enum_SetHPAPathType: compu {phys=raw for raw 0..255}, range phys 0..255
  application array data type ADT_Arr_SatelInfo: category=ARRAY, dynamic-array-size-profile=VSA_LINEAR  # 卫星信息 satellites information
    element ADT_Arr_SatelInfo: category=STRUCTURE, type=ADT_Strt_SatelInfo, array-size-handling=ALL-INDICES-SAME-ARRAY-SIZE, array-size-semantics=VARIABLE-SIZE, max-number-of-elements=100
  app type ADT_StrVar_State: category=STRING, sw-text-props={array-size-semantics=VARIABLE-SIZE, sw-max-text-size=460, base-type=UTF_8}
  application array data type ADT_ICC_arr_MixForkInfoList: category=ARRAY, dynamic-array-size-profile=VSA_LINEAR  # 混淆路口
    element ADT_ICC_arr_MixForkInfoList: category=STRUCTURE, type=ADT_ICC_strt_MixForkInfoList, array-size-handling=ALL-INDICES-SAME-ARRAY-SIZE, array-size-semantics=VARIABLE-SIZE, max-number-of-elements=6
  app type ADT_LCM_IMU_Gyro_Z: category=VALUE, compu {phys=raw-4.363323 for raw -4.363323..4.36332313; unit rad/s}, range phys -4.363323..4.36332313
  application record data type ADT_CellularNetworkInfo: category=STRUCTURE  # 蜂窝网信息状态上报
    7 x application record element:
      DTE_celluarRegisterStatus: category=VALUE, type=ADT_CelluarRegisterStatus  # 网络注册状态
      DTE_celluarEsimStatus: category=VALUE, type=ADT_CelluarEsimStatus  # SIM卡状态
      DTE_celluarServiceStatus: category=VALUE, type=ADT_CelluarServiceStatus  # 系统服务状态
      DTE_celluarRoamingStatus: category=VALUE, type=ADT_CelluarRoamingStatus  # 网络漫游状态
      DTE_strength: category=VALUE, type=ADT_Strength  # 网络信号状态
      DTE_apnCount: category=VALUE, type=ADT_ApnCount  # apn个数
      DTE_apnArray: category=ARRAY, type=ADT_ApnArray  # apn数组
  app type ADT_LCM_IMU_Gyro_Y: category=VALUE, compu {phys=raw-4.363323 for raw -4.363323..4.36332313; unit rad/s}, range phys -4.363323..4.36332313
  app type ADT_LCM_IMU_Gyro_X: category=VALUE, compu {phys=raw-4.363323 for raw -4.363323..4.36332313; unit rad/s}, range phys -4.363323..4.36332313
  application array data type ADT_HPATraining_arr_Reserved: category=ARRAY  # 预留
    element ADT_HPATraining_arr_Reserved: category=VALUE, type=ADT_Reserved_uint8_Type, array-size-semantics=FIXED-SIZE, max-number-of-elements=28
  app type ADT_ADAS_val_ParkingProcessTakeTime: category=VALUE, compu {phys=raw for raw 0..255; unit s}, range phys 0..255
  application array data type ADT_MNPRouteInfo_arr_Reserved: category=ARRAY
    element ADT_MNPRouteInfo_arr_Reserved: category=VALUE, type=ADT_Reserved_uint8_Type, array-size-semantics=FIXED-SIZE, max-number-of-elements=20
  app type ADT_ADAS_enum_TolNOAMileage: category=VALUE, compu {phys=raw for raw 0..100000; unit km}, range phys 0..100000  # NOA行驶里程
  app type ADT_ADAS_val_heading: category=VALUE, compu {phys=raw for raw 0..360; unit degree}, range phys 0..360
  app type ADT_IcaNcaState: category=VALUE, compu {0=OFF, 1=ICA_STANDBY, 2=ICA_LATERAL_OVERRIDE, 3=ICA_LONGITUDINAL_OVERRIDE, 4=ICA_LAT_LONG_OVERRIDE, 5=ICA_ACTIVE, 6=NCA_STANDBY, 7=NCA_LATERAL_OVERRIDE, 8=NCA_LONGITUDINAL_OVERRIDE, 9=NCA_LAT_LONG_OVERRIDE, 10=NCA_ACTIVE, 11=L3_NCA_STANDBY, 12=L3_NCA_ACTIVE, 255=INVALID}  # ICA/NCA激活与否状态信息
  application record data type ADT_ADAS_strt_ICAInfo: category=STRUCTURE
    4 x application record element, all with category=VALUE:
      DTE_ICASts: type=ADT_ADAS_enum_ICASts  # ICA 工作状态
      DTE_ICATextInfo: type=ADT_ADAS_enum_ICATextInfo  # ICA 提示信息
      DTE_ICAQuitReason: type=ADT_ADAS_enum_ICAQuitReason  # ICA 退出原因
      DTE_ICASenarioReminder: type=ADT_ADAS_enum_ICASenarioReminder  # ICA场景提示
  app type ADT_ICC_enum_NOALCCSwitchBtnSts: category=VALUE, compu {phys=raw for raw 0..255}, range phys 0..255  # NOA与LCC切换指令
  app type ADT_ICC_enum_MRAOperationId: category=VALUE, compu {phys=raw for raw 0..255}, range phys 0..255
  application array data type ADT_ICC_arr_FrontLanes: category=ARRAY, dynamic-array-size-profile=VSA_LINEAR
    element ADT_ICC_arr_FrontLanes: category=STRUCTURE, type=ADT_ICC_strt_LaneAction, array-size-handling=ALL-INDICES-SAME-ARRAY-SIZE, array-size-semantics=VARIABLE-SIZE, max-number-of-elements=32
  app type ADT_ADAS_val_VPATunnel: category=STRING, sw-text-props={array-size-semantics=VARIABLE-SIZE, sw-max-text-size=50, base-type=UTF_8}  # VPA通道名
  app type ADT_ADAS_enum_MNPRouteAvailable: category=VALUE, compu {phys=raw for raw 0..255}, range phys 0..255  # 记忆路线推荐提示
  application record data type ADT_SentryModeStatus: category=STRUCTURE  # 哨兵模式状态
    application record element DTE_sentryModeSt: category=VALUE, type=ADT_SentryModeSt  # 哨兵模式状态
    application record element DTE_sentryModeDuration: category=VALUE, type=ADT_SentryModeDuration  # 哨兵模式开启时长(min)
  app type ADT_ADAS_enum_TolU_turnsNum: category=VALUE, compu {phys=raw for raw 0..18446744073709551615; unit pcs}, range phys 0..18446744073709551615  # 掉头次数
  application record data type ADT_ICC_strt_CameraSpeed: category=STRUCTURE
    application record element DTE_SpeedLimitInfo: category=VALUE, type=ADT_ICC_int16_SpeedLimit  # 电子眼限速信息
    application record element DTE_CameraSpeedReserved: category=ARRAY, type=ADT_CameraSpeed_arr_Reserved  # 预留
  app type ADT_ADAS_enum_FSRACruiseSpdOffsetModFb: category=VALUE, compu {phys=raw for raw 0..255}, range phys 0..255
  application array data type ADT_LinePoint_arr_Reserved: category=ARRAY  # 预留
    element ADT_LinePoint_arr_Reserved: category=VALUE, type=ADT_Reserved_uint8_Type, array-size-semantics=FIXED-SIZE, max-number-of-elements=5
  app type ADT_ADAS_enum_ICASenarioReminder: category=VALUE, compu {phys=raw for raw 0..255}, range phys 0..255
  app type ADT_ADAS_ProfLong_PathIdx: category=VALUE, compu {phys=raw for raw 0..63}, range phys 0..63
  application record data type ADT_ICC_strt_FacilityInfo: category=STRUCTURE  # 道路设施信息
    4 x application record element:
      DTE_FacilityCoord: category=STRUCTURE, type=ADT_ICC_strt_Coord2DDouble  # 道路设施坐标
      DTE_FacilityType: category=VALUE, type=ADT_ICC_int32_FacilityType  # 道路设施类型
      DTE_FacilityDistance: category=VALUE, type=ADT_ICC_int32_Dist
      DTE_FacilityInfoReserved: category=ARRAY, type=ADT_FacilityInfo_arr_Reserved  # 预留
  app type ADT_ADAS_enum_SceneSts: category=VALUE, compu {phys=raw for raw 0..255}, range phys 0..255  # 行泊切换状态机
  application record data type ADT_ADAS_strt_VPASpot: category=STRUCTURE  # VPA用户特殊车位属性信息
    4 x application record element:
      DTE_VPASlotID: category=VALUE, type=ADT_ADAS_val_SlotID  # 车位ID
      DTE_VPASpotName: category=STRING, type=ADT_ADAS_string_VPASpotName  # 用户特殊车位名字
      DTE_VPASpotFloor: category=VALUE, type=ADT_ADAS_enum_VPAFloor  # 用户特殊车位的楼层
      DTE_VPASpotLabel: category=ARRAY, type=ADT_ADAS_arr_VPASpotLabel  # 用户特殊车位的标签信息
  6 x app type:
    ADT_TripUtcSecs: category=VALUE, compu {phys=raw for raw 0..4294967295}, range phys 0..4294967295  # 预约出行时间
    ADT_ADAS_enum_SglAutoMergeChangeLane: category=VALUE, compu {phys=raw for raw 0..65535; unit pcs}, range phys 0..65535  # 自动并道换道
    ADT_ADAS_enum_SafeStopReminder: category=VALUE, compu {phys=raw for raw 0..255}, range phys 0..255  # 领航辅助执行安全停车提示
    ADT_ADAS_string_PathName: category=STRING, sw-text-props={array-size-semantics=VARIABLE-SIZE, sw-max-text-size=20, base-type=UTF_8}
    ADT_ADAS_enum_TimeGapSet: category=VALUE, compu {phys=raw for raw 0..255}, range phys 0..255
    ADT_ICC_enum_SetOnwayLabelType: category=VALUE, compu {phys=raw for raw 0..255}, range phys 0..255
  application record data type ADT_ICC_strt_CrossNaviInfo: category=STRUCTURE
    14 x application record element:
      DTE_CrossNaviPathID: category=VALUE, type=ADT_Gen_int64_ID  # path唯一id
      DTE_CrossNaviSegIdx: category=VALUE, type=ADT_ICC_int32_Index  # 所在segment段，从0开始
      DTE_CrossNaviMainAction: category=VALUE, type=ADT_ICC_int32_MainAction  # 导航动作
      DTE_CrossNaviAssistAction: category=VALUE, type=ADT_ICC_int32_AssistAction  # 导航辅助动作
      DTE_CrossManeuverId: category=VALUE, type=ADT_Gen_int32_ManeuverID  # 路口转向ID
      DTE_CrossNaviDestDirection: category=VALUE, type=ADT_ICC_int32_DestDirection  # 途经点、充电站、目的地相对路径的位置关系
      DTE_CrossNaviTunnelFlag: category=VALUE, type=ADT_ICC_int32_TunnelFlag  # 是否为隧道内外分叉
      DTE_CrossNaviOutCnt: category=VALUE, type=ADT_Gen_val_int32  # 进入环岛时为环岛出口数；隧道内分叉为分叉个数
      DTE_CrossNaviManeuverID: category=VALUE, type=ADT_Gen_int32_ManeuverID  # 满足顺行展示距离时为顺行图标，否则见枚举值
      DTE_CrossNextRoadName: category=STRING, type=ADT_ICC_string_RoadName  # 下条道路名称，途经点为途经点或者目的地名称
      DTE_CrossCurToSegmentDist: category=VALUE, type=ADT_ICC_int32_Dist  # 当前车位所在导航段终点到segIdx终点的距离（单位米）
      DTE_CrossCurToSegmentTime: category=VALUE, type=ADT_ICC_int32_Time  # 当前车位所在导航段终点到segIdx终点的时间（单位秒）
      DTE_CrossViaNum: category=VALUE, type=ADT_Gen_val_int16  # 途经点、充电站编号
      DTE_CrossNaviReserved: category=ARRAY, type=ADT_CrossNavi_arr_Reserved  # 预留
  application record data type ADT_ADAS_strt_FusionMapPoint: category=STRUCTURE
    application record element DTE_Point: category=ARRAY, type=ADT_ADAS_arr_FusionMetaData  # 三角剖分顶点位置
    application record element DTE_Idx: category=ARRAY, type=ADT_ADAS_arr_FusionMetaData  # 三角剖分顶点数据
    application record element DTE_length: category=ARRAY, type=ADT_ADAS_arr_FusionMetaData  # 三角剖分长度信息
  app type ADT_ADAS_enum_NOPLaneChangeWarnType: category=VALUE, compu {phys=raw for raw 0..255}, range phys 0..255
  application record data type ADT_Strt_TollGateLaneInfo: category=STRUCTURE  # 收费站通道信息 Toll gate lane information
    application record element DTE_TollLaneType: category=VALUE, type=ADT_Enum_TollLaneType  # 收费站通道类型 Toll gate lane types
    application record element DTE_TollGateInfoReserved: category=ARRAY, type=ADT_Arr_TollGateInfoReserved  # 预留 Reserved
  app type ADT_Str_MemRoute: category=STRING, sw-text-props={array-size-semantics=VARIABLE-SIZE, sw-max-text-size=32, base-type=UTF_8}
  application array data type ADT_ICC_arr_TrafficLightCountdown: category=ARRAY, dynamic-array-size-profile=VSA_LINEAR
    element ADT_ICC_arr_TrafficLightCountdown: category=STRUCTURE, type=ADT_ICC_strt_TrafficLightCountdown, array-size-handling=ALL-INDICES-SAME-ARRAY-SIZE, array-size-semantics=VARIABLE-SIZE, max-number-of-elements=10
  app type ADT_OTAAPPTSecs: category=VALUE, compu {phys=raw for raw 0..4294967295}, range phys 0..4294967295  # 预约升级时间
  application array data type ADT_IHCInfo_arr_Reserved: category=ARRAY  # 预留
    element ADT_IHCInfo_arr_Reserved: category=VALUE, type=ADT_Reserved_uint8_Type, array-size-semantics=FIXED-SIZE, max-number-of-elements=50
  7 x app type:
    ADT_ADAS_enum_ICAQuitReason: category=VALUE, compu {phys=raw for raw 0..255}, range phys 0..255
    ADT_StrVar_EcuVerison: category=STRING, sw-text-props={array-size-semantics=VARIABLE-SIZE, sw-max-text-size=64, base-type=UTF_8}  # ECU版本号
    ADT_ADAS_enum_MNPStopMemRouteDrawing: category=VALUE, compu {phys=raw for raw 0..255}, range phys 0..255  # 通知导航停止记忆路线的描画
    ADT_ADAS_Seg_EffSpdLmtType: category=VALUE, compu {phys=raw for raw 0..7}, range phys 0..7
    ADT_ICC_int32_Dist: category=VALUE, compu {phys=raw for raw 0..2147483647; unit m}, range phys 0..2147483647
    ADT_ICC_enum_MNPAllRoutesInfoReq: category=VALUE, compu {phys=raw for raw 0..255}, range phys 0..255  # 请求获取全部记忆路线信息
    ADT_ADAS_enum_HPAPathType: category=VALUE, compu {phys=raw for raw 0..255}, range phys 0..255
  application record data type ADT_ADAS_strt_DrivingTrajectoryPoint: category=STRUCTURE  # 轨迹点位置
    application record element DTE_TrajectoryPointX: category=VALUE, type=ADT_Gen_val_Coordinate_X  # 轨迹形点X坐标
    application record element DTE_TrajectoryPointY: category=VALUE, type=ADT_Gen_val_Coordinate_Y  # 轨迹形点Y坐标
  5 x app type:
    ADT_vhrReportEnable: category=VALUE, compu {0=VHRREPORTENABLE_CLOSE, 1=VHRREPORTENABLE_OPEN}
    ADT_ICC_enum_ApaPocDirection: category=VALUE, compu {phys=raw for raw 0..255}, range phys 0..255
    ADT_ICC_int32_TmcInfoStatus: category=VALUE, compu {phys=raw for raw 0..2147483647}, range phys 0..2147483647
    ADT_StrVar_BleSlaverLeftMac: category=STRING, sw-text-props={array-size-semantics=VARIABLE-SIZE, sw-max-text-size=24, base-type=UTF_8}  # 蓝牙左从模块 MAC 地址
    ADT_Strength: category=VALUE, compu {0..5=INI_STRENGTH_0..INI_STRENGTH_5}
  application record data type ADT_ADAS_strt_ParkingGenaralInfo: category=STRUCTURE
    6 x application record element, all with category=VALUE:
      DTE_ParkingActiveSubFuncSt: type=ADT_ADAS_enum_ParkingActiveSubFuncSt  # 泊车子功能激活状态
      DTE_ParkingQuitInd: type=ADT_ADAS_enum_ParkingQuitInd  # 泊车退出提示
      DTE_ParkingDriOperateInd: type=ADT_ADAS_enum_ParkingDriOperateInd  # 驾驶员操作提示
      DTE_ParkingPauseInd: type=ADT_ADAS_enum_ParkingPauseInd  # 泊车暂停提示
      DTE_ParkingFailureReasonInd: type=ADT_ADAS_enum_ParkingFailureReasonInd  # 泊车故障原因
      DTE_ParkingVoiceRemind: type=ADT_ADAS_enum_ParkingVoiceRemind  # 泊车语音提示
  4 x app type, all with category=VALUE:
    ADT_ADAS_Stub_Update: compu {phys=raw for raw 0..1}, range phys 0..1
    ADT_CID: compu {phys=raw for raw 0..4294967295}, range phys 0..4294967295  # 基站编号0开始的整数
    ADT_ADAS_enum_MNPNewRouteBtnSt: compu {phys=raw for raw 0..255}, range phys 0..255  # 新建路线按钮高亮提示
    ADT_Progress: compu {phys=raw for raw 0..100; unit %}, range phys 0..100  # TBOX升级进度
  application array data type ADT_ADAS_arr_OCCInfoList: category=ARRAY, dynamic-array-size-profile=VSA_LINEAR  # freespace数组
    element ADT_ADAS_arr_OCCInfoList: category=STRUCTURE, type=ADT_ADAS_strt_OCCInfo, array-size-handling=ALL-INDICES-SAME-ARRAY-SIZE, array-size-semantics=VARIABLE-SIZE, max-number-of-elements=10000
  app type ADT_Str_ProductCode: category=STRING, sw-text-props={array-size-semantics=VARIABLE-SIZE, sw-max-text-size=40, base-type=UTF_8}  # ADAS供应商代码 ADAS supplier code
  application record data type ADT_ADAS_strt_DynamicObject: category=STRUCTURE
    11 x application record element, all with category=VALUE:
      DTE_objectId: type=ADT_Gen_val_ID  # 目标id
      DTE_objectType: type=ADT_ADAS_enum_DynamicObjectType  # 目标类型
      DTE_lightStatus: type=ADT_ADAS_enum_LightStatus  # 目标灯光状态
      DTE_objectPoseX: type=ADT_Gen_val_Coordinate_X  # 目标位置X坐标
      DTE_objectPoseY: type=ADT_Gen_val_Coordinate_Y  # 目标位置Y坐标
      DTE_objectYaw: type=ADT_Gen_val_Yaw  # 目标位姿
      DTE_objectColor: type=ADT_ADAS_enum_ObjectColor  # 高亮显示
      DTE_objectVelocityX: type=ADT_ADAS_val_vehicleSpd  # 目标X向速度
      DTE_objectVelocityY: type=ADT_ADAS_val_vehicleSpd  # 目标Y向速度
      DTE_timestampnSec: type=ADT_ADAS_val_timestampnSec  # 时间戳-纳秒
      DTE_laneID: type=ADT_ADAS_val_laneID  # 目标所属车道ID
  application array data type ADT_ADAS_arr_ScoreMap: category=ARRAY  # 网格置信度
    element ADT_ADAS_arr_ScoreMap: category=VALUE, type=ADT_ADAS_uint8_ScoreMap, array-size-semantics=FIXED-SIZE, max-number-of-elements=30720
  app type ADT_ResponseVhrRemoteCall: category=VALUE, compu {0=RESPONSEVHRREMOTECALL_SUCCESS, 1=RESPONSEVHRREMOTECALL_FAILED, 2=RESPONSEVHRREMOTECALL_LOGNOTEXIST, 3=RESPONSEVHRREMOTECALL_TASKISEXECUTING}  # VHR日志远程调取--响应
  app type ADT_ICC_int32_ShowType: category=VALUE, compu {phys=raw for raw 0..2147483647}, range phys 0..2147483647  # 显示形态标识
  app type ADT_LCM_IMU_gpsSow: category=VALUE, compu {phys=raw for raw 0..4294967295; unit ms}, range phys 0..4294967295
  application record data type ADT_ADAS_strt_TrajectoryPoint: category=STRUCTURE
    application record element DTE_Coordinate_X: category=VALUE, type=ADT_Gen_val_Coordinate_X  # X坐标
    application record element DTE_Coordinate_Y: category=VALUE, type=ADT_Gen_val_Coordinate_Y  # Y坐标
  app type ADT_ADAS_enum_NOARemainingMileageFromODD: category=VALUE, compu {phys=raw for raw 0..200; unit m}, range phys 0..200  # 距离前方ODD终点里程数
  app type ADT_HDOP: category=VALUE, compu {phys=raw for raw 0..10000}, range phys 0..10000
  application record data type ADT_ICC_Strt_ADASSettingInfo: category=STRUCTURE
    35 x application record element, all with category=VALUE:
      DTE_ICAEnableBtnSts: type=ADT_ICC_enum_ICAEnableBtnSts  # ICA功能使能开关
      DTE_FSRASpdSetMod: type=ADT_ICC_enum_FSRASpdSetMod  # 巡航速度调整方式设置（无开关）
      DTE_FSRACruiseSpdMod: type=ADT_ICC_enum_FSRACruiseSpdMod  # 设定巡航车速模式
      DTE_FSRACruiseSpdOffsetMod: type=ADT_ICC_enum_FSRACruiseSpdOffsetMod  # 设定偏移方式
      DTE_FSRACruiseSpdOffsetSpd: type=ADT_ICC_enum_FSRACruiseSpdOffsetSpd  # 固定偏移速度
      DTE_FSRACruiseSpdOffsetPercent: type=ADT_ICC_enum_FSRACruiseSpdOffsetPercent  # 百分比偏移速度
      DTE_ISLIWarnMod: type=ADT_ICC_enum_ISLIWarnMod  # 智能限速提醒方式
      DTE_ISLISpdOffsetMod: type=ADT_ICC_enum_ISLISpdOffsetMod  # 限速设置方式（预留）
      DTE_ISLICruiseSpdRelOffset: type=ADT_ICC_enum_ISLICruiseSpdRelOffset  # 相对限制值（预留）
      DTE_ISLICruiseSpdAbdOffset: type=ADT_ICC_enum_ISLICruiseSpdAbdOffset  # 绝对限制值（预留）
      DTE_FCWWarnDistance: type=ADT_ICC_enum_FCWWarnDistance  # FCW报警距离限制
      DTE_FCWSettingSt: type=ADT_ICC_enum_FCWSettingSt  # FCW功能设置状态
      DTE_AEBSettingSt: type=ADT_ICC_enum_AEBSettingSt  # AEB功能设置状态
      DTE_LKSSettingSt: type=ADT_ICC_enum_LKSSettingSt  # LDW/LDP功能设置状态
      DTE_LDWWarnType: type=ADT_ICC_enum_LDWWarnType  # LDW/LDP报警方式
      DTE_ELKSettingSt: type=ADT_ICC_enum_ELKSettingSt  # ELK功能设置状态
      DTE_BSDSettingSt: type=ADT_ICC_enum_BSDSettingSt  # BSD/LCW功能设置状态
      DTE_DOWSettingSt: type=ADT_ICC_enum_DOWSettingSt  # DOW功能设置状态
      DTE_HODWarnSettingSt: type=ADT_ICC_enum_HODWarnSettingSt  # HOD脱手模式状态
      DTE_FCTAWarnType: type=ADT_ICC_enum_FCTAWarnType  # FCTA报警方式
      DTE_RCTAWarnType: type=ADT_ICC_enum_RCTAWarnType  # RCTA报警方式
      DTE_ESASettingSt: type=ADT_ICC_enum_ESASettingSt  # ESA功能设置状态
      DTE_AMAPSettingSt: type=ADT_ICC_enum_AMAPSettingSt  # AMAP功能设置状态
      DTE_NOPEnableBtnSts: type=ADT_ICC_enum_NOPEnableBtnSts  # NOP功能使能开关
      DTE_VoiceRemindSettingMode: type=ADT_ICC_enum_VoiceRemindSettingMode  # 语音播报模式
      DTE_NOPLaneChangeStyle: type=ADT_ICC_enum_NOPLaneChangeStyle  # NOP超车变道风格
      DTE_NOPLaneChangeMod: type=ADT_ICC_enum_NOPLaneChangeMod  # NOP变道模式
      DTE_NOPLaneChangeWarnType: type=ADT_ICC_enum_NOPLaneChangeWarnType  # NOP变道提醒模式
      DTE_U_NOPEnableBtnSts: type=ADT_ICC_enum_U_NOPEnableBtnSts  # 城区NOP功能使能开关
      DTE_HPASettingSt: type=ADT_ICC_enum_HPASettingSt  # 记忆泊车功能使能开关
      DTE_VPASettingSt: type=ADT_ICC_enum_VPASettingSt  # 代客泊车功能使能开关
      DTE_APASettingSt: type=ADT_ICC_enum_APASettingSt  # 自动泊车功能使能开关
      DTE_VoiceRemindSettingSt: type=ADT_ICC_enum_VoiceRemindSettingSt  # 语音播报功能设置开关
      DTE_DrivingVoiceRemindSettingSt: type=ADT_ICC_enum_DrivingVoiceRemindSettingSt  # 行车语音播报功能设置开关
      DTE_NRASettingSt: type=ADT_ICC_enum_NRASettingSt  # 窄路辅助使能开关
  application array data type ADT_ADAS_arr_ParkingSlot: category=ARRAY, dynamic-array-size-profile=VSA_LINEAR
    element ADT_ADAS_arr_ParkingSlot: category=STRUCTURE, type=ADT_ADAS_strt_ParkingSlot, array-size-handling=ALL-INDICES-SAME-ARRAY-SIZE, array-size-semantics=VARIABLE-SIZE, max-number-of-elements=20
  application array data type ADT_CrossNavi_arr_Reserved: category=ARRAY
    element ADT_CrossNavi_arr_Reserved: category=VALUE, type=ADT_Reserved_int32_Type, array-size-semantics=FIXED-SIZE, max-number-of-elements=20
  4 x app type, all with category=VALUE:
    ADT_ADAS_enum_MNPNewRouteSaving: compu {phys=raw for raw 0..100; unit %}, range phys 0..100  # 记忆路线保存进度
    ADT_ICC_enum_AMAPSwtSet: compu {phys=raw for raw 0..255}, range phys 0..255  # 加速踏板防误踩设置项开关
    ADT_ICC_enum_RPASettingSt: compu {phys=raw for raw 0..255}, range phys 0..255  # 遥控泊车设置状态
    ADT_ICC_boolean_isSpecial: compu {phys=raw for raw 0..2147483647}, range phys 0..2147483647  # 城市特色电子眼标识
  application array data type ADT_FacilityInfo_arr_Reserved: category=ARRAY  # 预留
    element ADT_FacilityInfo_arr_Reserved: category=VALUE, type=ADT_Reserved_int32_Type, array-size-semantics=FIXED-SIZE, max-number-of-elements=100
  5 x app type, all with category=VALUE:
    ADT_ADAS_enum_VPASts: compu {phys=raw for raw 0..255}, range phys 0..255
    ADT_Enum_Data_ID: compu {phys=raw for raw 0..4294967295}, range phys 0..4294967295  # 数据闭环埋点ID Data closed-loop tracking ID
    ADT_ICC_enum_LKSWarnSensitivity: compu {phys=raw for raw 0..255}, range phys 0..255  # LKS预警灵敏度
    ADT_Enum_SimCardRegistraionStatus: compu {phys=raw for raw 0..1}, range phys 0..1  # Sim卡注册状态
    ADT_ADAS_enum_SlotType: compu {phys=raw for raw 0..255}, range phys 0..255
  application record data type ADT_Struct_HDMapInfo: category=STRUCTURE  # HD Map审图号等信息
    4 x application record element:
      DTE_ApprovalVersion: category=STRING, type=ADT_StrVar_HDMap  # 审图号信息
      DTE_Supplier: category=STRING, type=ADT_StrVar_HDMap  # 供应商信息
      DTE_DBVersion: category=STRING, type=ADT_StrVar_HDMap  # 地图数据版本号信息
      DTE_HDMapInfoReserved: category=ARRAY, type=ADT_HDMapInfo_arr_Reserved  # 预留
  app type ADT_ICC_int64_Speed: category=VALUE, compu {phys=raw for raw 0..9223372036854775807; unit km/h}, range phys 0..9223372036854775807
  app type ADT_ADAS_enum_ELKSts: category=VALUE, compu {phys=raw for raw 0..255}, range phys 0..255
  application array data type ADT_ADAS_arr_MNPMemRoutes: category=ARRAY, dynamic-array-size-profile=VSA_LINEAR  # 记忆路线信息数组
    element ADT_ADAS_arr_MNPMemRoutes: category=STRUCTURE, type=ADT_ADAS_strt_MNPMemRoute, array-size-handling=ALL-INDICES-SAME-ARRAY-SIZE, array-size-semantics=VARIABLE-SIZE, max-number-of-elements=64
  app type ADT_ADAS_enum_SglAutoRoadCrossingsNum: category=VALUE, compu {phys=raw for raw 0..65535; unit pcs}, range phys 0..65535  # 自动过路口数量
  app type ADT_ADAS_enum_DMSWarning: category=VALUE, compu {phys=raw for raw 0..255}, range phys 0..255  # 脱眼报警
  application record data type ADT_EphemerisDataSwitch: category=STRUCTURE  # 星历请求/停止命令
    application record element DTE_ephemerisDataSwitchCmd: category=VALUE, type=ADT_EphemerisDataSwitchCmd  # 星历数据开关指令
    application record element DTE_ephemerisDataType: category=VALUE, type=ADT_EphemerisDataType  # 星历数据类型
  application record data type ADT_Struct_TBOXOTAAPPTSet: category=STRUCTURE  # 设置预约升级时间
    application record element DTE_ScheduleID: category=STRING, type=ADT_StrVar_ScheduleID  # OTA的任务ID
    application record element DTE_OTAAPPTSecs: category=VALUE, type=ADT_OTAAPPTSecs  # 预约升级时间
  app type ADT_WiFiApName: category=STRING, sw-text-props={array-size-semantics=VARIABLE-SIZE, sw-max-text-size=64, base-type=UTF_8}  # WiFi热点名称
  application array data type ADT_RoadPointCellArray: category=ARRAY, dynamic-array-size-profile=VSA_LINEAR  # 代客泊车单点小区信息数组
    element ADT_RoadPointCellArray: category=STRUCTURE, type=ADT_RoadPointCellInfo, array-size-handling=ALL-INDICES-SAME-ARRAY-SIZE, array-size-semantics=VARIABLE-SIZE, max-number-of-elements=8
  app type ADT_ICC_int32_AssistAction: category=VALUE, compu {phys=raw for raw 0..2147483647}, range phys 0..2147483647
  application record data type ADT_Struct_TBOXOTAState: category=STRUCTURE  # 发送OTA状态给TBOX
    4 x application record element:
      DTE_usid: category=STRING, type=ADT_StrVar_usid  # 会话ID
      DTE_ScheduleID: category=STRING, type=ADT_StrVar_ScheduleID  # OTA的任务ID
      DTE_ScheduleTime: category=VALUE, type=ADT_ScheduleTime  # OTA的任务时间
      DTE_State: category=STRING, type=ADT_StrVar_State  # OTA状态
  application record data type ADT_Struct_NetworkStatus: category=STRUCTURE  # 移动网络状态信息
    7 x application record element:
      DTE_DataConnection: category=VALUE, type=ADT_Enum_DataConnection  # 数据连接是否有效
      DTE_SimCardRegistraionStatus: category=VALUE, type=ADT_Enum_SimCardRegistraionStatus  # Sim卡注册状态
      DTE_MobileNetworkType: category=VALUE, type=ADT_Enum_MobileNetworkType  # 移动网络类型
      DTE_Roaming: category=VALUE, type=ADT_Enum_Roaming  # 是否出于漫游中
      DTE_SignalStrength: category=VALUE, type=ADT_Integer_SignalStrength  # 信号强度
      DTE_RouterIPAddress: category=STRING, type=ADT_StrVar_RouterIPAddress  # 路由器IP
      DTE_VPNIPAddress: category=STRING, type=ADT_StrVar_VPNIPAddress  # VPN IP
  application record data type ADT_ADAS_strt_StaticObject: category=STRUCTURE
    9 x application record element, all with category=VALUE:
      DTE_objectId: type=ADT_Gen_val_ID  # 目标id
      DTE_objectType: type=ADT_ADAS_enum_StaticObjectType  # 目标类型
      DTE_objectPoseX: type=ADT_Gen_val_Coordinate_X  # 目标位置X坐标
      DTE_objectPoseY: type=ADT_Gen_val_Coordinate_Y  # 目标位置Y坐标
      DTE_objectYaw: type=ADT_Gen_val_Yaw  # 目标位姿
      DTE_objectLength: type=ADT_Gen_val_Length  # 目标长度
      DTE_objecWidth: type=ADT_Gen_val_Width  # 目标宽度
      DTE_timestampnSec: type=ADT_ADAS_val_timestampnSec  # 时间戳-纳秒
      DTE_laneID: type=ADT_ADAS_val_laneID  # 目标所属车道ID
  app type ADT_ICC_enum_NavRampInfo: category=VALUE, compu {phys=raw for raw 0..255}, range phys 0..255  # 前方路口匝道信息
  application record data type ADT_Struct_UploadBEICALLSts: category=STRUCTURE  # 上报紧急救援通话状态
    4 x application record element:
      DTE_CallType: category=VALUE, type=ADT_Enum_CallType  # 呼叫号码列表
      DTE_PhoneNumber: category=STRING, type=ADT_StrVar_PhoneNumber  # 电话号码
      DTE_State: category=VALUE, type=ADT_Enum_State  # 通话状态
      DTE_Millisecond: category=VALUE, type=ADT_Millisecond  # 通话时间
  app type ADT_ICC_enum_NOPLaneChangeWarnType: category=VALUE, compu {phys=raw for raw 0..255}, range phys 0..255  # NOP变道提醒模式
  application array data type ADT_HPAOnWayLabel_arr_Reserved: category=ARRAY  # 预留
    element ADT_HPAOnWayLabel_arr_Reserved: category=VALUE, type=ADT_Reserved_uint8_Type, array-size-semantics=FIXED-SIZE, max-number-of-elements=30
  application array data type ADT_CruiseInfo_arr_Reserved: category=ARRAY
    element ADT_CruiseInfo_arr_Reserved: category=VALUE, type=ADT_Reserved_int32_Type, array-size-semantics=FIXED-SIZE, max-number-of-elements=20
  app type ADT_ICC_Navi_Latitude: category=VALUE, compu {phys=raw-180 for raw -90.0081..89.9975; unit deg}, range phys -90.0081..89.9975
  application array data type ADT_ADAS_arr_VPASelfBuildMap: category=ARRAY, dynamic-array-size-profile=VSA_LINEAR
    element ADT_ADAS_arr_VPASelfBuildMap: category=STRUCTURE, type=ADT_ADAS_strt_VPASelfBuildMap, array-size-handling=ALL-INDICES-SAME-ARRAY-SIZE, array-size-semantics=VARIABLE-SIZE, max-number-of-elements=50
  application record data type ADT_ADAS_strt_SDmapInfo: category=STRUCTURE  # SDmap输出信息
    10 x application record element:
      DTE_NavigationSts: category=VALUE, type=ADT_ICC_enum_NavigationSts  # 导航状态
      DTE_NavigationCountryID: category=VALUE, type=ADT_ICC_enum_NaviCountryID  # 导航地区ID
      DTE_NavigationCurrenrtRoadType: category=VALUE, type=ADT_ICC_enum_NaviRoadType  # 导航道路等级
      DTE_NaviRampOutDistance: category=VALUE, type=ADT_ICC_val_Distance  # 自车距离下一出口距离
      DTE_NaviIntervalCameraInfo: category=ARRAY, type=ADT_ICC_arr_NaviIntervalCameraInfo  # 导航模式下区间测速信息
      DTE_NaviCameraRes: category=ARRAY, type=ADT_ICC_arr_NaviCameraRes  # 导航模式下电子眼信息
      DTE_NaviCruiseFacilityInfo: category=ARRAY, type=ADT_ICC_arr_NaviCruiseFacilityInfo  # 巡航模式下电子眼信息
      DTE_NaviRoadSpeed: category=VALUE, type=ADT_ICC_enum_SpeedLimitValue  # 路段限速
      DTE_WeatherInfo: category=ARRAY, type=ADT_ICC_arr_WeatherInfo  # 自车前方2km天气信息
      DTE_TrafficJamInfo: category=ARRAY, type=ADT_ICC_arr_TrafficJamInfo  # 自车前方2km交通拥堵信息
  application record data type ADT_Strt_VersInfo: category=STRUCTURE  # ADAS版本信息
    6 x application record element:
      DTE_ADCCSoftwareVers: category=STRING, type=ADT_Str_SoftwareVers  # ADCC软件版本号 ADCC software version number
      DTE_ADCCInterVers: category=STRING, type=ADT_Str_InterVers  # ADCC内部版本号 ADCC Internal version number
      DTE_ADCCProductID: category=STRING, type=ADT_Str_ProductID  # ADCC产品唯一ID（产品序列号/唯一码） ADCC Product Unique ID (Product Serial Number/Unique Code)
      DTE_ADCCHardwareVers: category=STRING, type=ADT_Str_HardwareVers  # ADCC硬件零件号 ADCC hardware part number
      DTE_ADCCProductCode: category=STRING, type=ADT_Str_ProductCode  # ADCC供应商代码 ADCC supplier code
      DTE_VersInfoReserved: category=ARRAY, type=ADT_Arr_VersInfoReserved  # 预留 Reserved
  application array data type ADT_PrkgSlot_arr_Reserved: category=ARRAY  # 预留
    element ADT_PrkgSlot_arr_Reserved: category=VALUE, type=ADT_Reserved_uint8_Type, array-size-semantics=FIXED-SIZE, max-number-of-elements=20
  application array data type ADT_HPARepaly_arr_Reserved: category=ARRAY  # 预留
    element ADT_HPARepaly_arr_Reserved: category=VALUE, type=ADT_Reserved_uint8_Type, array-size-semantics=FIXED-SIZE, max-number-of-elements=30
  app type ADT_Str_MemRouteInfo: category=STRING, sw-text-props={array-size-semantics=VARIABLE-SIZE, sw-max-text-size=100, base-type=UTF_8}
  app type ADT_Enum_TBOXOTARemoteAPPTCancel: category=VALUE, compu {0=OTARemoteAPPTCancelNoResp, 1=OTARemoteAPPTCancelResp}, range phys 0..255  # 远控取消OTA预约升级
  application record data type ADT_TimeZoneInfo: category=STRUCTURE  # 包含时区的小时和分钟信息
    4 x application record element, all with category=VALUE:
      DTE_timezoneValidFlag: type=ADT_TimeValidFlag  # 时区信息有效性
      DTE_timezoneUtcHour: type=ADT_TimezoneUtcHours  # 时区小时偏差信息
      DTE_timezoneUtcMinute: type=ADT_TimezoneUtcMinutes  # 时区分钟偏差信息
      DTE_dstFlag: type=ADT_DSTFlag  # 表示当前是否处于夏令时
  application record data type ADT_ADAS_strt_HPAOnWayLabel: category=STRUCTURE
    5 x application record element:
      DTE_HPAOnWayLabelID: category=VALUE, type=ADT_Gen_val_ID  # 记忆泊车路径标签ID
      DTE_HPAOnWayLabelType: category=VALUE, type=ADT_ADAS_enum_HPAPathLabeType  # 记忆泊车路径标签类型
      DTE_HPAOnWayLabelPoint: category=STRUCTURE, type=ADT_ADAS_strt_HPAVPAPathInfo  # 记忆泊车路径标签坐标
      DTE_HPAOnWayLabelPointNum: category=VALUE, type=ADT_Gen_val_unit8  # 记忆泊车路径标签数量
      DTE_HPAOnWayLabelReserved: category=ARRAY, type=ADT_HPAOnWayLabel_arr_Reserved  # 预留
  application array data type ADT_ADAS_arr_VPAFloor: category=ARRAY, dynamic-array-size-profile=VSA_LINEAR  # VPA楼层列表
    element ADT_ADAS_arr_VPAFloor: category=VALUE, type=ADT_ADAS_enum_VPAFloor, array-size-handling=ALL-INDICES-SAME-ARRAY-SIZE, array-size-semantics=VARIABLE-SIZE, max-number-of-elements=50
  app type ADT_ADAS_enum_SlotStatus: category=VALUE, compu {phys=raw for raw 0..255}, range phys 0..255
  app type ADT_ADAS_val_latitude: category=VALUE, compu {phys=raw for raw 0..90; unit degree}, range phys 0..90
  application record data type ADT_ADAS_strt_MNPMemRoute: category=STRUCTURE  # 记忆路线信息
    12 x application record element:
      DTE_MemRouteID: category=VALUE, type=ADT_Gen_val_ID  # 路线ID
      DTE_MemRouteName: category=STRING, type=ADT_Str_MemRoute  # 路线名称
      DTE_MemRouteStartName: category=STRING, type=ADT_Str_MemRoute  # 路线起点名称
      DTE_MemRouteEndName: category=STRING, type=ADT_Str_MemRoute  # 路线终点名称
      DTE_MemRouteEndPoint: category=STRUCTURE, type=ADT_ADAS_strt_MNPMemRoutePoint  # 路线终点坐标
      DTE_MemRouteMileage: category=VALUE, type=ADT_ADAS_enum_MNPRouteMileage  # 路线里程数
      DTE_MemRouteCreatTime: category=STRING, type=ADT_Str_MemRoute  # 路线创建时间
      DTE_MemRouteGrade: category=VALUE, type=ADT_ADAS_enum_MNPMemRouteGrade  # 路线评分
      DTE_MemRouteReady: category=VALUE, type=ADT_ADAS_enum_MNPMemRouteReadyFlag  # 路线是否可用
      DTE_MemRouteUseFlag: category=VALUE, type=ADT_ADAS_enum_MNPMemRouteUseFlag  # 路线是否正在使用中
      DTE_MemRouteUseFreq: category=VALUE, type=ADT_ADAS_enum_MNPMemRouteUseFreq  # 路线使用频率
      DTE_MNPMemRouteReserved: category=ARRAY, type=ADT_MNPMemRoute_arr_Reserved  # 预留
  app type ADT_StrVar_IMEIInfo: category=STRING, sw-text-props={array-size-semantics=VARIABLE-SIZE, sw-max-text-size=15, base-type=UTF_8}  # 国际移动台设备识别码信息
  app type ADT_SentryModePlanEndTime_minute: category=VALUE, compu {phys=raw for raw 0..59}, range phys 0..59  # 哨兵模式预约结束时间（分）
  application array data type ADT_ADAS_arr_MNPMemRoutePoints: category=ARRAY, dynamic-array-size-profile=VSA_LINEAR  # 需要在SD显示的路线轨迹点
    element ADT_ADAS_arr_MNPMemRoutePoints: category=STRUCTURE, type=ADT_ADAS_strt_MNPMemRoutePoint, array-size-handling=ALL-INDICES-SAME-ARRAY-SIZE, array-size-semantics=VARIABLE-SIZE, max-number-of-elements=150000
  application array data type ADT_ICC_arr_NaviCongestionDetailInfo: category=ARRAY, dynamic-array-size-profile=VSA_LINEAR
    element ADT_ICC_arr_NaviCongestionDetailInfo: category=STRUCTURE, type=ADT_ICC_strt_NaviCongestionDetailInfo, array-size-handling=ALL-INDICES-SAME-ARRAY-SIZE, array-size-semantics=VARIABLE-SIZE, max-number-of-elements=10
  application record data type ADT_Struct_NOA_SDMapLongInfo: category=STRUCTURE  # 标准地图信息_Long
    8 x application record element, all with category=VALUE:
      DTE_ProfLong_MsgType: type=ADT_ADAS_MsgType  # 标识该消息标识profile longmessage
      DTE_ProfLong_CycCnt: type=ADT_ADAS_ProfLong_CycCnt  # 这个messagetype和profile type的循环计数器:重构器可以用这个值来检测丢失的消息
      DTE_ProfLong_PathIdx: type=ADT_ADAS_ProfLong_PathIdx  # 这个profile所在path的索引值
      DTE_ProfLong_Offset: type=ADT_ADAS_ProfLong_Offset  # 起点位置到第一个profilespot的位移距离
      DTE_ProfLong_Update: type=ADT_ADAS_ProfLong_Update  # profile long 更新
      DTE_ProfLong_ProfType: type=ADT_ADAS_ProfLong_ProfType  # profile long类型
      DTE_ProfLong_CtrlPoint: type=ADT_ADAS_ProfLong_CtrlPoint  # 控制点
      DTE_ProfLong_Value: type=ADT_ADAS_ProfLong_Value  # profile long 值
  app type ADT_ICC_enum_SelectZoneType: category=VALUE, compu {phys=raw for raw 0..255}, range phys 0..255
  app type ADT_DSTFlag: category=VALUE, compu {0=DST_ACTIVE, 1=DST_INACTIVE, 2=DST_NOTSUPPORT}  # 表示当前是否处于夏令时
  application record data type ADT_Struct_CurrenMonthTalkTime: category=STRUCTURE  # TBOX的当月通话时长
    application record element DTE_TotalTalkTime: category=VALUE, type=ADT_TotalTalkTime  # 通话时长总计
    application record element DTE_OutgoingTotalTime: category=VALUE, type=ADT_OutgoingTotalTime  # 拨出电话时长总计
    application record element DTE_IncomingTotalTime: category=VALUE, type=ADT_IncomingTotalTime  # 拨入电话时长总计
  application array data type ADT_HDMapInfo_arr_Reserved: category=ARRAY
    element ADT_HDMapInfo_arr_Reserved: category=VALUE, type=ADT_Reserved_uint8_Type, array-size-semantics=FIXED-SIZE, max-number-of-elements=30
  application record data type ADT_ADAS_strt_HpaUseData: category=STRUCTURE
    5 x application record element, all with category=VALUE:
      DTE_HpaCruiseDist: type=ADT_ADAS_val_ParkingDist  # 本次泊车距离
      DTE_HpaCruiseTime: type=ADT_ADAS_val_ParkingProcessTakeTime  # 本次泊车时长
      DTE_HPAVPAGiveWayPedTimes: type=ADT_ADAS_val_HPAVPAGiveWayPedTimes  # 让路行人次数
      DTE_HPAVPAGiveWayVehTimes: type=ADT_ADAS_val_HPAVPAGiveWayVehTimes  # 让路车辆次数
      DTE_HPASpeedBumpNum: type=ADT_Gen_val_unit8  # 通过减速带数量
  app type ADT_ADAS_enum_SidePassSt: category=VALUE, compu {phys=raw for raw 0..255}, range phys 0..255
  application array data type ADT_NaviIntCameraDyn_arr_Reserved: category=ARRAY
    element ADT_NaviIntCameraDyn_arr_Reserved: category=VALUE, type=ADT_Reserved_int32_Type, array-size-semantics=FIXED-SIZE, max-number-of-elements=20
  app type ADT_ADAS_enum_ACCholdSts: category=VALUE, compu {phys=raw for raw 0..255}, range phys 0..255
  app type ADT_ResumeFactorySet: category=VALUE, compu {phys=raw for raw 0..1}, range phys 0..1  # 恢复出厂设置
  app type ADT_Enum_SetCallNumber: category=VALUE, compu {phys=raw for raw 0..2}, range phys 0..2
  application array data type ADT_TolNtfADDrivingCardinfo_arr_Reserved: category=ARRAY
    element ADT_TolNtfADDrivingCardinfo_arr_Reserved: category=VALUE, type=ADT_Reserved_uint8_Type, array-size-semantics=FIXED-SIZE, max-number-of-elements=100
  application record data type ADT_Struct_TBOXOTARemoteAPPTSet: category=STRUCTURE  # 远控OTA预约升级
    application record element DTE_ScheduleID: category=STRING, type=ADT_StrVar_ScheduleID  # OTA的任务ID
    application record element DTE_OTAAPPTSecs: category=VALUE, type=ADT_OTAAPPTSecs  # 预约升级时间
  app type ADT_Enum_FirstCertificationMark: category=VALUE, compu {phys=raw for raw 0..7}, range phys 0..7  # 首次认证标识
  application record data type ADT_ADAS_strt_VPASpeedBump: category=STRUCTURE  # VPA地图范围
    application record element DTE_VPASpeedBumpFloor: category=VALUE, type=ADT_ADAS_enum_VPAFloor  # 范围所属楼层
    application record element DTE_VPASpeedBumpStartPoint: category=STRUCTURE, type=ADT_ADAS_strt_VPAPointType  # 减速带起始点
    application record element DTE_VPASpeedBumpEndPoint: category=STRUCTURE, type=ADT_ADAS_strt_VPAPointType  # 监督带终点
  6 x app type, all with category=VALUE:
    ADT_ADAS_enum_RADSEnableBtnStFb: compu {phys=raw for raw 0..255}, range phys 0..255  # 循迹倒车设置反馈
    ADT_ICC_enum_ICAEnableBtnSts: compu {phys=raw for raw 0..255}, range phys 0..255  # ICA功能使能开关
    ADT_EcallModeFed: compu {phys=raw for raw 0..255}, range phys 0..255  # Ecall触发方式反馈
    ADT_ADAS_enum_HPAVPARepalyRemind: compu {phys=raw for raw 0..255}, range phys 0..255
    ADT_ICC_enum_MNPDelRouteIDBtnSt: compu {phys=raw for raw 0..20}, range phys 0..20  # 删除的记忆路线ID
    ADT_ADAS_enum_DAIReminder: compu {phys=raw for raw 0..255}, range phys 0..255
  application record data type ADT_ICC_strt_SDmapLaneInfo: category=STRUCTURE  # 车道信息
    4 x application record element:
      DTE_BackLane: category=ARRAY, type=ADT_ICC_arr_BackLane  # 背景车道
      DTE_FrontLane: category=ARRAY, type=ADT_ICC_arr_FrontLane  # 前景车道
      DTE_BackExtenLane: category=ARRAY, type=ADT_ICC_arr_BackExtenLane  # 背景拓展车道
      DTE_NaviToNextRoadDist: category=VALUE, type=ADT_ICC_val_Distance  # 自车距离下个路口距离
  6 x app type, all with category=VALUE:
    ADT_ICC_uint32_SelectZoneID: compu {phys=raw for raw 0..255}, range phys 0..255
    ADT_ADAS_ProfShort_Value1: compu {phys=raw for raw 0..1023}, range phys 0..1023
    ADT_ADAS_val_YboundMin: compu {phys=raw for raw -1000..1000}, range phys -1000..1000
    ADT_ADAS_enum_ACCTextMessage: compu {phys=raw for raw 0..255}, range phys 0..255
    ADT_ADAS_ProfShort_Value0: compu {phys=raw for raw 0..1023}, range phys 0..1023
    ADT_ICC_enum_FSRACruiseSpdOffsetSpd: compu {phys=raw for raw -10..10; unit kph}, range phys -10..10  # 固定偏移速度
  application record data type ADT_SingleSimDetailInfo: category=STRUCTURE  # 单sim卡详细信息
    4 x application record element:
      DTE_simOperator: category=VALUE, type=ADT_SimOperator  # sim卡运营商
      DTE_simRealNameInfo: category=VALUE, type=ADT_SimRealNameInfo  # 实名制信息
      DTE_isSimInPostion: category=VALUE, type=ADT_IsSimInPostion  # 卡是否在位
      DTE_reserved: category=ARRAY, type=ADT_SingleSimDetailInfoReserved  # 预留字段
  app type ADT_ICC_enum_HPASlotSearchOperationID: category=VALUE, compu {phys=raw for raw 0..255}, range phys 0..255
  app type ADT_ADAS_enum_SglAccessRemitramp: category=VALUE, compu {phys=raw for raw 0..65535; unit pcs}, range phys 0..65535  # 汇入汇出匝道
  app type ADT_CelluarEsimStatus: category=VALUE, compu {0=INI_INVALID_SIM, 1=INI_VALID_SIM, 2=INI_ONLY_CS_INVALID, 3=INI_ONLY_PS_INVALID, 4=INI_CS_PS_INVALID, 255=INI_SIM_NO_EXIST, 256=INI_OTHER}
  application record data type ADT_GetUUIDCodeResponse: category=STRUCTURE  # 获取车辆的用户唯一识别码
    application record element DTE_VehUUIDCode: category=STRING, type=ADT_UUIDCode  # 车辆用户唯一识别码
  app type ADT_ADAS_enum_LDWSts: category=VALUE, compu {phys=raw for raw 0..255}, range phys 0..255
  application array data type ADT_EphemerisDataByteArray: category=ARRAY  # 星历数据消息通道
    element ADT_EphemerisDataByteArray: category=VALUE, type=ADT_EphemerisDataByteElement, array-size-semantics=FIXED-SIZE, max-number-of-elements=1024
  5 x app type, all with category=VALUE:
    ADT_ADAS_enum_DynamicObjectType: compu {phys=raw for raw 0..255}, range phys 0..255  # 目标类型
    ADT_ICC_enum_Trend: compu {phys=raw for raw 0..255}, range phys 0..255  # 拥堵趋势
    ADT_ADAS_val_SpdLimitOffsetAbs: compu {phys=raw for raw -20..20; unit kph}, range phys -20..20  # 固定限速偏移量
    ADT_ICC_int32_LightType: compu {phys=raw for raw 0..2147483647}, range phys 0..2147483647  # 红绿灯状态类型
    ADT_ADAS_enum_IntersectionDriBehavior: compu {phys=raw for raw 0..255}, range phys 0..255
  application array data type ADT_LCM_Array_GNSSData: category=ARRAY, dynamic-array-size-profile=VSA_LINEAR  # Location Data from GNSS_RawData
    element ADT_LCM_Array_GNSSData: category=VALUE, type=ADT_LCM_RAWDATA, array-size-handling=ALL-INDICES-SAME-ARRAY-SIZE, array-size-semantics=VARIABLE-SIZE, max-number-of-elements=1024
  12 x app type, all with category=VALUE:
    ADT_ADAS_enum_MNPMemRouteReadyFlag: compu {phys=raw for raw 0..255}, range phys 0..255  # 路线是否可用
    ADT_ADAS_enum_TrafficSignType: compu {phys=raw for raw 0..255}, range phys 0..255
    ADT_Dbl_GndHeadInfo: compu {phys=raw for raw 0..360; unit deg}, range phys 0..360  # 地面航向信息 Ground course information
    ADT_Speed: compu {phys=raw for raw 0..10000}, range phys 0..10000
    ADT_ADAS_enum_LKS_WarnSensitivity: compu {phys=raw for raw 0..255}, range phys 0..255  # LKS预警灵敏度
    ADT_ADAS_enum_VPASpotLabel: compu {phys=raw for raw 0..255}, range phys 0..255  # 用户特殊车位的标签类型
    ADT_SimSwitchStatus: compu {phys=raw for raw 0..255}, range phys 0..255  # 切卡过程状态
    ADT_CellularPci: compu {phys=raw for raw 0..4294967295}, range phys 0..4294967295  # PCI
    ADT_ADAS_enum_ISLISpeedLimitSign: compu {phys=raw for raw 0..255}, range phys 0..255
    ADT_ICC_boolean_Unobstructed: compu {phys=raw for raw 0..2147483647}, range phys 0..2147483647  # 是否通畅
    ADT_Enum_TollStationPathStFb: compu {phys=raw for raw 0..255}, range phys 0..255  # 收费通道选择状态 Toll Station Path select status
    ADT_ICC_enum_RecordUploadBtn: compu {phys=raw for raw 0..255}, range phys 0..255  # 录音数据回传按钮
  application array data type ADT_ApaRpaFcn_arr_Reserved: category=ARRAY  # 预留
    element ADT_ApaRpaFcn_arr_Reserved: category=VALUE, type=ADT_Reserved_uint8_Type, array-size-semantics=FIXED-SIZE, max-number-of-elements=50
  app type ADT_StrVar_BleSlaverRightVer: category=STRING, sw-text-props={array-size-semantics=VARIABLE-SIZE, sw-max-text-size=24, base-type=UTF_8}  # 蓝牙右从模块软件版本
  application record data type ADT_ICC_Strt_ADASSettingInfo_3: category=STRUCTURE
    84 x application record element:
      DTE_ICAEnableBtnSts: category=VALUE, type=ADT_ICC_enum_ICAEnableBtnSts  # ICA功能使能开关
      DTE_FSRASpdSetMod: category=VALUE, type=ADT_ICC_enum_FSRASpdSetMod  # 巡航速度调整方式设置（无开关）
      DTE_FSRACruiseSpdMod: category=VALUE, type=ADT_ICC_enum_FSRACruiseSpdMod  # 设定巡航车速模式
      DTE_FSRACruiseSpdOffsetMod: category=VALUE, type=ADT_ICC_enum_FSRACruiseSpdOffsetMod  # 设定偏移方式
      DTE_FSRACruiseSpdOffsetSpd: category=VALUE, type=ADT_ICC_enum_FSRACruiseSpdOffsetSpd  # 固定偏移速度
      DTE_FSRACruiseSpdOffsetPercent: category=VALUE, type=ADT_ICC_enum_FSRACruiseSpdOffsetPercent  # 百分比偏移速度
      DTE_ISLIWarnMod: category=VALUE, type=ADT_ICC_enum_ISLIWarnMod  # 智能限速提醒方式
      DTE_ISLISpdOffsetMod: category=VALUE, type=ADT_ICC_enum_ISLISpdOffsetMod  # 限速设置方式（预留）
      DTE_ISLICruiseSpdRelOffset: category=VALUE, type=ADT_ICC_enum_ISLICruiseSpdRelOffset  # 相对限制值（预留）
      DTE_ISLICruiseSpdAbdOffset: category=VALUE, type=ADT_ICC_enum_ISLICruiseSpdAbdOffset  # 绝对限制值（预留）
      DTE_FCWWarnDistance: category=VALUE, type=ADT_ICC_enum_FCWWarnDistance  # FCW报警距离限制
      DTE_FCWSettingSt: category=VALUE, type=ADT_ICC_enum_FCWSettingSt  # FCW功能设置状态
      DTE_AEBSettingSt: category=VALUE, type=ADT_ICC_enum_AEBSettingSt  # AEB功能设置状态
      DTE_LKSSettingSt: category=VALUE, type=ADT_ICC_enum_LKSSettingSt  # LDW/LDP功能设置状态
      DTE_LDWWarnType: category=VALUE, type=ADT_ICC_enum_LDWWarnType  # LDW/LDP报警方式
      DTE_ELKSettingSt: category=VALUE, type=ADT_ICC_enum_ELKSettingSt  # ELK功能设置状态
      DTE_BSDSettingSt: category=VALUE, type=ADT_ICC_enum_BSDSettingSt  # BSD/LCW功能设置状态
      DTE_DOWSettingSt: category=VALUE, type=ADT_ICC_enum_DOWSettingSt  # DOW功能设置状态
      DTE_ICAplusSettingSt: category=VALUE, type=ADT_ICC_enum_ICAplussetting  # 直行红绿灯启停设置状态
      DTE_FCTAWarnType: category=VALUE, type=ADT_ICC_enum_FCTAWarnType  # FCTA报警方式
      DTE_RCTAWarnType: category=VALUE, type=ADT_ICC_enum_RCTAWarnType  # RCTA报警方式
      DTE_ESASettingSt: category=VALUE, type=ADT_ICC_enum_ESASettingSt  # ESA功能设置状态
      DTE_AMAPSettingSt: category=VALUE, type=ADT_ICC_enum_AMAPSettingSt  # AMAP功能设置状态
      DTE_NOPEnableBtnSts: category=VALUE, type=ADT_ICC_enum_NOPEnableBtnSts  # NOP功能使能开关
      DTE_VoiceRemindSettingMode: category=VALUE, type=ADT_ICC_enum_VoiceRemindSettingMode  # 语音播报模式
      DTE_NOPLaneChangeStyle: category=VALUE, type=ADT_ICC_enum_NOPLaneChangeStyle  # NOP超车变道风格
      DTE_NOPLaneChangeMod: category=VALUE, type=ADT_ICC_enum_NOPLaneChangeMod  # NOP变道模式
      DTE_NOPLaneChangeWarnType: category=VALUE, type=ADT_ICC_enum_NOPLaneChangeWarnType  # NOP变道提醒模式
      DTE_U_NOPEnableBtnSts: category=VALUE, type=ADT_ICC_enum_U_NOPEnableBtnSts  # 城区NOP功能使能开关
      DTE_HPASettingSt: category=VALUE, type=ADT_ICC_enum_HPASettingSt  # 记忆泊车功能使能开关
      DTE_VPASettingSt: category=VALUE, type=ADT_ICC_enum_VPASettingSt  # 代客泊车功能使能开关
      DTE_APASettingSt: category=VALUE, type=ADT_ICC_enum_APASettingSt  # 自动泊车功能使能开关
      DTE_VoiceRemindSettingSt: category=VALUE, type=ADT_ICC_enum_VoiceRemindSettingSt  # 语音播报功能设置开关
      DTE_DrivingVoiceRemindSettingSt: category=VALUE, type=ADT_ICC_enum_DrivingVoiceRemindSettingSt  # 行车语音播报功能设置开关
      DTE_NRASettingSt: category=VALUE, type=ADT_ICC_enum_NRASettingSt  # 窄路辅助使能开关
      DTE_RPASetSettingSt: category=VALUE, type=ADT_ICC_enum_RPASettingSt  # 遥控泊车设置项开关
      DTE_ParkingSpeedSettingSt: category=VALUE, type=ADT_ICC_enum_ParkingSpeedSet  # 泊车速度设置开关
      DTE_HPACrusingSpeedSettingSt: category=VALUE, type=ADT_ICC_enum_ParkingSpeedSet  # 泊车巡航车速设置项开关
      DTE_MEBSwtSet: category=VALUE, type=ADT_ICC_enum_MEBSwtSet  # MEB设置项开关
      DTE_AMAPSwtSet: category=VALUE, type=ADT_ICC_enum_AMAPSwtSet  # 加速踏板防误踩设置项开关
      DTE_MNPEnableBtnSt: category=VALUE, type=ADT_ICC_enum_MNPEnableBtnSt  # 记忆领航功能使能开关
      DTE_LccPlusEnableBtnSt: category=VALUE, type=ADT_ICC_enum_LccPlusEnableBtnSt  # 巡航增强功能使能开关
      DTE_LKSWarnSensitivity: category=VALUE, type=ADT_ICC_enum_LKSWarnSensitivity  # LKS预警灵敏度
      DTE_DAIEnableBtnSt: category=VALUE, type=ADT_ICC_enum_DAIEnableBtnSt  # DAI功能使能开关
      DTE_IHCEnableBtnSt: category=VALUE, type=ADT_ICC_enum_IHCEnableBtnSt  # IHC功能使能开关
      DTE_ISLICruiseSpdOffsetAbd: category=VALUE, type=ADT_ICC_enum_ISLICruiseSpdOffsetAbd  # 固定限速偏移量
      DTE_MNPNewBtnSt: category=VALUE, type=ADT_ICC_enum_MNPNewBtnSt  # 新建路线按钮
      DTE_MNPMemRouteQuitBtnSt: category=VALUE, type=ADT_ICC_enum_MNPMemRouteQuitBtnSt  # 退出路线学习按钮
      DTE_MNPUseRouteQuitBtnSt: category=VALUE, type=ADT_ICC_enum_MNPUseRouteQuitBtnSt  # 退出路线使用按钮
      DTE_MNPMemRouteCompleteBtnSt: category=VALUE, type=ADT_ICC_enum_MNPMemRouteCompleteBtnSt  # 路线记忆结束按钮
      DTE_MNPMemRouteNewName: category=STRING, type=ADT_Str_MemRoute  # 修改后的记忆路线名称
      DTE_MNPDelRouteIDBtnSt: category=VALUE, type=ADT_ICC_enum_MNPDelRouteIDBtnSt  # 删除的记忆路线ID
      DTE_MNPUseRouteIDBtnSt: category=VALUE, type=ADT_ICC_enum_MNPUseRouteIDBtnSt  # 选中使用的记忆路线ID
      DTE_MNPRouteNewName: category=STRING, type=ADT_Str_MemRouteInfo  # 修改后的记忆路线名称
      DTE_MNPDelRouteID: category=STRING, type=ADT_Str_MemRouteInfo  # 删除的记忆路线ID
      DTE_MNPUseRouteID: category=STRING, type=ADT_Str_MemRouteInfo  # 选中使用的记忆路线ID
      DTE_MNPRenameRouteID: category=STRING, type=ADT_Str_MemRouteInfo  # 修改名称的记忆路线ID
      DTE_NewMemRouteStartName: category=STRING, type=ADT_Str_MemRouteInfo  # 当前记忆中的路线起点名称
      DTE_NewMemRouteEndName: category=STRING, type=ADT_Str_MemRouteInfo  # 当前记忆中的路线终点名称
      DTE_MNPAllRoutesInfoReq: category=VALUE, type=ADT_ICC_enum_MNPAllRoutesInfoReq  # 请求获取全部记忆路线信息
      DTE_MNPRouteInfoReq: category=STRING, type=ADT_ICC_enum_MNPRouteInfoReq  # 请求当前记忆路线信息
      DTE_HNOACruiseSpdOffsetMod: category=VALUE, type=ADT_ICC_enum_HNOACruiseSpdOffsetMod  # 设定车速偏移方式
      DTE_HNOACruiseSpdOffsetSpd: category=VALUE, type=ADT_ICC_enum_HNOACruiseSpdOffsetSpd  # 固定偏移速度
      DTE_TSREnableBtnSt: category=VALUE, type=ADT_ICC_enum_TSREnableBtnSt  # TSR功能使能开关
      DTE_TLREnableBtnSt: category=VALUE, type=ADT_ICC_enum_TLREnableBtnSt  # TLR功能使能开关
      DTE_TLAEnableBtnSt: category=VALUE, type=ADT_ICC_enum_TLAEnableBtnSt  # TLA功能使能开关
      DTE_HandsOffWarningStyle: category=VALUE, type=ADT_ICC_enum_HandsOffWarningStyle  # 脱手报警风格
      DTE_VoiceControlLaneChange: category=VALUE, type=ADT_ICC_enum_VoiceControlLaneChange  # 语音变道指令
      DTE_VoiceControlCruiseSpeedAdjust: category=VALUE, type=ADT_ICC_enum_VoiceControlCruiseSpeedAdjust  # 语音巡航速度调节指令
      DTE_VoiceControlCruiseSpeed: category=VALUE, type=ADT_ICC_val_VoiceControlCruiseSpeed  # 语音巡航调节速度值
      DTE_VoiceControlCruiseDistanceAdjust: category=VALUE, type=ADT_ICC_enum_VoiceControlCruiseDistanceAdjust  # 语音巡航距离调节指令
      DTE_NOALCCSwitchBtnSts: category=VALUE, type=ADT_ICC_enum_NOALCCSwitchBtnSts  # NOA与LCC切换指令
      DTE_DetourAroundObstacleBtnSt: category=VALUE, type=ADT_ICC_enum_DetourAroundObstacleBtnSt  # 借道绕行障碍物软开关
      DTE_EfficientPassageBtnSt: category=VALUE, type=ADT_ICC_enum_EfficientPassageBtnSt  # 高效通行软开关
      DTE_IntelligentEvasionBtnSt: category=VALUE, type=ADT_ICC_enum_IntelligentEvasionBtnSt  # 智慧躲闪软开关
      DTE_RADSEnableBtnSt: category=VALUE, type=ADT_ICC_enum_RADSEnableBtnSt  # 循迹倒车软开关
      DTE_OutsideParkingBtnSt: category=VALUE, type=ADT_ICC_enum_OutsideParkingBtnSt  # 离车泊入软开关
      DTE_RGearDefaultFunctionBtnSt: category=VALUE, type=ADT_ICC_enum_RGearDefaultFunctionBtnSt  # R挡默认打开项设置
      DTE_RecordUploadBtn: category=VALUE, type=ADT_ICC_enum_RecordUploadBtn  # 录音数据回传按钮
      DTE_DatauploadBtn: category=VALUE, type=ADT_ICC_enum_DatauploadBtn  # 一键数据回传使能
      DTE_TollStationPathSet: category=VALUE, type=ADT_Enum_TollStationPathSet  # 收费站通道设置 Toll gate lane setting
      DTE_ADSRestartBtnSt: category=VALUE, type=ADT_Enum_ADSRestartBtnSt  # 域控制器一键重启按键 One-click restart button for the domain controller
      DTE_FreeparkMagModeBtnSt: category=VALUE, type=ADT_Enum_FreeparkMagModeBtnSt  # 一键贴边按钮 One-click edge pressing button
      DTE_ADASSettingInfoReserved: category=ARRAY, type=ADT_ADASSettingInfo_arr_Reserved2  # 预留
  application array data type ADT_Arr_KPI_DataInLoop: category=ARRAY  # KPI数据埋点 KPI data tracking
    element ADT_Arr_KPI_DataInLoop: category=VALUE, type=ADT_Enum_KPI_DataInLoopUnit, array-size-semantics=FIXED-SIZE, max-number-of-elements=1200
  app type ADT_Count: category=VALUE, compu {phys=raw for raw 0..255}, range phys 0..255  # 基站信息个数
  application record data type ADT_ICC_Strt_ADASSettingInfo_2: category=STRUCTURE
    54 x application record element:
      DTE_ICAEnableBtnSts: category=VALUE, type=ADT_ICC_enum_ICAEnableBtnSts  # ICA功能使能开关
      DTE_FSRASpdSetMod: category=VALUE, type=ADT_ICC_enum_FSRASpdSetMod  # 巡航速度调整方式设置（无开关）
      DTE_FSRACruiseSpdMod: category=VALUE, type=ADT_ICC_enum_FSRACruiseSpdMod  # 设定巡航车速模式
      DTE_FSRACruiseSpdOffsetMod: category=VALUE, type=ADT_ICC_enum_FSRACruiseSpdOffsetMod  # 设定偏移方式
      DTE_FSRACruiseSpdOffsetSpd: category=VALUE, type=ADT_ICC_enum_FSRACruiseSpdOffsetSpd  # 固定偏移速度
      DTE_FSRACruiseSpdOffsetPercent: category=VALUE, type=ADT_ICC_enum_FSRACruiseSpdOffsetPercent  # 百分比偏移速度
      DTE_ISLIWarnMod: category=VALUE, type=ADT_ICC_enum_ISLIWarnMod  # 智能限速提醒方式
      DTE_ISLISpdOffsetMod: category=VALUE, type=ADT_ICC_enum_ISLISpdOffsetMod  # 限速设置方式（预留）
      DTE_ISLICruiseSpdRelOffset: category=VALUE, type=ADT_ICC_enum_ISLICruiseSpdRelOffset  # 相对限制值（预留）
      DTE_ISLICruiseSpdAbdOffset: category=VALUE, type=ADT_ICC_enum_ISLICruiseSpdAbdOffset  # 绝对限制值（预留）
      DTE_FCWWarnDistance: category=VALUE, type=ADT_ICC_enum_FCWWarnDistance  # FCW报警距离限制
      DTE_FCWSettingSt: category=VALUE, type=ADT_ICC_enum_FCWSettingSt  # FCW功能设置状态
      DTE_AEBSettingSt: category=VALUE, type=ADT_ICC_enum_AEBSettingSt  # AEB功能设置状态
      DTE_LKSSettingSt: category=VALUE, type=ADT_ICC_enum_LKSSettingSt  # LDW/LDP功能设置状态
      DTE_LDWWarnType: category=VALUE, type=ADT_ICC_enum_LDWWarnType  # LDW/LDP报警方式
      DTE_ELKSettingSt: category=VALUE, type=ADT_ICC_enum_ELKSettingSt  # ELK功能设置状态
      DTE_BSDSettingSt: category=VALUE, type=ADT_ICC_enum_BSDSettingSt  # BSD/LCW功能设置状态
      DTE_DOWSettingSt: category=VALUE, type=ADT_ICC_enum_DOWSettingSt  # DOW功能设置状态
      DTE_ICAplusSettingSt: category=VALUE, type=ADT_ICC_enum_ICAplussetting  # 直行红绿灯启停设置状态
      DTE_FCTAWarnType: category=VALUE, type=ADT_ICC_enum_FCTAWarnType  # FCTA报警方式
      DTE_RCTAWarnType: category=VALUE, type=ADT_ICC_enum_RCTAWarnType  # RCTA报警方式
      DTE_ESASettingSt: category=VALUE, type=ADT_ICC_enum_ESASettingSt  # ESA功能设置状态
      DTE_AMAPSettingSt: category=VALUE, type=ADT_ICC_enum_AMAPSettingSt  # AMAP功能设置状态
      DTE_NOPEnableBtnSts: category=VALUE, type=ADT_ICC_enum_NOPEnableBtnSts  # NOP功能使能开关
      DTE_VoiceRemindSettingMode: category=VALUE, type=ADT_ICC_enum_VoiceRemindSettingMode  # 语音播报模式
      DTE_NOPLaneChangeStyle: category=VALUE, type=ADT_ICC_enum_NOPLaneChangeStyle  # NOP超车变道风格
      DTE_NOPLaneChangeMod: category=VALUE, type=ADT_ICC_enum_NOPLaneChangeMod  # NOP变道模式
      DTE_NOPLaneChangeWarnType: category=VALUE, type=ADT_ICC_enum_NOPLaneChangeWarnType  # NOP变道提醒模式
      DTE_U_NOPEnableBtnSts: category=VALUE, type=ADT_ICC_enum_U_NOPEnableBtnSts  # 城区NOP功能使能开关
      DTE_HPASettingSt: category=VALUE, type=ADT_ICC_enum_HPASettingSt  # 记忆泊车功能使能开关
      DTE_VPASettingSt: category=VALUE, type=ADT_ICC_enum_VPASettingSt  # 代客泊车功能使能开关
      DTE_APASettingSt: category=VALUE, type=ADT_ICC_enum_APASettingSt  # 自动泊车功能使能开关
      DTE_VoiceRemindSettingSt: category=VALUE, type=ADT_ICC_enum_VoiceRemindSettingSt  # 语音播报功能设置开关
      DTE_DrivingVoiceRemindSettingSt: category=VALUE, type=ADT_ICC_enum_DrivingVoiceRemindSettingSt  # 行车语音播报功能设置开关
      DTE_NRASettingSt: category=VALUE, type=ADT_ICC_enum_NRASettingSt  # 窄路辅助使能开关
      DTE_RPASetSettingSt: category=VALUE, type=ADT_ICC_enum_RPASettingSt  # 遥控泊车设置项开关
      DTE_ParkingSpeedSettingSt: category=VALUE, type=ADT_ICC_enum_ParkingSpeedSet  # 泊车速度设置开关
      DTE_HPACrusingSpeedSettingSt: category=VALUE, type=ADT_ICC_enum_ParkingSpeedSet  # 泊车巡航车速设置项开关
      DTE_MEBSwtSet: category=VALUE, type=ADT_ICC_enum_MEBSwtSet  # MEB设置项开关
      DTE_AMAPSwtSet: category=VALUE, type=ADT_ICC_enum_AMAPSwtSet  # 加速踏板防误踩设置项开关
      DTE_MNPEnableBtnSt: category=VALUE, type=ADT_ICC_enum_MNPEnableBtnSt  # 记忆领航功能使能开关
      DTE_LccPlusEnableBtnSt: category=VALUE, type=ADT_ICC_enum_LccPlusEnableBtnSt  # 巡航增强功能使能开关
      DTE_LKSWarnSensitivity: category=VALUE, type=ADT_ICC_enum_LKSWarnSensitivity  # LKS预警灵敏度
      DTE_DAIEnableBtnSt: category=VALUE, type=ADT_ICC_enum_DAIEnableBtnSt  # DAI功能使能开关
      DTE_IHCEnableBtnSt: category=VALUE, type=ADT_ICC_enum_IHCEnableBtnSt  # IHC功能使能开关
      DTE_ISLICruiseSpdOffsetAbd: category=VALUE, type=ADT_ICC_enum_ISLICruiseSpdOffsetAbd  # 固定限速偏移量
      DTE_MNPNewBtnSt: category=VALUE, type=ADT_ICC_enum_MNPNewBtnSt  # 新建路线按钮
      DTE_MNPMemRouteQuitBtnSt: category=VALUE, type=ADT_ICC_enum_MNPMemRouteQuitBtnSt  # 退出路线学习按钮
      DTE_MNPUseRouteQuitBtnSt: category=VALUE, type=ADT_ICC_enum_MNPUseRouteQuitBtnSt  # 退出路线使用按钮
      DTE_MNPMemRouteCompleteBtnSt: category=VALUE, type=ADT_ICC_enum_MNPMemRouteCompleteBtnSt  # 路线记忆结束按钮
      DTE_MNPMemRouteNewName: category=STRING, type=ADT_Str_MemRoute  # 修改后的记忆路线名称
      DTE_MNPDelRouteIDBtnSt: category=VALUE, type=ADT_ICC_enum_MNPDelRouteIDBtnSt  # 删除的记忆路线ID
      DTE_MNPUseRouteIDBtnSt: category=VALUE, type=ADT_ICC_enum_MNPUseRouteIDBtnSt  # 选中使用的记忆路线ID
      DTE_ADASSettingInfoReserved: category=ARRAY, type=ADT_ADASSettingInfo_arr_Reserved  # 预留
  7 x app type:
    ADT_ICC_string_LightDesc: category=STRING, sw-text-props={array-size-semantics=VARIABLE-SIZE, sw-max-text-size=1000, base-type=UTF_8}  # 灯态列表
    ADT_SimNum: category=VALUE, compu {phys=raw for raw 0..255}, range phys 0..255  # 支持的sim数量，表示车辆支持的运营商数量（包括eSIM支持的运营商）
    ADT_Enum_ElevnInfo: category=VALUE, compu {phys=raw for raw -90..90; unit deg}, range phys -90..90  # 仰角信息 Elevation information
    ADT_Enum_DiagnosisState: category=VALUE, compu {phys=raw for raw 0..5}, range phys 0..5  # 诊断状态
    ADT_ADAS_enum_MNPBuildMapSts: category=VALUE, compu {phys=raw for raw 0..255}, range phys 0..255  # MNP建图工作状态
    ADT_Enum_CamStreamSwt: category=VALUE, compu {phys=raw for raw 0..255}, range phys 0..255  # 相机视频流开关请求 Camera Video Stream Switch Request
    ADT_ADAS_Seg_Offset: category=VALUE, compu {phys=raw for raw 0..8191; unit m}, range phys 0..8191
  application array data type ADT_HPAStaticObject_arr_Reserved: category=ARRAY  # 预留
    element ADT_HPAStaticObject_arr_Reserved: category=VALUE, type=ADT_Reserved_uint8_Type, array-size-semantics=FIXED-SIZE, max-number-of-elements=30
  application array data type ADT_Arr_CamStreamStRespResd: category=ARRAY  # 预留 Reserved
    element ADT_Arr_CamStreamStRespResd: category=VALUE, type=ADT_Reserved_uint8_Type, array-size-semantics=FIXED-SIZE, max-number-of-elements=20
  app type ADT_Enum_TollLaneType: category=VALUE, compu {phys=raw for raw -2147483648..2147483647}, range phys -2147483648..2147483647  # 收费站通道类型 Toll gate lane types
  app type ADT_StrVar_TBoxVersion: category=STRING, sw-text-props={array-size-semantics=VARIABLE-SIZE, sw-max-text-size=32, base-type=UTF_8}  # TBOX版本号
  application record data type ADT_ADAS_strt_APARPAInfo_2: category=STRUCTURE
    28 x application record element:
      DTE_ApaOperationResp: category=VALUE, type=ADT_ADAS_enum_ParkingOperationResp  # APARPA按键状态反馈
      DTE_ApaRpaSts: category=VALUE, type=ADT_ADAS_enum_ApaRpaSts  # APARPA状态机信息
      DTE_ParkingTypeSelectFb: category=VALUE, type=ADT_ADAS_enum_PicPocType  # 泊入泊出方式选择反馈
      DTE_ParkinDirectionSts: category=VALUE, type=ADT_ADAS_enum_ParkinDirectionSts  # 泊入方向状态反馈
      DTE_FreeParkSlotAvaSts: category=VALUE, type=ADT_Gen_enum_AvailableSts  # 自由泊入车位可用性状态
      DTE_ParkOutDirectionSt: category=VALUE, type=ADT_ADAS_enum_ParkOutDirectionSt  # 泊出方向状态
      DTE_POCFLParallelSts: category=VALUE, type=ADT_Gen_enum_ValidityStatus  # 左前平行泊出位置可用性
      DTE_POCFLCorssSts: category=VALUE, type=ADT_Gen_enum_ValidityStatus  # 左前垂直泊出位置可用性
      DTE_POCFRParallelSts: category=VALUE, type=ADT_Gen_enum_ValidityStatus  # 右前平行泊出位置可用性
      DTE_POCFRCrossSts: category=VALUE, type=ADT_Gen_enum_ValidityStatus  # 右前垂直泊出位置可用性
      DTE_POCFrontCrossSts: category=VALUE, type=ADT_Gen_enum_ValidityStatus  # 前方垂直泊出位置可用性
      DTE_POCRearCrossSts: category=VALUE, type=ADT_Gen_enum_ValidityStatus  # 后方垂直泊出位置可用性
      DTE_POCRLCrossSts: category=VALUE, type=ADT_Gen_enum_ValidityStatus  # 左后方垂直泊出位置可用性
      DTE_POCRRCrossSts: category=VALUE, type=ADT_Gen_enum_ValidityStatus  # 右后方垂直泊出位置可用性
      DTE_APAActiveFuncInd: category=VALUE, type=ADT_ADAS_enum_APAActiveFuncInd  # 自动泊车激活功能
      DTE_ApaSelectIDInd: category=VALUE, type=ADT_ADAS_val_SlotID  # 泊车选择的车位ID
      DTE_ParkingStopDist: category=VALUE, type=ADT_ADAS_val_ParkingDist  # 泊车剩余距离
      DTE_APARPATrajectory: category=ARRAY, type=ADT_ADAS_arr_TrajectoryPoint  # 泊车规划引导线
      DTE_RpaAvaliableStatus: category=VALUE, type=ADT_Gen_enum_AvailableSts  # Rpa可用状态
      DTE_ApaEgoVehPos: category=STRUCTURE, type=ADT_ADAS_strt_EgoPose  # 泊车位姿信息
      DTE_ApaTargetSlotInfo: category=STRUCTURE, type=ADT_ADAS_strt_ApaTargetSlotInfo  # 泊入目标车位信息
      DTE_APAStartButtonSts: category=VALUE, type=ADT_ADAS_enum_ParkingButtonSts  # 开始泊车按钮
      DTE_APARPAButtonSts: category=VALUE, type=ADT_ADAS_enum_ParkingButtonSts  # 自动泊车切换RPA按钮
      DTE_BAFASts: category=VALUE, type=ADT_ADAS_enum_BAFASts  # 遥控直入直出状态机信息
      DTE_ParkInDirectionAvaType: category=VALUE, type=ADT_ADAS_enum_ParkInDirectionAvaType  # 泊入车位的可泊方向类型
      DTE_APAResumeButtonSts: category=VALUE, type=ADT_ADAS_enum_ParkingButtonSts  # 恢复泊车按钮可用状态
      DTE_APAPopup: category=VALUE, type=ADT_ADAS_enum_APAPopup  # APA弹窗
      DTE_APARPAInfoReserved: category=ARRAY, type=ADT_APARPAInfo_arr_Reserved  # 预留
  8 x app type:
    ADT_ADAS_Seg_PartOfCalcRoute: category=VALUE, compu {phys=raw for raw 0..3}, range phys 0..3
    ADT_ADAS_enum_SglAutoAvoidObstacle: category=VALUE, compu {phys=raw for raw 0..65535; unit pcs}, range phys 0..65535  # 自动避障（避障变道和避障bypass）
    ADT_ICC_string_LevelName: category=STRING, sw-text-props={array-size-semantics=VARIABLE-SIZE, sw-max-text-size=200, base-type=UTF_8}  # 预警名称
    ADT_ICC_int64_Time: category=VALUE, compu {phys=raw for raw 0..9223372036854775807; unit s}, range phys 0..9223372036854775807
    ADT_AppSrv_ReturnCode: category=VALUE, compu {0=SUCCESS, 1=FAILED}  # 操作返回值
    ADT_ADAS_val_FSRACruiseSpdOffsetPercentFb: category=VALUE, compu {phys=raw for raw -20..20; unit %}, range phys -20..20
    ADT_ICC_int32_CruiseFacilitType: category=VALUE, compu {phys=raw for raw 0..2147483647}, range phys 0..2147483647
    ADT_SwtSts: category=VALUE, compu {phys=raw for raw 0..2}, range phys 0..2  # 开关状态
  application record data type ADT_ICC_strt_HPAPathOperation_2: category=STRUCTURE
    6 x application record element:
      DTE_PathOperationId: category=VALUE, type=ADT_ICC_enum_PathOperationId  # 路线操作指令
      DTE_PathId: category=VALUE, type=ADT_ICC_uint8_PathId  # 路线ID
      DTE_SetPathName: category=STRING, type=ADT_ICC_string_SetPathName  # 路线名称
      DTE_SetPathLabel: category=VALUE, type=ADT_ICC_enum_SetPathLabel  # 路线标签
      DTE_SetHPAPathType: category=VALUE, type=ADT_ICC_enum_SetHPAPathType  # 设置路线类型
      DTE_HPAPathOperationReserved: category=ARRAY, type=ADT_HPAPathOperation_arr_Reserved  # 预留
  app type ADT_ADAS_ego_vehicleSpd: category=VALUE, compu {phys=raw for raw 0..360; unit km/h}, range phys 0..360
  app type ADT_ADAS_enum_ALCTextInfo: category=VALUE, compu {phys=raw for raw 0..255}, range phys 0..255
  app type ADT_ADAS_enum_iLOATextInfo: category=VALUE, compu {phys=raw for raw 0..255}, range phys 0..255
  application record data type ADT_Struct_NOA_SDMapPosInfo: category=STRUCTURE  # 标准地图信息
    11 x application record element, all with category=VALUE:
      DTE_Posn_MsgType: type=ADT_ADAS_MsgType  # 标识该消息类型为PositionMessage
      DTE_Posn_CycCnt: type=ADT_ADAS_Posn_CycCnt  # PositionMessage的循环计数器:重构器Reconstructor可以使用这个值来检测丢失的消息
      DTE_Posn_PathIdx: type=ADT_ADAS_Posn_PathIdx  # 当前Path的索引号:如果这个值与前一个索引为0的POSITION消息中的值有变化，车辆已经离开了当前path； 0-7的标记有特殊含义
      DTE_Posn_Offset: type=ADT_ADAS_Posn_Offset  # 车辆距路径起点位置
      DTE_Posn_Idx: type=ADT_ADAS_Posn_Idx  # 如果Av2HP支持Positioning备选，则为Position候选的索引号。 候选0总是最可能的位置候选，候选1位第二可能，以此类推。 如果AVHP不支持Positioning备选，则常为0。
      DTE_Posn_Age: type=ADT_ADAS_Posn_Age  # 从消息被发出，到车辆位置已被positioning子系统算出时，两者之间的时间差:
      DTE_Posn_Spd: type=ADT_ADAS_Posn_Spd  # 车辆沿Path行驶的预计速度
      DTE_Posn_Rehead: type=ADT_ADAS_Posn_Rehead  # 相对于path的车头朝向
      DTE_Posn_PosProbb: type=ADT_ADAS_Posn_PosProbb  # 这个值由ADASISv2 Horizon生成器的Positioning模块算出，不同的Av2HPs将使用不同的算法来计算这个值取值0代表未知unknown；取值31代表N/A
      DTE_Posn_PosConfdc: type=ADT_ADAS_Posn_PosConfdc  # Position置信度
      DTE_Posn_CurLane: type=ADT_ADAS_Posn_CurLane  # 当前车道
  app type ADT_ADAS_enum_OutsideParkingBtnStFb: category=VALUE, compu {phys=raw for raw 0..255}, range phys 0..255  # 离车泊入开关设置反馈
  app type ADT_ICC_string_Trend: category=STRING, sw-text-props={array-size-semantics=VARIABLE-SIZE, sw-max-text-size=1000, base-type=UTF_8}
  application record data type ADT_ADAS_strt_HPATrainingPathInfo: category=STRUCTURE
    8 x application record element:
      DTE_HpaTrainingPathID: category=VALUE, type=ADT_Gen_val_ID  # 路线ID
      DTE_TrainingPathName: category=STRING, type=ADT_ADAS_string_PathName  # 路线名称
      DTE_HPAtrainingPathCurrentDist: category=VALUE, type=ADT_ADAS_val_ParkingDist  # 记忆泊车路线学习实时累计距离
      DTE_TrainingPathLength: category=VALUE, type=ADT_ADAS_val_ParkingDist  # 路线长度
      DTE_TrainingLinePoint: category=ARRAY, type=ADT_ADAS_arr_PathPoint  # 路线学习点集
      DTE_HPATrainingPathSlotInfo: category=ARRAY, type=ADT_ADAS_arr_HPAPathslot  # 路线记忆车位
      DTE_HPASpeedBumpInfo: category=ARRAY, type=ADT_ADAS_arr_HPASpeedBumpInfo  # 路线记忆减速带
      DTE_TrainingPathLabel: category=VALUE, type=ADT_ADAS_enum_PathLabel  # 路线标签
  app type ADT_StrVar_BleMasterVer: category=STRING, sw-text-props={array-size-semantics=VARIABLE-SIZE, sw-max-text-size=24, base-type=UTF_8}  # 蓝牙主模块软件版本
  app type ADT_StrVar_VIN: category=STRING, sw-text-props={array-size-semantics=VARIABLE-SIZE, sw-max-text-size=17, base-type=UTF_8}  # 车辆识别码
  application array data type ADT_Arr_CamStreamSwtReqResd: category=ARRAY  # 预留 Reserved
    element ADT_Arr_CamStreamSwtReqResd: category=VALUE, type=ADT_Reserved_uint8_Type, array-size-semantics=FIXED-SIZE, max-number-of-elements=20
  5 x app type, all with category=VALUE:
    ADT_ADAS_enum_FCTBWarnActSt: compu {phys=raw for raw 0..255}, range phys 0..255  # FCTB报警执行状态
    ADT_DataUint8: compu {phys=raw for raw 0..255}, range phys 0..255  # uint8数据
    ADT_ADAS_enum_TrafficLightsType: compu {phys=raw for raw 0..255}, range phys 0..255  # 交通灯箱类型
    ADT_ADAS_val_YboundMax: compu {phys=raw for raw -1000..1000}, range phys -1000..1000
    ADT_ResponseVhrCompLogReportEnableCfg: compu {0=RESPONSEVHRCOMPLOGREPORTENABLECFG_SUCCESS, 1=RESPONSEVHRCOMPLOGREPORTENABLECFG_ERROR}  # 部件日志主动上报开关配置--响应
  application record data type ADT_Struct_NOA_SDMapMetaInfo: category=STRUCTURE  # 标准地图信息_Meta
    13 x application record element, all with category=VALUE:
      DTE_Meta_MsgType: type=ADT_ADAS_MsgType  # 标识该消息位meta datamessage
      DTE_Meta_CycCnt: type=ADT_ADAS_Meta_CycCnt  # 这个messagetype的循环计数器:重构器可以用这个值来检测丢失的消息
      DTE_Meta_CountryCode: type=ADT_ADAS_Meta_CountryCode  # 国家代码
      DTE_Meta_RegionCode: type=ADT_ADAS_Meta_RegionCode  # 区域代码
      DTE_Meta_DrvSide: type=ADT_ADAS_Meta_DrvSide  # 驾驶方向
      DTE_Meta_SpdUnits: type=ADT_ADAS_Meta_SpdUnits  # 限速单位
      DTE_Meta_ProtVer_Major: type=ADT_ADAS_Meta_ProtVer_Major  # 主要协议版本
      DTE_Meta_ProtVer_Minor: type=ADT_ADAS_Meta_ProtVer_Minor  # 次要协议版本
      DTE_Meta_ProtVer_MinorSub: type=ADT_ADAS_Meta_ProtVer_MinorSub  # 次要协议子版本
      DTE_Meta_HwVer: type=ADT_ADAS_Meta_HwVer  # 生成器的硬件和/或 软件版本
      DTE_Meta_MapProvider: type=ADT_ADAS_Meta_MapProvider  # 地图供应商
      DTE_Meta_MapVerYear: type=ADT_ADAS_Meta_MapVerYear  # 地图版本年
      DTE_Meta_MapVerQtr: type=ADT_ADAS_Meta_MapVerQtr  # 地图版本季度
  application array data type ADT_EndPoi_arr_Reserved: category=ARRAY
    element ADT_EndPoi_arr_Reserved: category=VALUE, type=ADT_Reserved_int32_Type, array-size-semantics=FIXED-SIZE, max-number-of-elements=10
  app type ADT_ADAS_enum_TolAccessRemitramp: category=VALUE, compu {phys=raw for raw 0..18446744073709551615; unit pcs}, range phys 0..18446744073709551615  # 汇入汇出匝道
  application record data type ADT_ADAS_strt_SlotPoint: category=STRUCTURE
    application record element DTE_Point_X: category=VALUE, type=ADT_ADAS_float_Point  # x坐标位置信息
    application record element DTE_Point_Y: category=VALUE, type=ADT_ADAS_float_Point  # y坐标位置信息
  application array data type ADT_TunnelInfo_arr_Reserved: category=ARRAY  # 预留
    element ADT_TunnelInfo_arr_Reserved: category=VALUE, type=ADT_Reserved_int32_Type, array-size-semantics=FIXED-SIZE, max-number-of-elements=100
  app type ADT_ICC_enum_IHCEnableBtnSt: category=VALUE, compu {phys=raw for raw 0..255}, range phys 0..255  # IHC功能使能开关
  app type ADT_ADAS_enum_FcwAcitveSt: category=VALUE, compu {phys=raw for raw 0..255}, range phys 0..255
  application record data type ADT_ICC_strt_Coord3DDouble: category=STRUCTURE
    application record element DTE_Coord3DDoubleLon: category=VALUE, type=ADT_ICC_val_longitude  # 经度
    application record element DTE_Coord3DDoubleLat: category=VALUE, type=ADT_ICC_val_latitude  # 维度
    application record element DTE_Coord3DDoubleAlt: category=VALUE, type=ADT_ICC_val_altitude  # 高度
  app type ADT_VhrLogStartTime: category=VALUE, compu {phys=raw for raw 0..9223372036854775807}, range phys 0..9223372036854775807
  application array data type ADT_ICC_arr_ExtensionLanes: category=ARRAY, dynamic-array-size-profile=VSA_LINEAR
    element ADT_ICC_arr_ExtensionLanes: category=STRUCTURE, type=ADT_ICC_strt_ExtenLaneAction, array-size-handling=ALL-INDICES-SAME-ARRAY-SIZE, array-size-semantics=VARIABLE-SIZE, max-number-of-elements=32
  application record data type ADT_ADAS_strt_LSSInfo: category=STRUCTURE
    8 x application record element, all with category=VALUE:
      DTE_LKSSts: type=ADT_ADAS_enum_LKSSts  # 车道辅助系统状态
      DTE_LKSMod: type=ADT_ADAS_enum_LKSMod  # 车道辅助模式
      DTE_ELKSts: type=ADT_ADAS_enum_ELKSts  # 紧急车道保持状态
      DTE_LKSLeftTrackingSt: type=ADT_ADAS_enum_LKSLeftTrackingSt  # 左侧跟踪状态
      DTE_LKSRightTrackingSt: type=ADT_ADAS_enum_LKSRightTrackingSt  # 右侧跟踪状态
      DTE_ELKLeftActiveSt: type=ADT_ADAS_enum_ELKLeftActiveSt  # ELK 左侧激活状态
      DTE_ELKRightActiveSt: type=ADT_ADAS_enum_ELKRightActiveSt  # ELK 右侧激活状态
      DTE_LKSwarning: type=ADT_ADAS_enum_LKS_warning  # LDP声音报警信号
  app type ADT_ADS_ReservedUnit8: category=VALUE, compu {phys=raw for raw 0..255}, range phys 0..255  # uint8类型保留字段
  application array data type ADT_ADAS_arr_MNPRoutesInfo: category=ARRAY, dynamic-array-size-profile=VSA_LINEAR  # 记忆路线信息数组
    element ADT_ADAS_arr_MNPRoutesInfo: category=STRUCTURE, type=ADT_ADAS_strt_MNPRouteInfo, array-size-handling=ALL-INDICES-SAME-ARRAY-SIZE, array-size-semantics=VARIABLE-SIZE, max-number-of-elements=20
  app type ADT_ADAS_ProfShort_ProfType: category=VALUE, compu {phys=raw for raw 0..31}, range phys 0..31
  application array data type ADT_GnssRawInfo: category=ARRAY, dynamic-array-size-profile=VSA_LINEAR  # GNSS原始数据上报
    element ADT_GnssRawInfo: category=VALUE, type=ADT_GnssRawInfoElement, array-size-handling=ALL-INDICES-SAME-ARRAY-SIZE, array-size-semantics=VARIABLE-SIZE, max-number-of-elements=65535
  application array data type ADT_SimDetailInfoArray: category=ARRAY, dynamic-array-size-profile=VSA_LINEAR  # sim卡数组
    element ADT_SimDetailInfoArray: category=STRUCTURE, type=ADT_SingleSimDetailInfo, array-size-handling=ALL-INDICES-SAME-ARRAY-SIZE, array-size-semantics=VARIABLE-SIZE, max-number-of-elements=8
  app type ADT_ICC_int32_Busway: category=VALUE, compu {phys=raw for raw 0..2147483647}, range phys 0..2147483647
  application record data type ADT_Str_CamStreamStResp: category=STRUCTURE  # 摄像头视频状态反馈 Camera Video Status Response
    application record element DTE_CamStreamOrntn: category=VALUE, type=ADT_Enum_CamStreamOrntn  # 相机视频流方位 Camera Video Stream Orientation
    application record element DTE_CamStreamStResp: category=VALUE, type=ADT_Enum_CamStreamSt  # 相机视频流状态反馈 Camera Video Stream Status Response
    application record element DTE_CamStreamStRespResd: category=ARRAY, type=ADT_Arr_CamStreamStRespResd  # 预留 Reserved
  app type ADT_ADAS_enum_AESActiveSt: category=VALUE, compu {phys=raw for raw 0..255}, range phys 0..255
  app type ADT_Dbl_HDOPfInfo: category=VALUE, compu {phys=raw for raw 0..100}, range phys 0..100  # 水平精度因子信息 Horizontal dilution of precision information
  app type ADT_ICC_int32_LightDir: category=VALUE, compu {phys=raw for raw 0..2147483647}, range phys 0..2147483647  # 红绿指示方向
  application array data type ADT_ICC_arr_CrossNaviInfo: category=ARRAY, dynamic-array-size-profile=VSA_LINEAR
    element ADT_ICC_arr_CrossNaviInfo: category=STRUCTURE, type=ADT_ICC_strt_CrossNaviInfo, array-size-handling=ALL-INDICES-SAME-ARRAY-SIZE, array-size-semantics=VARIABLE-SIZE, max-number-of-elements=10
  8 x app type:
    ADT_ADAS_enum_RoadMarkerType: category=VALUE, compu {phys=raw for raw 0..255}, range phys 0..255  # 路面标记类型
    ADT_ScheduleTime: category=VALUE, compu {phys=raw for raw 0..4294967295}, range phys 0..4294967295  # OTA的任务时间
    ADT_ADAS_enum_HPAPathLabeType: category=VALUE, compu {phys=raw for raw 0..255}, range phys 0..255  # 记忆泊车标签类型
    ADT_AccState: category=VALUE, compu {0=ACC_OFF, 1=ACC_STANDBY, 2=ACC_OVERRIDE, 3=ACC_ACTIVE, 4=ACC_STANDSTILL, 255=INVALID}  # ACC激活状态信息
    ADT_SentryModeSetResult: category=VALUE, compu {0=SUCCESS, 1=NOT_IN_P_GEAR, 2=LOW_BATTERY, 3=OTA_STATUS, 4=SYSTEM_FAILURE, 5=STORAGE_ABNORMAL, 6=VEHICLE_IN_USE, 7=DCDC_FAILURE, 8=LICENSE_INVALID, 9=SAFE_LOCATION}  # 哨兵模式开关结果
    ADT_ICC_enum_MNPRouteInfoReq: category=STRING, sw-text-props={array-size-semantics=VARIABLE-SIZE, sw-max-text-size=100, base-type=UTF_8}  # 请求当前记忆路线信息
    ADT_ICC_enum_ExtenLaneAction: category=VALUE, compu {phys=raw for raw 0..255}, range phys 0..255
    ADT_ICC_enum_NavCurrRoadType: category=VALUE, compu {phys=raw for raw 0..255}, range phys 0..255  # 导航道路类型
  application array data type ADT_CameraStreamRequestMessage: category=ARRAY, dynamic-array-size-profile=VSA_LINEAR  # CDC到ADS的视频请求消息
    element ADT_CameraStreamRequestMessage: category=VALUE, type=ADT_CameraStreamBasicElement, array-size-handling=ALL-INDICES-SAME-ARRAY-SIZE, array-size-semantics=VARIABLE-SIZE, max-number-of-elements=1048576
  app type ADT_ADAS_val_StandardDeviation: category=VALUE, compu {phys=raw for raw 0..1}, range phys 0..1
  application array data type ADT_NaviCameraExt_arr_Reserved: category=ARRAY
    element ADT_NaviCameraExt_arr_Reserved: category=VALUE, type=ADT_Reserved_int32_Type, array-size-semantics=FIXED-SIZE, max-number-of-elements=20
  app type ADT_ADAS_enum_ELKRightActiveSt: category=VALUE, compu {phys=raw for raw 0..255}, range phys 0..255
  app type ADT_ADAS_enum_FCWAEBTextInfo: category=VALUE, compu {phys=raw for raw 0..255}, range phys 0..255  # FCW/AEB文言提示信息
  app type ADT_PointIndex: category=VALUE, compu {phys=raw for raw -9999..9999}, range phys -9999..9999  # 单点索引
  application record data type ADT_ParkingAreaCellMapInfo: category=STRUCTURE  # 进入停车场时，上报停车场范围内的所有小区消息，以小区为维度
    application record element DTE_cellNum: category=VALUE, type=ADT_CellularCellNum  # 小区数量
    application record element DTE_cellMapArray: category=ARRAY, type=ADT_CellularCellMapArray  # 小区地图数组
  application array data type ADT_GreenWave_arr_Reserved: category=ARRAY
    element ADT_GreenWave_arr_Reserved: category=VALUE, type=ADT_Reserved_int32_Type, array-size-semantics=FIXED-SIZE, max-number-of-elements=15
  app type ADT_ADAS_val_FSRACruiseSpdOffsetSpdFb: category=VALUE, compu {phys=raw for raw -10..10}, range phys -10..10
  application record data type ADT_AllSimDetailInfo: category=STRUCTURE  # 车辆Sim卡信息
    4 x application record element:
      DTE_simNum: category=VALUE, type=ADT_SimNum  # 支持的sim数量
      DTE_multiSimSwitchMode: category=VALUE, type=ADT_MultiSimSwitchMode  # 多SIM切换模式
      DTE_reserved: category=ARRAY, type=ADT_AllSimDetailInfoReserved  # 预留字段
      DTE_simDetailInfoArray: category=ARRAY, type=ADT_SimDetailInfoArray  # sim卡详细信息数组
  app type ADT_ADAS_Meta_ProtVer_MinorSub: category=VALUE, compu {phys=raw for raw 0..7}, range phys 0..7
  application record data type ADT_ADAS_strt_EgoFusionPose: category=STRUCTURE
    10 x application record element, all with category=VALUE:
      DTE_longitude: type=ADT_ADAS_val_longitude  # 经度
      DTE_latitude: type=ADT_ADAS_val_latitude  # 纬度
      DTE_altitude: type=ADT_ADAS_val_altitude  # 高度
      DTE_heading: type=ADT_ADAS_val_heading  # 航向角
      DTE_vehicleSpeed: type=ADT_ADAS_ego_vehicleSpd  # 车辆本身车速，单位:km/h
      DTE_FusionlocalizationSD: type=ADT_ADAS_val_StandardDeviation  # 融合位置标准差
      DTE_altitudeSD: type=ADT_ADAS_val_StandardDeviation  # 高度标准差
      DTE_headingSD: type=ADT_ADAS_val_StandardDeviation  # 航向角标准差
      DTE_vehicleSpeedSD: type=ADT_ADAS_val_StandardDeviation  # 车辆本身车速标准差
      DTE_timestampmSec: type=ADT_ADAS_val_timestampmSec  # 时间戳-毫秒
  app type ADT_ADAS_enum_ALCSoundWarn: category=VALUE, compu {phys=raw for raw 0..255}, range phys 0..255
  application record data type ADT_ADAS_strt_LinePoint: category=STRUCTURE  # 形点信息
    4 x application record element:
      DTE_LinePointX: category=VALUE, type=ADT_Gen_val_Coordinate_X  # 点位置X坐标，车辆坐标系参考后轴中心点的X，单位cm
      DTE_LinePointY: category=VALUE, type=ADT_Gen_val_Coordinate_Y  # 点位置Y坐标，车辆坐标系参考后轴中心点的Y，单位cm
      DTE_LinePointZ: category=VALUE, type=ADT_Gen_val_Coordinate_Z  # 点位置Z坐标，车辆坐标系参考后轴中心点的Z，单位cm
      DTE_LinePointReserved: category=ARRAY, type=ADT_LinePoint_arr_Reserved  # 预留
  app type ADT_Gen_enum_OnOffSts: category=VALUE, compu {phys=raw for raw 0..255}, range phys 0..255
  application record data type ADT_ADAS_strt_AdvanceParkingInfo: category=STRUCTURE
    22 x application record element:
      DTE_HPASts: category=VALUE, type=ADT_ADAS_enum_HPASts  # 记忆泊车状态信息
      DTE_HPASearchOnWaySelectSlotID: category=VALUE, type=ADT_ADAS_val_SlotID  # 记忆泊车沿途找车位泊入车位在记忆路线中的车位ID
      DTE_HPAUseData: category=STRUCTURE, type=ADT_ADAS_strt_HpaUseData  # 记忆泊车循迹信息统计
      DTE_VPAWarningInfo: category=VALUE, type=ADT_ADAS_enum_VPAWarningInfo  # 代客泊车报警信息
      DTE_HPAPathSelectIDInd: category=VALUE, type=ADT_Gen_val_ID  # 记忆泊车路线选择ID反馈
      DTE_HPAVPARepalyRemind: category=VALUE, type=ADT_ADAS_enum_HPAVPARepalyRemind  # 记忆泊车代客泊车语音及显示提示
      DTE_HPAVPATrajectory: category=ARRAY, type=ADT_ADAS_arr_TrajectoryPoint  # 泊车规划引导线
      DTE_HpaOperationResp: category=VALUE, type=ADT_ADAS_enum_ParkingOperationResp  # HPA按键状态反馈
      DTE_HpaEgoVehPos: category=STRUCTURE, type=ADT_ADAS_strt_EgoPose  # HPA位姿信息
      DTE_VPADropOffVld: category=VALUE, type=ADT_Gen_enum_AvailableSts  # 代客泊车Drop off 可用性
      DTE_VPAPickUpVld: category=VALUE, type=ADT_Gen_enum_AvailableSts  # 代客泊车Pick up 可用性
      DTE_VPASelfMapBuildVld: category=VALUE, type=ADT_Gen_enum_AvailableSts  # 代客泊车自建地图可用性
      DTE_VPAProcessBarInd: category=VALUE, type=ADT_ADAS_val_ParkingProgressBarInd  # 代客泊车进度条
      DTE_VPAVld: category=VALUE, type=ADT_Gen_enum_AvailableSts  # 代客泊车可用性
      DTE_VPAPickUpPosSelectReq: category=VALUE, type=ADT_ADAS_enum_VPAPickUpPosSelectReq  # 代客泊车Pick up 位置选择请求
      DTE_VPADropOffPosSelectReq: category=VALUE, type=ADT_ADAS_enum_VPADropOffPosSelectReq  # 代客泊车Drop off位置选择请求
      DTE_VPASts: category=VALUE, type=ADT_ADAS_enum_VPASts  # 代客泊车状态信息
      DTE_VPAFuncTypeFb: category=VALUE, type=ADT_ADAS_enum_VPAFunctionType  # 代客泊车当前激活功能类型反馈
      DTE_VPARemainingDist: category=VALUE, type=ADT_ADAS_val_ParkingDist  # 代客泊车剩余距离
      DTE_HPARequestAPAUI: category=VALUE, type=ADT_ADAS_enum_HPARequestAPAUI  # 记忆泊车调用自动泊车UI请求
      DTE_HpaActiveCheckSts: category=VALUE, type=ADT_ADAS_enum_HpaActiveCheckSts  # 记忆泊车激活检测结果反馈
      DTE_HPAReplayRecAvl: category=VALUE, type=ADT_Gen_enum_AvailableSts  # 记忆泊车推荐回放路线可用
  9 x app type, all with category=VALUE:
    ADT_ICC_enum_HPAOperationId: compu {phys=raw for raw 0..255}, range phys 0..255
    ADT_ADAS_val_LineEquation_C1: compu {phys=raw for raw -1.023..1.023; unit rad}, range phys -1.023..1.023
    ADT_ADAS_val_timestampmSec: compu {phys=raw for raw 0..4398046511103; unit ms}, range phys 0..4398046511103
    ADT_ADAS_val_LineEquation_C0: compu {phys=raw for raw -10.23..10.23; unit m}, range phys -10.23..10.23
    ADT_ADAS_enum_DAISts: compu {phys=raw for raw 0..255}, range phys 0..255
    ADT_ADAS_val_LineEquation_C3: compu {phys=raw for raw -3.2768E-4..3.2767E-4; unit 1/m^2}, range phys -3.2768E-4..3.2767E-4
    ADT_Enum_TBOXOTARemoteInstall: compu {0=OTARemoteInstallNoResp, 1=OTARemoteInstallResp}, range phys 0..255  # OTA立即升级
    ADT_ADAS_val_LineEquation_C2: compu {phys=raw for raw -0.01023..0.01023; unit 1/m}, range phys -0.01023..0.01023
    ADT_ICC_Navi_Longitude: compu {phys=raw-180 for raw -180.005..179.995; unit deg}, range phys -180.005..179.995
  application record data type ADT_ADAS_strt_Light: category=STRUCTURE  # 红绿灯信息
    4 x application record element:
      DTE_LightType: category=VALUE, type=ADT_ADAS_enum_LightType  # 红绿灯类型
      DTE_LightColor: category=VALUE, type=ADT_ADAS_enum_LightColor  # 红绿灯颜色
      DTE_RemainingTime: category=VALUE, type=ADT_ADAS_val_RemainingTime  # 红绿灯剩余时间
      DTE_LightReserved: category=ARRAY, type=ADT_Light_arr_Reserved  # 预留
  4 x app type, all with category=VALUE:
    ADT_ADAS_val_SpdLimitRelOffset: compu {phys=raw for raw -20..20}, range phys -20..20
    ADT_ADAS_enumTargetObjColor: compu {phys=raw for raw 0..255}, range phys 0..255  # 目标颜色
    ADT_ADAS_enum_FCTAWarnTypeSts: compu {phys=raw for raw 0..255}, range phys 0..255  # FCTA报警类型状态
    ADT_WiFiStrength: compu {0..5=INI_WIFI_STRENGTH_0..INI_WIFI_STRENGTH_5}
  application record data type ADT_ADAS_strt_ALCInfo: category=STRUCTURE
    7 x application record element, all with category=VALUE:
      DTE_ALCStatus: type=ADT_ADAS_enum_ALCSts  # 拨杆变道功能状态
      DTE_ALCDirIndicator: type=ADT_ADAS_enum_ALCDirIndicator  # 拨杆变道方向
      DTE_ALCAbortReason: type=ADT_ADAS_enum_ALCAbortReason  # 变道退出原因
      DTE_ALCSoundWarn: type=ADT_ADAS_enum_ALCSoundWarn  # 变道声音报警
      DTE_ALCTextInfomation: type=ADT_ADAS_enum_ALCTextInfo  # 变道提示信息
      DTE_ALCTakeOverRequest: type=ADT_ADAS_enum_ALCTakeOverRequest  # 变道接管请求
      DTE_ALCPermitSt: type=ADT_ADAS_enum_LCPermitSt  # 拨杆变道允许状态
  12 x app type:
    ADT_Dbl_PDOPInfo: category=VALUE, compu {phys=raw for raw 0..100}, range phys 0..100  # 位置精度因子信息 Position dilution of precision information
    ADT_ADAS_Posn_CurLane: category=VALUE, compu {phys=raw for raw 0..7}, range phys 0..7
    ADT_ADAS_Seg_Update: category=VALUE, compu {phys=raw for raw 0..1}, range phys 0..1
    ADT_StrVar_BleSlaverLeftVer: category=STRING, sw-text-props={array-size-semantics=VARIABLE-SIZE, sw-max-text-size=24, base-type=UTF_8}  # 蓝牙左从模块软件版本
    ADT_ICC_enum_TLREnableBtnSt: category=VALUE, compu {phys=raw for raw 0..255}, range phys 0..255  # TLR功能使能开关
    ADT_IsSimInPostion: category=VALUE, compu {phys=raw for raw 0..255}, range phys 0..255  # Sim卡是否在位
    ADT_FactoryResetTimeLength: category=VALUE, compu {phys=raw for raw 1..1800; unit s}, range phys 1..1800  # 恢厂所需时间
    ADT_ICC_enum_HPALTEdbm: category=VALUE, compu {phys=raw for raw 0..255}, range phys 0..255
    ADT_ADAS_enum_SglU_turnsNum: category=VALUE, compu {phys=raw for raw 0..65535; unit pcs}, range phys 0..65535  # 掉头次数
    ADT_ADAS_enum_VPAVoiceRemind: category=VALUE, compu {phys=raw for raw 0..255}, range phys 0..255
    ADT_EphemerisDataSwitchCmd: category=VALUE, compu {phys=raw for raw 0..255}, range phys 0..255  # 星历数据开关指令
    ADT_TimeInfoHour: category=VALUE, compu {phys=raw for raw 0..23}, range phys 0..23  # 时
  application array data type ADT_ADASSettingInfo_arr_Reserved: category=ARRAY  # 预留
    element ADT_ADASSettingInfo_arr_Reserved: category=VALUE, type=ADT_Reserved_uint8_Type, array-size-semantics=FIXED-SIZE, max-number-of-elements=50
  6 x app type:
    ADT_StrVar_fileName: category=STRING, sw-text-props={array-size-semantics=VARIABLE-SIZE, sw-max-text-size=32, base-type=UTF_8}  # log文件名称
    ADT_ADAS_enum_ParkingActiveSubFuncSt: category=VALUE, compu {phys=raw for raw 0..255}, range phys 0..255
    ADT_ICC_int32_LinkRemainDist: category=VALUE, compu {phys=raw for raw 0..2147483647; unit m}, range phys 0..2147483647
    ADT_ICC_boolean_scopeFlag: category=VALUE, compu {phys=raw for raw 0..255}, range phys 0..255  # 自车位置是否在拥堵区域内
    ADT_ADAS_enum_NOPALCReqDriverConf: category=VALUE, compu {phys=raw for raw 0..255}, range phys 0..255
    ADT_Enum_RouteMMStatus: category=VALUE, compu {phys=raw for raw 0..255}, range phys 0..255  # HD路线匹配状态
  application record data type ADT_ADAS_strt_TrafficLight: category=STRUCTURE
    7 x application record element, all with category=VALUE:
      DTE_trafficLightId: type=ADT_Gen_val_ID  # 交通灯ID
      DTE_trafficLightType: type=ADT_ADAS_enum_TrafficLightType  # 交通灯类型
      DTE_trafficLightColor: type=ADT_ADAS_enum_TrafficLightColor  # 交通灯颜色
      DTE_remainingTime: type=ADT_ADAS_val_TrafficLightCountdownNumber  # 交通灯剩余时间
      DTE_TrafficLightPosX: type=ADT_Gen_val_Coordinate_X  # 交通灯位置X
      DTE_TrafficLightPosY: type=ADT_Gen_val_Coordinate_Y  # 交通灯位置Y
      DTE_TrafficLightPosZ: type=ADT_Gen_val_Coordinate_Z  # 交通灯位置Z
  4 x app type:
    ADT_StrVar_ModemVersion: category=STRING, sw-text-props={array-size-semantics=VARIABLE-SIZE, sw-max-text-size=40, base-type=UTF_8}  # Modem版本号
    ADT_ADAS_enum_TLATextInfo: category=VALUE, compu {phys=raw for raw 0..255}, range phys 0..255  # TLA提示信息
    ADT_ADAS_enum_LDPSts: category=VALUE, compu {phys=raw for raw 0..255}, range phys 0..255
    ADT_SatelliteNum: category=VALUE, compu {phys=raw for raw 0..10000}, range phys 0..10000
  application array data type ADT_TrafficSignIdentify_arr_Reserved: category=ARRAY
    element ADT_TrafficSignIdentify_arr_Reserved: category=VALUE, type=ADT_Reserved_uint8_Type, array-size-semantics=FIXED-SIZE, max-number-of-elements=30
  app type ADT_ADAS_Posn_Idx: category=VALUE, compu {phys=raw for raw 0..3}, range phys 0..3
  app type ADT_ICC_enum_FCWSettingSt: category=VALUE, compu {phys=raw for raw 0..255}, range phys 0..255  # FCW功能设置状态
  application array data type ADT_ADAS_arr_DynamicObjects_2: category=ARRAY, dynamic-array-size-profile=VSA_LINEAR  # 行车动态目标数组
    element ADT_ADAS_arr_DynamicObjects_2: category=STRUCTURE, type=ADT_ADAS_strt_DynamicObject_2, array-size-handling=ALL-INDICES-SAME-ARRAY-SIZE, array-size-semantics=VARIABLE-SIZE, max-number-of-elements=150
  application record data type ADT_ICC_strt_ApaFreeSlotInfo: category=STRUCTURE
    5 x application record element:
      DTE_FreeSlotType: category=VALUE, type=ADT_ICC_enum_FreeSlotType  # 自选车位的类型
      DTE_FreeSlotPoint0Top1: category=STRUCTURE, type=ADT_ICC_strt_SlotPoint  # 自选车位的角点0位置
      DTE_FreeSlotPoint1Top2: category=STRUCTURE, type=ADT_ICC_strt_SlotPoint  # 自选车位的角点1位置
      DTE_FreeSlotPoint2Bottom1: category=STRUCTURE, type=ADT_ICC_strt_SlotPoint  # 自选车位的角点2位置
      DTE_FreeSlotPoint3Bottom2: category=STRUCTURE, type=ADT_ICC_strt_SlotPoint  # 自选车位的角点3位置
  application array data type ADT_NotAvoid_arr_Reserved: category=ARRAY
    element ADT_NotAvoid_arr_Reserved: category=VALUE, type=ADT_Reserved_int32_Type, array-size-semantics=FIXED-SIZE, max-number-of-elements=20
  app type ADT_ICC_enum_MNPUseRouteQuitBtnSt: category=VALUE, compu {phys=raw for raw 0..255}, range phys 0..255  # 退出路线使用按钮
  app type ADT_LanePositionInfo_offset_Lateral: category=VALUE, compu {phys=raw for raw 0..500; unit m}, range phys 0..500
  application array data type ADT_OperatingSimInfoReserved: category=ARRAY  # 当前使用的Sim卡信息预留
    element ADT_OperatingSimInfoReserved: category=VALUE, type=ADT_INI_ReservedUnit8, array-size-semantics=FIXED-SIZE, max-number-of-elements=16
  app type ADT_TotalTalkTime: category=VALUE, compu {phys=raw for raw 0..4294967295}, range phys 0..4294967295  # 通话时长总计
  app type ADT_ICC_int32_NaviInfoFlag: category=VALUE, compu {phys=raw for raw 0..2147483647}, range phys 0..2147483647
  application record data type ADT_ADAS_strt_VPASelfBuildMapDate: category=STRUCTURE  # 自建地图数据
    6 x application record element, all with category=VALUE, type=ADT_Gen_val_unit8:
      DTE_Padding{1..6}  # 填充{1..6}
  app type ADT_ADAS_ProfLong_Update: category=VALUE, compu {phys=raw for raw 0..1}, range phys 0..1
  application record data type ADT_Struct_CertificateIssuedMark: category=STRUCTURE  # 安全状态标识
    application record element DTE_FirstCertificationMark: category=VALUE, type=ADT_Enum_FirstCertificationMark  # 首次认证标识
    application record element DTE_CertificateIssuedMark: category=VALUE, type=ADT_Enum_CertificateIssuedMark  # 已下发标识
    application record element DTE_SKLearnFlag: category=VALUE, type=ADT_Enum_SKLearnFlag  # SK学习标识
  application record data type ADT_ADAS_strt_StaticObject_2: category=STRUCTURE
    9 x application record element, all with category=VALUE:
      DTE_objectId: type=ADT_Gen_uint64_ID  # 目标id
      DTE_objectType: type=ADT_ADAS_enum_StaticObjectType  # 目标类型
      DTE_objectPoseX: type=ADT_Gen_val_Coordinate_X  # 目标位置X坐标
      DTE_objectPoseY: type=ADT_Gen_val_Coordinate_Y  # 目标位置Y坐标
      DTE_objectYaw: type=ADT_Gen_val_Yaw  # 目标位姿
      DTE_objectLength: type=ADT_Gen_val_Length  # 目标长度
      DTE_objecWidth: type=ADT_Gen_val_Width  # 目标宽度
      DTE_timestampnSec: type=ADT_ADAS_val_timestampnSec  # 时间戳-纳秒
      DTE_laneID: type=ADT_ADAS_uint64_laneID  # 目标所属车道ID
  app type ADT_INI_ReservedUnit8: category=VALUE, compu {phys=raw for raw 0..255}, range phys 0..255  # uint8类型保留字段
  app type ADT_ADAS_Meta_MapProvider: category=VALUE, compu {phys=raw for raw 0..7}, range phys 0..7
  application array data type ADT_ADAS_arr_VPARange: category=ARRAY, dynamic-array-size-profile=VSA_LINEAR  # VPA地图范围列表
    element ADT_ADAS_arr_VPARange: category=STRUCTURE, type=ADT_ADAS_strt_VPARange, array-size-handling=ALL-INDICES-SAME-ARRAY-SIZE, array-size-semantics=VARIABLE-SIZE, max-number-of-elements=100
  6 x app type:
    ADT_ADAS_enum_DriverHandsoffWarning: category=VALUE, compu {phys=raw for raw 0..255}, range phys 0..255  # 脱手报警
    ADT_ICC_int32_CongestionStatus: category=VALUE, compu {phys=raw for raw 0..2147483647}, range phys 0..2147483647  # 拥堵程度
    ADT_ICC_enum_Affect: category=STRING, sw-text-props={array-size-semantics=VARIABLE-SIZE, sw-max-text-size=50, base-type=UTF_8}  # 拥堵影响车道
    ADT_StrVar_password: category=STRING, sw-text-props={array-size-semantics=VARIABLE-SIZE, sw-max-text-size=15, base-type=UTF_8}
    ADT_ADAS_enum_ParkingChimeVoice: category=VALUE, compu {phys=raw for raw 0..255}, range phys 0..255
    ADT_WiFiCurConnStatus: category=VALUE, compu {1=INI_WIFI_DISCONNECTED, 2=INI_WIFI_CONNECTING, 3=INI_WIFI_CONNECTED, 4=INI_WIFI_CONNECT_FAILED, 5=INI_WIFI_CONNECT_FAILED_INVALID_PWD}
  application record data type ADT_ICC_strt_RampInfo: category=STRUCTURE  # 匝道信息
    4 x application record element:
      DTE_RampExists: category=VALUE, type=ADT_ICC_boolean_exists
      DTE_RampDistance1: category=VALUE, type=ADT_ICC_int32_Dist
      DTE_RampDistance2: category=VALUE, type=ADT_ICC_int32_Dist
      DTE_RampInfoReserved: category=ARRAY, type=ADT_RampInfo_arr_Reserved  # 预留
  app type ADT_Enum_Result: category=VALUE, compu {phys=raw for raw 0..1}, range phys 0..1
  app type ADT_ADAS_val_HPAVPAGiveWayPedTimes: category=VALUE, compu {phys=raw for raw 0..255; unit time}, range phys 0..255
  application array data type ADT_WeatherInfo_arr_Reserved_1: category=ARRAY
    element ADT_WeatherInfo_arr_Reserved_1: category=VALUE, type=ADT_Reserved_int32_Type, array-size-semantics=FIXED-SIZE, max-number-of-elements=15
  app type ADT_ADAS_enum_TLRSts: category=VALUE, compu {phys=raw for raw 0..255}, range phys 0..255  # 交通灯识别功能状态
  app type ADT_Enum_Action: category=VALUE, compu {phys=raw for raw 0..1}, range phys 0..1
  application array data type ADT_Arr_DataInLoop: category=ARRAY  # 回传数据字段 Transmitted back data field
    element ADT_Arr_DataInLoop: category=VALUE, type=ADT_Enum_DataInLoopUnit, array-size-semantics=FIXED-SIZE, max-number-of-elements=1200
  app type ADT_ADAS_Meta_HwVer: category=VALUE, compu {phys=raw for raw 0..511}, range phys 0..511
  application record data type ADT_ADAS_strt_MNPRoutesInfo: category=STRUCTURE
    application record element DTE_MNPMemRoutes: category=ARRAY, type=ADT_ADAS_arr_MNPMemRoutes  # 记忆路线信息数组
    application record element DTE_MNPMemRoutePoints: category=ARRAY, type=ADT_ADAS_arr_MNPMemRoutePoints  # 需要在SD显示的路线轨迹点
    application record element DTE_MNPRoutesReserved: category=ARRAY, type=ADT_MNPRoutes_arr_Reserved  # 预留
  application record data type ADT_ADAS_strt_AebTargetObjInfo: category=STRUCTURE  # FCW AEB目标信息
    6 x application record element, all with category=VALUE:
      DTE_TargetObjID: type=ADT_ADAS_enumTargetObjID  # 目标ID
      DTE_TargetObjColor: type=ADT_ADAS_enumTargetObjColor  # 目标颜色
      DTE_TargetObjType: type=ADT_ADAS_enumTargetObjType  # 目标类型
      DTE_TargetObjPosX: type=ADT_Gen_val_Coordinate_X  # 目标X向距离
      DTE_TargetObjPosY: type=ADT_Gen_val_Coordinate_Y  # 目标Y向距离
      DTE_TargetObjSpdX: type=ADT_ADAS_val_vehicleSpd  # 目标纵向速度
  11 x app type:
    ADT_ADAS_enum_HPASts: category=VALUE, compu {phys=raw for raw 0..255}, range phys 0..255
    ADT_ADAS_enum_MNPMemRouteGrade: category=VALUE, compu {phys=raw for raw 0..100}, range phys 0..100  # 路线评分
    ADT_Enum_MatchingMode: category=VALUE, compu {phys=raw for raw 0..255}, range phys 0..255  # 车线匹配状态
    ADT_Enum_UpdateFTPSts: category=VALUE, compu {phys=raw for raw 0..1}, range phys 0..1  # FTP状态
    ADT_ADAS_enum_TSRSt: category=VALUE, compu {phys=raw for raw 0..255}, range phys 0..255
    ADT_ICC_string_RoadName: category=STRING, sw-text-props={array-size-semantics=VARIABLE-SIZE, sw-max-text-size=1000, base-type=UTF_8}
    ADT_ICC_string_GateName: category=STRING, sw-text-props={array-size-semantics=VARIABLE-SIZE, sw-max-text-size=300, base-type=UTF_8}
    ADT_ADAS_enum_VPADropOffPosSelectReq: category=VALUE, compu {phys=raw for raw 0..255}, range phys 0..255
    ADT_SentryModePlanStartTime_hour: category=VALUE, compu {phys=raw for raw 0..23}, range phys 0..23  # 哨兵模式预约开启时间（时）
    ADT_UpFlow: category=VALUE, compu {phys=raw for raw 0..2415919103; unit byte}, range phys 0..2415919103
    ADT_ICC_enum_RGearDefaultFunctionBtnSt: category=VALUE, compu {phys=raw for raw 0..255}, range phys 0..255  # R挡默认打开项设置
  application array data type ADT_ADAS_arr_RoadMarker: category=ARRAY, dynamic-array-size-profile=VSA_LINEAR
    element ADT_ADAS_arr_RoadMarker: category=STRUCTURE, type=ADT_ADAS_strt_RoadMarker, array-size-handling=ALL-INDICES-SAME-ARRAY-SIZE, array-size-semantics=VARIABLE-SIZE, max-number-of-elements=28
  application record data type ADT_ValetParkingRoadCellInfo: category=STRUCTURE  # ADS发送所有轨迹图层信息
    application record element DTE_valetParkingReferDistanceStep: category=VALUE, type=ADT_ValetParkingReferDistanceStep  # 代客泊车路点间隔
    application record element DTE_valetParkingPointNum: category=VALUE, type=ADT_ValetParkingPointNum  # 代客泊车路点个数
    application record element DTE_valetParkingPoinNetArray: category=ARRAY, type=ADT_ValetParkingPoinNetArray  # 代客泊车各点小区信息数组
  app type ADT_ICC_int32_FacilityType: category=VALUE, compu {phys=raw for raw -2147483648..2147483647}, range phys -2147483648..2147483647  # 道路设施类型
  app type ADT_Enum_EcuType: category=VALUE, compu {phys=raw for raw 0..255}, range phys 0..255  # ECU版本
  application array data type ADT_ActiveSafetyFcn_arr_Reserved: category=ARRAY  # 预留
    element ADT_ActiveSafetyFcn_arr_Reserved: category=VALUE, type=ADT_Reserved_uint8_Type, array-size-semantics=FIXED-SIZE, max-number-of-elements=47
  application array data type ADT_Array_DataType: category=ARRAY, dynamic-array-size-profile=VSA_LINEAR  # 数据类型
    element ADT_Array_DataType: category=VALUE, type=ADT_DataUint8, array-size-handling=ALL-INDICES-SAME-ARRAY-SIZE, array-size-semantics=VARIABLE-SIZE, max-number-of-elements=1300
  app type ADT_ADAS_enumTargetObjType: category=VALUE, compu {phys=raw for raw 0..255}, range phys 0..255  # 目标类型
  application record data type ADT_ICC_strt_TrafficLightInfo: category=STRUCTURE
    8 x application record element:
      DTE_TrafficLightWaitNum: category=VALUE, type=ADT_Gen_val_int64  # 等红绿灯轮数
      DTE_TrafficLightDir: category=VALUE, type=ADT_ICC_int32_LightDir  # 红绿指示方向
      DTE_TrafficLightStates: category=STRUCTURE, type=ADT_ICC_strt_LightState  # 灯态
      DTE_TrafficLightDesc: category=STRING, type=ADT_ICC_string_LightDesc  # 灯态列表
      DTE_TrafficLightShowType: category=VALUE, type=ADT_ICC_int32_ShowType  # 显示形态标识
      DTE_TrafficLightPhase: category=VALUE, type=ADT_ICC_int32_LightPhase  # 左转和直行是否同相位
      DTE_StandardType: category=VALUE, type=ADT_ICC_int32_StandardType  # 灯规格类型
      DTE_TrafficLightReserved: category=ARRAY, type=ADT_TrafficLight_arr_Reserved  # 预留
  application array data type ADT_LSSInfo_arr_Reserved: category=ARRAY  # 预留
    element ADT_LSSInfo_arr_Reserved: category=VALUE, type=ADT_Reserved_uint8_Type, array-size-semantics=FIXED-SIZE, max-number-of-elements=48
  app type ADT_ICC_enum_VPASettingSt: category=VALUE, compu {phys=raw for raw 0..255}, range phys 0..255  # VPA功能设置状态
  app type ADT_ValetParkingNetworkQuality: category=VALUE, compu {phys=raw for raw 0..255}, range phys 0..255  # 代客泊车感知网络质量状态
  application array data type ADT_TLRInfo_arr_Reserved: category=ARRAY
    element ADT_TLRInfo_arr_Reserved: category=VALUE, type=ADT_Reserved_uint8_Type, array-size-semantics=FIXED-SIZE, max-number-of-elements=30
  4 x app type:
    ADT_ICC_enum_VPAOperationId: category=VALUE, compu {phys=raw for raw 0..255}, range phys 0..255
    ADT_TimeStamp64: category=VALUE, compu {phys=raw for raw 0..18446744073709551615; unit ms}, range phys 0..18446744073709551615  # UTC 时间
    ADT_ADAS_enum_LinePositionIndex: category=VALUE, compu {phys=raw for raw 0..255}, range phys 0..255
    ADT_Str_InterVers: category=STRING, sw-text-props={array-size-semantics=VARIABLE-SIZE, sw-max-text-size=40, base-type=UTF_8}  # ADAS内部版本号 ADAS Internal version number
  application array data type ADT_ADAS_arr_HPAPathDetail_2: category=ARRAY, dynamic-array-size-profile=VSA_LINEAR
    element ADT_ADAS_arr_HPAPathDetail_2: category=STRUCTURE, type=ADT_ADAS_strt_HPAPathDetail_2, array-size-handling=ALL-INDICES-SAME-ARRAY-SIZE, array-size-semantics=VARIABLE-SIZE, max-number-of-elements=20
  app type ADT_CellularFrequency: category=VALUE, compu {phys=raw for raw 0..4294967295}, range phys 0..4294967295  # 频点
  app type ADT_ResetCommand: category=VALUE, compu {0=RESETCOMMAND_FACTORYRESET, 1=RESETCOMMAND_NOT_USED}  # 恢厂命令
  application array data type ADT_ICC_arr_ViaPointInfo: category=ARRAY, dynamic-array-size-profile=VSA_LINEAR
    element ADT_ICC_arr_ViaPointInfo: category=STRUCTURE, type=ADT_ICC_strt_ViaPointInfo, array-size-handling=ALL-INDICES-SAME-ARRAY-SIZE, array-size-semantics=VARIABLE-SIZE, max-number-of-elements=100
  app type ADT_ICC_enum_APARoad_Class: category=VALUE, compu {phys=raw for raw 0..255}, range phys 0..255
  application record data type ADT_ADAS_strt_EgoPose: category=STRUCTURE
    6 x application record element, all with category=VALUE:
      DTE_EgoVehPoseX: type=ADT_Gen_val_Coordinate_X  # 自车位置坐标
      DTE_EgoVehPoseY: type=ADT_Gen_val_Coordinate_Y  # 自车位置坐标
      DTE_EgoVehPoseZ: type=ADT_Gen_val_Coordinate_Z  # 自车位置坐标
      DTE_EgoVehYaw: type=ADT_Gen_val_Yaw  # 自车位姿
      DTE_EgoVehPitch: type=ADT_Gen_val_Pitch  # 自车位姿
      DTE_EgoVehRoll: type=ADT_Gen_val_Roll  # 自车位姿
  app type ADT_ADAS_ProfShort_Dist1: category=VALUE, compu {phys=raw for raw 0..1023}, range phys 0..1023
  app type ADT_ADAS_ProfLong_ProfType: category=VALUE, compu {phys=raw for raw 0..63}, range phys 0..63
  application record data type ADT_ADAS_strt_SDmapInfo_international: category=STRUCTURE  # 国际SD地图输出信息
    17 x application record element, all with category=VALUE:
      DTE_NavSpeedLimitStatus: type=ADT_ICC_enum_NavSpeedLimitStatus  # 导航地图状态
      DTE_NavCountryCodeInfo: type=ADT_ICC_enum_NavCountryCodeInfo  # 导航国家代码
      DTE_NavCurrRoadType: type=ADT_ICC_enum_NavCurrRoadType  # 导航道路类型
      DTE_NavSpeedLimit: type=ADT_ICC_enum_NavSpeedLimit  # 导航限速值
      DTE_NavSpeedLimitUnits: type=ADT_ICC_enum_NavSpeedLimitUnits  # 导航限速单位
      DTE_NavSpeedLimitType: type=ADT_ICC_enum_NavSpeedLimitType  # 导航限速类型
      DTE_NavRampInfo: type=ADT_ICC_enum_NavRampInfo  # 前方路口匝道信息
      DTE_NavRampDistance: type=ADT_DataUint16  # 前方匝道距离
      DTE_NavRoundabouts: type=ADT_Gen_val_unit8  # 圆环限速信息
      DTE_NavJunctions: type=ADT_Gen_val_unit8  # 交叉口距离信息
      DTE_NavWinding: type=ADT_DataUint16  # 前方道路弯曲角度
      DTE_NavTrafficlights: type=ADT_Gen_val_unit8  # 前方红绿灯距离信息
      DTE_NavRainSpeedLimit: type=ADT_Gen_val_unit8  # 雨天道路限速值
      DTE_NavSnowSpeedLimit: type=ADT_Gen_val_unit8  # 雪天道路限速值
      DTE_NavFogSpeedLimit: type=ADT_Gen_val_unit8  # 大雾道路限速值
      DTE_NavIsTimeSpeedLimit: type=ADT_ICC_enum_NavIsTimeSpeedLimit  # 时间限速状态
      DTE_NavTimeSpeedLimit: type=ADT_Gen_val_unit8  # 时间条件道路限速值
  app type ADT_ADAS_enum_HNOPSts: category=VALUE, compu {phys=raw for raw 0..255}, range phys 0..255
  app type ADT_IcaState: category=VALUE, compu {0=OFF, 1=ICA_STANDBY, 2=ICA_LATERAL_OVERRIDE, 3=ICA_LONGITUDINAL_OVERRIDE, 4=ICA_LAT_LONG_OVERRIDE, 5=ICA_ACTIVE, 255=INVALID}  # ICA状态信息
  application record data type ADT_ADAS_strt_APARPAInfo: category=STRUCTURE
    21 x application record element:
      DTE_ApaOperationResp: category=VALUE, type=ADT_ADAS_enum_ParkingOperationResp  # APARPA按键状态反馈
      DTE_ApaRpaSts: category=VALUE, type=ADT_ADAS_enum_ApaRpaSts  # APARPA状态机信息
      DTE_ParkingTypeSelectFb: category=VALUE, type=ADT_ADAS_enum_PicPocType  # 泊入泊出方式选择反馈
      DTE_ParkinDirectionSts: category=VALUE, type=ADT_ADAS_enum_ParkinDirectionSts  # 泊入方向状态反馈
      DTE_FreeParkSlotAvaSts: category=VALUE, type=ADT_Gen_enum_AvailableSts  # 自由泊入车位可用性状态
      DTE_ParkOutDirectionSt: category=VALUE, type=ADT_ADAS_enum_ParkOutDirectionSt  # 泊出方向状态
      DTE_POCFLParallelSts: category=VALUE, type=ADT_Gen_enum_ValidityStatus  # 左前平行泊出位置可用性
      DTE_POCFLCorssSts: category=VALUE, type=ADT_Gen_enum_ValidityStatus  # 左前垂直泊出位置可用性
      DTE_POCFRParallelSts: category=VALUE, type=ADT_Gen_enum_ValidityStatus  # 右前平行泊出位置可用性
      DTE_POCFRCrossSts: category=VALUE, type=ADT_Gen_enum_ValidityStatus  # 右前垂直泊出位置可用性
      DTE_POCFrontCrossSts: category=VALUE, type=ADT_Gen_enum_ValidityStatus  # 前方垂直泊出位置可用性
      DTE_POCRearCrossSts: category=VALUE, type=ADT_Gen_enum_ValidityStatus  # 后方垂直泊出位置可用性
      DTE_POCRLCrossSts: category=VALUE, type=ADT_Gen_enum_ValidityStatus  # 左后方垂直泊出位置可用性
      DTE_POCRRCrossSts: category=VALUE, type=ADT_Gen_enum_ValidityStatus  # 右后方垂直泊出位置可用性
      DTE_APAActiveFuncInd: category=VALUE, type=ADT_ADAS_enum_APAActiveFuncInd  # 自动泊车激活功能
      DTE_ApaSelectIDInd: category=VALUE, type=ADT_ADAS_val_SlotID  # 泊车选择的车位ID
      DTE_ParkingStopDist: category=VALUE, type=ADT_ADAS_val_ParkingDist  # 泊车剩余距离
      DTE_APARPATrajectory: category=ARRAY, type=ADT_ADAS_arr_TrajectoryPoint  # 泊车规划引导线
      DTE_RpaAvaliableStatus: category=VALUE, type=ADT_Gen_enum_AvailableSts  # Rpa可用状态
      DTE_ApaEgoVehPos: category=STRUCTURE, type=ADT_ADAS_strt_EgoPose  # 泊车位姿信息
      DTE_ApaTargetSlotInfo: category=STRUCTURE, type=ADT_ADAS_strt_ApaTargetSlotInfo  # 泊入目标车位信息
  app type ADT_ADAS_enum_TLRONOFFSts: category=VALUE, compu {phys=raw for raw 0..255}, range phys 0..255  # 交通灯识别系统开关状态
  application record data type ADT_CellularCellMapInfo: category=STRUCTURE  # 小区网络地图信息
    7 x application record element:
      DTE_cellId: category=VALUE, type=ADT_CellularCellId  # 小区信息
      DTE_mcc: category=VALUE, type=ADT_CellularMcc  # 移动国家码
      DTE_mnc: category=VALUE, type=ADT_CellularMnc  # 移动网络码
      DTE_rat: category=VALUE, type=ADT_CellularRat  # 网络制式
      DTE_frequency: category=VALUE, type=ADT_CellularFrequency  # 频点
      DTE_pci: category=VALUE, type=ADT_CellularPci  # PCI
      DTE_reservedByteArray: category=ARRAY, type=ADT_CellularCellMapInfoReserved  # 预留字段
  app type ADT_ADAS_enum_MAASts: category=VALUE, compu {phys=raw for raw 0..255}, range phys 0..255
  application array data type ADT_NaviStatus_arr_Reserved: category=ARRAY
    element ADT_NaviStatus_arr_Reserved: category=VALUE, type=ADT_Reserved_int32_Type, array-size-semantics=FIXED-SIZE, max-number-of-elements=20
  application record data type ADT_ADAS_strt_ParkingSlot: category=STRUCTURE
    9 x application record element:
      DTE_SlotID: category=VALUE, type=ADT_ADAS_val_SlotID  # 车位ID
      DTE_SlotType: category=VALUE, type=ADT_ADAS_enum_SlotType  # 车位类型
      DTE_SlotStatus: category=VALUE, type=ADT_ADAS_enum_SlotStatus  # 车位可用状态
      DTE_SlotPointTop1: category=STRUCTURE, type=ADT_ADAS_strt_SlotPoint  # 车位顶点1
      DTE_SlotPointTop2: category=STRUCTURE, type=ADT_ADAS_strt_SlotPoint  # 车位顶点2
      DTE_SlotPointBottom1: category=STRUCTURE, type=ADT_ADAS_strt_SlotPoint  # 车位顶点3
      DTE_SlotPointBottom2: category=STRUCTURE, type=ADT_ADAS_strt_SlotPoint  # 车位顶点4
      DTE_SlotNum: category=VALUE, type=ADT_Gen_val_ID  # 车位序号
      DTE_SlotWheelStopperInfo: category=STRUCTURE, type=ADT_ADAS_strt_SlotWheelStopperInfo  # 车位轮挡信息
  application record data type ADT_EphemerisDataInfo: category=STRUCTURE  # 星历数据信息
    6 x application record element:
      DTE_ephemerisDataType: category=VALUE, type=ADT_EphemerisDataType  # 星历数据类型
      DTE_ephemerisDataFormat: category=VALUE, type=ADT_EphemerisDataFormat  # 星历数据格式
      DTE_ephemerisDataIndexTotal: category=VALUE, type=ADT_ephemerisDataIndexTotal  # 星历数据一共有几包
      DTE_ephemerisDataIndex: category=VALUE, type=ADT_EphemerisDataIndex  # 星历数据索引
      DTE_ephemerisDataLength: category=VALUE, type=ADT_EphemerisDataLength  # 星历数据长度
      DTE_ephemerisDataByteArray: category=ARRAY, type=ADT_EphemerisDataByteArray  # 星历数据消息通道
  7 x app type, all with category=VALUE:
    ADT_ICC_int32_LastSeconds: compu {phys=raw for raw 0..2147483647}, range phys 0..2147483647
    ADT_ICC_int32_CameraPriority: compu {phys=raw for raw 0..2147483647}, range phys 0..2147483647  # 电子眼显示优先级
    ADT_ICC_boolean_isVariable: compu {phys=raw for raw 0..2147483647}, range phys 0..2147483647  # 是否可变限速电子眼
    ADT_Enum_TBOXOTARemoteAPPTSet: compu {0=OTARemoteAPPTSetNoResp, 1=OTARemoteAPPTSetResp}, range phys 0..255  # 远控OTA预约升级
    ADT_ICC_int32_StandardType: compu {phys=raw for raw 0..2147483647}, range phys 0..2147483647  # 灯规格类型
    ADT_ICC_enum_ISLISpdOffsetMod: compu {phys=raw for raw 0..255}, range phys 0..255  # 限速设置方式（预留）
    ADT_DataUint16: compu {phys=raw for raw 0..65535}, range phys 0..65535  # 无符号16位整型
  application record data type ADT_ADAS_strt_MNPInfo_2: category=STRUCTURE
    16 x application record element:
      DTE_MNPSts: category=VALUE, type=ADT_ADAS_enum_MNPSts  # MNP工作状态
      DTE_MNPBuildMapSts: category=VALUE, type=ADT_ADAS_enum_MNPBuildMapSts  # MNP建图工作状态
      DTE_MNPNewRoute: category=VALUE, type=ADT_ADAS_enum_MNPNewRoute  # 可以新建路线提示
      DTE_MNPRouteMileage: category=VALUE, type=ADT_ADAS_enum_MNPRouteMileage  # 当前记忆里程数
      DTE_MNPRouteSaving: category=VALUE, type=ADT_ADAS_enum_MNPNewRouteSaving  # 记忆路线保存进度
      DTE_MNPMemRoutesNum: category=VALUE, type=ADT_ADAS_arr_MNPMemRoutesNum  # 已记忆路线数量
      DTE_MNPRouteAvailable: category=VALUE, type=ADT_ADAS_enum_MNPRouteAvailable  # 记忆路线推荐提示
      DTE_MNPBuildMapTextInfomation: category=VALUE, type=ADT_ADAS_enum_MNPBuildMapTextInfo  # 记忆行车建图阶段文言提示信息
      DTE_MNPUseMapTextInfomation: category=VALUE, type=ADT_ADAS_enum_MNPUseMapTextInfo  # 记忆行车使用阶段文言提示信息
      DTE_MNPDelRouteID: category=STRING, type=ADT_Str_MemRouteInfo  # 删除的路线ID
      DTE_MNPDelRouteSts: category=VALUE, type=ADT_ADAS_enum_MNPDelRouteSts  # 删除路线是否成功
      DTE_MNPNewRouteBtnSt: category=VALUE, type=ADT_ADAS_enum_MNPNewRouteBtnSt  # 新建路线按钮高亮提示
      DTE_MNPStopMemRouteDrawing: category=VALUE, type=ADT_ADAS_enum_MNPStopMemRouteDrawing  # 通知导航停止记忆路线的描画
      DTE_MNPNewMapInfo: category=STRUCTURE, type=ADT_ADAS_strt_MNPRouteInfo  # 新建路线信息
      DTE_MNPAllRoutesStateInfo: category=ARRAY, type=ADT_ADAS_arr_MNPRoutesStateInfo  # 全部路线的状态信息
      DTE_MNPInfoReserved: category=ARRAY, type=ADT_MNPInfo_arr_Reserved2  # 预留
  6 x app type, all with category=VALUE:
    ADT_EcallMode: compu {phys=raw for raw 0..255}, range phys 0..255  # Ecall触发方式
    ADT_ICC_int32_NaviMode: compu {phys=raw for raw 0..2147483647}, range phys 0..2147483647
    ADT_ICC_enum_SetPathLabel: compu {phys=raw for raw 0..255}, range phys 0..255
    ADT_Enum_CertificateIssuedMark: compu {phys=raw for raw 0..7}, range phys 0..7  # 已下发标识
    ADT_ICC_enum_FSRACruiseSpdMod: compu {phys=raw for raw 0..255}, range phys 0..255  # 设定巡航车速模式
    ADT_Enum_AvmCamCalPrmsReq: compu {phys=raw for raw 0..255}, range phys 0..255  # 获取环视相机标定参数（含内外参） Retrieve AVM Camera Calibration Parameters (Intrinsic & Extrinsic)
  application record data type ADT_ADAS_strt_AebTargetObjInfo_2: category=STRUCTURE  # FCW AEB目标信息
    6 x application record element, all with category=VALUE:
      DTE_TargetObjID: type=ADT_ADAS_uint64_TargetObjID  # 目标ID
      DTE_TargetObjColor: type=ADT_ADAS_enumTargetObjColor  # 目标颜色
      DTE_TargetObjType: type=ADT_ADAS_enumTargetObjType  # 目标类型
      DTE_TargetObjPosX: type=ADT_Gen_val_Coordinate_X  # 目标X向距离
      DTE_TargetObjPosY: type=ADT_Gen_val_Coordinate_Y  # 目标Y向距离
      DTE_TargetObjSpdX: type=ADT_ADAS_val_vehicleSpd  # 目标纵向速度
  application array data type ADT_ICC_arr_NaviWeatherInfo: category=ARRAY, dynamic-array-size-profile=VSA_LINEAR  # 天气详细信息
    element ADT_ICC_arr_NaviWeatherInfo: category=STRUCTURE, type=ADT_ICC_strt_NaviWeatherInfo_1, array-size-handling=ALL-INDICES-SAME-ARRAY-SIZE, array-size-semantics=VARIABLE-SIZE, max-number-of-elements=10
  application record data type ADT_ICC_strt_VpaSelectZoneInfo: category=STRUCTURE
    5 x application record element, all with category=VALUE:
      DTE_SelectZoneID: type=ADT_ICC_uint32_SelectZoneID  # 选择区域ID
      DTE_SelectZoneType: type=ADT_ICC_enum_SelectZoneType  # 选择区域类型
      DTE_SelectZoneFloor: type=ADT_ICC_enum_SelectZoneFloor  # 选择区域所在楼层
      DTE_SelectZonePos_X: type=ADT_ICC_float_SelectZonePos_X  # 选择区域X坐标
      DTE_SelectZonePos_Y: type=ADT_ICC_float_SelectZonePos_Y  # 选择区域Y坐标
  app type ADT_Enum_FreeparkMagModeBtnSt: category=VALUE, compu {phys=raw for raw 0..255}, range phys 0..255  # 一键贴边按钮 One-click edge pressing button
  application record data type ADT_ADAS_strt_VPAParkingInfo: category=STRUCTURE  # VPA的功能状态信息
    19 x application record element:
      DTE_VPAParkingSts: category=VALUE, type=ADT_ADAS_enum_VPAStation  # VPA的状态
      DTE_VPAParkingQuitInd: category=VALUE, type=ADT_ADAS_enum_VPAQuitInd  # VPA退出提示
      DTE_VPAParkingDriOperateInd: category=VALUE, type=ADT_ADAS_enum_VPADriOperateInd  # VPA驾驶员操作提示
      DTE_VPAParkingPauseInd: category=VALUE, type=ADT_ADAS_enum_VPAPauseInd  # VPA暂停提示
      DTE_VPAParkingFailureReasonInd: category=VALUE, type=ADT_ADAS_enum_VPAFailureReasonInd  # VPA故障原因
      DTE_VPAParkingVoiceRemind: category=VALUE, type=ADT_ADAS_enum_VPAVoiceRemind  # VPA语音提示
      DTE_VPABuildMapDistance: category=VALUE, type=ADT_Gen_val_float32  # VPA建图距离
      DTE_VPABuildMapProgress: category=VALUE, type=ADT_DataUint8  # VPA生成大地图的进度
      DTE_VPABuildMapParkingSlotNumber: category=VALUE, type=ADT_DataUint32  # VPA已经学习的车位数量
      DTE_VPABuildMapLayerNumber: category=VALUE, type=ADT_DataUint16  # VPA已经 学习了多少层
      DTE_VPACurrentLayer: category=VALUE, type=ADT_ADAS_enum_VPAFloor  # VPA车辆所在当前层
      DTE_VPACurisingDistance: category=VALUE, type=ADT_Gen_val_float32  # VPA巡航剩余距离
      DTE_VPAGlobalRouting: category=ARRAY, type=ADT_ADAS_arr_VPARoadLine  # VPA全局轨迹线
      DTE_VPADrivingTrajectoryPoint: category=ARRAY, type=ADT_ADAS_arr_TrajectoryPoint  # 决策引导线
      DTE_VPACurrentParkingLotID: category=VALUE, type=ADT_Gen_val_ID  # 当前位于的停车场ID
      DTE_VPABuildMapMaxDistance: category=VALUE, type=ADT_Gen_val_float32  # 支持的最大建图距离
      DTE_VPACrusingProgress: category=VALUE, type=ADT_DataUint8  # 代客泊车进度条
      DTE_VPARpaToggleBtnDisp: category=VALUE, type=ADT_DataUint8  # 是否显示遥控泊车开关
      DTE_VPAButtonStatus: category=VALUE, type=ADT_ADAS_enum_VPAButtonStatus  # 驾驶员请求手动建图反馈信号
  app type ADT_ADAS_enum_AESDirection: category=VALUE, compu {phys=raw for raw 0..255}, range phys 0..255
  application array data type ADT_ADASSettingInfo_arr_Reserved2: category=ARRAY  # 预留
    element ADT_ADASSettingInfo_arr_Reserved2: category=VALUE, type=ADT_Reserved_uint8_Type, array-size-semantics=FIXED-SIZE, max-number-of-elements=89
  application record data type ADT_SensitiveState: category=STRUCTURE  # 敏感状态
    application record element DTE_permissionId: category=VALUE, type=ADT_PermissionId  # 权限ID
    application record element DTE_permissionConfigState: category=VALUE, type=ADT_PermissionConfigState  # 权限的开关值
  app type ADT_Enum_SNRInfo: category=VALUE, compu {phys=raw for raw 0..255; unit dBHz}, range phys 0..255  # 信噪比信息 Signal-to-noise ratio information
  application array data type ADT_ADAS_arr_HPATrajectoryPoint: category=ARRAY
    element ADT_ADAS_arr_HPATrajectoryPoint: category=STRUCTURE, type=ADT_ADAS_strt_HPAVPAPathInfo, array-size-semantics=FIXED-SIZE, max-number-of-elements=64
  app type ADT_Enum_CarrierInfo: category=VALUE, compu {phys=raw for raw 0..9999.999; unit MHz}, range phys 0..9999.999  # 载波频率信息 Carrier frequency information
  app type ADT_StrVar_Telephonenumber: category=STRING, sw-text-props={array-size-semantics=VARIABLE-SIZE, sw-max-text-size=15, base-type=UTF_8}  # 电话号码
  application array data type ADT_ICC_arr_CameraSpeed: category=ARRAY, dynamic-array-size-profile=VSA_LINEAR
    element ADT_ICC_arr_CameraSpeed: category=STRUCTURE, type=ADT_ICC_strt_CameraSpeed, array-size-handling=ALL-INDICES-SAME-ARRAY-SIZE, array-size-semantics=VARIABLE-SIZE, max-number-of-elements=10
  app type ADT_ADAS_Seg_PathIdx: category=VALUE, compu {phys=raw for raw 0..63}, range phys 0..63
  application record data type ADT_ADAS_strt_ActiveSafetyFcnInfo_2: category=STRUCTURE
    10 x application record element:
      DTE_FcwSts: category=VALUE, type=ADT_ADAS_enum_FcwSts  # FCW功能状态
      DTE_AebSts: category=VALUE, type=ADT_ADAS_enum_AebSts  # AEB功能状态
      DTE_FcwWarnDist: category=VALUE, type=ADT_ADAS_enum_FcwWarnDist  # FCW报警距离
      DTE_FcwAcitveSt: category=VALUE, type=ADT_ADAS_enum_FcwAcitveSt  # FCW执行状态
      DTE_AebAcitveSt: category=VALUE, type=ADT_ADAS_enum_AebAcitveSt  # AEB执行状态
      DTE_FCWAEBTextInfomation: category=VALUE, type=ADT_ADAS_enum_FCWAEBTextInfo  # FCW/AEB文言提示信息
      DTE_FCTAWarnTypeSts: category=VALUE, type=ADT_ADAS_enum_FCTAWarnTypeSts  # FCTA报警类型状态
      DTE_FCTAWarningActiveSt: category=VALUE, type=ADT_ADAS_enum_FCTAWarnActSt  # FCTA报警执行状态
      DTE_FCTBWarningActiveSt: category=VALUE, type=ADT_ADAS_enum_FCTBWarnActSt  # FCTB报警执行状态
      DTE_ActiveSafetyFcnReserved: category=ARRAY, type=ADT_ActiveSafetyFcn_arr_Reserved  # 预留
  application record data type ADT_IcaNcaL3State: category=STRUCTURE  # ICA/L2NCA/L3智驾激活与否状态信息扩展
    4 x application record element:
      DTE_icaState: category=VALUE, type=ADT_IcaState  # ICA状态信息
      DTE_l2NCAState: category=VALUE, type=ADT_L2NCAState  # L2NCA状态信息
      DTE_l3state: category=VALUE, type=ADT_L3state  # L3智驾状态信息
      DTE_reserved: category=ARRAY, type=ADT_IcaNcaL3StateReserved  # 预留字段
  application array data type ADT_ADAS_arr_HPAPathslot_2: category=ARRAY, dynamic-array-size-profile=VSA_LINEAR
    element ADT_ADAS_arr_HPAPathslot_2: category=STRUCTURE, type=ADT_ADAS_strt_ParkingSlot_2, array-size-handling=ALL-INDICES-SAME-ARRAY-SIZE, array-size-semantics=VARIABLE-SIZE, max-number-of-elements=2000
  app type ADT_ADAS_val_HNOACruiseSpdOffsetSpdFb: category=VALUE, compu {phys=raw for raw -20..20; unit kph}, range phys -20..20  # 固定偏移速度反馈
  app type ADT_ICC_float_Speed: category=VALUE, compu {phys=raw for raw 0..360; unit km/h}, range phys 0..360
  app type ADT_Longitude: category=VALUE, compu {phys=raw for raw 0..10000}, range phys 0..10000
  application array data type ADT_ValetParkingStatusReserved: category=ARRAY  # 代客泊车实时信息预留
    element ADT_ValetParkingStatusReserved: category=VALUE, type=ADT_ADS_ReservedUnit8, array-size-semantics=FIXED-SIZE, max-number-of-elements=16
  app type ADT_ADAS_enum_TolAutoAvoidObstacle: category=VALUE, compu {phys=raw for raw 0..18446744073709551615; unit pcs}, range phys 0..18446744073709551615  # 自动避障（避障变道和避障bypass）
  app type ADT_ADAS_enum_TrafficLightType: category=VALUE, compu {phys=raw for raw 0..255}, range phys 0..255
  app type ADT_Millisecond: category=VALUE, compu {phys=raw for raw 0..4294967295}, range phys 0..4294967295  # 通话时间
  application record data type ADT_ICC_strt_NaviIntCameraDynInfo: category=STRUCTURE
    6 x application record element:
      DTE_NaviIntDistance: category=VALUE, type=ADT_ICC_int32_Dist  # 区间测速电子眼长度
      DTE_NaviIntRemainDistance: category=VALUE, type=ADT_ICC_int32_Dist  # 进入区间测速路段后实时的区间路段剩余距离
      DTE_NaviIntAverageSpeed: category=VALUE, type=ADT_ICC_int32_Speed  # 进入区间测速路段后的实时平均车速
      DTE_ReasonableSpeed: category=VALUE, type=ADT_ICC_int32_Speed  # 进入区间测速路段后的剩余路段的合理车速
      DTE_NaviIntCameraSpeedLimit: category=ARRAY, type=ADT_ICC_arr_CameraSpeed  # 区间测速电子眼限速
      DTE_NaviIntCameraDynReserved: category=ARRAY, type=ADT_NaviIntCameraDyn_arr_Reserved  # 预留
  application array data type ADT_ADAS_arr_DrivingTrajectoryPointList: category=ARRAY, dynamic-array-size-profile=VSA_LINEAR  # 轨迹形点数组
    element ADT_ADAS_arr_DrivingTrajectoryPointList: category=STRUCTURE, type=ADT_ADAS_strt_DrivingTrajectoryPoint, array-size-handling=ALL-INDICES-SAME-ARRAY-SIZE, array-size-semantics=VARIABLE-SIZE, max-number-of-elements=1000
  app type ADT_quitFactoryResetResponse: category=VALUE, compu {0=QUITFACTORYRESETRESPONSE_SUCESS, 1=QUITFACTORYRESETRESPONSE_FAILURE, 2=QUITFACTORYRESETRESPONSE_NOT_USED}  # 退出恢厂状态响应
  application record data type ADT_ICC_strt_NaviCameraExt: category=STRUCTURE
    11 x application record element:
      DTE_CameraId: category=VALUE, type=ADT_Gen_int32_ID  # 电子眼id
      DTE_CameraSegmentIdx: category=VALUE, type=ADT_ICC_int32_Index  # 电子眼所在segment索引
      DTE_CameraLinkIndex: category=VALUE, type=ADT_ICC_int32_Index  # 电子眼所在link索引
      DTE_CameraDistance: category=VALUE, type=ADT_ICC_int32_Dist  # 自车到电子眼距离
      DTE_CameraDistanceToEnd: category=VALUE, type=ADT_ICC_int32_Dist  # 电子眼到Link终点的距离(单位:米, 仅导航场景生效）
      DTE_CameraRoadClass: category=VALUE, type=ADT_ICC_int32_RoadClass  # 电子眼所在道路的道路等级
      DTE_CameraisHidden: category=VALUE, type=ADT_ICC_boolean_Hidden  # 是否隐藏式电子眼
      DTE_CameraCoord2D: category=STRUCTURE, type=ADT_ICC_strt_Coord2DDouble  # 摄像头位置坐标
      DTE_CameraCoord3D: category=STRUCTURE, type=ADT_ICC_strt_Coord3DDouble  # 摄像头位置坐标
      DTE_SubCameras: category=ARRAY, type=ADT_ICC_arr_NaviSubCameraExt  # 电子眼细类
      DTE_NaviCameraExtReserved: category=ARRAY, type=ADT_NaviCameraExt_arr_Reserved  # 预留
  app type ADT_ADAS_enum_HPAFloor: category=VALUE, compu {phys=raw for raw 0..255}, range phys 0..255
  application record data type ADT_ICC_strt_TmcInfoDataBean: category=STRUCTURE
    6 x application record element:
      DTE_TmcInfoNumber: category=VALUE, type=ADT_Gen_val_int32  # 路况柱状图每段的编号，编号越小越靠近起点，从1开始
      DTE_TmcInfoStatus: category=VALUE, type=ADT_ICC_int32_TmcInfoStatus  # 每段柱状图信息
      DTE_TmcInfoDistance: category=VALUE, type=ADT_ICC_int32_Dist  # 路况柱状图每段的路程距离，单位米
      DTE_TmcInfoPercent: category=VALUE, type=ADT_ICC_float_Percent  # 每段路况柱状图占总路程的百分比（0～1）
      DTE_TmcInfoTravelTime: category=VALUE, type=ADT_ICC_int32_Time  # 路况柱状图每一段的预计通行时间，单位s
      DTE_TmcInfoReserved: category=ARRAY, type=ADT_TmcInfo_arr_Reserved  # 预留
  application array data type ADT_ICAInfo_arr_Reserved: category=ARRAY  # 预留
    element ADT_ICAInfo_arr_Reserved: category=VALUE, type=ADT_Reserved_uint8_Type, array-size-semantics=FIXED-SIZE, max-number-of-elements=40
  app type ADT_ResponseVhrCancelRemoteCall: category=VALUE, compu {0=RESPONSEVHRCANCELREMOTECALL_SUCCESS, 1=RESPONSEVHRCANCELREMOTECALL_ERROR, 1001=RESPONSEVHRCANCELREMOTECALL_RELATEDIDNOTEXIST}  # 取消VHR日志远程调取--响应
  app type ADT_StrVar_BleSlaverRightMac: category=STRING, sw-text-props={array-size-semantics=VARIABLE-SIZE, sw-max-text-size=24, base-type=UTF_8}  # 蓝牙右从模块 MAC 地址
  application array data type ADT_Arr_AvmCamCalPrms: category=ARRAY  # 环视相机标定参数（含内外参） AVM Camera Calibration Parameters (Intrinsic & Extrinsic)
    element ADT_Arr_AvmCamCalPrms: category=VALUE, type=ADT_Enum_CamCalPrmsData, array-size-semantics=FIXED-SIZE, max-number-of-elements=832
  10 x app type:
    ADT_ADAS_enum_NarrowRoadAssistSts: category=VALUE, compu {phys=raw for raw 0..255}, range phys 0..255  # 窄路辅助功能状态
    ADT_Enum_Roaming: category=VALUE, compu {phys=raw for raw 0..1}, range phys 0..1  # 是否出于漫游中
    ADT_ADAS_Seg_Tunnel: category=VALUE, compu {phys=raw for raw 0..3}, range phys 0..3
    ADT_ADAS_val_OCCNum: category=VALUE, compu {phys=raw for raw 0..65535}, range phys 0..65535  # freespace个数
    ADT_StrVar_HardwareVersion: category=STRING, sw-text-props={array-size-semantics=VARIABLE-SIZE, sw-max-text-size=10, base-type=UTF_8}  # 硬件版本号
    ADT_Flt_GndSpdInfo: category=VALUE, compu {phys=raw for raw 0..100; unit m/s}, range phys 0..100  # 地面速度 (米每秒)信息 Ground velocity (meters per second) information
    ADT_StrVar_HDMap: category=STRING, sw-text-props={array-size-semantics=VARIABLE-SIZE, sw-max-text-size=128, base-type=UTF_8}
    ADT_ADAS_enum_MNPMemRouteUseFreq: category=VALUE, compu {phys=raw for raw 0..255}, range phys 0..255  # 路线使用频率
    ADT_ADAS_Seg_DividedRoad: category=VALUE, compu {phys=raw for raw 0..3}, range phys 0..3
    ADT_ADAS_ProfShort_CtrlPoint: category=VALUE, compu {phys=raw for raw 0..1}, range phys 0..1
  application record data type ADT_Struct_NOA_SDMapSegmentInfo: category=STRUCTURE  # 标准地图信息_Segment
    18 x application record element, all with category=VALUE:
      DTE_Seg_MsgType: type=ADT_ADAS_MsgType  # 标识该消息为segmentMessage
      DTE_Seg_CycCnt: type=ADT_ADAS_Seg_CycCnt  # EGMENTMessage的循环计数器:重构器可以用这个值来检测丢失的消息
      DTE_Seg_PathIdx: type=ADT_ADAS_Seg_PathIdx  # 这个segment所属于的path的索引值
      DTE_Seg_Offset: type=ADT_ADAS_Seg_Offset  # 当前segment起点到该Path起点的距离
      DTE_Seg_Update: type=ADT_ADAS_Seg_Update  # Segment更新
      DTE_Seg_FuncRoadClass: type=ADT_ADAS_Seg_FuncRoadClass  # segmentFRC信息（对应道路类型，主路）
      DTE_Seg_FormOfWay: type=ADT_ADAS_Seg_FormOfWay  # egment道路设施信息（对应匝道信息，主路及需要进入）
      DTE_Seg_EffSpdLmt: type=ADT_ADAS_Seg_EffSpdLmt  # segment限速信息
      DTE_Seg_EffSpdLmtType: type=ADT_ADAS_Seg_EffSpdLmtType  # segment有效限速类型信息。其中0x5高德内部拓展为测速电子眼类别
      DTE_Seg_NumOfLaneDrvDir: type=ADT_ADAS_Seg_NumOfLaneDrvDir  # segment行车方向车道数信息
      DTE_Seg_NumOfLaneOppDir: type=ADT_ADAS_Seg_NumOfLaneOppDir  # segment行车反向车道数信息
      DTE_Seg_Tunnel: type=ADT_ADAS_Seg_Tunnel  # segment隧道信息
      DTE_Seg_Bridge: type=ADT_ADAS_Seg_Bridge  # segment桥信息
      DTE_Seg_DividedRoad: type=ADT_ADAS_Seg_DividedRoad  # segment隔离带信息
      DTE_Seg_BuildUpArea: type=ADT_ADAS_Seg_BuildUpArea  # segment 所在位置是城市/郊区信息
      DTE_Seg_CmplxInsct: type=ADT_ADAS_Seg_CmplxInsct  # segment复杂路口信息
      DTE_Seg_RelProbb: type=ADT_ADAS_Seg_RelProbb  # 相比在同一条path的上一个segment，这段segment的相对概率
      DTE_Seg_PartOfCalcRoute: type=ADT_ADAS_Seg_PartOfCalcRoute  # segment是否是规划路径信息
  application array data type ADT_CruiseFacility_arr_Reserved: category=ARRAY
    element ADT_CruiseFacility_arr_Reserved: category=VALUE, type=ADT_Reserved_int32_Type, array-size-semantics=FIXED-SIZE, max-number-of-elements=20
  app type ADT_ADAS_enum_ISLISpdLimType: category=VALUE, compu {phys=raw for raw 0..255}, range phys 0..255
  app type ADT_ICC_enum_Cause: category=VALUE, compu {phys=raw for raw 0..255}, range phys 0..255  # 拥堵原因
  application record data type ADT_ADAS_strt_LaneLine: category=STRUCTURE
    13 x application record element, all with category=VALUE:
      DTE_lineIndex: type=ADT_ADAS_enum_LinePositionIndex  # 车道线索引
      DTE_lineId: type=ADT_Gen_val_ID  # 车道线ID
      DTE_lineColor: type=ADT_ADAS_enum_LineColor  # 车道线颜色
      DTE_lineType: type=ADT_ADAS_enum_LineType  # 车道线类型
      DTE_lineEquation_C{0..3}: type=ADT_ADAS_val_LineEquation_C{0..3}  # 车道线方程C{0..3}
      DTE_laneLineWidth: type=ADT_Gen_val_float32  # 车道线宽度
      DTE_lineStart_X: type=ADT_Gen_val_Coordinate_X  # 车道线起点X坐标
      DTE_lineStart_Y: type=ADT_Gen_val_Coordinate_Y  # 车道线起点Y坐标
      DTE_lineEnd_X: type=ADT_Gen_val_Coordinate_X  # 车道线终止点X坐标
      DTE_lineEnd_Y: type=ADT_Gen_val_Coordinate_Y  # 车道线终止点Y坐标
  app type ADT_ICC_enum_NavSpeedLimitType: category=VALUE, compu {phys=raw for raw 0..255}, range phys 0..255  # 导航限速类型
  app type ADT_ADAS_Posn_Spd: category=VALUE, compu {phys=raw for raw 0..511; unit m/s}, range phys 0..511
  application array data type ADT_ALCInfo_arr_Reserved: category=ARRAY  # 预留
    element ADT_ALCInfo_arr_Reserved: category=VALUE, type=ADT_Reserved_uint8_Type, array-size-semantics=FIXED-SIZE, max-number-of-elements=46
  app type ADT_ICC_int32_LaneCategoryType: category=VALUE, compu {phys=raw for raw 0..2147483647}, range phys 0..2147483647
  application record data type ADT_ADAS_strt_IHCInfo: category=STRUCTURE
    application record element DTE_IHC_Status: category=VALUE, type=ADT_ADAS_enum_IHC_Status  # IHC功能状态
    application record element DTE_IHCTextInfomation: category=VALUE, type=ADT_ADAS_enum_IHCTextInfo  # IHC文言提示信息
    application record element DTE_IHCInfoReserved: category=ARRAY, type=ADT_IHCInfo_arr_Reserved  # 预留
  13 x app type:
    ADT_ICC_enum_HPASettingSt: category=VALUE, compu {phys=raw for raw 0..255}, range phys 0..255  # HPA功能设置状态
    ADT_ADAS_enum_ESSActiveSt: category=VALUE, compu {phys=raw for raw 0..255}, range phys 0..255
    ADT_ICC_enum_SelectZoneFloor: category=VALUE, compu {phys=raw for raw 0..255}, range phys 0..255
    ADT_ADAS_string_VPASpotName: category=STRING, sw-text-props={array-size-semantics=VARIABLE-SIZE, sw-max-text-size=50, base-type=UTF_8}  # VPA车位名
    ADT_Enum_UpdSta: category=VALUE, compu {phys=raw for raw 0..255}, range phys 0..255  # TBOX升级状态
    ADT_ADAS_enum_ALCSts: category=VALUE, compu {phys=raw for raw 0..255}, range phys 0..255
    ADT_FactoryResetResult: category=VALUE, compu {1=FACTORYRESETRESULT_NOT_USED, 2=FACTORYRESETRESULT_FACTORYRESETSUCCESS, 3=FACTORYRESETRESULT_FACTORYRESETFAILURE}  # 恢厂执行结果
    ADT_ADAS_enum_HandsOffWarningStyle: category=VALUE, compu {phys=raw for raw 0..255}, range phys 0..255  # 脱手报警风格
    ADT_keeptimelengthResponse: category=VALUE, compu {0=KEEPTIMELENGTHRESPONSE_SUCCESS, 1=KEEPTIMELENGTHRESPONSE_FAILURE, 2=KEEPTIMELENGTHRESPONSE_NOT_USED}  # 保持恢厂状态时长响应
    ADT_ICC_string_EventId: category=STRING, sw-text-props={array-size-semantics=VARIABLE-SIZE, sw-max-text-size=100, base-type=UTF_8}
    ADT_ICC_enum_ELKSettingSt: category=VALUE, compu {phys=raw for raw 0..255}, range phys 0..255  # ELK功能设置状态
    ADT_ICC_boolean_Valid: category=VALUE, compu {phys=raw for raw 0..2147483647}, range phys 0..2147483647
    ADT_SentryModePlanStartTime_date: category=VALUE, compu {phys=raw for raw 0..4294967295}, range phys 0..4294967295  # 哨兵模式预约开启时间（年月日）
  application array data type ADT_LocMatchInfo_arr_Reserved: category=ARRAY  # 预留
    element ADT_LocMatchInfo_arr_Reserved: category=VALUE, type=ADT_Reserved_int32_Type, array-size-semantics=FIXED-SIZE, max-number-of-elements=50
  4 x app type, all with category=VALUE:
    ADT_ICC_enum_LKSSettingSt: compu {phys=raw for raw 0..255}, range phys 0..255  # LDW/LDP功能设置状态
    ADT_ADAS_enum_TolRespondCongestion: compu {phys=raw for raw 0..18446744073709551615; unit pcs}, range phys 0..18446744073709551615  # 应对加塞
    ADT_OTAUtcSecs: compu {phys=raw for raw 0..4294967295}, range phys 0..4294967295  # 预约升级时间
    ADT_CellularCellNum: compu {phys=raw for raw 0..4294967295}, range phys 0..4294967295  # 小区数量
  application record data type ADT_WiFiConnStatus: category=STRUCTURE  # Wifi当前连接状态
    6 x application record element:
      DTE_wiFiApName: category=STRING, type=ADT_WiFiApName  # 登入热点ID
      DTE_wiFiCurConnStatus: category=VALUE, type=ADT_WiFiCurConnStatus  # 连接状态
      DTE_wiFiStrength: category=VALUE, type=ADT_WiFiStrength  # 信号强度
      DTE_wiFiUploadDataStatus: category=VALUE, type=ADT_WiFiUploadDataStatus  # 上行数据状态
      DTE_wiFiDownloadDataStatus: category=VALUE, type=ADT_WiFiDownloadDataStatus  # 下行数据状态
      DTE_wiFiLinkedInternet: category=VALUE, type=ADT_WiFiLinkedInternet  # 是否是可以上网
  app type ADT_Enum_AomCommand: category=VALUE, compu {phys=raw for raw 0..255}, range phys 0..255  # 高精画页中用户对NOP和ICA的控制命令
  application record data type ADT_ICC_strt_EndPoiInfo: category=STRUCTURE
    4 x application record element:
      DTE_EndPoiName: category=STRING, type=ADT_ICC_string_Name  # 名称
      DTE_EndPoiAddress: category=STRING, type=ADT_ICC_string_Address  # 地址
      DTE_EndPoNaviPos: category=STRUCTURE, type=ADT_ICC_strt_Coord2DDouble  # 经纬度信息
      DTE_EndPoiReserved: category=ARRAY, type=ADT_EndPoi_arr_Reserved  # 预留
  app type ADT_ICC_val_longitude: category=VALUE, compu {phys=raw for raw 0..180; unit degree}, range phys 0..180  # 经度
  application record data type ADT_ICC_strt_NaviWeatherInfo: category=STRUCTURE  # 天气信息
    application record element DTE_NaviPathID: category=VALUE, type=ADT_Gen_int64_ID  # 路线ID
    application record element DTE_NaviWeatherInfo: category=ARRAY, type=ADT_ICC_arr_NaviWeatherInfo  # 天气详细信息
    application record element DTE_NaviWeatherReserved: category=ARRAY, type=ADT_NaviWeather_arr_Reserved  # 预留
  application record data type ADT_SimSwitchEvent: category=STRUCTURE  # 切卡事件通知
    4 x application record element:
      DTE_simSwitchStatus: category=VALUE, type=ADT_SimSwitchStatus  # Sim切换状态
      DTE_simSwitchTargetMode: category=VALUE, type=ADT_SimMode  # Sim卡切换目标模式
      DTE_simSwitchTargetOperator: category=VALUE, type=ADT_SimOperator  # Sim卡切换目标运营商
      DTE_reserved: category=ARRAY, type=ADT_SimSwitchEventReserved  # 预留字段
  7 x app type, all with category=VALUE:
    ADT_L3state: compu {0=OFF, 1=L3_NCA_STANDBY, 2=L3_NCA_ACTIVE, 255=INVALID}  # L3智驾状态信息
    ADT_Enum_AziInfo: compu {phys=raw for raw 0..360; unit deg}, range phys 0..360  # 方位角信息 Azimuth information
    ADT_EphemerisDataIndex: compu {phys=raw for raw 0..2048}, range phys 0..2048  # 数据包索引，针对A/PGNSS，每次从1开始，每包递增，针对实时星历，固定填0
    ADT_ICC_enum_LearnOperationId: compu {phys=raw for raw 0..255}, range phys 0..255
    ADT_ICC_int32_RouteOption: compu {phys=raw for raw 0..2147483647}, range phys 0..2147483647  # 偏航
    ADT_ADAS_uint16_SurfaceMeshBevh: compu {phys=raw for raw 0..65535}, range phys 0..65535
    ADT_ICC_int32_FormWay: compu {phys=raw for raw -2147483648..2147483647}, range phys -2147483648..2147483647
  application array data type ADT_MRAInfo_arr_Reserved: category=ARRAY
    element ADT_MRAInfo_arr_Reserved: category=VALUE, type=ADT_Reserved_uint8_Type, array-size-semantics=FIXED-SIZE, max-number-of-elements=50
  5 x app type:
    ADT_ADAS_enum_MRACheckSts: category=VALUE, compu {phys=raw for raw 0..255}, range phys 0..255
    ADT_TimeInfoDay: category=VALUE, compu {phys=raw for raw 1..31}, range phys 1..31  # 日
    ADT_ADAS_Meta_SpdUnits: category=VALUE, compu {phys=raw for raw 0..1}, range phys 0..1
    ADT_StrVar_RouterIPAddress: category=STRING, sw-text-props={array-size-semantics=VARIABLE-SIZE, sw-max-text-size=30, base-type=UTF_8}  # 路由器IP
    ADT_ADAS_uint8_ScoreMap: category=VALUE, compu {phys=raw for raw 0..255}, range phys 0..255
  application record data type ADT_ICC_strt_MyLocationInfo: category=STRUCTURE  # 位置信息
    application record element DTE_MyLocationCurrentPos: category=STRUCTURE, type=ADT_ICC_strt_Coord3DDouble  # 自车经纬度
    application record element DTE_MyLocationSpeed: category=VALUE, type=ADT_ICC_float_Speed  # 自车车速 km/h
    application record element DTE_MyLocationReserved: category=ARRAY, type=ADT_MyLocation_arr_Reserved  # 预留
  app type ADT_ICC_boolean_Hidden: category=VALUE, compu {phys=raw for raw 0..2147483647}, range phys 0..2147483647
  app type ADT_Reserved_int32_Type: category=VALUE, compu {phys=raw for raw 0..2147483647}, range phys 0..2147483647
  app type ADT_ADAS_uint16_SurfaceMeshBevw: category=VALUE, compu {phys=raw for raw 0..65535}, range phys 0..65535
  application record data type ADT_Struct_ECUVersion: category=STRUCTURE  # ECU基本信息
    application record element DTE_EcuType: category=VALUE, type=ADT_Enum_EcuType  # ECU版本
    application record element DTE_EcuVerison: category=STRING, type=ADT_StrVar_EcuVerison  # ECU版本号
  application array data type ADT_TrafficLight_arr_Reserved: category=ARRAY
    element ADT_TrafficLight_arr_Reserved: category=VALUE, type=ADT_Reserved_int32_Type, array-size-semantics=FIXED-SIZE, max-number-of-elements=20
  application record data type ADT_ADAS_strt_UNOPfunctionInfo: category=STRUCTURE
    7 x application record element:
      DTE_UNOPSts: category=VALUE, type=ADT_ADAS_enum_UNOPSts  # 城市领航辅助状态
      DTE_SidePassConfirmReq: category=VALUE, type=ADT_ADAS_enum_SidePassConfirmReq  # 绕行请求驾驶员确认
      DTE_SidePassSt: category=VALUE, type=ADT_ADAS_enum_SidePassSt  # 绕行功能状态
      DTE_IntersectionDriBehavior: category=VALUE, type=ADT_ADAS_enum_IntersectionDriBehavior  # 十字路口行为
      DTE_UNOPScenariosReminder: category=VALUE, type=ADT_ADAS_enum_UNOPScenariosReminder  # HNOP场景提示信息
      DTE_UrbanTrafficLight: category=ARRAY, type=ADT_ADAS_arr_TrafficLight  # 城区交通灯信息
      DTE_TLRFcnSts: category=VALUE, type=ADT_Gen_enum_OnOffSts  # 交通灯状态反馈
  app type ADT_ADAS_val_ParkingProgressBarInd: category=VALUE, compu {phys=raw for raw 0..100; unit %}, range phys 0..100
  application array data type ADT_Arr_TollGateLaneInfo: category=ARRAY, dynamic-array-size-profile=VSA_LINEAR
    element ADT_Arr_TollGateLaneInfo: category=STRUCTURE, type=ADT_Strt_TollGateLaneInfo, array-size-handling=ALL-INDICES-SAME-ARRAY-SIZE, array-size-semantics=VARIABLE-SIZE, max-number-of-elements=50
  4 x app type, all with category=VALUE:
    ADT_ADAS_enum_ParkingButtonSts: compu {phys=raw for raw 0..255}, range phys 0..255
    ADT_ADAS_enum_MNPBuildMapTextInfo: compu {phys=raw for raw 0..255}, range phys 0..255  # 记忆行车建图阶段文言提示信息
    ADT_ICC_enum_NaviRoadType: compu {phys=raw for raw 0..255}, range phys 0..255
    ADT_Enum_VehicleDiag: compu {phys=raw for raw 0..1}, range phys 0..1  # 向TBOX请求车辆诊断
  application record data type ADT_ADAS_strt_HPATrainingPathInfo_2: category=STRUCTURE
    12 x application record element:
      DTE_HpaTrainingPathID: category=VALUE, type=ADT_Gen_val_ID  # 路线ID
      DTE_TrainingPathName: category=STRING, type=ADT_ADAS_string_PathName  # 路线名称
      DTE_HPAtrainingPathCurrentDist: category=VALUE, type=ADT_ADAS_val_ParkingDist  # 记忆泊车路线学习实时累计距离
      DTE_TrainingPathLength: category=VALUE, type=ADT_ADAS_val_ParkingDist  # 路线长度
      DTE_TrainingLinePoint: category=ARRAY, type=ADT_ADAS_arr_PathPoint_2  # 路线学习点集
      DTE_HPATrainingPathSlotInfo: category=ARRAY, type=ADT_ADAS_arr_HPAPathslot_2  # 路线记忆车位
      DTE_HPASpeedBumpInfo: category=ARRAY, type=ADT_ADAS_arr_HPASpeedBumpInfo  # 路线记忆减速带
      DTE_TrainingPathLabel: category=VALUE, type=ADT_ADAS_enum_PathLabel  # 路线标签
      DTE_HPATrainingStaticObject: category=ARRAY, type=ADT_ADAS_arr_HPAParkingStaticObjects  # 静态障碍物显示
      DTE_CompleteTrainingButtonSts: category=VALUE, type=ADT_ADAS_enum_ParkingButtonSts  # 完成学习按钮
      DTE_CompleteAndParkTrainingButtonSts: category=VALUE, type=ADT_ADAS_enum_ParkingButtonSts  # 泊入并完成学习按钮
      DTE_HPATrainingReserved: category=ARRAY, type=ADT_HPATraining_arr_Reserved  # 预留
  6 x app type, all with category=VALUE:
    ADT_Enum_TBOXOTAAPPTInstall: compu {0=OTAAPPTInstallNoResp, 1=OTAAPPTInstallResp}, range phys 0..255  # TBOX通知预约升级事件
    ADT_TimeInfoMinute: compu {phys=raw for raw 0..59}, range phys 0..59  # 分
    ADT_Enum_ADSRestartBtnSt: compu {phys=raw for raw 0..255}, range phys 0..255  # 域控制器一键重启按键 One-click restart button for the domain controller
    ADT_ADAS_enum_TolAutoRoadCrossingsNum: compu {phys=raw for raw 0..18446744073709551615; unit pcs}, range phys 0..18446744073709551615  # 自动过路口数量
    ADT_ADAS_enum_FCTAWarnActSt: compu {phys=raw for raw 0..255}, range phys 0..255  # FCTA报警执行状态
    ADT_ICC_int32_NaviStatus: compu {phys=raw for raw 0..2147483647}, range phys 0..2147483647
  application record data type ADT_OperatingSimInfo: category=STRUCTURE  # 当前使用的Sim卡信息
    application record element DTE_simCurrentOperator: category=VALUE, type=ADT_SimOperator  # 当前使用Sim的运营商
    application record element DTE_simCurrentMode: category=VALUE, type=ADT_SimMode  # 当前使用Sim卡的模式
    application record element DTE_OperatingSimInfoReserved: category=ARRAY, type=ADT_OperatingSimInfoReserved  # 预留字段
  app type ADT_DmsWarning: category=VALUE, compu {0=OFF, 1=Distraction_warning_level1, 2=Fatigue_warning_level1, 3=Distraction_warning_level2, 4=Fatigue_warning_level2, 5=Distraction_warning_level3, 6=Fatigue_warning_level3, 7=Distraction_tellphone_call, 8=Driver_Availability_level1, 9=Driver_Availability_level2, 10=Driver_Availability_level3, 255=INVALID}  # 智驾状态下的疲劳分神提醒
  application record data type ADT_Struct_ExtMMResWLnk: category=STRUCTURE  # 车道级地图匹配结果
    application record element DTE_timestamp: category=VALUE, type=ADT_DataUint64  # 时间戳ms
    application record element DTE_mode: category=VALUE, type=ADT_Enum_MatchingMode  # map match mode state, defined by enum MatchingMode
    application record element DTE_lane: category=STRUCTURE, type=ADT_Struct_LanePositionInfo  # Lane匹配信息 ，onlane，offlane状态参考mode
  app type ADT_ICC_enum_MNPEnableBtnSt: category=VALUE, compu {phys=raw for raw 0..255}, range phys 0..255  # 记忆领航功能使能开关
  application record data type ADT_ADAS_strt_RoadSurfaceMesh: category=STRUCTURE  # 可行驶区域渲染
    11 x application record element:
      DTE_SurfaceMeshAvailable: category=VALUE, type=ADT_ADAS_uint8_Available
      DTE_SurfaceMeshScoreMap: category=ARRAY, type=ADT_ADAS_arr_ScoreMap  # 网格置信度
      DTE_SurfaceMeshBevh: category=VALUE, type=ADT_ADAS_uint16_SurfaceMeshBevh
      DTE_SurfaceMeshBevw: category=VALUE, type=ADT_ADAS_uint16_SurfaceMeshBevw
      DTE_SurfaceMeshXboundMin: category=VALUE, type=ADT_ADAS_val_XboundMin
      DTE_SurfaceMeshXboundMax: category=VALUE, type=ADT_ADAS_val_XboundMax
      DTE_SurfaceMeshYboundMin: category=VALUE, type=ADT_ADAS_val_YboundMin
      DTE_SurfaceMeshYboundMax: category=VALUE, type=ADT_ADAS_val_YboundMax
      DTE_MeshMeterPerPixelx: category=VALUE, type=ADT_ADAS_val_MeterPerPixelx
      DTE_MeshMeterPerPixely: category=VALUE, type=ADT_ADAS_val_MeterPerPixely
      DTE_SurfaceMeshReserved: category=ARRAY, type=ADT_SurfaceMesh_arr_Reserved
  app type ADT_L2NCAState: category=VALUE, compu {0=OFF, 1=NCA_STANDBY, 2=NCA_LATERAL_OVERRIDE, 3=NCA_LONGITUDINAL_OVERRIDE, 4=NCA_LAT_LONG_OVERRIDE, 5=NCA_ACTIVE, 255=INVALID}  # L2NCA状态信息
  app type ADT_ADAS_enum_PathMatchSts: category=VALUE, compu {phys=raw for raw 0..255}, range phys 0..255
  application array data type ADT_ADAS_arr_VPASpotLabel: category=ARRAY, dynamic-array-size-profile=VSA_LINEAR  # 用户特殊车位的标签类型列表
    element ADT_ADAS_arr_VPASpotLabel: category=VALUE, type=ADT_ADAS_enum_VPASpotLabel, array-size-handling=ALL-INDICES-SAME-ARRAY-SIZE, array-size-semantics=VARIABLE-SIZE, max-number-of-elements=100
  7 x app type, all with category=VALUE:
    ADT_UTC: compu {phys=raw for raw 0..10000}, range phys 0..10000
    ADT_ADAS_enum_ICAPlusONOFFSts: compu {phys=raw for raw 0..255}, range phys 0..255
    ADT_ICC_boolean_isMatch: compu {phys=raw for raw 0..2147483647}, range phys 0..2147483647  # 区间测速是否配对:仅对区间测速电子眼生效
    ADT_ICC_enum_PathOperationId: compu {phys=raw for raw 0..255}, range phys 0..255
    ADT_ICC_enum_NavIsTimeSpeedLimit: compu {phys=raw for raw 0..255}, range phys 0..255  # 时间限速状态
    ADT_LanePositionInfo_heading: compu {phys=raw for raw 0..360; unit degree}, range phys 0..360
    ADT_ICC_val_VoiceControlCruiseSpeed: compu {phys=raw for raw 0..255}, range phys 0..255  # 语音巡航调节速度值
  5 x application array data type, all with category=ARRAY:
    ADT_ADAS_arr_TrajectoryPoint
      element ADT_ADAS_arr_TrajectoryPoint: category=STRUCTURE, type=ADT_ADAS_strt_TrajectoryPoint, array-size-semantics=FIXED-SIZE, max-number-of-elements=64
    ADT_ISLIInfo_arr_Reserved  # 预留
      element ADT_ISLIInfo_arr_Reserved: category=VALUE, type=ADT_Reserved_uint8_Type, array-size-semantics=FIXED-SIZE, max-number-of-elements=50
    ADT_Array_RouteMMSeg: dynamic-array-size-profile=VSA_LINEAR  # HD路线匹配片段数组
      element ADT_Array_RouteMMSeg: category=STRUCTURE, type=ADT_Struct_RouteMMSeg, array-size-handling=ALL-INDICES-SAME-ARRAY-SIZE, array-size-semantics=VARIABLE-SIZE, max-number-of-elements=255
    ADT_ICC_arr_FrontLane: dynamic-array-size-profile=VSA_LINEAR  # 前景车道
      element ADT_ICC_arr_FrontLane: category=VALUE, type=ADT_ICC_enum_LaneAction, array-size-handling=ALL-INDICES-SAME-ARRAY-SIZE, array-size-semantics=VARIABLE-SIZE, max-number-of-elements=12
    ADT_ADAS_arr_RoadMarker_2: dynamic-array-size-profile=VSA_LINEAR
      element ADT_ADAS_arr_RoadMarker_2: category=STRUCTURE, type=ADT_ADAS_strt_RoadMarker_2, array-size-handling=ALL-INDICES-SAME-ARRAY-SIZE, array-size-semantics=VARIABLE-SIZE, max-number-of-elements=28
  app type ADT_ADAS_val_LightNum: category=VALUE, compu {phys=raw for raw 0..255}, range phys 0..255  # 红绿灯个数
  app type ADT_StrVar_SIM_IMSI: category=STRING, sw-text-props={array-size-semantics=VARIABLE-SIZE, sw-max-text-size=15, base-type=UTF_8}  # 15位的国际移动用户识别码
  application record data type ADT_ADAS_strt_MRAInfo_2: category=STRUCTURE
    10 x application record element:
      DTE_MRASts: category=VALUE, type=ADT_ADAS_enum_MRASts  # 循迹倒车状态信息
      DTE_MRATrajRecordDist: category=VALUE, type=ADT_ADAS_val_ParkingDist  # 循迹倒车记录路径长度
      DTE_MRACheckSts: category=VALUE, type=ADT_ADAS_enum_MRACheckSts  # 循迹倒车不能激活原因
      DTE_MRATrajRemainingDist: category=VALUE, type=ADT_ADAS_val_ParkingDist  # 循迹倒车剩余距离
      DTE_MRAAvaliableStatus: category=VALUE, type=ADT_Gen_enum_AvailableSts  # 循迹倒车可用状态
      DTE_MRATrajectory: category=ARRAY, type=ADT_ADAS_arr_TrajectoryPoint  # 循迹倒车规划引导线
      DTE_MraOperationResp: category=VALUE, type=ADT_ADAS_enum_ParkingOperationResp  # MRA按键状态反馈
      DTE_MRAStartButtonSts: category=VALUE, type=ADT_ADAS_enum_ParkingButtonSts  # 开始泊车按钮可用状态
      DTE_MRAResumeButtonSts: category=VALUE, type=ADT_ADAS_enum_ParkingButtonSts  # 恢复泊车按钮可用状态
      DTE_MRAInfoReserved: category=ARRAY, type=ADT_MRAInfo_arr_Reserved  # 预留
  application record data type ADT_ICC_strt_CongestionInfo: category=STRUCTURE  # 交通拥堵详细信息
    24 x application record element:
      DTE_TimeOfSeconds: category=VALUE, type=ADT_ICC_int32_Time  # 预计通过该拥堵段的时长（单位:秒）
      DTE_ScopeFlag: category=VALUE, type=ADT_ICC_boolean_ScopeFlag_1  # 当前自车位置是否在拥堵区域内
      DTE_BeginSegmentIndex: category=VALUE, type=ADT_ICC_int32_Index  # 拥堵段的起始导航段索引
      DTE_BeginLinkIndex: category=VALUE, type=ADT_ICC_int32_Index  # 拥堵段的起始link段索引
      DTE_BeginLinkRoadName: category=STRING, type=ADT_ICC_string_RoadName  # 拥堵段的起始link段的道路名
      DTE_BeginSectionIndex: category=VALUE, type=ADT_ICC_int32_Index  # 拥堵段的起始精细化段索引
      DTE_EndSegmentIndex: category=VALUE, type=ADT_ICC_int32_Index  # 拥堵段的结束导航段索引
      DTE_EndLinkIndex: category=VALUE, type=ADT_ICC_int32_Index  # 拥堵段的结束link段索引
      DTE_EndSectionIndex: category=VALUE, type=ADT_ICC_int32_Index  # 拥堵段的结束精细化段索引
      DTE_CongestionStatus: category=VALUE, type=ADT_ICC_int32_CongestionStatus  # 拥堵程度
      DTE_RemainDist: category=VALUE, type=ADT_ICC_int32_Dist  # 当前剩余拥堵长度
      DTE_BeginExactLength: category=VALUE, type=ADT_ICC_int32_Dist  # 起始段精细化段的距离，若为0表示起始段为非精细化段
      DTE_BeginCoorIndex: category=VALUE, type=ADT_ICC_int32_Index  # 拥堵起点区域最近（拥堵起始点前）的形状点索引
      DTE_EndExactLength: category=VALUE, type=ADT_ICC_int32_Dist  # 结束段精细化段的距离，若为0表示结束段为非精细化段
      DTE_EndCoorIndex: category=VALUE, type=ADT_ICC_int32_Index  # 拥堵结束区域最近（拥堵结束点前）的形状点索引
      DTE_BeginExactLength3D: category=VALUE, type=ADT_ICC_int32_Dist  # 3D起始段精细化段的距离，若为0表示起始段为非精细化段
      DTE_BeginExactPoint3D: category=STRUCTURE, type=ADT_ICC_strt_Coord3DDouble  # 3D拥堵区域的起始点真实坐标
      DTE_BeginCoorIndex3D: category=VALUE, type=ADT_ICC_int32_Index  # 3D拥堵起点区域最近（拥堵起始点前）的形状点索引
      DTE_EndExactLength3D: category=VALUE, type=ADT_ICC_int32_Dist  # 3D结束段精细化段的距离，若为0表示结束段为非精细化段
      DTE_EndExactPoint3D: category=STRUCTURE, type=ADT_ICC_strt_Coord3DDouble  # 3D拥堵区域的结束点真实坐标
      DTE_EndCoorIndex3D: category=VALUE, type=ADT_ICC_int32_Index  # 3D拥堵结束区域最近（拥堵结束点前）的形状点索引
      DTE_BeginExactPoint: category=STRUCTURE, type=ADT_ICC_strt_Coord2DDouble  # 拥堵区域的起始点真实坐标
      DTE_EndExactPoint: category=STRUCTURE, type=ADT_ICC_strt_Coord2DDouble  # 拥堵区域的结束点真实坐标
      DTE_CongestionReserved: category=ARRAY, type=ADT_Congestion_arr_Reserved  # 预留
  6 x app type:
    ADT_Enum_LogPrepareState: category=VALUE, compu {phys=raw for raw 0..1}, range phys 0..1  # 日志上传是否准备好
    ADT_EphemerisDataLength: category=VALUE, compu {phys=raw for raw 0..2048}, range phys 0..2048  # 星历数据长度
    ADT_ADAS_enum_ESSDirection: category=VALUE, compu {phys=raw for raw 0..255}, range phys 0..255
    ADT_VhrLogString: category=STRING, sw-text-props={array-size-semantics=VARIABLE-SIZE, sw-max-text-size=50, base-type=UTF_8}
    ADT_SentryModeAlarmCnt: category=VALUE, compu {phys=raw for raw 0..10000}, range phys 0..10000  # 哨兵模式警报告警次数
    ADT_ADAS_Stub_Offset: category=VALUE, compu {phys=raw for raw 0..8191}, range phys 0..8191
  application array data type ADT_ADAS_arr_LaneLineData: category=ARRAY, dynamic-array-size-profile=VSA_LINEAR  # 车道线信息数组
    element ADT_ADAS_arr_LaneLineData: category=STRUCTURE, type=ADT_ADAS_strt_LaneLine, array-size-handling=ALL-INDICES-SAME-ARRAY-SIZE, array-size-semantics=VARIABLE-SIZE, max-number-of-elements=8
  application record data type ADT_ADAS_strt_HNOPfunctionInfo: category=STRUCTURE
    16 x application record element:
      DTE_HNOPSts: category=VALUE, type=ADT_ADAS_enum_HNOPSts  # 高速领航辅助状态
      DTE_NOPLaneChangeMod: category=VALUE, type=ADT_ADAS_enum_NOPLaneChangeMod  # 领航辅助变道模式
      DTE_NOPLaneChangeStyle: category=VALUE, type=ADT_ADAS_enum_NOPLaneChangeStyle  # 领航辅助速控模式
      DTE_NOPLaneChangeInfo: category=VALUE, type=ADT_ADAS_enum_NOPLaneChangeInfo  # 领航辅助变道状态信息
      DTE_SafeStopReminder: category=VALUE, type=ADT_ADAS_enum_SafeStopReminder  # 领航辅助执行安全停车提示
      DTE_NOPQuitReason: category=VALUE, type=ADT_ADAS_enum_NOPQuitReason  # 领航辅助退出原因
      DTE_NOPALCReqDriverConf: category=VALUE, type=ADT_ADAS_enum_NOPALCReqDriverConf  # 推荐变道请求确认
      DTE_NOPDegradeReminder: category=VALUE, type=ADT_ADAS_enum_DegradeReminder  # 领航辅助升降级行为提示
      DTE_NOPStReminder: category=VALUE, type=ADT_ADAS_enum_NOPStReminder  # 领航辅助状态提示
      DTE_NOPLaneChangeReason: category=VALUE, type=ADT_ADAS_enum_NOPLaneChangeReason  # 领航辅助变道原因
      DTE_HNOPScenariosReminder: category=VALUE, type=ADT_ADAS_enum_HNOPScenariosReminder  # HNOP场景提示信息
      DTE_Confidencelevel: category=VALUE, type=ADT_ADAS_enum_Confidencelevel  # 场景控制置信度
      DTE_TrajectoryPoint: category=ARRAY, type=ADT_ADAS_arr_TrajectoryPoint  # 决策引导线
      DTE_LeaveFastLaneSts: category=VALUE, type=ADT_ADAS_enum_LeaveFastLaneSts  # 驶离快车道模式设置状态反馈
      DTE_NOPLaneChangeWarnTypeFb: category=VALUE, type=ADT_ADAS_enum_NOPLaneChangeWarnType  # 领航辅助变道报警类型
      DTE_NOPLCPermitSt: category=VALUE, type=ADT_ADAS_enum_LCPermitSt  # 领航辅助变道允许状态
  application record data type ADT_ADAS_strt_MNPMemRoutePoint: category=STRUCTURE
    application record element DTE_Coordinate_X: category=VALUE, type=ADT_Gen_val_Coordinate_X  # 记忆路线轨迹点坐标X
    application record element DTE_Coordinate_Y: category=VALUE, type=ADT_Gen_val_Coordinate_Y  # 记忆路线轨迹点坐标Y
    application record element DTE_Coordinate_Z: category=VALUE, type=ADT_Gen_val_Coordinate_Z  # 记忆路线轨迹点坐标Z
  application array data type ADT_ADAS_arr_VPARoadLine: category=ARRAY, dynamic-array-size-profile=VSA_LINEAR  # VPA中心道路信息
    element ADT_ADAS_arr_VPARoadLine: category=STRUCTURE, type=ADT_ADAS_strt_VPARoadLinePoint, array-size-handling=ALL-INDICES-SAME-ARRAY-SIZE, array-size-semantics=VARIABLE-SIZE, max-number-of-elements=100
  app type ADT_ICC_string_PoiName: category=STRING, sw-text-props={array-size-semantics=VARIABLE-SIZE, sw-max-text-size=500, base-type=UTF_8}
  application array data type ADT_ICC_arr_CongestionInfo: category=ARRAY, dynamic-array-size-profile=VSA_LINEAR  # 拥堵时长和原因详细信息
    element ADT_ICC_arr_CongestionInfo: category=STRUCTURE, type=ADT_ICC_strt_CongestionInfo, array-size-handling=ALL-INDICES-SAME-ARRAY-SIZE, array-size-semantics=VARIABLE-SIZE, max-number-of-elements=20
  app type ADT_DownFlow: category=VALUE, compu {phys=raw for raw 0..2415919103; unit byte}, range phys 0..2415919103
  application array data type ADT_Array_Data: category=ARRAY, dynamic-array-size-profile=VSA_LINEAR  # 打包的数据
    element ADT_Array_Data: category=VALUE, type=ADT_DataUint8, array-size-handling=ALL-INDICES-SAME-ARRAY-SIZE, array-size-semantics=VARIABLE-SIZE, max-number-of-elements=2097152
  app type ADT_ADAS_enum_AESESSTextInfo: category=VALUE, compu {phys=raw for raw 0..255}, range phys 0..255
  application array data type ADT_NaviWeather_arr_Reserved: category=ARRAY
    element ADT_NaviWeather_arr_Reserved: category=VALUE, type=ADT_Reserved_int32_Type, array-size-semantics=FIXED-SIZE, max-number-of-elements=10
  4 x app type, all with category=VALUE:
    ADT_ADAS_Meta_MapVerYear: compu {phys=raw for raw 0..63}, range phys 0..63
    ADT_Enum_UpdateCompleted: compu {phys=raw for raw 0..255}, range phys 0..255  # DMC发送升级成功指令
    ADT_ICC_val_latitude: compu {phys=raw for raw 0..90; unit degree}, range phys 0..90  # 纬度
    ADT_ADAS_enum_NOPStReminder: compu {phys=raw for raw 0..255}, range phys 0..255
  application record data type ADT_ADAS_strt_AdvanceParkingInfo_2: category=STRUCTURE
    28 x application record element:
      DTE_HPASts: category=VALUE, type=ADT_ADAS_enum_HPASts  # 记忆泊车状态信息
      DTE_HPASearchOnWaySelectSlotID: category=VALUE, type=ADT_ADAS_val_SlotID  # 记忆泊车沿途找车位泊入车位在记忆路线中的车位ID
      DTE_HPAUseData: category=STRUCTURE, type=ADT_ADAS_strt_HpaUseData  # 记忆泊车循迹信息统计
      DTE_VPAWarningInfo: category=VALUE, type=ADT_ADAS_enum_VPAWarningInfo  # 代客泊车报警信息
      DTE_HPAPathSelectIDInd: category=VALUE, type=ADT_Gen_val_ID  # 记忆泊车路线选择ID反馈
      DTE_HPAVPARepalyRemind: category=VALUE, type=ADT_ADAS_enum_HPAVPARepalyRemind  # 记忆泊车代客泊车语音及显示提示
      DTE_HPAVPATrajectory: category=ARRAY, type=ADT_ADAS_arr_HPATrajectoryPoint  # 泊车规划引导线
      DTE_HpaOperationResp: category=VALUE, type=ADT_ADAS_enum_ParkingOperationResp  # HPA按键状态反馈
      DTE_HpaEgoVehPos: category=STRUCTURE, type=ADT_ADAS_strt_EgoPose  # HPA位姿信息
      DTE_VPADropOffVld: category=VALUE, type=ADT_Gen_enum_AvailableSts  # 代客泊车Drop off 可用性
      DTE_VPAPickUpVld: category=VALUE, type=ADT_Gen_enum_AvailableSts  # 代客泊车Pick up 可用性
      DTE_VPASelfMapBuildVld: category=VALUE, type=ADT_Gen_enum_AvailableSts  # 代客泊车自建地图可用性
      DTE_VPAProcessBarInd: category=VALUE, type=ADT_ADAS_val_ParkingProgressBarInd  # 代客泊车进度条
      DTE_VPAVld: category=VALUE, type=ADT_Gen_enum_AvailableSts  # 代客泊车可用性
      DTE_VPAPickUpPosSelectReq: category=VALUE, type=ADT_ADAS_enum_VPAPickUpPosSelectReq  # 代客泊车Pick up 位置选择请求
      DTE_VPADropOffPosSelectReq: category=VALUE, type=ADT_ADAS_enum_VPADropOffPosSelectReq  # 代客泊车Drop off位置选择请求
      DTE_VPASts: category=VALUE, type=ADT_ADAS_enum_VPASts  # 代客泊车状态信息
      DTE_VPAFuncTypeFb: category=VALUE, type=ADT_ADAS_enum_VPAFunctionType  # 代客泊车当前激活功能类型反馈
      DTE_VPARemainingDist: category=VALUE, type=ADT_ADAS_val_ParkingDist  # 代客泊车剩余距离
      DTE_HPARequestAPAUI: category=VALUE, type=ADT_ADAS_enum_HPARequestAPAUI  # 记忆泊车调用自动泊车UI请求
      DTE_HpaActiveCheckSts: category=VALUE, type=ADT_ADAS_enum_HpaActiveCheckSts  # 记忆泊车激活检测结果反馈
      DTE_HPAReplayRecAvl: category=VALUE, type=ADT_Gen_enum_AvailableSts  # 记忆泊车推荐回放路线可用
      DTE_HPAPopup: category=VALUE, type=ADT_ADAS_enum_HPAPopup  # 记忆泊车弹窗
      DTE_HPAStartButtonSts: category=VALUE, type=ADT_ADAS_enum_ParkingButtonSts  # 记忆泊车开始按钮
      DTE_HPAResumeButtonSts: category=VALUE, type=ADT_ADAS_enum_ParkingButtonSts  # 记忆泊车恢复按钮
      DTE_HPARPAButtonSts: category=VALUE, type=ADT_ADAS_enum_ParkingButtonSts  # 记忆泊车切换RPA按钮
      DTE_CreatPathButtonSts: category=VALUE, type=ADT_ADAS_enum_ParkingButtonSts  # 创建路线图标显示状态
      DTE_AdvPrkgReserved: category=ARRAY, type=ADT_AdvPrkg_arr_Reserved  # 预留
  app type ADT_ADAS_enum_VPAEntranceType: category=VALUE, compu {phys=raw for raw 0..255}, range phys 0..255
  app type ADT_Bool_Ephemeris: category=VALUE, compu {phys=raw for raw 0..255}, range phys 0..255  # 是否有星历信息 Is there any ephemeris information
  application array data type ADT_ICC_arr_TrafficJamInfo: category=ARRAY, dynamic-array-size-profile=VSA_LINEAR
    element ADT_ICC_arr_TrafficJamInfo: category=STRUCTURE, type=ADT_ICC_strt_TrafficJamInfo, array-size-handling=ALL-INDICES-SAME-ARRAY-SIZE, array-size-semantics=VARIABLE-SIZE, max-number-of-elements=5
  application array data type ADT_Congestion_arr_Reserved: category=ARRAY
    element ADT_Congestion_arr_Reserved: category=VALUE, type=ADT_Reserved_int32_Type, array-size-semantics=FIXED-SIZE, max-number-of-elements=15
  5 x app type:
    ADT_StrVar_MSISDN: category=STRING, sw-text-props={array-size-semantics=VARIABLE-SIZE, sw-max-text-size=15, base-type=UTF_8}  # 15位移动电话号码
    ADT_Gen_val_Coordinate_Y: category=VALUE, compu {phys=raw for raw -4294967296..4294967296; unit cm}, range phys -4294967296..4294967296  # y轴坐标或向量
    ADT_Gen_val_Coordinate_X: category=VALUE, compu {phys=raw for raw -4294967296..4294967296; unit cm}, range phys -4294967296..4294967296  # X轴坐标或向量
    ADT_Step: category=VALUE, compu {phys=raw for raw 0..255}, range phys 0..255  # 诊断步骤
    ADT_Gen_val_Coordinate_Z: category=VALUE, compu {phys=raw for raw -4294967296..4294967296; unit cm}, range phys -4294967296..4294967296  # z轴坐标或向量
  application record data type ADT_ADAS_strt_TrafficLightInfo: category=STRUCTURE  # 交通灯信息
    6 x application record element:
      DTE_TrafficLightId: category=VALUE, type=ADT_Gen_val_ID  # 交通灯箱ID
      DTE_TrafficLightPos: category=STRUCTURE, type=ADT_ADAS_strt_TrafficLightPos  # 交通灯箱位置
      DTE_TrafficLightType: category=VALUE, type=ADT_ADAS_enum_TrafficLightsType  # 交通灯箱类型
      DTE_LightNum: category=VALUE, type=ADT_ADAS_val_LightNum  # 红绿灯个数
      DTE_LightList: category=ARRAY, type=ADT_ADAS_arr_LightList  # 红绿灯数组
      DTE_TrafficLightInfoReserved: category=ARRAY, type=ADT_TrafficLightInfo_arr_Reserved  # 预留
  app type ADT_ICC_enum_IntelligentEvasionBtnSt: category=VALUE, compu {phys=raw for raw 0..255}, range phys 0..255  # 智慧躲闪软开关
  app type ADT_ADAS_enum_NRAQuitReason: category=VALUE, compu {phys=raw for raw 0..255}, range phys 0..255
  application array data type ADT_MNPMemRoute_arr_Reserved: category=ARRAY  # 预留
    element ADT_MNPMemRoute_arr_Reserved: category=VALUE, type=ADT_Reserved_uint8_Type, array-size-semantics=FIXED-SIZE, max-number-of-elements=30
  app type ADT_Enum_SatelIdNrInfo: category=VALUE, compu {phys=raw for raw 0..65535}, range phys 0..65535  # 卫星标识号信息 Satellite identification number information
  application array data type ADT_AvmCamIntrinsicsData: category=ARRAY  # 环视相机内参数据
    element ADT_AvmCamIntrinsicsData: category=VALUE, type=ADT_CamIntrinsicsData, array-size-semantics=FIXED-SIZE, max-number-of-elements=832
  5 x app type, all with category=VALUE:
    ADT_TimeInfoSecond: compu {phys=raw for raw 0..59}, range phys 0..59  # 秒
    ADT_ICC_enum_FSRACruiseSpdOffsetMod: compu {phys=raw for raw 0..255}, range phys 0..255  # 设定偏移方式
    ADT_DataInt32: compu {phys=raw for raw 0..4294967295; unit 1/2^32 full circle}, range phys 0..4294967295  # 有符号32位整型
    ADT_CameraStreamBasicElement: compu {phys=raw for raw 0..255}, range phys 0..255  # ADS/CDC通信通道基础元素
    ADT_ADAS_val_SlotID: compu {phys=raw for raw 0..65535; unit /}, range phys 0..65535
  application array data type ADT_ADSHMISettingMessage: category=ARRAY, dynamic-array-size-profile=VSA_LINEAR  # HMI Server(ADS)到设置项的通知事件
    element ADT_ADSHMISettingMessage: category=VALUE, type=ADT_ADSHMIBasicElement, array-size-handling=ALL-INDICES-SAME-ARRAY-SIZE, array-size-semantics=VARIABLE-SIZE, max-number-of-elements=1048576
  app type ADT_ICC_enum_NavSpeedLimit: category=VALUE, compu {phys=raw for raw 0..255}, range phys 0..255  # 导航限速值
  application record data type ADT_ADAS_strt_MNPInfo: category=STRUCTURE
    10 x application record element:
      DTE_MNPSts: category=VALUE, type=ADT_ADAS_enum_MNPSts  # MNP工作状态
      DTE_MNPBuildMapSts: category=VALUE, type=ADT_ADAS_enum_MNPBuildMapSts  # MNP建图工作状态
      DTE_MNPNewRoute: category=VALUE, type=ADT_ADAS_enum_MNPNewRoute  # 可以新建路线提示
      DTE_MNPRouteMileage: category=VALUE, type=ADT_ADAS_enum_MNPRouteMileage  # 当前记忆里程数
      DTE_MNPRouteSaving: category=VALUE, type=ADT_ADAS_enum_MNPNewRouteSaving  # 记忆路线保存进度
      DTE_MNPMemRoutesNum: category=VALUE, type=ADT_ADAS_arr_MNPMemRoutesNum  # 已记忆路线数量
      DTE_MNPRouteAvailable: category=VALUE, type=ADT_ADAS_enum_MNPRouteAvailable  # 记忆路线推荐提示
      DTE_MNPBuildMapTextInfomation: category=VALUE, type=ADT_ADAS_enum_MNPBuildMapTextInfo  # 记忆行车建图阶段文言提示信息
      DTE_MNPUseMapTextInfomation: category=VALUE, type=ADT_ADAS_enum_MNPUseMapTextInfo  # 记忆行车使用阶段文言提示信息
      DTE_MNPInfoReserved: category=ARRAY, type=ADT_MNPInfo_arr_Reserved  # 预留
  app type ADT_ADAS_enum_TolLCCMileage: category=VALUE, compu {phys=raw for raw 0..100000; unit km}, range phys 0..100000  # LCC行驶里程
  app type ADT_ADAS_enum_ParkOutDirectionSt: category=VALUE, compu {phys=raw for raw 0..255}, range phys 0..255
  application record data type ADT_ICC_strt_TrafficJamInfo: category=STRUCTURE
    5 x application record element:
      DTE_JamID: category=VALUE, type=ADT_ICC_val_ID  # 拥堵段ID
      DTE_TimeOfSeconds: category=VALUE, type=ADT_ICC_val_Time  # 预计通过拥堵时段时间
      DTE_RemianDistance: category=VALUE, type=ADT_ICC_val_Distance  # 拥堵剩余距离
      DTE_NaviCongestionDetailInfo: category=ARRAY, type=ADT_ICC_arr_NaviCongestionDetailInfo  # 拥堵时长和原因详细信息
      DTE_NaviCongestionExtend: category=STRUCTURE, type=ADT_ICC_str_NaviCongestionExtend  # 拥堵扩展信息
  app type ADT_NanoSecondTimeStampOffset: category=VALUE, compu {phys=raw for raw -9223372036854775808..9223372036854775807; unit ns}, range phys -9223372036854775808..9223372036854775807  # 纳秒差值
  application record data type ADT_ICC_strt_NaviIntervalCameraInfo1: category=STRUCTURE
    4 x application record element, all with category=VALUE:
      DTE_NavigationSubCameraExtType: type=ADT_ICC_enum_SubCameraExtType  # 导航状态电子眼类型
      DTE_NavigationCameraDistance: type=ADT_ICC_val_Distance  # 自车距离前方电子眼位置距离
      DTE_NavSpeedLimitValue: type=ADT_ICC_enum_SpeedLimitValue  # 限速值
      DTE_NavSpeedLimitUnit: type=ADT_ICC_enum_SpeedLimitUnit  # 限速单位
  6 x app type, all with category=VALUE:
    ADT_Gen_enum_AvailableSts: compu {phys=raw for raw 0..255}, range phys 0..255
    ADT_ADAS_enum_HNOACruiseSpdOffsetModFb: compu {phys=raw for raw 0..255}, range phys 0..255  # 车速偏移方式反馈
    ADT_AvmCamIntrinsicsDataReq: compu {phys=raw for raw 0..255}, range phys 0..255  # 获取环视相机内参数据
    ADT_ADAS_Stub_FormOfWay: compu {phys=raw for raw 0..15}, range phys 0..15
    ADT_ICC_enum_ESASettingSt: compu {phys=raw for raw 0..255}, range phys 0..255  # ESA功能设置状态
    ADT_ICC_int32_GreenWaveType: compu {phys=raw for raw 0..2147483647}, range phys 0..2147483647
  4 x application record data type, all with category=STRUCTURE:
    ADT_ICC_strt_VpaFcnOperating
      6 x application record element:
        DTE_VPAOperationId: category=VALUE, type=ADT_ICC_enum_VPAOperationId  # VPA功能操作指令
        DTE_VPASelectZoneInfo: category=STRUCTURE, type=ADT_ICC_strt_VpaSelectZoneInfo  # VPA地图区域选择信息
        DTE_VPASubModReq: category=VALUE, type=ADT_ICC_enum_VPASubModReq  # VPA功能模式选择
        DTE_VPAParkingLotOpInfo: category=STRUCTURE, type=ADT_ICC_strt_VpaParkingLotInfo  # VPA 停车场操作信息
        DTE_VPASelectSlotId: category=VALUE, type=ADT_ADAS_val_SlotID  # VPA选择的目的地车位
        DTE_VPASelectEntranceId: category=VALUE, type=ADT_ADAS_val_SlotID  # VPA选择的出入口id
    ADT_ADAS_strt_MRAInfo
      7 x application record element:
        DTE_MRASts: category=VALUE, type=ADT_ADAS_enum_MRASts  # 循迹倒车状态信息
        DTE_MRATrajRecordDist: category=VALUE, type=ADT_ADAS_val_ParkingDist  # 循迹倒车记录路径长度
        DTE_MRACheckSts: category=VALUE, type=ADT_ADAS_enum_MRACheckSts  # 循迹倒车不能激活原因
        DTE_MRATrajRemainingDist: category=VALUE, type=ADT_ADAS_val_ParkingDist  # 循迹倒车剩余距离
        DTE_MRAAvaliableStatus: category=VALUE, type=ADT_Gen_enum_AvailableSts  # 循迹倒车可用状态
        DTE_MRATrajectory: category=ARRAY, type=ADT_ADAS_arr_TrajectoryPoint  # 循迹倒车规划引导线
        DTE_MraOperationResp: category=VALUE, type=ADT_ADAS_enum_ParkingOperationResp  # MRA按键状态反馈
    ADT_ADAS_strt_OccPoint
      application record element DTE_Coordinate_X: category=VALUE, type=ADT_Gen_val_Coordinate_X  # X坐标
      application record element DTE_Coordinate_Y: category=VALUE, type=ADT_Gen_val_Coordinate_Y  # Y坐标
    ADT_ADAS_strt_VPALayerInfo  # 自建图层级信息
      application record element DTE_VPALayerNumber: category=VALUE, type=ADT_DataUint32  # 总层数
      application record element DTE_VPALayerList: category=ARRAY, type=ADT_ADAS_arr_VPAFloor  # 楼层列表
      application record element DTE_VPATunnelList: category=ARRAY, type=ADT_ADAS_arr_VPATunnel  # 通道名列表
  application array data type ADT_ADAS_arr_VPASpots: category=ARRAY, dynamic-array-size-profile=VSA_LINEAR  # VPA用户特殊车位属性列表
    element ADT_ADAS_arr_VPASpots: category=STRUCTURE, type=ADT_ADAS_strt_VPASpot, array-size-handling=ALL-INDICES-SAME-ARRAY-SIZE, array-size-semantics=VARIABLE-SIZE, max-number-of-elements=100
  app type ADT_ADAS_enum_HandsOnReq: category=VALUE, compu {phys=raw for raw 0..255}, range phys 0..255  # 请求驾驶员握住方向盘提示
  app type ADT_ICC_enum_LaneAction: category=VALUE, compu {phys=raw for raw 0..255}, range phys 0..255
  application record data type ADT_Struct_TBOXAPPT: category=STRUCTURE  # TBOX已预约时间
    application record element DTE_TripUtcSecs: category=VALUE, type=ADT_TripUtcSecs  # 预约出行时间
    application record element DTE_ChargingUtcSecs: category=VALUE, type=ADT_ChargingUtcSecs  # 预约充电时间
    application record element DTE_OTAUtcSecs: category=VALUE, type=ADT_OTAUtcSecs  # 预约升级时间
  app type ADT_ADSHMIBasicElement: category=VALUE, compu {phys=raw for raw 0..255}, range phys 0..255  # ADS HMI数据通道基础元素
  application record data type ADT_ADAS_strt_ISLIInfo: category=STRUCTURE
    8 x application record element, all with category=VALUE:
      DTE_ISLISt: type=ADT_ADAS_enum_ISLISt  # 超速报警功能状态
      DTE_ISLISpeedLimitSign: type=ADT_ADAS_enum_ISLISpeedLimitSign  # 限速标志
      DTE_ISLISpeedLimitUnit: type=ADT_ADAS_enum_ISLISpeedLimitUnit  # 限速标志单位
      DTE_ISLIOverSpeedWarn: type=ADT_ADAS_enum_ISLIOverSpeedWarn  # 超速报警状态
      DTE_ISLIWarningModFb: type=ADT_ADAS_enum_ISLIWarningMod  # 超速报警模式反馈
      DTE_ISLISpdLimType: type=ADT_ADAS_enum_ISLISpdLimType  # 超速限制类型
      DTE_ISLICruiseSpdAbsOffsetFb: type=ADT_ADAS_val_SpdLimitAbsOffset  # 限速绝对偏差值反馈
      DTE_ISLICruiseSpdRelOffsetFb: type=ADT_ADAS_val_SpdLimitRelOffset  # 限速相对偏差值反馈
  7 x app type:
    ADT_StrVar_VPNIPAddress: category=STRING, sw-text-props={array-size-semantics=VARIABLE-SIZE, sw-max-text-size=30, base-type=UTF_8}  # VPN IP
    ADT_ICC_string_SoundInfo: category=STRING, sw-text-props={array-size-semantics=VARIABLE-SIZE, sw-max-text-size=1000, base-type=UTF_8}  # TTS 播报
    ADT_ADAS_enum_RGearDefaultFunctionBtnStFb: category=VALUE, compu {phys=raw for raw 0..255}, range phys 0..255  # R挡默认打开项设置反馈
    ADT_ADAS_enum_Traffic3DSignType: category=VALUE, compu {phys=raw for raw 0..4294967295}, range phys 0..4294967295  # 交通标识类型
    ADT_Gen_val_float32: category=VALUE, compu {phys=raw for raw 0..42949672.95}, range phys 0..42949672.95  # float32浮点数
    ADT_ADAS_Stub_CmplxInsct: category=VALUE, compu {phys=raw for raw 0..3}, range phys 0..3
    ADT_ICC_int32_SubType: category=VALUE, compu {phys=raw for raw 0..2147483647}, range phys 0..2147483647
  application record data type ADT_RequestVhrCancelRemoteCall: category=STRUCTURE  # 取消VHR日志远程调取--请求
    application record element DTE_vhrCompID: category=STRING, type=ADT_VhrCompID  # 部件ID
    application record element DTE_vhrRelatedId: category=STRING, type=ADT_VhrRelatedId  # 日志关联id
  app type ADT_LCM_RAWDATA: category=VALUE, compu {phys=raw for raw -128..127}, range phys -128..127  # GNSS_RawData
  app type ADT_ADAS_val_RemainingTime: category=VALUE, compu {phys=raw for raw 0..255; unit s}, range phys 0..255  # 红绿灯剩余时间
  application array data type ADT_AllSimDetailInfoReserved: category=ARRAY  # 车辆Sim卡信息预留
    element ADT_AllSimDetailInfoReserved: category=VALUE, type=ADT_INI_ReservedUnit8, array-size-semantics=FIXED-SIZE, max-number-of-elements=16
  app type ADT_Latitude: category=VALUE, compu {phys=raw for raw 0..10000}, range phys 0..10000
  app type ADT_ADAS_enum_MNPMemRouteUseFlag: category=VALUE, compu {phys=raw for raw 0..255}, range phys 0..255  # 路线是否正在使用中
  application array data type ADT_MyLocation_arr_Reserved: category=ARRAY
    element ADT_MyLocation_arr_Reserved: category=VALUE, type=ADT_Reserved_int32_Type, array-size-semantics=FIXED-SIZE, max-number-of-elements=20
  app type ADT_ADAS_Meta_MapVerQtr: category=VALUE, compu {phys=raw for raw 0..3}, range phys 0..3
  application record data type ADT_Struct_GeoPos2D: category=STRUCTURE  # 2D点位置
    application record element DTE_lon: category=VALUE, type=ADT_DataInt32  # 经度
    application record element DTE_lat: category=VALUE, type=ADT_DataInt32  # 纬度
  application record data type ADT_LCM_strt_IMUData: category=STRUCTURE  # Measuring Data of IMU
    8 x application record element, all with category=VALUE:
      DTE_IMU_Acc_X: type=ADT_LCM_IMU_Acc_X  # 加速度计:惯导X轴
      DTE_IMU_Acc_Y: type=ADT_LCM_IMU_Acc_Y  # 加速度计:惯导Y轴
      DTE_IMU_Acc_Z: type=ADT_LCM_IMU_Acc_Z  # 加速度计:惯导Z轴
      DTE_IMU_Gyro_X: type=ADT_LCM_IMU_Gyro_X  # 陀螺:惯导X轴
      DTE_IMU_Gyro_Y: type=ADT_LCM_IMU_Gyro_Y  # 陀螺:惯导Y轴
      DTE_IMU_Gyro_Z: type=ADT_LCM_IMU_Gyro_Z  # 陀螺:惯导Z轴
      DTE_IMU_gpsWeek: type=ADT_LCM_IMU_gpsWeek  # GPS周，起点时间是1980年1月6日0时0分0秒，未同步恒为0
      DTE_IMU_gpsSow: type=ADT_LCM_IMU_gpsSow  # GPS周内秒，起点每周日的0时0点0分0秒，未同步恒为0
  app type ADT_ADAS_ProfShort_AccurClass: category=VALUE, compu {phys=raw for raw 0..3}, range phys 0..3
  application record data type ADT_Struct_GNSSInfo: category=STRUCTURE  # GNSS位置信息
    application record element DTE_NMEA: category=STRING, type=ADT_StrVar_NMEA  # 位置信息
    application record element DTE_ACCURACY: category=VALUE, type=ADT_ACCURACY  # 精度
    application record element DTE_SeqNum: category=VALUE, type=ADT_SeqNum  # 序列号
  app type ADT_StrVar_user: category=STRING, sw-text-props={array-size-semantics=VARIABLE-SIZE, sw-max-text-size=15, base-type=UTF_8}
  app type ADT_ICC_enum_VoiceControlLaneChange: category=VALUE, compu {phys=raw for raw 0..255}, range phys 0..255  # 语音变道指令
  application array data type ADT_ADAS_arr_LightList: category=ARRAY, dynamic-array-size-profile=VSA_LINEAR  # 红绿灯数组
    element ADT_ADAS_arr_LightList: category=STRUCTURE, type=ADT_ADAS_strt_Light, array-size-handling=ALL-INDICES-SAME-ARRAY-SIZE, array-size-semantics=VARIABLE-SIZE, max-number-of-elements=3
  5 x app type, all with category=VALUE:
    ADT_ADAS_enum_IHCTextInfo: compu {phys=raw for raw 0..255}, range phys 0..255  # IHC文言提示信息
    ADT_LanePositionInfo_offset: compu {phys=raw for raw 0..4294967296; unit m}, range phys 0..4294967296
    ADT_ADAS_enum_UNOPSts: compu {phys=raw for raw 0..255}, range phys 0..255
    ADT_ADAS_val_MNPMemRoutePointsNum: compu {phys=raw for raw 0..65535}, range phys 0..65535  # 路线轨迹点数量
    ADT_ICC_int32_Penalty: compu {phys=raw for raw 0..2147483647}, range phys 0..2147483647  # 电子眼的详细违章类型
  application record data type ADT_ADAS_strt_ActiveSafetyFcnInfo: category=STRUCTURE
    5 x application record element, all with category=VALUE:
      DTE_FcwSts: type=ADT_ADAS_enum_FcwSts  # FCW功能状态
      DTE_AebSts: type=ADT_ADAS_enum_AebSts  # AEB功能状态
      DTE_FcwWarnDist: type=ADT_ADAS_enum_FcwWarnDist  # FCW报警距离
      DTE_FcwAcitveSt: type=ADT_ADAS_enum_FcwAcitveSt  # FCW执行状态
      DTE_AebAcitveSt: type=ADT_ADAS_enum_AebAcitveSt  # AEB执行状态
  application record data type ADT_ADAS_strt_VPAParkingSLot: category=STRUCTURE  # VPA停车位信息
    10 x application record element:
      DTE_VPASlotID: category=VALUE, type=ADT_ADAS_val_SlotID  # 车位ID
      DTE_VPASlotType: category=VALUE, type=ADT_ADAS_enum_SlotType  # 车位类型
      DTE_VPASlotStatus: category=VALUE, type=ADT_ADAS_enum_SlotStatus  # 车位可用状态
      DTE_VPASlotPointTop1: category=STRUCTURE, type=ADT_ADAS_strt_HPAVPAPathInfo  # 车位顶点1
      DTE_VPASlotPointTop2: category=STRUCTURE, type=ADT_ADAS_strt_HPAVPAPathInfo  # 车位顶点2
      DTE_VPASlotPointBottom1: category=STRUCTURE, type=ADT_ADAS_strt_HPAVPAPathInfo  # 车位顶点3
      DTE_VPASlotPointBottom2: category=STRUCTURE, type=ADT_ADAS_strt_HPAVPAPathInfo  # 车位顶点4
      DTE_VPASlotNum: category=VALUE, type=ADT_ADAS_val_SlotID  # 车位序号
      DTE_VPASlotFloor: category=VALUE, type=ADT_ADAS_enum_VPAFloor  # 车位楼层
      DTE_SlotWheelStopperInfo: category=STRUCTURE, type=ADT_ADAS_strt_SlotWheelStopperInfo  # 车位轮挡信息
  app type ADT_ADAS_enum_NRAPreScanSts: category=VALUE, compu {phys=raw for raw 0..255}, range phys 0..255
  app type ADT_ADAS_ProfShort_Update: category=VALUE, compu {phys=raw for raw 0..1}, range phys 0..1
  application array data type ADT_ICC_arr_NaviCruiseFacilityInfo: category=ARRAY, dynamic-array-size-profile=VSA_LINEAR  # 巡航模式下电子眼信息
    element ADT_ICC_arr_NaviCruiseFacilityInfo: category=STRUCTURE, type=ADT_ICC_strt_NaviCruiseFacilityInfo, array-size-handling=ALL-INDICES-SAME-ARRAY-SIZE, array-size-semantics=VARIABLE-SIZE, max-number-of-elements=2
  app type ADT_Enum_TSPConnectionState: category=VALUE, compu {phys=raw for raw 0..1}, range phys 0..1  # TSP连接状态
  app type ADT_ADAS_Posn_Offset: category=VALUE, compu {phys=raw for raw 0..8191; unit m}, range phys 0..8191
  application record data type ADT_ADAS_strt_IntelligentEvasionInfo: category=STRUCTURE
    application record element DTE_iLOASts: category=VALUE, type=ADT_ADAS_enum_iLOASts  # 智慧躲闪功能状态
    application record element DTE_iLOAActdirection: category=VALUE, type=ADT_ADAS_enum_iLOAActdirection  # 智慧躲闪方向
    application record element DTE_iLOATextInfo: category=VALUE, type=ADT_ADAS_enum_iLOATextInfo  # 智慧躲闪提示信息
  app type ADT_StrVar_TBOXOTARemoteAPPTCancel: category=STRING, sw-text-props={array-size-semantics=VARIABLE-SIZE, sw-max-text-size=16, base-type=UTF_8}  # 远控取消OTA预约升级
  application record data type ADT_ICC_strt_NaviCongestionInfo: category=STRUCTURE  # 交通拥堵
    7 x application record element:
      DTE_CongestionPathID: category=VALUE, type=ADT_Gen_int64_ID  # 路线ID
      DTE_TotalTimeOfSeconds: category=VALUE, type=ADT_ICC_int64_Time  # 预计通过拥堵时段时间
      DTE_TotalRemainDist: category=VALUE, type=ADT_ICC_int64_Dist  # 拥堵剩余距离
      DTE_Unobstructed: category=VALUE, type=ADT_ICC_boolean_Unobstructed  # 是否通畅
      DTE_CongestionInfos: category=ARRAY, type=ADT_ICC_arr_CongestionInfo  # 拥堵时长和原因详细信息
      DTE_CongestionExtend: category=STRUCTURE, type=ADT_ICC_strt_CongestionExtend  # 拥堵扩展信息
      DTE_NaviCongestionReserved: category=ARRAY, type=ADT_NaviCongestion_arr_Reserved  # 预留
  app type ADT_ADAS_enum_ParkingPauseInd: category=VALUE, compu {phys=raw for raw 0..255}, range phys 0..255
  application record data type ADT_ICC_strt_NaviStatusBean: category=STRUCTURE  # 导航状态
    application record element DTE_NaviMode: category=VALUE, type=ADT_ICC_int32_NaviMode  # 导航模式
    application record element DTE_NaviStatus: category=VALUE, type=ADT_ICC_int32_NaviStatus  # 导航状态
    application record element DTE_NaviStatusReserved: category=ARRAY, type=ADT_NaviStatus_arr_Reserved  # 预留
  application array data type ADT_ICC_arr_BackExtenLanes: category=ARRAY, dynamic-array-size-profile=VSA_LINEAR
    element ADT_ICC_arr_BackExtenLanes: category=STRUCTURE, type=ADT_ICC_strt_ExtenLaneAction, array-size-handling=ALL-INDICES-SAME-ARRAY-SIZE, array-size-semantics=VARIABLE-SIZE, max-number-of-elements=32
