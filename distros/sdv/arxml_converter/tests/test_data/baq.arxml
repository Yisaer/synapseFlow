[part 1 of 11: packages /DataTypeMappingSets to /Communication/PDUs]
AUTOSAR XML (schema 00048)
standard types defined: boolean, sint32, sint64, float64, sint8, uint64, uint32, uint8, float32, uint16, sint16
package /DataTypeMappingSets
  data type mapping set Data_Type_Mappings
    data-type-maps:
      application-data-type=ADT_ADAS_enum_ACCholdSts, implementation-data-type=IDT_ADAS_enum_ACCholdSts
      application-data-type=ADT_VhrRelatedId, implementation-data-type=IDT_VhrRelatedId
      application-data-type=ADT_ICAInfo_arr_Reserved, implementation-data-type=IDT_ICAInfo_arr_Reserved
      application-data-type=ADT_ADAS_arr_ScoreMap, implementation-data-type=IDT_ADAS_arr_ScoreMap
      application-data-type=ADT_ADAS_enum_FcwSts, implementation-data-type=IDT_ADAS_enum_FcwSts
      application-data-type=ADT_LCM_IMU_Acc_X, implementation-data-type=IDT_LCM_IMU_Acc_X
      application-data-type=ADT_ICC_string_CongestionId, implementation-data-type=IDT_ICC_string_CongestionId
      application-data-type=ADT_LCM_IMU_Acc_Z, implementation-data-type=IDT_LCM_IMU_Acc_Z
      application-data-type=ADT_SimSwitchStatus, implementation-data-type=IDT_SimSwitchStatus
      application-data-type=ADT_LCM_IMU_Acc_Y, implementation-data-type=IDT_LCM_IMU_Acc_Y
      application-data-type=ADT_ViaPoint_arr_Reserved, implementation-data-type=IDT_ViaPoint_arr_Reserved
      application-data-type=ADT_ADAS_val_YboundMin, implementation-data-type=IDT_ADAS_val_YboundMin
      application-data-type=ADT_ICC_val_longitude, implementation-data-type=IDT_ICC_val_longitude
      application-data-type=ADT_TotalStep, implementation-data-type=IDT_TotalStep
      application-data-type=ADT_ADAS_enum_HNOACruiseSpdOffsetModFb, implementation-data-type=IDT_ADAS_enum_HNOACruiseSpdOffsetModFb
      application-data-type=ADT_ADAS_arr_TrafficLight, implementation-data-type=IDT_ADAS_arr_TrafficLight
      application-data-type=ADT_ADAS_enum_SafeStopReminder, implementation-data-type=IDT_ADAS_enum_SafeStopReminder
      application-data-type=ADT_Gen_val_unit8, implementation-data-type=IDT_Gen_val_unit8
      application-data-type=ADT_Str_HardwareVers, implementation-data-type=IDT_Str_HardwareVers
      application-data-type=ADT_ADAS_enum_ALCDirIndicator, implementation-data-type=IDT_ADAS_enum_ALCDirIndicator
      application-data-type=ADT_ICC_arr_NaviIntCameraDynInfo, implementation-data-type=IDT_ICC_arr_NaviIntCameraDynInfo
      application-data-type=ADT_Enum_TBOXOTAAPPTCancel, implementation-data-type=IDT_Enum_TBOXOTAAPPTCancel
      application-data-type=ADT_FactoryResetResult, implementation-data-type=IDT_FactoryResetResult
      application-data-type=ADT_ICC_enum_NavRampInfo, implementation-data-type=IDT_ICC_enum_NavRampInfo
      application-data-type=ADT_Gen_val_Width, implementation-data-type=IDT_Gen_val_Width
      application-data-type=ADT_ADAS_enum_SlotStatus, implementation-data-type=IDT_ADAS_enum_SlotStatus
      application-data-type=ADT_ADAS_enum_MNPRouteMileage, implementation-data-type=IDT_ADAS_enum_MNPRouteMileage
      application-data-type=ADT_CellularRsrp, implementation-data-type=IDT_CellularRsrp
      application-data-type=ADT_vhrReportEnable, implementation-data-type=IDT_vhrReportEnable
      application-data-type=ADT_ADAS_enum_NOALCCSwitchBtnONOFFSts, implementation-data-type=IDT_ADAS_enum_NOALCCSwitchBtnONOFFSts
      application-data-type=ADT_ICC_strt_HPASetOnwayLabel, implementation-data-type=IDT_ICC_strt_HPASetOnwayLabel
      application-data-type=ADT_ICC_enum_RGearDefaultFunctionBtnSt, implementation-data-type=IDT_ICC_enum_RGearDefaultFunctionBtnSt
      application-data-type=ADT_ICC_enum_FSRACruiseSpdOffsetMod, implementation-data-type=IDT_ICC_enum_FSRACruiseSpdOffsetMod
      application-data-type=ADT_Enum_GNSSType2, implementation-data-type=IDT_Enum_GNSSType2
      application-data-type=ADT_Enum_GNSSType1, implementation-data-type=IDT_Enum_GNSSType1
      application-data-type=ADT_CellularCellId, implementation-data-type=IDT_CellularCellId
      application-data-type=ADT_ADASSettingInfo_arr_Reserved2, implementation-data-type=IDT_ADASSettingInfo_arr_Reserved2
      application-data-type=ADT_ADAS_arr_ParkingStaticObjects, implementation-data-type=IDT_ADAS_arr_ParkingStaticObjects
      application-data-type=ADT_ICC_enum_AMAPSwtSet, implementation-data-type=IDT_ICC_enum_AMAPSwtSet
      application-data-type=ADT_ADAS_strt_MRAInfo, implementation-data-type=IDT_ADAS_strt_MRAInfo
      application-data-type=ADT_StrVar_BleMasterVer, implementation-data-type=IDT_StrVar_BleMasterVer
      application-data-type=ADT_Bool_Almanac, implementation-data-type=IDT_Bool_Almanac
      application-data-type=ADT_ICC_enum_NavIsTimeSpeedLimit, implementation-data-type=IDT_ICC_enum_NavIsTimeSpeedLimit
      application-data-type=ADT_ADAS_arr_VPARoadLine, implementation-data-type=IDT_ADAS_arr_VPARoadLine
      application-data-type=ADT_ADAS_enum_LDPSts, implementation-data-type=IDT_ADAS_enum_LDPSts
      application-data-type=ADT_Enum_KPI_DataInLoopUnit, implementation-data-type=IDT_Enum_KPI_DataInLoopUnit
      application-data-type=ADT_ICC_strt_CongestionInfo, implementation-data-type=IDT_ICC_strt_CongestionInfo
      application-data-type=ADT_ICC_enum_SetOnwayLabelType, implementation-data-type=IDT_ICC_enum_SetOnwayLabelType
      application-data-type=ADT_ADAS_strt_RoadMarkerSupplement, implementation-data-type=IDT_ADAS_strt_RoadMarkerSupplement
      application-data-type=ADT_ADAS_enum_SlotType, implementation-data-type=IDT_ADAS_enum_SlotType
      application-data-type=ADT_ADAS_enum_LKS_WarnSensitivity, implementation-data-type=IDT_ADAS_enum_LKS_WarnSensitivity
      application-data-type=ADT_ADAS_enum_VPAFunctionType, implementation-data-type=IDT_ADAS_enum_VPAFunctionType
      application-data-type=ADT_ADAS_enum_AESActiveSt, implementation-data-type=IDT_ADAS_enum_AESActiveSt
      application-data-type=ADT_ApnIndex, implementation-data-type=IDT_ApnIndex
      application-data-type=ADT_DSTFlag, implementation-data-type=IDT_DSTFlag
      application-data-type=ADT_ADAS_strt_ParkingSlot, implementation-data-type=IDT_ADAS_strt_ParkingSlot
      application-data-type=ADT_StrVar_IMEIInfo, implementation-data-type=IDT_StrVar_IMEIInfo
      application-data-type=ADT_ADAS_enum_DAIReminder, implementation-data-type=IDT_ADAS_enum_DAIReminder
      application-data-type=ADT_ICC_Navi_Latitude, implementation-data-type=IDT_ICC_Navi_Latitude
      application-data-type=ADT_ResetCommand, implementation-data-type=IDT_ResetCommand
      application-data-type=ADT_ICC_int32_CityCode, implementation-data-type=IDT_ICC_int32_CityCode
      application-data-type=ADT_Traffic3DSign_arr_Reserved, implementation-data-type=IDT_Traffic3DSign_arr_Reserved
      application-data-type=ADT_ADAS_val_SlotID, implementation-data-type=IDT_ADAS_val_SlotID
      application-data-type=ADT_ADAS_enum_VPAQuitInd, implementation-data-type=IDT_ADAS_enum_VPAQuitInd
      application-data-type=ADT_Struct_CallNumberList, implementation-data-type=IDT_Struct_CallNumberList
      application-data-type=ADT_Gen_int32_ID, implementation-data-type=IDT_Gen_int32_ID
      application-data-type=ADT_ADAS_enum_NOPLaneChangeInfo, implementation-data-type=IDT_ADAS_enum_NOPLaneChangeInfo
      application-data-type=ADT_Gen_val_int64, implementation-data-type=IDT_Gen_val_int64
      application-data-type=ADT_EphemerisDataSwitch, implementation-data-type=IDT_EphemerisDataSwitch
      application-data-type=ADT_ADAS_strt_TrafficLight, implementation-data-type=IDT_ADAS_strt_TrafficLight
      application-data-type=ADT_L2NCAState, implementation-data-type=IDT_L2NCAState
      application-data-type=ADT_Heading, implementation-data-type=IDT_Heading
      application-data-type=ADT_ADAS_strt_SpeedBumpInfo, implementation-data-type=IDT_ADAS_strt_SpeedBumpInfo
      application-data-type=ADT_ADAS_val_FusionMetaData, implementation-data-type=IDT_ADAS_val_FusionMetaData
      application-data-type=ADT_ValetParkingActiveStatus, implementation-data-type=IDT_ValetParkingActiveStatus
      application-data-type=ADT_NanoSecondTimeStampOffset, implementation-data-type=IDT_NanoSecondTimeStampOffset
      application-data-type=ADT_StrVar_EcuVerison, implementation-data-type=IDT_StrVar_EcuVerison
      application-data-type=ADT_ADAS_strt_HPATrainingPathInfo, implementation-data-type=IDT_ADAS_strt_HPATrainingPathInfo
      application-data-type=ADT_ADAS_enum_DegradeReminder, implementation-data-type=IDT_ADAS_enum_DegradeReminder
      application-data-type=ADT_ADS_ReservedUnit8, implementation-data-type=IDT_ADS_ReservedUnit8
      application-data-type=ADT_ADAS_strt_RoadSurfaceMesh, implementation-data-type=IDT_ADAS_strt_RoadSurfaceMesh
      application-data-type=ADT_Struct_NetworkStatus, implementation-data-type=IDT_Struct_NetworkStatus
      application-data-type=ADT_ADAS_Stub_FuncRoadClass, implementation-data-type=IDT_ADAS_Stub_FuncRoadClass
      application-data-type=ADT_ADAS_enum_ACCQuitReason, implementation-data-type=IDT_ADAS_enum_ACCQuitReason
      application-data-type=ADT_ADAS_arr_VPAFloor, implementation-data-type=IDT_ADAS_arr_VPAFloor
      application-data-type=ADT_Enum_BleKeyFilling, implementation-data-type=IDT_Enum_BleKeyFilling
      application-data-type=ADT_CellularMnc, implementation-data-type=IDT_CellularMnc
      application-data-type=ADT_ADAS_enum_ALCTakeOverRequest, implementation-data-type=IDT_ADAS_enum_ALCTakeOverRequest
      application-data-type=ADT_PrkgSlot_arr_Reserved, implementation-data-type=IDT_PrkgSlot_arr_Reserved
      application-data-type=ADT_ADAS_enum_TolDatauploadBtnFb, implementation-data-type=IDT_ADAS_enum_TolDatauploadBtnFb
      application-data-type=ADT_ICC_string_LightDesc, implementation-data-type=IDT_ICC_string_LightDesc
      application-data-type=ADT_MRAInfo_arr_Reserved, implementation-data-type=IDT_MRAInfo_arr_Reserved
      application-data-type=ADT_ICC_strt_ApaRpaFcnOperating, implementation-data-type=IDT_ICC_strt_ApaRpaFcnOperating
      application-data-type=ADT_ICC_strt_TmcInfoDataBean, implementation-data-type=IDT_ICC_strt_TmcInfoDataBean
      application-data-type=ADT_Struct_TBOXOTAState, implementation-data-type=IDT_Struct_TBOXOTAState
      application-data-type=ADT_ICC_enum_FSRACruiseSpdOffsetPercent, implementation-data-type=IDT_ICC_enum_FSRACruiseSpdOffsetPercent
      application-data-type=ADT_Gen_enum_OnOffSts, implementation-data-type=IDT_Gen_enum_OnOffSts
      application-data-type=ADT_Altitude, implementation-data-type=IDT_Altitude
      application-data-type=ADT_ADAS_enum_TrafficLightType, implementation-data-type=IDT_ADAS_enum_TrafficLightType
      application-data-type=ADT_ADAS_enum_AebSts, implementation-data-type=IDT_ADAS_enum_AebSts
      application-data-type=ADT_ADAS_string_VPASpotName, implementation-data-type=IDT_ADAS_string_VPASpotName
      application-data-type=ADT_ADAS_strt_VPASelfBuildMap, implementation-data-type=IDT_ADAS_strt_VPASelfBuildMap
      application-data-type=ADT_ICC_enum_CruiseFacilityType, implementation-data-type=IDT_ICC_enum_CruiseFacilityType
      application-data-type=ADT_ICC_int32_NotAvoidType, implementation-data-type=IDT_ICC_int32_NotAvoidType
      application-data-type=ADT_Enum_TBOXOTAState, implementation-data-type=IDT_Enum_TBOXOTAState
      application-data-type=ADT_ADAS_val_timestampnSec, implementation-data-type=IDT_ADAS_val_timestampnSec
      application-data-type=ADT_ICC_strt_NaviWeatherInfo, implementation-data-type=IDT_ICC_strt_NaviWeatherInfo
      application-data-type=ADT_ADAS_arr_LinePoint, implementation-data-type=IDT_ADAS_arr_LinePoint
      application-data-type=ADT_ICC_string_LevelName, implementation-data-type=IDT_ICC_string_LevelName
      application-data-type=ADT_HpaFcn_arr_Reserved, implementation-data-type=IDT_HpaFcn_arr_Reserved
      application-data-type=ADT_UTC, implementation-data-type=IDT_UTC
      application-data-type=ADT_ACCURACY, implementation-data-type=IDT_ACCURACY
      application-data-type=ADT_ADAS_enum_ParkingChimeVoice, implementation-data-type=IDT_ADAS_enum_ParkingChimeVoice
      application-data-type=ADT_ADAS_val_FSRACruiseSpdOffsetSpdFb, implementation-data-type=IDT_ADAS_val_FSRACruiseSpdOffsetSpdFb
      application-data-type=ADT_ADAS_Meta_MapVerYear, implementation-data-type=IDT_ADAS_Meta_MapVerYear
      application-data-type=ADT_ADAS_enum_MNPMemRouteUseFreq, implementation-data-type=IDT_ADAS_enum_MNPMemRouteUseFreq
      application-data-type=ADT_ICC_enum_HPAUndoOperationID, implementation-data-type=IDT_ICC_enum_HPAUndoOperationID
      application-data-type=ADT_StrVar_Telephonenumber, implementation-data-type=IDT_StrVar_Telephonenumber
      application-data-type=ADT_ADAS_Stub_CycCnt, implementation-data-type=IDT_ADAS_Stub_CycCnt
      application-data-type=ADT_ICC_val_altitude, implementation-data-type=IDT_ICC_val_altitude
      application-data-type=ADT_LanePositionInfo_offset, implementation-data-type=IDT_LanePositionInfo_offset
      application-data-type=ADT_ADAS_enum_LightColor, implementation-data-type=IDT_ADAS_enum_LightColor
      application-data-type=ADT_ADAS_strt_TrafficSign_2, implementation-data-type=IDT_ADAS_strt_TrafficSign_2
      application-data-type=ADT_ADAS_enum_MNPDelRouteSts, implementation-data-type=IDT_ADAS_enum_MNPDelRouteSts
      application-data-type=ADT_ADAS_enum_HpaActiveCheckSts, implementation-data-type=IDT_ADAS_enum_HpaActiveCheckSts
      application-data-type=ADT_EphemerisDataFormat, implementation-data-type=IDT_EphemerisDataFormat
      application-data-type=ADT_Enum_TollLaneType, implementation-data-type=IDT_Enum_TollLaneType
      application-data-type=ADT_ADAS_strt_HPATrainingPathInfo_2, implementation-data-type=IDT_ADAS_strt_HPATrainingPathInfo_2
      application-data-type=ADT_ICC_strt_NaviStatusBean, implementation-data-type=IDT_ICC_strt_NaviStatusBean
      application-data-type=ADT_ADAS_arr_VPAStaticObjects, implementation-data-type=IDT_ADAS_arr_VPAStaticObjects
      application-data-type=ADT_SentryModeFaults, implementation-data-type=IDT_SentryModeFaults
      application-data-type=ADT_ICC_val_Direction, implementation-data-type=IDT_ICC_val_Direction
      application-data-type=ADT_ICC_enum_FCWSettingSt, implementation-data-type=IDT_ICC_enum_FCWSettingSt
      application-data-type=ADT_Gen_val_int16, implementation-data-type=IDT_Gen_val_int16
      application-data-type=ADT_ADAS_enum_FSRASpdSetMod, implementation-data-type=IDT_ADAS_enum_FSRASpdSetMod
      application-data-type=ADT_ADAS_enum_ParkingScreen_ctrl, implementation-data-type=IDT_ADAS_enum_ParkingScreen_ctrl
      application-data-type=ADT_ADAS_Meta_CountryCode, implementation-data-type=IDT_ADAS_Meta_CountryCode
      application-data-type=ADT_ICC_enum_VoiceControlCruiseDistanceAdjust, implementation-data-type=IDT_ICC_enum_VoiceControlCruiseDistanceAdjust
      application-data-type=ADT_HDOP, implementation-data-type=IDT_HDOP
      application-data-type=ADT_ADAS_strt_OccPoint, implementation-data-type=IDT_ADAS_strt_OccPoint
      application-data-type=ADT_ADAS_strt_SensorSt, implementation-data-type=IDT_ADAS_strt_SensorSt
      application-data-type=ADT_SwtSts, implementation-data-type=IDT_SwtSts
      application-data-type=ADT_ValetParkingRealtimeInfoReserved, implementation-data-type=IDT_ValetParkingRealtimeInfoReserved
      application-data-type=ADT_ResponseVhrCompLogReportEnableCfg, implementation-data-type=IDT_ResponseVhrCompLogReportEnableCfg
      application-data-type=ADT_ADAS_arr_FusionMetaData, implementation-data-type=IDT_ADAS_arr_FusionMetaData
      application-data-type=ADT_ADAS_enum_TrafficSignType, implementation-data-type=IDT_ADAS_enum_TrafficSignType
      application-data-type=ADT_ICC_int32_LightType, implementation-data-type=IDT_ICC_int32_LightType
      application-data-type=ADT_ICC_strt_NaviIntervalCameraInfo1, implementation-data-type=IDT_ICC_strt_NaviIntervalCameraInfo1
      application-data-type=ADT_ICC_strt_MyLocationInfo, implementation-data-type=IDT_ICC_strt_MyLocationInfo
      application-data-type=ADT_ADAS_Stub_SubPathIdx, implementation-data-type=IDT_ADAS_Stub_SubPathIdx
      application-data-type=ADT_keeptimelengthResponse, implementation-data-type=IDT_keeptimelengthResponse
      application-data-type=ADT_ADAS_arr_StaticObjects, implementation-data-type=IDT_ADAS_arr_StaticObjects
      application-data-type=ADT_Enum_CarrierInfo, implementation-data-type=IDT_Enum_CarrierInfo
      application-data-type=ADT_SentryModeRpt, implementation-data-type=IDT_SentryModeRpt
      application-data-type=ADT_ADAS_Seg_PathIdx, implementation-data-type=IDT_ADAS_Seg_PathIdx
      application-data-type=ADT_ADAS_val_DrivingTrajectoryPointNum, implementation-data-type=IDT_ADAS_val_DrivingTrajectoryPointNum
      application-data-type=ADT_ADAS_val_LightNum, implementation-data-type=IDT_ADAS_val_LightNum
      application-data-type=ADT_TotalTalkTime, implementation-data-type=IDT_TotalTalkTime
      application-data-type=ADT_ADAS_enum_TargetSlotAvailableParkInType, implementation-data-type=IDT_ADAS_enum_TargetSlotAvailableParkInType
      application-data-type=ADT_ICC_enum_APARoad_Class, implementation-data-type=IDT_ICC_enum_APARoad_Class
      application-data-type=ADT_ADAS_Posn_Age, implementation-data-type=IDT_ADAS_Posn_Age
      application-data-type=ADT_ICC_int32_RouteOption, implementation-data-type=IDT_ICC_int32_RouteOption
      application-data-type=ADT_ADAS_arr_VPAParkingLotInfo, implementation-data-type=IDT_ADAS_arr_VPAParkingLotInfo
      application-data-type=ADT_Reserved_uint8_Type, implementation-data-type=IDT_Reserved_uint8_Type
      application-data-type=ADT_Gen_val_int32, implementation-data-type=IDT_Gen_val_int32
      application-data-type=ADT_ADAS_enum_TolAutoAvoidObstacle, implementation-data-type=IDT_ADAS_enum_TolAutoAvoidObstacle
      application-data-type=ADT_ADAS_enum_TrafficLightColor, implementation-data-type=IDT_ADAS_enum_TrafficLightColor
      application-data-type=ADT_HPAStaticObject_arr_Reserved, implementation-data-type=IDT_HPAStaticObject_arr_Reserved
      application-data-type=ADT_Enum_DiagnosisState, implementation-data-type=IDT_Enum_DiagnosisState
      application-data-type=ADT_Enum_TollStationPathSet, implementation-data-type=IDT_Enum_TollStationPathSet
      application-data-type=ADT_ADAS_enum_TSISgnLongStay, implementation-data-type=IDT_ADAS_enum_TSISgnLongStay
      application-data-type=ADT_ValetParkingCurrentIndex, implementation-data-type=IDT_ValetParkingCurrentIndex
      application-data-type=ADT_Struct_SIMCardinfo, implementation-data-type=IDT_Struct_SIMCardinfo
      application-data-type=ADT_RequestVhrCompLogReportEnableCfg, implementation-data-type=IDT_RequestVhrCompLogReportEnableCfg
      application-data-type=ADT_RoadMarkerSupplement_arr_Reserved, implementation-data-type=IDT_RoadMarkerSupplement_arr_Reserved
      application-data-type=ADT_ICC_enum_PathOperationId, implementation-data-type=IDT_ICC_enum_PathOperationId
      application-data-type=ADT_ICC_strt_FacilityInfo, implementation-data-type=IDT_ICC_strt_FacilityInfo
      application-data-type=ADT_ICC_arr_NaviInfoPanel, implementation-data-type=IDT_ICC_arr_NaviInfoPanel
      application-data-type=ADT_ADAS_arr_ParkingDynamicObjects, implementation-data-type=IDT_ADAS_arr_ParkingDynamicObjects
      application-data-type=ADT_ADAS_strt_LinePoint, implementation-data-type=IDT_ADAS_strt_LinePoint
      application-data-type=ADT_ADAS_enum_ICAPlusONOFFSts, implementation-data-type=IDT_ADAS_enum_ICAPlusONOFFSts
      application-data-type=ADT_EndPoi_arr_Reserved, implementation-data-type=IDT_EndPoi_arr_Reserved
      application-data-type=ADT_ACCSupplementInfo_arr_Reserved, implementation-data-type=IDT_ACCSupplementInfo_arr_Reserved
      application-data-type=ADT_Enum_Network, implementation-data-type=IDT_Enum_Network
      application-data-type=ADT_ADAS_strt_MNPMemRoutePoint, implementation-data-type=IDT_ADAS_strt_MNPMemRoutePoint
      application-data-type=ADT_StrVar_ECUSoftwareNumber, implementation-data-type=IDT_StrVar_ECUSoftwareNumber
      application-data-type=ADT_ADAS_enum_EfficientPassageBtnStFb, implementation-data-type=IDT_ADAS_enum_EfficientPassageBtnStFb
      application-data-type=ADT_ADAS_val_YboundMax, implementation-data-type=IDT_ADAS_val_YboundMax
      application-data-type=ADT_GnssInfo, implementation-data-type=IDT_GnssInfo
      application-data-type=ADT_ADAS_enum_LongiTakeOverReq, implementation-data-type=IDT_ADAS_enum_LongiTakeOverReq
      application-data-type=ADT_ADAS_enum_VPADriOperateInd, implementation-data-type=IDT_ADAS_enum_VPADriOperateInd
      application-data-type=ADT_ICC_uint16_SelectSlotID, implementation-data-type=IDT_ICC_uint16_SelectSlotID
      application-data-type=ADT_ADAS_strt_SlotPoint, implementation-data-type=IDT_ADAS_strt_SlotPoint
      application-data-type=ADT_ADAS_arr_LaneLineData, implementation-data-type=IDT_ADAS_arr_LaneLineData
      application-data-type=ADT_ADAS_enum_RGearDefaultFunctionBtnStFb, implementation-data-type=IDT_ADAS_enum_RGearDefaultFunctionBtnStFb
      application-data-type=ADT_LanePositionInfo_heading, implementation-data-type=IDT_LanePositionInfo_heading
      application-data-type=ADT_ADAS_strt_ICAInfo, implementation-data-type=IDT_ADAS_strt_ICAInfo
      application-data-type=ADT_ADAS_arr_Traffic3DSignList, implementation-data-type=IDT_ADAS_arr_Traffic3DSignList
      application-data-type=ADT_Strt_TollGateLaneInfo, implementation-data-type=IDT_Strt_TollGateLaneInfo
      application-data-type=ADT_keeptimelength, implementation-data-type=IDT_keeptimelength
      application-data-type=ADT_ADAS_Seg_FormOfWay, implementation-data-type=IDT_ADAS_Seg_FormOfWay
      application-data-type=ADT_Integer_SignalStrength, implementation-data-type=IDT_Integer_SignalStrength
      application-data-type=ADT_ADAS_strt_HPAVPAPathInfo, implementation-data-type=IDT_ADAS_strt_HPAVPAPathInfo
      application-data-type=ADT_ICC_arr_CameraSpeed, implementation-data-type=IDT_ICC_arr_CameraSpeed
      application-data-type=ADT_ICC_string_Trend, implementation-data-type=IDT_ICC_string_Trend
      application-data-type=ADT_ResumeFactorySet, implementation-data-type=IDT_ResumeFactorySet
      application-data-type=ADT_ADAS_Seg_Offset, implementation-data-type=IDT_ADAS_Seg_Offset
      application-data-type=ADT_ICC_int32_AlertLevel, implementation-data-type=IDT_ICC_int32_AlertLevel
      application-data-type=ADT_ADAS_enum_SidePassConfirmReq, implementation-data-type=IDT_ADAS_enum_SidePassConfirmReq
      application-data-type=ADT_StrVar_TBoxVersion, implementation-data-type=IDT_StrVar_TBoxVersion
      application-data-type=ADT_StrVar_user, implementation-data-type=IDT_StrVar_user
      application-data-type=ADT_ADAS_enum_ISLIWarningMod, implementation-data-type=IDT_ADAS_enum_ISLIWarningMod
      application-data-type=ADT_ICC_enum_MNPUseRouteIDBtnSt, implementation-data-type=IDT_ICC_enum_MNPUseRouteIDBtnSt
      application-data-type=ADT_ICC_enum_NavigationSts, implementation-data-type=IDT_ICC_enum_NavigationSts
      application-data-type=ADT_ADAS_strt_MNPInfo_2, implementation-data-type=IDT_ADAS_strt_MNPInfo_2
      application-data-type=ADT_ICC_enum_HNOACruiseSpdOffsetMod, implementation-data-type=IDT_ICC_enum_HNOACruiseSpdOffsetMod
      application-data-type=ADT_ApnCount, implementation-data-type=IDT_ApnCount
      application-data-type=ADT_ADAS_enum_AESESSTextInfo, implementation-data-type=IDT_ADAS_enum_AESESSTextInfo
      application-data-type=ADT_ICC_int64_Speed, implementation-data-type=IDT_ICC_int64_Speed
      application-data-type=ADT_Struct_UsbUpdateSta, implementation-data-type=IDT_Struct_UsbUpdateSta
      application-data-type=ADT_ADAS_Meta_ProtVer_Major, implementation-data-type=IDT_ADAS_Meta_ProtVer_Major
      application-data-type=ADT_ICC_enum_MEBSwtSet, implementation-data-type=IDT_ICC_enum_MEBSwtSet
      application-data-type=ADT_CongestionExtend_arr_Reserved, implementation-data-type=IDT_CongestionExtend_arr_Reserved
      application-data-type=ADT_ADAS_enum_LDWSts, implementation-data-type=IDT_ADAS_enum_LDWSts
      application-data-type=ADT_ICC_enum_NOPLaneChangeMod, implementation-data-type=IDT_ICC_enum_NOPLaneChangeMod
      application-data-type=ADT_ICC_strt_NaviGreenWaveCarSpeed, implementation-data-type=IDT_ICC_strt_NaviGreenWaveCarSpeed
      application-data-type=ADT_WiFiCurConnStatus, implementation-data-type=IDT_WiFiCurConnStatus
      application-data-type=ADT_ICC_boolean_isNew, implementation-data-type=IDT_ICC_boolean_isNew
      application-data-type=ADT_ICC_enum_HPALTEdbm, implementation-data-type=IDT_ICC_enum_HPALTEdbm
      application-data-type=ADT_ICC_int32_WeatherID, implementation-data-type=IDT_ICC_int32_WeatherID
      application-data-type=ADT_ICC_string_Name, implementation-data-type=IDT_ICC_string_Name
      application-data-type=ADT_ADAS_enum_SceneSts, implementation-data-type=IDT_ADAS_enum_SceneSts
      application-data-type=ADT_CelluarEsimStatus, implementation-data-type=IDT_CelluarEsimStatus
      application-data-type=ADT_ICC_uint64_Time, implementation-data-type=IDT_ICC_uint64_Time
      application-data-type=ADT_Str_MemRouteInfo, implementation-data-type=IDT_Str_MemRouteInfo
      application-data-type=ADT_ADAS_arr_MNPMemRoutes, implementation-data-type=IDT_ADAS_arr_MNPMemRoutes
      application-data-type=ADT_ADAS_enum_GoNotifier, implementation-data-type=IDT_ADAS_enum_GoNotifier
      application-data-type=ADT_Gen_int32_ManeuverID, implementation-data-type=IDT_Gen_int32_ManeuverID
      application-data-type=ADT_SentryModeSetResult, implementation-data-type=IDT_SentryModeSetResult
      application-data-type=ADT_ADAS_enum_TLRONOFFSts, implementation-data-type=IDT_ADAS_enum_TLRONOFFSts
      application-data-type=ADT_ADAS_enum_PathState, implementation-data-type=IDT_ADAS_enum_PathState
      application-data-type=ADT_Struct_TBOXOTAAPPTSet, implementation-data-type=IDT_Struct_TBOXOTAAPPTSet
      application-data-type=ADT_ADAS_enum_HandsOffWarningStyle, implementation-data-type=IDT_ADAS_enum_HandsOffWarningStyle
      application-data-type=ADT_ICC_int32_NaviSplit, implementation-data-type=IDT_ICC_int32_NaviSplit
      application-data-type=ADT_ADAS_val_MeterPerPixely, implementation-data-type=IDT_ADAS_val_MeterPerPixely
      application-data-type=ADT_ADAS_val_MeterPerPixelx, implementation-data-type=IDT_ADAS_val_MeterPerPixelx
      application-data-type=ADT_ICC_strt_VpaFcnOperating, implementation-data-type=IDT_ICC_strt_VpaFcnOperating
      application-data-type=ADT_ICC_strt_HpaFcnOperating_2, implementation-data-type=IDT_ICC_strt_HpaFcnOperating_2
      application-data-type=ADT_ICC_int32_LaneCategoryType, implementation-data-type=IDT_ICC_int32_LaneCategoryType
      application-data-type=ADT_Struct_VehicleDiagStatus, implementation-data-type=IDT_Struct_VehicleDiagStatus
      application-data-type=ADT_ICC_strt_NaviCongestionDetailInfo, implementation-data-type=IDT_ICC_strt_NaviCongestionDetailInfo
      application-data-type=ADT_ADAS_strt_ApaTargetSlotInfo, implementation-data-type=IDT_ADAS_strt_ApaTargetSlotInfo
      application-data-type=ADT_IHCInfo_arr_Reserved, implementation-data-type=IDT_IHCInfo_arr_Reserved
      application-data-type=ADT_ICC_int32_TunnelFlag, implementation-data-type=IDT_ICC_int32_TunnelFlag
      application-data-type=ADT_ADAS_arr_PathPoint, implementation-data-type=IDT_ADAS_arr_PathPoint
      application-data-type=ADT_ICC_enum_DatauploadBtn, implementation-data-type=IDT_ICC_enum_DatauploadBtn
      application-data-type=ADT_ADAS_enum_TimeGapSet, implementation-data-type=IDT_ADAS_enum_TimeGapSet
      application-data-type=ADT_ADAS_strt_HPAPathDetail, implementation-data-type=IDT_ADAS_strt_HPAPathDetail
      application-data-type=ADT_WiFiConnStatus, implementation-data-type=IDT_WiFiConnStatus
      application-data-type=ADT_ADAS_enum_SglAutoMergeChangeLane, implementation-data-type=IDT_ADAS_enum_SglAutoMergeChangeLane
      application-data-type=ADT_ICC_arr_NaviIntervalCameraInfo, implementation-data-type=IDT_ICC_arr_NaviIntervalCameraInfo
      application-data-type=ADT_UUIDCode, implementation-data-type=IDT_UUIDCode
      application-data-type=ADT_DataInt8, implementation-data-type=IDT_DataInt8
      application-data-type=ADT_SentryModeCmd, implementation-data-type=IDT_SentryModeCmd
      application-data-type=ADT_Enum_TSPConnectionState, implementation-data-type=IDT_Enum_TSPConnectionState
      application-data-type=ADT_ADAS_enum_AESSts, implementation-data-type=IDT_ADAS_enum_AESSts
      application-data-type=ADT_ADAS_strt_APARPAInfo_2, implementation-data-type=IDT_ADAS_strt_APARPAInfo_2
      application-data-type=ADT_ADAS_enum_ApaRpaSts, implementation-data-type=IDT_ADAS_enum_ApaRpaSts
      application-data-type=ADT_U32_TBOXOSRTC, implementation-data-type=IDT_U32_TBOXOSRTC
      application-data-type=ADT_ADAS_enum_NOPLaneChangeMod, implementation-data-type=IDT_ADAS_enum_NOPLaneChangeMod
      application-data-type=ADT_SentryModePlanFb, implementation-data-type=IDT_SentryModePlanFb
      application-data-type=ADT_ICC_float_Percent, implementation-data-type=IDT_ICC_float_Percent
      application-data-type=ADT_CellularRat, implementation-data-type=IDT_CellularRat
      application-data-type=ADT_ADAS_enum_MNPMemRouteUseFlag, implementation-data-type=IDT_ADAS_enum_MNPMemRouteUseFlag
      application-data-type=ADT_ICC_enum_Cause, implementation-data-type=IDT_ICC_enum_Cause
      application-data-type=ADT_ADAS_val_laneID, implementation-data-type=IDT_ADAS_val_laneID
      application-data-type=ADT_Arr_VersInfoReserved, implementation-data-type=IDT_Arr_VersInfoReserved
      application-data-type=ADT_ADAS_val_ParkingProcessTakeTime, implementation-data-type=IDT_ADAS_val_ParkingProcessTakeTime
      application-data-type=ADT_EphemerisDataIndex, implementation-data-type=IDT_EphemerisDataIndex
      application-data-type=ADT_ADAS_strt_APARPAInfo, implementation-data-type=IDT_ADAS_strt_APARPAInfo
      application-data-type=ADT_HPAPathInfo_arr_Reserved, implementation-data-type=IDT_HPAPathInfo_arr_Reserved
      application-data-type=ADT_ADAS_ProfShort_Dist1, implementation-data-type=IDT_ADAS_ProfShort_Dist1
      application-data-type=ADT_ADAS_enum_NarrowRoadAssistSts, implementation-data-type=IDT_ADAS_enum_NarrowRoadAssistSts
      application-data-type=ADT_ADAS_arr_DynamicObjects_2, implementation-data-type=IDT_ADAS_arr_DynamicObjects_2
      application-data-type=ADT_SecondTimeStampOffset, implementation-data-type=IDT_SecondTimeStampOffset
      application-data-type=ADT_Step, implementation-data-type=IDT_Step
      application-data-type=ADT_ADAS_enum_NOPLaneChangeStyle, implementation-data-type=IDT_ADAS_enum_NOPLaneChangeStyle
      application-data-type=ADT_ADAS_strt_VPAParkingSLot, implementation-data-type=IDT_ADAS_strt_VPAParkingSLot
      application-data-type=ADT_ADAS_strt_HpaEndPos, implementation-data-type=IDT_ADAS_strt_HpaEndPos
      application-data-type=ADT_SimSwitchEvent, implementation-data-type=IDT_SimSwitchEvent
      application-data-type=ADT_ParkingAreaCellMapInfo, implementation-data-type=IDT_ParkingAreaCellMapInfo
      application-data-type=ADT_ICC_boolean_scopeFlag, implementation-data-type=IDT_ICC_boolean_scopeFlag
      application-data-type=ADT_ADAS_enum_TLATextInfo, implementation-data-type=IDT_ADAS_enum_TLATextInfo
      application-data-type=ADT_IsSimInPostion, implementation-data-type=IDT_IsSimInPostion
      application-data-type=ADT_StrVar_ModemVersion, implementation-data-type=IDT_StrVar_ModemVersion
      application-data-type=ADT_ADAS_val_latitude, implementation-data-type=IDT_ADAS_val_latitude
      application-data-type=ADT_SingleSimDetailInfo, implementation-data-type=IDT_SingleSimDetailInfo
      application-data-type=ADT_ADAS_strt_AdvanceParkingInfo_2, implementation-data-type=IDT_ADAS_strt_AdvanceParkingInfo_2
      application-data-type=ADT_ADAS_string_PathName, implementation-data-type=IDT_ADAS_string_PathName
      application-data-type=ADT_ICC_enum_OutsideParkingBtnSt, implementation-data-type=IDT_ICC_enum_OutsideParkingBtnSt
      application-data-type=ADT_ADAS_strt_VPARoadLinePoint, implementation-data-type=IDT_ADAS_strt_VPARoadLinePoint
      application-data-type=ADT_ADAS_val_TrafficLightCountdownNumber, implementation-data-type=IDT_ADAS_val_TrafficLightCountdownNumber
      application-data-type=ADT_ICC_enum_LearnOperationId, implementation-data-type=IDT_ICC_enum_LearnOperationId
      application-data-type=ADT_ADAS_enum_iLOAActdirection, implementation-data-type=IDT_ADAS_enum_iLOAActdirection
      application-data-type=ADT_LocMatchInfo_arr_Reserved, implementation-data-type=IDT_LocMatchInfo_arr_Reserved
      application-data-type=ADT_RoadPointCellArray, implementation-data-type=IDT_RoadPointCellArray
      application-data-type=ADT_ADAS_enum_ISLISt, implementation-data-type=IDT_ADAS_enum_ISLISt
      application-data-type=ADT_DVRcameraSts, implementation-data-type=IDT_DVRcameraSts
      application-data-type=ADT_ADAS_strt_VPASpot, implementation-data-type=IDT_ADAS_strt_VPASpot
      application-data-type=ADT_ICC_int32_Busway, implementation-data-type=IDT_ICC_int32_Busway
      application-data-type=ADT_ADAS_strt_VPASpeedBump, implementation-data-type=IDT_ADAS_strt_VPASpeedBump
      application-data-type=ADT_ADAS_strt_MNPAllRoutesInfo, implementation-data-type=IDT_ADAS_strt_MNPAllRoutesInfo
      application-data-type=ADT_TolNtfADDrivingCardinfo_arr_Reserved, implementation-data-type=IDT_TolNtfADDrivingCardinfo_arr_Reserved
      application-data-type=ADT_ADAS_strt_Traffic3DSign, implementation-data-type=IDT_ADAS_strt_Traffic3DSign
      application-data-type=ADT_ICC_strt_LocMatchInfo, implementation-data-type=IDT_ICC_strt_LocMatchInfo
      application-data-type=ADT_MNPRouteInfo_arr_Reserved, implementation-data-type=IDT_MNPRouteInfo_arr_Reserved
      application-data-type=ADT_SentryModePlanTime_flag, implementation-data-type=IDT_SentryModePlanTime_flag
      application-data-type=ADT_PointIndex, implementation-data-type=IDT_PointIndex
      application-data-type=ADT_ICC_int32_Time, implementation-data-type=IDT_ICC_int32_Time
      application-data-type=ADT_ADAS_arr_ParkingSlot, implementation-data-type=IDT_ADAS_arr_ParkingSlot
      application-data-type=ADT_ADAS_arr_OCCInfoList, implementation-data-type=IDT_ADAS_arr_OCCInfoList
      application-data-type=ADT_Gen_enum_ValidityStatus, implementation-data-type=IDT_Gen_enum_ValidityStatus
      application-data-type=ADT_ADAS_enum_iLOATextInfo, implementation-data-type=IDT_ADAS_enum_iLOATextInfo
      application-data-type=ADT_ADAS_enum_HNOPConfidence, implementation-data-type=IDT_ADAS_enum_HNOPConfidence
      application-data-type=ADT_CellularNetworkInfo, implementation-data-type=IDT_CellularNetworkInfo
      application-data-type=ADT_Gen_val_Yaw, implementation-data-type=IDT_Gen_val_Yaw
      application-data-type=ADT_StrVar_usid, implementation-data-type=IDT_StrVar_usid
      application-data-type=ADT_MixForkInfo_arr_Reserved, implementation-data-type=IDT_MixForkInfo_arr_Reserved
      application-data-type=ADT_ADAS_enum_DMSWarning, implementation-data-type=IDT_ADAS_enum_DMSWarning
      application-data-type=ADT_Enum_CamStreamSt, implementation-data-type=IDT_Enum_CamStreamSt
      application-data-type=ADT_LCM_strt_IMUData, implementation-data-type=IDT_LCM_strt_IMUData
      application-data-type=ADT_ADAS_strt_DynamicObject_2, implementation-data-type=IDT_ADAS_strt_DynamicObject_2
      application-data-type=ADT_Strt_GNSSInfo, implementation-data-type=IDT_Strt_GNSSInfo
      application-data-type=ADT_Enum_KL15State, implementation-data-type=IDT_Enum_KL15State
      application-data-type=ADT_WiFiApName, implementation-data-type=IDT_WiFiApName
      application-data-type=ADT_ADAS_Seg_DividedRoad, implementation-data-type=IDT_ADAS_Seg_DividedRoad
      application-data-type=ADT_ICC_enum_ESASettingSt, implementation-data-type=IDT_ICC_enum_ESASettingSt
      application-data-type=ADT_Enum_DataInLoopUnit, implementation-data-type=IDT_Enum_DataInLoopUnit
      application-data-type=ADT_SimDetailInfoArray, implementation-data-type=IDT_SimDetailInfoArray
      application-data-type=ADT_LCM_IMU_gpsWeek, implementation-data-type=IDT_LCM_IMU_gpsWeek
      application-data-type=ADT_ALCInfo_arr_Reserved, implementation-data-type=IDT_ALCInfo_arr_Reserved
      application-data-type=ADT_TimeInfoDay, implementation-data-type=IDT_TimeInfoDay
      application-data-type=ADT_ADAS_enum_FcwWarnDist, implementation-data-type=IDT_ADAS_enum_FcwWarnDist
      application-data-type=ADT_ICC_arr_TrafficJamInfo, implementation-data-type=IDT_ICC_arr_TrafficJamInfo
      application-data-type=ADT_FcmCamIntrinsicsData, implementation-data-type=IDT_FcmCamIntrinsicsData
      application-data-type=ADT_ADAS_enum_NarrowRoadAssistTextInfo, implementation-data-type=IDT_ADAS_enum_NarrowRoadAssistTextInfo
      application-data-type=ADT_ICC_enum_AEBSettingSt, implementation-data-type=IDT_ICC_enum_AEBSettingSt
      application-data-type=ADT_ADAS_Stub_TurnAngl, implementation-data-type=IDT_ADAS_Stub_TurnAngl
      application-data-type=ADT_ADAS_enum_TrafficLightAssistBtnStFb, implementation-data-type=IDT_ADAS_enum_TrafficLightAssistBtnStFb
      application-data-type=ADT_ADAS_enum_FCTAWarnActSt, implementation-data-type=IDT_ADAS_enum_FCTAWarnActSt
      application-data-type=ADT_ADAS_enum_MNPMemRouteGrade, implementation-data-type=IDT_ADAS_enum_MNPMemRouteGrade
      application-data-type=ADT_ADAS_strt_HpaUseData, implementation-data-type=IDT_ADAS_strt_HpaUseData
      application-data-type=ADT_ICC_boolean_Valid, implementation-data-type=IDT_ICC_boolean_Valid
      application-data-type=ADT_ICC_strt_CruiseFacilityInfo, implementation-data-type=IDT_ICC_strt_CruiseFacilityInfo
      application-data-type=ADT_EphemerisDataInfo, implementation-data-type=IDT_EphemerisDataInfo
      application-data-type=ADT_AvmCamIntrinsicsData, implementation-data-type=IDT_AvmCamIntrinsicsData
      application-data-type=ADT_ADAS_Posn_Offset, implementation-data-type=IDT_ADAS_Posn_Offset
      application-data-type=ADT_ICC_strt_CruiseInfo, implementation-data-type=IDT_ICC_strt_CruiseInfo
      application-data-type=ADT_ADAS_enum_AebAcitveSt, implementation-data-type=IDT_ADAS_enum_AebAcitveSt
      application-data-type=ADT_ADAS_Stub_PartOfCalcRoute, implementation-data-type=IDT_ADAS_Stub_PartOfCalcRoute
      application-data-type=ADT_ICC_Strt_ADASSettingInfo_2, implementation-data-type=IDT_ICC_Strt_ADASSettingInfo_2
      application-data-type=ADT_ADAS_enum_HPAPathType, implementation-data-type=IDT_ADAS_enum_HPAPathType
      application-data-type=ADT_ICC_Strt_ADASSettingInfo_3, implementation-data-type=IDT_ICC_Strt_ADASSettingInfo_3
      application-data-type=ADT_Struct_Cellinfo, implementation-data-type=IDT_Struct_Cellinfo
      application-data-type=ADT_ADAS_uint16_SurfaceMeshBevh, implementation-data-type=IDT_ADAS_uint16_SurfaceMeshBevh
      application-data-type=ADT_ICC_arr_NaviWeatherInfo, implementation-data-type=IDT_ICC_arr_NaviWeatherInfo
      application-data-type=ADT_ICC_int32_FormWay, implementation-data-type=IDT_ICC_int32_FormWay
      application-data-type=ADT_Millisecond, implementation-data-type=IDT_Millisecond
      application-data-type=ADT_ICC_strt_ExtenLaneAction, implementation-data-type=IDT_ICC_strt_ExtenLaneAction
      application-data-type=ADT_ICC_arr_BackLane, implementation-data-type=IDT_ICC_arr_BackLane
      application-data-type=ADT_ADAS_enum_ICASenarioReminder, implementation-data-type=IDT_ADAS_enum_ICASenarioReminder
      application-data-type=ADT_ICC_enum_FCWWarnDistance, implementation-data-type=IDT_ICC_enum_FCWWarnDistance
      application-data-type=ADT_ADAS_strt_VPALayerInfo, implementation-data-type=IDT_ADAS_strt_VPALayerInfo
      application-data-type=ADT_Countdown_arr_Reserved, implementation-data-type=IDT_Countdown_arr_Reserved
      application-data-type=ADT_ADAS_enum_MNPBuildMapTextInfo, implementation-data-type=IDT_ADAS_enum_MNPBuildMapTextInfo
      application-data-type=ADT_ADAS_enum_MNPMemRouteState, implementation-data-type=IDT_ADAS_enum_MNPMemRouteState
      application-data-type=ADT_ADAS_arr_TrajectoryPoint, implementation-data-type=IDT_ADAS_arr_TrajectoryPoint
      application-data-type=ADT_HPAPathOperation_arr_Reserved, implementation-data-type=IDT_HPAPathOperation_arr_Reserved
      application-data-type=ADT_ICC_enum_HNOACruiseSpdOffsetSpd, implementation-data-type=IDT_ICC_enum_HNOACruiseSpdOffsetSpd
      application-data-type=ADT_ADAS_strt_Traffic3DSignPos, implementation-data-type=IDT_ADAS_strt_Traffic3DSignPos
      application-data-type=ADT_ICC_string_PoiName, implementation-data-type=IDT_ICC_string_PoiName
      application-data-type=ADT_ADAS_val_PathSaveProgress, implementation-data-type=IDT_ADAS_val_PathSaveProgress
      application-data-type=ADT_ADAS_enum_SidePassSt, implementation-data-type=IDT_ADAS_enum_SidePassSt
      application-data-type=ADT_CelluarRoamingStatus, implementation-data-type=IDT_CelluarRoamingStatus
      application-data-type=ADT_ICC_int32_OwnerShip, implementation-data-type=IDT_ICC_int32_OwnerShip
      application-data-type=ADT_ADAS_enum_HPAFloor, implementation-data-type=IDT_ADAS_enum_HPAFloor
      application-data-type=ADT_SimRealNameInfo, implementation-data-type=IDT_SimRealNameInfo
      application-data-type=ADT_ADAS_strt_LaneCenterPoint, implementation-data-type=IDT_ADAS_strt_LaneCenterPoint
      application-data-type=ADT_ICC_strt_NaviIntCameraDynInfo, implementation-data-type=IDT_ICC_strt_NaviIntCameraDynInfo
      application-data-type=ADT_ICC_arr_BackExtenLane, implementation-data-type=IDT_ICC_arr_BackExtenLane
      application-data-type=ADT_RequestVhrRemoteCall, implementation-data-type=IDT_RequestVhrRemoteCall
      application-data-type=ADT_ADAS_enum_VPAEntranceType, implementation-data-type=IDT_ADAS_enum_VPAEntranceType
      application-data-type=ADT_ADAS_enum_ACCVoiceReminder, implementation-data-type=IDT_ADAS_enum_ACCVoiceReminder
      application-data-type=ADT_ADAS_arr_MNPMemRoutePosition, implementation-data-type=IDT_ADAS_arr_MNPMemRoutePosition
      application-data-type=ADT_ADAS_arr_AebTargetObjInfo, implementation-data-type=IDT_ADAS_arr_AebTargetObjInfo
      application-data-type=ADT_ValetParkingReferDistanceStep, implementation-data-type=IDT_ValetParkingReferDistanceStep
      application-data-type=ADT_ADAS_Seg_Bridge, implementation-data-type=IDT_ADAS_Seg_Bridge
      application-data-type=ADT_ADAS_val_HNOACruiseSpdOffsetSpdFb, implementation-data-type=IDT_ADAS_val_HNOACruiseSpdOffsetSpdFb
      application-data-type=ADT_ADAS_enum_VPAVoiceRemind, implementation-data-type=IDT_ADAS_enum_VPAVoiceRemind
      application-data-type=ADT_SensitiveState, implementation-data-type=IDT_SensitiveState
      application-data-type=ADT_ICC_int32_GreenWaveType, implementation-data-type=IDT_ICC_int32_GreenWaveType
      application-data-type=ADT_ADAS_enum_MRASts, implementation-data-type=IDT_ADAS_enum_MRASts
      application-data-type=ADT_ICC_enum_APASettingSt, implementation-data-type=IDT_ICC_enum_APASettingSt
      application-data-type=ADT_ADAS_enum_UNOPScenariosReminder, implementation-data-type=IDT_ADAS_enum_UNOPScenariosReminder
      application-data-type=ADT_Struct_UpdateFTPSts, implementation-data-type=IDT_Struct_UpdateFTPSts
      application-data-type=ADT_ADAS_arr_OccPoint, implementation-data-type=IDT_ADAS_arr_OccPoint
      application-data-type=ADT_CameraStreamBasicElement, implementation-data-type=IDT_CameraStreamBasicElement
      application-data-type=ADT_Struct_ECUVersion, implementation-data-type=IDT_Struct_ECUVersion
      application-data-type=ADT_PrkgGenaral_arr_Reserved, implementation-data-type=IDT_PrkgGenaral_arr_Reserved
      application-data-type=ADT_ADAS_enum_LKSMod, implementation-data-type=IDT_ADAS_enum_LKSMod
      application-data-type=ADT_ICC_boolean_Hidden, implementation-data-type=IDT_ICC_boolean_Hidden
      application-data-type=ADT_SentryModeCmdFb, implementation-data-type=IDT_SentryModeCmdFb
      application-data-type=ADT_Dbl_VDOPInfo, implementation-data-type=IDT_Dbl_VDOPInfo
      application-data-type=ADT_DataUint8, implementation-data-type=IDT_DataUint8
      application-data-type=ADT_MNPMemRoute_arr_Reserved, implementation-data-type=IDT_MNPMemRoute_arr_Reserved
      application-data-type=ADT_ADAS_val_HPAVPAGiveWayPedTimes, implementation-data-type=IDT_ADAS_val_HPAVPAGiveWayPedTimes
      application-data-type=ADT_CellularPci, implementation-data-type=IDT_CellularPci
      application-data-type=ADT_ICC_enum_LKSWarnSensitivity, implementation-data-type=IDT_ICC_enum_LKSWarnSensitivity
      application-data-type=ADT_Enum_AntState, implementation-data-type=IDT_Enum_AntState
      application-data-type=ADT_ICC_enum_LccPlusEnableBtnSt, implementation-data-type=IDT_ICC_enum_LccPlusEnableBtnSt
      application-data-type=ADT_ADAS_Meta_SpdUnits, implementation-data-type=IDT_ADAS_Meta_SpdUnits
      application-data-type=ADT_ADAS_enum_FSRACruiseSpdOffsetModFb, implementation-data-type=IDT_ADAS_enum_FSRACruiseSpdOffsetModFb
      application-data-type=ADT_ADAS_val_SpdLimitRelOffset, implementation-data-type=IDT_ADAS_val_SpdLimitRelOffset
      application-data-type=ADT_ADAS_strt_TrafficLightList, implementation-data-type=IDT_ADAS_strt_TrafficLightList
      application-data-type=ADT_ICC_enum_FSRASpdSetMod, implementation-data-type=IDT_ICC_enum_FSRASpdSetMod
      application-data-type=ADT_Str_SoftwareVers, implementation-data-type=IDT_Str_SoftwareVers
      application-data-type=ADT_Enum_FirstCertificationMark, implementation-data-type=IDT_Enum_FirstCertificationMark
      application-data-type=ADT_ADAS_arr_HPAPathslot, implementation-data-type=IDT_ADAS_arr_HPAPathslot
      application-data-type=ADT_ADAS_enum_PathLabel, implementation-data-type=IDT_ADAS_enum_PathLabel
      application-data-type=ADT_Enum_CertificateIssuedMark, implementation-data-type=IDT_Enum_CertificateIssuedMark
      application-data-type=ADT_SentryModeStatus, implementation-data-type=IDT_SentryModeStatus
      application-data-type=ADT_NaviWeather_arr_Reserved, implementation-data-type=IDT_NaviWeather_arr_Reserved
      application-data-type=ADT_ICC_boolean_exists, implementation-data-type=IDT_ICC_boolean_exists
      application-data-type=ADT_ICC_string_EventId, implementation-data-type=IDT_ICC_string_EventId
      application-data-type=ADT_Struct_BleModuleInfo, implementation-data-type=IDT_Struct_BleModuleInfo
      application-data-type=ADT_ICC_arr_NaviGreenWaveCarSpeed, implementation-data-type=IDT_ICC_arr_NaviGreenWaveCarSpeed
      application-data-type=ADT_Enum_TBOXReady, implementation-data-type=IDT_Enum_TBOXReady
      application-data-type=ADT_CrossNavi_arr_Reserved, implementation-data-type=IDT_CrossNavi_arr_Reserved
      application-data-type=ADT_StrVar_BleMasterMac, implementation-data-type=IDT_StrVar_BleMasterMac
      application-data-type=ADT_ICC_int32_LightDir, implementation-data-type=IDT_ICC_int32_LightDir
      application-data-type=ADT_Enum_UsbUpdateStart, implementation-data-type=IDT_Enum_UsbUpdateStart
      application-data-type=ADT_ADAS_val_LineEquation_C2, implementation-data-type=IDT_ADAS_val_LineEquation_C2
      application-data-type=ADT_ICC_enum_U_NOPEnableBtnSts, implementation-data-type=IDT_ICC_enum_U_NOPEnableBtnSts
      application-data-type=ADT_ADAS_val_LineEquation_C3, implementation-data-type=IDT_ADAS_val_LineEquation_C3
      application-data-type=ADT_ADAS_enum_IHCTextInfo, implementation-data-type=IDT_ADAS_enum_IHCTextInfo
      application-data-type=ADT_Enum_Result, implementation-data-type=IDT_Enum_Result
      application-data-type=ADT_ADAS_val_LineEquation_C0, implementation-data-type=IDT_ADAS_val_LineEquation_C0
      application-data-type=ADT_ADAS_val_LineEquation_C1, implementation-data-type=IDT_ADAS_val_LineEquation_C1
      application-data-type=ADT_Struct_NOA_SDMapSegmentInfo, implementation-data-type=IDT_Struct_NOA_SDMapSegmentInfo
      application-data-type=ADT_ADAS_enum_ICASts, implementation-data-type=IDT_ADAS_enum_ICASts
      application-data-type=ADT_ICC_int32_NaviStatus, implementation-data-type=IDT_ICC_int32_NaviStatus
      application-data-type=ADT_TimeManagement, implementation-data-type=IDT_TimeManagement
      application-data-type=ADT_Enum_ADSRestartBtnSt, implementation-data-type=IDT_Enum_ADSRestartBtnSt
      application-data-type=ADT_Latitude, implementation-data-type=IDT_Latitude
      application-data-type=ADT_Gen_val_Coordinate_Y, implementation-data-type=IDT_Gen_val_Coordinate_Y
      application-data-type=ADT_Gen_val_Coordinate_X, implementation-data-type=IDT_Gen_val_Coordinate_X
      application-data-type=ADT_INI_ReservedUnit8, implementation-data-type=IDT_INI_ReservedUnit8
      application-data-type=ADT_Gen_val_Coordinate_Z, implementation-data-type=IDT_Gen_val_Coordinate_Z
      application-data-type=ADT_ADAS_Stub_Update, implementation-data-type=IDT_ADAS_Stub_Update
      application-data-type=ADT_ADAS_strt_ESSInfo_2, implementation-data-type=IDT_ADAS_strt_ESSInfo_2
      application-data-type=ADT_ADAS_strt_VPAParkingLotBaseData, implementation-data-type=IDT_ADAS_strt_VPAParkingLotBaseData
      application-data-type=ADT_ADAS_enum_LKSSts, implementation-data-type=IDT_ADAS_enum_LKSSts
      application-data-type=ADT_ICC_strt_Coord2DDouble, implementation-data-type=IDT_ICC_strt_Coord2DDouble
      application-data-type=ADT_ICC_strt_VpaSelectZoneInfo, implementation-data-type=IDT_ICC_strt_VpaSelectZoneInfo
      application-data-type=ADT_ADAS_enum_MNPRouteAvailable, implementation-data-type=IDT_ADAS_enum_MNPRouteAvailable
      application-data-type=ADT_ICC_enum_TLREnableBtnSt, implementation-data-type=IDT_ICC_enum_TLREnableBtnSt
      application-data-type=ADT_ADAS_Seg_EffSpdLmt, implementation-data-type=IDT_ADAS_Seg_EffSpdLmt
      application-data-type=ADT_ResponseVhrCancelRemoteCall, implementation-data-type=IDT_ResponseVhrCancelRemoteCall
      application-data-type=ADT_LCM_Array_GNSSData, implementation-data-type=IDT_LCM_Array_GNSSData
      application-data-type=ADT_ICC_strt_TimeAndDist, implementation-data-type=IDT_ICC_strt_TimeAndDist
      application-data-type=ADT_ADAS_strt_SDmapInfo, implementation-data-type=IDT_ADAS_strt_SDmapInfo
      application-data-type=ADT_EcallMode, implementation-data-type=IDT_EcallMode
      application-data-type=ADT_ADAS_enum_CruiseAccelerateSts, implementation-data-type=IDT_ADAS_enum_CruiseAccelerateSts
      application-data-type=ADT_ADAS_arr_HPAPathDetail_2, implementation-data-type=IDT_ADAS_arr_HPAPathDetail_2
      application-data-type=ADT_Struct_NOA_SDMapMetaInfo, implementation-data-type=IDT_Struct_NOA_SDMapMetaInfo
      application-data-type=ADT_OperatingSimInfoReserved, implementation-data-type=IDT_OperatingSimInfoReserved
      application-data-type=ADT_ADAS_enum_NOARemainingMileageFromODD, implementation-data-type=IDT_ADAS_enum_NOARemainingMileageFromODD
      application-data-type=ADT_ADAS_enum_DetourAroundObstacleBtnStFb, implementation-data-type=IDT_ADAS_enum_DetourAroundObstacleBtnStFb
      application-data-type=ADT_ADAS_enum_SglSendMode, implementation-data-type=IDT_ADAS_enum_SglSendMode
      application-data-type=ADT_ICC_uint32_SelectZoneID, implementation-data-type=IDT_ICC_uint32_SelectZoneID
      application-data-type=ADT_ICC_string_AoiName, implementation-data-type=IDT_ICC_string_AoiName
      application-data-type=ADT_Enum_LogFTPSts, implementation-data-type=IDT_Enum_LogFTPSts
      application-data-type=ADT_Struct_HDMapInfo, implementation-data-type=IDT_Struct_HDMapInfo
      application-data-type=ADT_ICC_enum_NaviRoadType, implementation-data-type=IDT_ICC_enum_NaviRoadType
      application-data-type=ADT_ApnArray, implementation-data-type=IDT_ApnArray
      application-data-type=ADT_ADAS_enum_TolAutoRoadCrossingsNum, implementation-data-type=IDT_ADAS_enum_TolAutoRoadCrossingsNum
      application-data-type=ADT_ICC_arr_BackLaneTypes, implementation-data-type=IDT_ICC_arr_BackLaneTypes
      application-data-type=ADT_ICC_enum_FCTAWarnType, implementation-data-type=IDT_ICC_enum_FCTAWarnType
      application-data-type=ADT_ADAS_arr_HPASpeedBumpInfo, implementation-data-type=IDT_ADAS_arr_HPASpeedBumpInfo
      application-data-type=ADT_ADAS_uint16_SurfaceMeshBevw, implementation-data-type=IDT_ADAS_uint16_SurfaceMeshBevw
      application-data-type=ADT_ADAS_enum_VPASts, implementation-data-type=IDT_ADAS_enum_VPASts
      application-data-type=ADT_ICC_enum_LKSSettingSt, implementation-data-type=IDT_ICC_enum_LKSSettingSt
      application-data-type=ADT_ICC_int64_Time, implementation-data-type=IDT_ICC_int64_Time
      application-data-type=ADT_ADAS_enum_TolAPAParkedOutTime, implementation-data-type=IDT_ADAS_enum_TolAPAParkedOutTime
      application-data-type=ADT_ADAS_enum_ISLISpeedLimitSign, implementation-data-type=IDT_ADAS_enum_ISLISpeedLimitSign
      application-data-type=ADT_ADAS_enum_MRACheckSts, implementation-data-type=IDT_ADAS_enum_MRACheckSts
      application-data-type=ADT_SentryModeAlarmCnt, implementation-data-type=IDT_SentryModeAlarmCnt
      application-data-type=ADT_ADAS_strt_ICAInfo_2, implementation-data-type=IDT_ADAS_strt_ICAInfo_2
      application-data-type=ADT_Arr_DataInLoop, implementation-data-type=IDT_Arr_DataInLoop
      application-data-type=ADT_ADAS_Seg_CmplxInsct, implementation-data-type=IDT_ADAS_Seg_CmplxInsct
      application-data-type=ADT_ICC_int16_Index, implementation-data-type=IDT_ICC_int16_Index
      application-data-type=ADT_ICC_enum_SelectZoneType, implementation-data-type=IDT_ICC_enum_SelectZoneType
      application-data-type=ADT_ICC_strt_ViaPointInfo, implementation-data-type=IDT_ICC_strt_ViaPointInfo
      application-data-type=ADT_ICC_enum_ISLICruiseSpdOffsetAbd, implementation-data-type=IDT_ICC_enum_ISLICruiseSpdOffsetAbd
      application-data-type=ADT_StrVar_MCC, implementation-data-type=IDT_StrVar_MCC
      application-data-type=ADT_SeqNum, implementation-data-type=IDT_SeqNum
      application-data-type=ADT_Arr_CamStreamStRespResd, implementation-data-type=IDT_Arr_CamStreamStRespResd
      application-data-type=ADT_ADAS_enum_VPAButtonStatus, implementation-data-type=IDT_ADAS_enum_VPAButtonStatus
      application-data-type=ADT_ADAS_enum_TolU_turnsNum, implementation-data-type=IDT_ADAS_enum_TolU_turnsNum
      application-data-type=ADT_ADAS_strt_VPASelfBuildMapDate, implementation-data-type=IDT_ADAS_strt_VPASelfBuildMapDate
      application-data-type=ADT_Enum_TBOXOTAAPPTInstall, implementation-data-type=IDT_Enum_TBOXOTAAPPTInstall
      application-data-type=ADT_Enum_CamCalPrmsData, implementation-data-type=IDT_Enum_CamCalPrmsData
      application-data-type=ADT_Enum_State, implementation-data-type=IDT_Enum_State
      application-data-type=ADT_TimeValidFlag, implementation-data-type=IDT_TimeValidFlag
      application-data-type=ADT_AvmCamIntrinsicsDataReq, implementation-data-type=IDT_AvmCamIntrinsicsDataReq
      application-data-type=ADT_Str_MemRoute, implementation-data-type=IDT_Str_MemRoute
      application-data-type=ADT_SentryModePlanStartTime_hour, implementation-data-type=IDT_SentryModePlanStartTime_hour
      application-data-type=ADT_ADAS_struct_NRAInfo, implementation-data-type=IDT_ADAS_struct_NRAInfo
      application-data-type=ADT_ADAS_arr_ParkingStaticObjects_2, implementation-data-type=IDT_ADAS_arr_ParkingStaticObjects_2
      application-data-type=ADT_ADAS_strt_EgoPose, implementation-data-type=IDT_ADAS_strt_EgoPose
      application-data-type=ADT_ChargingUtcSecs, implementation-data-type=IDT_ChargingUtcSecs
      application-data-type=ADT_ADAS_enum_VPAPickUpPosSelectReq, implementation-data-type=IDT_ADAS_enum_VPAPickUpPosSelectReq
      application-data-type=ADT_Longitude, implementation-data-type=IDT_Longitude
      application-data-type=ADT_ADAS_enum_MNPBuildMapSts, implementation-data-type=IDT_ADAS_enum_MNPBuildMapSts
      application-data-type=ADT_ADAS_ProfLong_PathIdx, implementation-data-type=IDT_ADAS_ProfLong_PathIdx
      application-data-type=ADT_Enum_FTPState, implementation-data-type=IDT_Enum_FTPState
      application-data-type=ADT_ICC_enum_NOPLaneChangeWarnType, implementation-data-type=IDT_ICC_enum_NOPLaneChangeWarnType
      application-data-type=ADT_ActiveSafetyFcn_arr_Reserved, implementation-data-type=IDT_ActiveSafetyFcn_arr_Reserved
      application-data-type=ADT_ADAS_ProfLong_Value, implementation-data-type=IDT_ADAS_ProfLong_Value
      application-data-type=ADT_ADAS_ProfShort_Offset, implementation-data-type=IDT_ADAS_ProfShort_Offset
      application-data-type=ADT_IcaState, implementation-data-type=IDT_IcaState
      application-data-type=ADT_StrVar_MNC, implementation-data-type=IDT_StrVar_MNC
      application-data-type=ADT_DVRSts, implementation-data-type=IDT_DVRSts
      application-data-type=ADT_ADAS_arr_HPATrajectoryPoint, implementation-data-type=IDT_ADAS_arr_HPATrajectoryPoint
      application-data-type=ADT_HPAPath_arr_Reserved, implementation-data-type=IDT_HPAPath_arr_Reserved
      application-data-type=ADT_ADAS_enum_ALCSts, implementation-data-type=IDT_ADAS_enum_ALCSts
      application-data-type=ADT_ICC_enum_NavSpeedLimit, implementation-data-type=IDT_ICC_enum_NavSpeedLimit
      application-data-type=ADT_Enum_UpdateCompleted, implementation-data-type=IDT_Enum_UpdateCompleted
      application-data-type=ADT_ADAS_enum_ALCTextInfo, implementation-data-type=IDT_ADAS_enum_ALCTextInfo
      application-data-type=ADT_ADAS_enum_MAASts, implementation-data-type=IDT_ADAS_enum_MAASts
      application-data-type=ADT_ICC_enum_VPASettingSt, implementation-data-type=IDT_ICC_enum_VPASettingSt
      application-data-type=ADT_ValetParkingRoadCellInfo, implementation-data-type=IDT_ValetParkingRoadCellInfo
      application-data-type=ADT_StrVar_RouterIPAddress, implementation-data-type=IDT_StrVar_RouterIPAddress
      application-data-type=ADT_ADAS_enum_FcwAcitveSt, implementation-data-type=IDT_ADAS_enum_FcwAcitveSt
      application-data-type=ADT_ADAS_enum_TSISgnGiWay, implementation-data-type=IDT_ADAS_enum_TSISgnGiWay
      application-data-type=ADT_ADAS_enum_SglRespondCongestion, implementation-data-type=IDT_ADAS_enum_SglRespondCongestion
      application-data-type=ADT_StrVar_BleSlaverRearMac, implementation-data-type=IDT_StrVar_BleSlaverRearMac
      application-data-type=ADT_ADAS_enum_ELKLeftActiveSt, implementation-data-type=IDT_ADAS_enum_ELKLeftActiveSt
      application-data-type=ADT_ConnStatus, implementation-data-type=IDT_ConnStatus
      application-data-type=ADT_DownFlow, implementation-data-type=IDT_DownFlow
      application-data-type=ADT_ICC_int32_FacilityType, implementation-data-type=IDT_ICC_int32_FacilityType
      application-data-type=ADT_ADAS_enum_HPAPathLabeType, implementation-data-type=IDT_ADAS_enum_HPAPathLabeType
      application-data-type=ADT_ADAS_enum_RoadMarkerType, implementation-data-type=IDT_ADAS_enum_RoadMarkerType
      application-data-type=ADT_ADAS_ProfLong_Offset, implementation-data-type=IDT_ADAS_ProfLong_Offset
      application-data-type=ADT_ICC_enum_ISLISpdOffsetMod, implementation-data-type=IDT_ICC_enum_ISLISpdOffsetMod
      application-data-type=ADT_ADAS_enum_NRAQuitReason, implementation-data-type=IDT_ADAS_enum_NRAQuitReason
      application-data-type=ADT_ICC_enum_FreeSlotType, implementation-data-type=IDT_ICC_enum_FreeSlotType
      application-data-type=ADT_TimeInfoSync, implementation-data-type=IDT_TimeInfoSync
      application-data-type=ADT_ADAS_arr_StaticObjects_2, implementation-data-type=IDT_ADAS_arr_StaticObjects_2
      application-data-type=ADT_Struct_LanePositionInfo, implementation-data-type=IDT_Struct_LanePositionInfo
      application-data-type=ADT_StrVar_CanConfig, implementation-data-type=IDT_StrVar_CanConfig
      application-data-type=ADT_Enum_Action, implementation-data-type=IDT_Enum_Action
      application-data-type=ADT_Congestion_arr_Reserved, implementation-data-type=IDT_Congestion_arr_Reserved
      application-data-type=ADT_TimeInfoMonth, implementation-data-type=IDT_TimeInfoMonth
      application-data-type=ADT_SimSwitchCheckFailReason, implementation-data-type=IDT_SimSwitchCheckFailReason
      application-data-type=ADT_ADAS_ProfLong_Update, implementation-data-type=IDT_ADAS_ProfLong_Update
      application-data-type=ADT_ICC_strt_NotAvoidInfo, implementation-data-type=IDT_ICC_strt_NotAvoidInfo
      application-data-type=ADT_ICC_arr_FrontLane, implementation-data-type=IDT_ICC_arr_FrontLane
      application-data-type=ADT_ADAS_enum_LinePositionIndex, implementation-data-type=IDT_ADAS_enum_LinePositionIndex
      application-data-type=ADT_Enum_TBOXOTARemoteAPPTSet, implementation-data-type=IDT_Enum_TBOXOTARemoteAPPTSet
      application-data-type=ADT_ICC_enum_VPAOperationId, implementation-data-type=IDT_ICC_enum_VPAOperationId
      application-data-type=ADT_ICC_int32_Angle, implementation-data-type=IDT_ICC_int32_Angle
      application-data-type=ADT_ADAS_enum_NOPStReminder, implementation-data-type=IDT_ADAS_enum_NOPStReminder
      application-data-type=ADT_ICC_val_Time, implementation-data-type=IDT_ICC_val_Time
      application-data-type=ADT_Enum_BEICALL, implementation-data-type=IDT_Enum_BEICALL
      application-data-type=ADT_ADAS_enum_ParkOutDirectionSt, implementation-data-type=IDT_ADAS_enum_ParkOutDirectionSt
      application-data-type=ADT_ICC_enum_SetPathLabel, implementation-data-type=IDT_ICC_enum_SetPathLabel
      application-data-type=ADT_Enum_RouteMMStatus, implementation-data-type=IDT_Enum_RouteMMStatus
      application-data-type=ADT_ICC_strt_RampInfo, implementation-data-type=IDT_ICC_strt_RampInfo
      application-data-type=ADT_ADAS_strt_VPAParkingInfo, implementation-data-type=IDT_ADAS_strt_VPAParkingInfo
      application-data-type=ADT_UpRate, implementation-data-type=IDT_UpRate
      application-data-type=ADT_MNPInfo_arr_Reserved2, implementation-data-type=IDT_MNPInfo_arr_Reserved2
      application-data-type=ADT_ADAS_enum_ParkingQuitInd, implementation-data-type=IDT_ADAS_enum_ParkingQuitInd
      application-data-type=ADT_ICC_enum_NavCurrRoadType, implementation-data-type=IDT_ICC_enum_NavCurrRoadType
      application-data-type=ADT_NaviCameraExt_arr_Reserved, implementation-data-type=IDT_NaviCameraExt_arr_Reserved
      application-data-type=ADT_Struct_TBOXOTAAPPTSync, implementation-data-type=IDT_Struct_TBOXOTAAPPTSync
      application-data-type=ADT_ICC_enum_NRASettingSt, implementation-data-type=IDT_ICC_enum_NRASettingSt
      application-data-type=ADT_ICC_arr_TimeAndDist, implementation-data-type=IDT_ICC_arr_TimeAndDist
      application-data-type=ADT_ADAS_val_XboundMin, implementation-data-type=IDT_ADAS_val_XboundMin
      application-data-type=ADT_ICC_float_Point, implementation-data-type=IDT_ICC_float_Point
      application-data-type=ADT_ADAS_enum_TolLCCMileage, implementation-data-type=IDT_ADAS_enum_TolLCCMileage
      application-data-type=ADT_ICC_strt_ApaRpaFcnOperating_2, implementation-data-type=IDT_ICC_strt_ApaRpaFcnOperating_2
      application-data-type=ADT_ADAS_strt_ParkingGenaralInfo_2, implementation-data-type=IDT_ADAS_strt_ParkingGenaralInfo_2
      application-data-type=ADT_Gen_val_Roll, implementation-data-type=IDT_Gen_val_Roll
      application-data-type=ADT_ADAS_ProfLong_ProfType, implementation-data-type=IDT_ADAS_ProfLong_ProfType
      application-data-type=ADT_ADAS_arr_MNPMemRoutePoints, implementation-data-type=IDT_ADAS_arr_MNPMemRoutePoints
      application-data-type=ADT_ADAS_enum_FCTAWarnTypeSts, implementation-data-type=IDT_ADAS_enum_FCTAWarnTypeSts
      application-data-type=ADT_ADAS_strt_HPAStaticObject, implementation-data-type=IDT_ADAS_strt_HPAStaticObject
      application-data-type=ADT_Arr_SatelInfoResd, implementation-data-type=IDT_Arr_SatelInfoResd
      application-data-type=ADT_ICC_enum_MNPUseRouteQuitBtnSt, implementation-data-type=IDT_ICC_enum_MNPUseRouteQuitBtnSt
      application-data-type=ADT_Arr_KPI_DataInLoop, implementation-data-type=IDT_Arr_KPI_DataInLoop
      application-data-type=ADT_LaneLine_arr_Reserved, implementation-data-type=IDT_LaneLine_arr_Reserved
      application-data-type=ADT_CellularCellMapInfoReserved, implementation-data-type=IDT_CellularCellMapInfoReserved
      application-data-type=ADT_PermissionId, implementation-data-type=IDT_PermissionId
      application-data-type=ADT_Enum_TBOXOTARemoteInstall, implementation-data-type=IDT_Enum_TBOXOTARemoteInstall
      application-data-type=ADT_StrVar_PhoneNumber, implementation-data-type=IDT_StrVar_PhoneNumber
      application-data-type=ADT_ADAS_enum_IntersectionDriBehavior, implementation-data-type=IDT_ADAS_enum_IntersectionDriBehavior
      application-data-type=ADT_ADAS_strt_MNPMemRoute, implementation-data-type=IDT_ADAS_strt_MNPMemRoute
      application-data-type=ADT_LSSInfo_arr_Reserved, implementation-data-type=IDT_LSSInfo_arr_Reserved
      application-data-type=ADT_ADAS_arr_RoadMarkerSupplement, implementation-data-type=IDT_ADAS_arr_RoadMarkerSupplement
      application-data-type=ADT_RoadPointCellStruct, implementation-data-type=IDT_RoadPointCellStruct
      application-data-type=ADT_CameraStreamRequestMessage, implementation-data-type=IDT_CameraStreamRequestMessage
      application-data-type=ADT_ADAS_Seg_FuncRoadClass, implementation-data-type=IDT_ADAS_Seg_FuncRoadClass
      application-data-type=ADT_OperatingSimInfo, implementation-data-type=IDT_OperatingSimInfo
      application-data-type=ADT_ADAS_enum_HPARequestAPAUI, implementation-data-type=IDT_ADAS_enum_HPARequestAPAUI
      application-data-type=ADT_ADAS_enum_SglAutoAvoidObstacle, implementation-data-type=IDT_ADAS_enum_SglAutoAvoidObstacle
      application-data-type=ADT_ADAS_strt_LSSInfo_2, implementation-data-type=IDT_ADAS_strt_LSSInfo_2
      application-data-type=ADT_ICC_string_WeatherName, implementation-data-type=IDT_ICC_string_WeatherName
      application-data-type=ADT_ADAS_val_Traffic3DSignNum, implementation-data-type=IDT_ADAS_val_Traffic3DSignNum
      application-data-type=ADT_ICC_int32_RoadClass, implementation-data-type=IDT_ICC_int32_RoadClass
      application-data-type=ADT_ADASSettingInfo_arr_Reserved, implementation-data-type=IDT_ADASSettingInfo_arr_Reserved
      application-data-type=ADT_ICC_val_ID, implementation-data-type=IDT_ICC_val_ID
      application-data-type=ADT_ICC_int32_Speed, implementation-data-type=IDT_ICC_int32_Speed
      application-data-type=ADT_MyLocation_arr_Reserved, implementation-data-type=IDT_MyLocation_arr_Reserved
      application-data-type=ADT_ADAS_strt_Traffic3DSignList, implementation-data-type=IDT_ADAS_strt_Traffic3DSignList
      application-data-type=ADT_Enum_VehicleDiag, implementation-data-type=IDT_Enum_VehicleDiag
      application-data-type=ADT_ValetParkingLayer, implementation-data-type=IDT_ValetParkingLayer
      application-data-type=ADT_StrVar_BleSlaverLeftVer, implementation-data-type=IDT_StrVar_BleSlaverLeftVer
      application-data-type=ADT_ADAS_arr_LaneLineData_2, implementation-data-type=IDT_ADAS_arr_LaneLineData_2
      application-data-type=ADT_NaviCongestion_arr_Reserved, implementation-data-type=IDT_NaviCongestion_arr_Reserved
      application-data-type=ADT_ICC_strt_TunnelInfo, implementation-data-type=IDT_ICC_strt_TunnelInfo
      application-data-type=ADT_AllSimDetailInfoReserved, implementation-data-type=IDT_AllSimDetailInfoReserved
      application-data-type=ADT_SentryModePlanEndTime_flag, implementation-data-type=IDT_SentryModePlanEndTime_flag
      application-data-type=ADT_ICC_enum_NOALCCSwitchBtnSts, implementation-data-type=IDT_ICC_enum_NOALCCSwitchBtnSts
      application-data-type=ADT_LCM_RAWDATA, implementation-data-type=IDT_LCM_RAWDATA
      application-data-type=ADT_ICC_arr_ViaPointInfo, implementation-data-type=IDT_ICC_arr_ViaPointInfo
      application-data-type=ADT_ICC_enum_EfficientPassageBtnSt, implementation-data-type=IDT_ICC_enum_EfficientPassageBtnSt
      application-data-type=ADT_ADAS_strt_HPARepalyPathInfo, implementation-data-type=IDT_ADAS_strt_HPARepalyPathInfo
      application-data-type=ADT_CameraStreamFaultMessage, implementation-data-type=IDT_CameraStreamFaultMessage
      application-data-type=ADT_ADAS_arr_VPASpots, implementation-data-type=IDT_ADAS_arr_VPASpots
      application-data-type=ADT_ADAS_enum_MNPUseMapTextInfo, implementation-data-type=IDT_ADAS_enum_MNPUseMapTextInfo
      application-data-type=ADT_Gen_val_Height, implementation-data-type=IDT_Gen_val_Height
      application-data-type=ADT_SentryModePlanEndTime_date, implementation-data-type=IDT_SentryModePlanEndTime_date
      application-data-type=ADT_ICC_strt_NaviCameraExt, implementation-data-type=IDT_ICC_strt_NaviCameraExt
      application-data-type=ADT_ICC_int32_Index, implementation-data-type=IDT_ICC_int32_Index
      application-data-type=ADT_ADAS_enum_NOPLaneChangeWarnType, implementation-data-type=IDT_ADAS_enum_NOPLaneChangeWarnType
      application-data-type=ADT_ADAS_Stub_Offset, implementation-data-type=IDT_ADAS_Stub_Offset
      application-data-type=ADT_Array_RouteMMSeg, implementation-data-type=IDT_Array_RouteMMSeg
      application-data-type=ADT_ICC_val_latitude, implementation-data-type=IDT_ICC_val_latitude
      application-data-type=ADT_ADAS_arr_HPAPathslot_2, implementation-data-type=IDT_ADAS_arr_HPAPathslot_2
      application-data-type=ADT_ADAS_enum_PathMatchSts, implementation-data-type=IDT_ADAS_enum_PathMatchSts
      application-data-type=ADT_RoadPointCellInfo, implementation-data-type=IDT_RoadPointCellInfo
      application-data-type=ADT_DataInt32, implementation-data-type=IDT_DataInt32
      application-data-type=ADT_ADAS_enum_Traffic3DSignType, implementation-data-type=IDT_ADAS_enum_Traffic3DSignType
      application-data-type=ADT_ICC_enum_ISLIWarnMod, implementation-data-type=IDT_ICC_enum_ISLIWarnMod
      application-data-type=ADT_ICC_enum_MNPMemRouteCompleteBtnSt, implementation-data-type=IDT_ICC_enum_MNPMemRouteCompleteBtnSt
      application-data-type=ADT_CameraStreamResponseMessage, implementation-data-type=IDT_CameraStreamResponseMessage
      application-data-type=ADT_ADAS_strt_ALCInfo, implementation-data-type=IDT_ADAS_strt_ALCInfo
      application-data-type=ADT_Enum_UpdatePrepare, implementation-data-type=IDT_Enum_UpdatePrepare
      application-data-type=ADT_ICC_strt_VpaParkingLotInfo, implementation-data-type=IDT_ICC_strt_VpaParkingLotInfo
      application-data-type=ADT_ADAS_enum_ESSDirection, implementation-data-type=IDT_ADAS_enum_ESSDirection
      application-data-type=ADT_SentryModeAlarmReason, implementation-data-type=IDT_SentryModeAlarmReason
      application-data-type=ADT_ICC_strt_HpaFcnOperating, implementation-data-type=IDT_ICC_strt_HpaFcnOperating
      application-data-type=ADT_Struct_NOA_SDMapStubInfo, implementation-data-type=IDT_Struct_NOA_SDMapStubInfo
      application-data-type=ADT_ICC_enum_VoiceRemindSettingSt, implementation-data-type=IDT_ICC_enum_VoiceRemindSettingSt
      application-data-type=ADT_ICC_int32_NaviMode, implementation-data-type=IDT_ICC_int32_NaviMode
      application-data-type=ADT_ADAS_Meta_MapProvider, implementation-data-type=IDT_ADAS_Meta_MapProvider
      application-data-type=ADT_EphemerisDataSwitchCmd, implementation-data-type=IDT_EphemerisDataSwitchCmd
      application-data-type=ADT_SingleSimDetailInfoReserved, implementation-data-type=IDT_SingleSimDetailInfoReserved
      application-data-type=ADT_ADAS_enum_HNOPSts, implementation-data-type=IDT_ADAS_enum_HNOPSts
      application-data-type=ADT_ICC_arr_CongestionInfo, implementation-data-type=IDT_ICC_arr_CongestionInfo
      application-data-type=ADT_ADAS_strt_ALCInfo_2, implementation-data-type=IDT_ADAS_strt_ALCInfo_2
      application-data-type=ADT_ICC_strt_NaviWeatherInfo_1, implementation-data-type=IDT_ICC_strt_NaviWeatherInfo_1
      application-data-type=ADT_VhrLogList, implementation-data-type=IDT_VhrLogList
      application-data-type=ADT_ICC_strt_NaviCruiseFacilityInfo, implementation-data-type=IDT_ICC_strt_NaviCruiseFacilityInfo
      application-data-type=ADT_NaviIntCameraDyn_arr_Reserved, implementation-data-type=IDT_NaviIntCameraDyn_arr_Reserved
      application-data-type=ADT_Enum_CallType, implementation-data-type=IDT_Enum_CallType
      application-data-type=ADT_CellularFrequency, implementation-data-type=IDT_CellularFrequency
      application-data-type=ADT_IcaNcaL3StateReserved, implementation-data-type=IDT_IcaNcaL3StateReserved
      application-data-type=ADT_Enum_SetCallNumber, implementation-data-type=IDT_Enum_SetCallNumber
      application-data-type=ADT_ADAS_strt_IHCInfo, implementation-data-type=IDT_ADAS_strt_IHCInfo
      application-data-type=ADT_ADAS_val_SpdLimitOffsetAbs, implementation-data-type=IDT_ADAS_val_SpdLimitOffsetAbs
      application-data-type=ADT_Str_CamStreamSwtReq, implementation-data-type=IDT_Str_CamStreamSwtReq
      application-data-type=ADT_ICC_int32_ShowType, implementation-data-type=IDT_ICC_int32_ShowType
      application-data-type=ADT_ADAS_enum_StaticObjectType, implementation-data-type=IDT_ADAS_enum_StaticObjectType
      application-data-type=ADT_ICC_enum_VoiceControlCruiseSpeedAdjust, implementation-data-type=IDT_ICC_enum_VoiceControlCruiseSpeedAdjust
      application-data-type=ADT_ICC_int32_NaviInfoFlag, implementation-data-type=IDT_ICC_int32_NaviInfoFlag
      application-data-type=ADT_ADAS_strt_SglNtfADDrivingCardinfo, implementation-data-type=IDT_ADAS_strt_SglNtfADDrivingCardinfo
      application-data-type=ADT_Arr_TollGateLaneInfo, implementation-data-type=IDT_Arr_TollGateLaneInfo
      application-data-type=ADT_ADAS_arr_HPAPathDetail, implementation-data-type=IDT_ADAS_arr_HPAPathDetail
      application-data-type=ADT_ADAS_strt_OCCInfo, implementation-data-type=IDT_ADAS_strt_OCCInfo
      application-data-type=ADT_ADAS_enum_NOPLaneChangeReason, implementation-data-type=IDT_ADAS_enum_NOPLaneChangeReason
      application-data-type=ADT_ADAS_strt_VPASelfBuildMapInfo, implementation-data-type=IDT_ADAS_strt_VPASelfBuildMapInfo
      application-data-type=ADT_ADAS_val_longitude, implementation-data-type=IDT_ADAS_val_longitude
      application-data-type=ADT_ICC_enum_MNPEnableBtnSt, implementation-data-type=IDT_ICC_enum_MNPEnableBtnSt
      application-data-type=ADT_ADAS_enum_TolNOAMileage, implementation-data-type=IDT_ADAS_enum_TolNOAMileage
      application-data-type=ADT_ADAS_Seg_BuildUpArea, implementation-data-type=IDT_ADAS_Seg_BuildUpArea
      application-data-type=ADT_ADAS_enum_DAISts, implementation-data-type=IDT_ADAS_enum_DAISts
      application-data-type=ADT_ADAS_strt_MRAInfo_2, implementation-data-type=IDT_ADAS_strt_MRAInfo_2
      application-data-type=ADT_Enum_UpdSta, implementation-data-type=IDT_Enum_UpdSta
      application-data-type=ADT_ADAS_strt_FusionMapPoint, implementation-data-type=IDT_ADAS_strt_FusionMapPoint
      application-data-type=ADT_LCM_IMU_gpsSow, implementation-data-type=IDT_LCM_IMU_gpsSow
      application-data-type=ADT_ICC_enum_ApaPocDirection, implementation-data-type=IDT_ICC_enum_ApaPocDirection
      application-data-type=ADT_ISLIInfo_arr_Reserved, implementation-data-type=IDT_ISLIInfo_arr_Reserved
      application-data-type=ADT_ADAS_enum_AESDirection, implementation-data-type=IDT_ADAS_enum_AESDirection
      application-data-type=ADT_ADAS_Posn_Spd, implementation-data-type=IDT_ADAS_Posn_Spd
      application-data-type=ADT_ICC_int32_ForbidType, implementation-data-type=IDT_ICC_int32_ForbidType
      application-data-type=ADT_ApnInfo, implementation-data-type=IDT_ApnInfo
      application-data-type=ADT_ICC_arr_WeatherInfo, implementation-data-type=IDT_ICC_arr_WeatherInfo
      application-data-type=ADT_SentryModePlanEndTime_hour, implementation-data-type=IDT_SentryModePlanEndTime_hour
      application-data-type=ADT_ICC_Navi_GpsPoint, implementation-data-type=IDT_ICC_Navi_GpsPoint
      application-data-type=ADT_ADAS_enum_ParkInDirectionAvaType, implementation-data-type=IDT_ADAS_enum_ParkInDirectionAvaType
      application-data-type=ADT_ICC_arr_OptimalLane, implementation-data-type=IDT_ICC_arr_OptimalLane
      application-data-type=ADT_ICC_arr_NaviCruiseFacilityInfo, implementation-data-type=IDT_ICC_arr_NaviCruiseFacilityInfo
      application-data-type=ADT_ADAS_enum_ACCSts, implementation-data-type=IDT_ADAS_enum_ACCSts
      application-data-type=ADT_ADAS_enum_IHC_Status, implementation-data-type=IDT_ADAS_enum_IHC_Status
      application-data-type=ADT_ADAS_enum_BAFASts, implementation-data-type=IDT_ADAS_enum_BAFASts
      application-data-type=ADT_ADAS_Posn_CycCnt, implementation-data-type=IDT_ADAS_Posn_CycCnt
      application-data-type=ADT_ADAS_Meta_CycCnt, implementation-data-type=IDT_ADAS_Meta_CycCnt
      application-data-type=ADT_VhrCompID, implementation-data-type=IDT_VhrCompID
      application-data-type=ADT_ADAS_strt_DynamicObject, implementation-data-type=IDT_ADAS_strt_DynamicObject
      application-data-type=ADT_Strt_VersInfo, implementation-data-type=IDT_Strt_VersInfo
      application-data-type=ADT_ICC_enum_MNPMemRouteQuitBtnSt, implementation-data-type=IDT_ICC_enum_MNPMemRouteQuitBtnSt
      application-data-type=ADT_SglNtfADDrivingCardinfo_arr_Reserved, implementation-data-type=IDT_SglNtfADDrivingCardinfo_arr_Reserved
      application-data-type=ADT_ADAS_enum_TolAutoMergeChangeLane, implementation-data-type=IDT_ADAS_enum_TolAutoMergeChangeLane
      application-data-type=ADT_StrVar_TBOXOTARemoteAPPTCancel, implementation-data-type=IDT_StrVar_TBOXOTARemoteAPPTCancel
      application-data-type=ADT_Struct_RouteMatchingResult, implementation-data-type=IDT_Struct_RouteMatchingResult
      application-data-type=ADT_ADAS_arr_HPAParkingStaticObjects, implementation-data-type=IDT_ADAS_arr_HPAParkingStaticObjects
      application-data-type=ADT_HPASetOnway_arr_Reserved, implementation-data-type=IDT_HPASetOnway_arr_Reserved
      application-data-type=ADT_ICC_enum_HPAOperationId, implementation-data-type=IDT_ICC_enum_HPAOperationId
      application-data-type=ADT_FactoryResetTimeLength, implementation-data-type=IDT_FactoryResetTimeLength
      application-data-type=ADT_ADAS_string_VPAParkingLotName, implementation-data-type=IDT_ADAS_string_VPAParkingLotName
      application-data-type=ADT_ADAS_enum_TLRSts, implementation-data-type=IDT_ADAS_enum_TLRSts
      application-data-type=ADT_Arr_AvmCamCalPrms, implementation-data-type=IDT_Arr_AvmCamCalPrms
      application-data-type=ADT_ICC_int32_NaviType, implementation-data-type=IDT_ICC_int32_NaviType
      application-data-type=ADT_ICC_int32_LastSeconds, implementation-data-type=IDT_ICC_int32_LastSeconds
      application-data-type=ADT_SentryModeSt, implementation-data-type=IDT_SentryModeSt
      application-data-type=ADT_ICC_strt_TrafficJamInfo, implementation-data-type=IDT_ICC_strt_TrafficJamInfo
      application-data-type=ADT_ADAS_strt_MNPRouteInfo, implementation-data-type=IDT_ADAS_strt_MNPRouteInfo
      application-data-type=ADT_Enum_EcuType, implementation-data-type=IDT_Enum_EcuType
      application-data-type=ADT_ADAS_val_XboundMax, implementation-data-type=IDT_ADAS_val_XboundMax
      application-data-type=ADT_ADAS_enum_ICAQuitReason, implementation-data-type=IDT_ADAS_enum_ICAQuitReason
      application-data-type=ADT_ICC_boolean_isVariable, implementation-data-type=IDT_ICC_boolean_isVariable
      application-data-type=ADT_IcaNcaState, implementation-data-type=IDT_IcaNcaState
      application-data-type=ADT_ICC_strt_Coord3DDouble, implementation-data-type=IDT_ICC_strt_Coord3DDouble
      application-data-type=ADT_StrVar_VIN, implementation-data-type=IDT_StrVar_VIN
      application-data-type=ADT_ADSHMIDeamonMessage, implementation-data-type=IDT_ADSHMIDeamonMessage
      application-data-type=ADT_ADAS_enum_HPASts, implementation-data-type=IDT_ADAS_enum_HPASts
      application-data-type=ADT_ADAS_strt_HPARepalyPathInfo_2, implementation-data-type=IDT_ADAS_strt_HPARepalyPathInfo_2
      application-data-type=ADT_ICC_enum_FSRACruiseSpdMod, implementation-data-type=IDT_ICC_enum_FSRACruiseSpdMod
      application-data-type=ADT_Gen_enum_AvailableSts, implementation-data-type=IDT_Gen_enum_AvailableSts
      application-data-type=ADT_Strt_SatelInfo, implementation-data-type=IDT_Strt_SatelInfo
      application-data-type=ADT_CamIntrinsicsData, implementation-data-type=IDT_CamIntrinsicsData
      application-data-type=ADT_Array_RenderData, implementation-data-type=IDT_Array_RenderData
      application-data-type=ADT_OTAAPPTSecs, implementation-data-type=IDT_OTAAPPTSecs
      application-data-type=ADT_ICC_enum_ISLICruiseSpdAbdOffset, implementation-data-type=IDT_ICC_enum_ISLICruiseSpdAbdOffset
      application-data-type=ADT_ICC_strt_TrafficLightCountdown, implementation-data-type=IDT_ICC_strt_TrafficLightCountdown
      application-data-type=ADT_Enum_FreeparkMagModeBtnSt, implementation-data-type=IDT_Enum_FreeparkMagModeBtnSt
      application-data-type=ADT_ADAS_val_timestampmSec, implementation-data-type=IDT_ADAS_val_timestampmSec
      application-data-type=ADT_ADAS_float_Point, implementation-data-type=IDT_ADAS_float_Point
      application-data-type=ADT_ADAS_enum_RADSEnableBtnStFb, implementation-data-type=IDT_ADAS_enum_RADSEnableBtnStFb
      application-data-type=ADT_ADAS_Seg_Tunnel, implementation-data-type=IDT_ADAS_Seg_Tunnel
      application-data-type=ADT_Enum_NavArriveAim, implementation-data-type=IDT_Enum_NavArriveAim
      application-data-type=ADT_Enum_SNRInfo, implementation-data-type=IDT_Enum_SNRInfo
      application-data-type=ADT_ICC_int32_LightPhase, implementation-data-type=IDT_ICC_int32_LightPhase
      application-data-type=ADT_Enum_AvmCamCalPrmsReq, implementation-data-type=IDT_Enum_AvmCamCalPrmsReq
      application-data-type=ADT_ADAS_strt_AdvanceParkingInfo, implementation-data-type=IDT_ADAS_strt_AdvanceParkingInfo
      application-data-type=ADT_ICC_strt_SlotPoint, implementation-data-type=IDT_ICC_strt_SlotPoint
      application-data-type=ADT_StrVar_ARMVersion, implementation-data-type=IDT_StrVar_ARMVersion
      application-data-type=ADT_Enum_CamStreamOrntn, implementation-data-type=IDT_Enum_CamStreamOrntn
      application-data-type=ADT_Arr_GNSSInfoResd, implementation-data-type=IDT_Arr_GNSSInfoResd
      application-data-type=ADT_ICC_enum_ICAEnableBtnSts, implementation-data-type=IDT_ICC_enum_ICAEnableBtnSts
      application-data-type=ADT_Dbl_HDOPfInfo, implementation-data-type=IDT_Dbl_HDOPfInfo
      application-data-type=ADT_Struct_NOA_SDMapShortInfo, implementation-data-type=IDT_Struct_NOA_SDMapShortInfo
      application-data-type=ADT_CelluarRegisterStatus, implementation-data-type=IDT_CelluarRegisterStatus
      application-data-type=ADT_OCCInfo_arr_Reserved, implementation-data-type=IDT_OCCInfo_arr_Reserved
      application-data-type=ADT_UUIDCodeRequest, implementation-data-type=IDT_UUIDCodeRequest
      application-data-type=ADT_ADAS_strt_MNPRouteStateInfo, implementation-data-type=IDT_ADAS_strt_MNPRouteStateInfo
      application-data-type=ADT_ADAS_arr_VPATunnel, implementation-data-type=IDT_ADAS_arr_VPATunnel
      application-data-type=ADT_ICC_enum_BSDSettingSt, implementation-data-type=IDT_ICC_enum_BSDSettingSt
      application-data-type=ADT_ADAS_enum_LineType, implementation-data-type=IDT_ADAS_enum_LineType
      application-data-type=ADT_ICC_enum_LaneAction, implementation-data-type=IDT_ICC_enum_LaneAction
      application-data-type=ADT_ICC_strt_NaviInfo, implementation-data-type=IDT_ICC_strt_NaviInfo
      application-data-type=ADT_ADAS_enum_ParkingOperationResp, implementation-data-type=IDT_ADAS_enum_ParkingOperationResp
      application-data-type=ADT_ICC_strt_SDmapLaneInfo, implementation-data-type=IDT_ICC_strt_SDmapLaneInfo
      application-data-type=ADT_ADAS_enum_ISLITextInfo, implementation-data-type=IDT_ADAS_enum_ISLITextInfo
      application-data-type=ADT_ICC_int64_HeavyTraffic, implementation-data-type=IDT_ICC_int64_HeavyTraffic
      application-data-type=ADT_ADAS_enum_FSRACruiseSpdModFb, implementation-data-type=IDT_ADAS_enum_FSRACruiseSpdModFb
      application-data-type=ADT_ADAS_enumTargetObjType, implementation-data-type=IDT_ADAS_enumTargetObjType
      application-data-type=ADT_Struct_NOA_SDMapLongInfo, implementation-data-type=IDT_Struct_NOA_SDMapLongInfo
      application-data-type=ADT_ICC_strt_NaviIntervalCameraInfo, implementation-data-type=IDT_ICC_strt_NaviIntervalCameraInfo
      application-data-type=ADT_WiFiStrength, implementation-data-type=IDT_WiFiStrength
      application-data-type=ADT_RequestVhrCancelRemoteCall, implementation-data-type=IDT_RequestVhrCancelRemoteCall
      application-data-type=ADT_CelluarServiceStatus, implementation-data-type=IDT_CelluarServiceStatus
      application-data-type=ADT_Gen_val_Length, implementation-data-type=IDT_Gen_val_Length
      application-data-type=ADT_Enum_LogPrepareState, implementation-data-type=IDT_Enum_LogPrepareState
      application-data-type=ADT_ADAS_enum_ISLISpdLimType, implementation-data-type=IDT_ADAS_enum_ISLISpdLimType
      application-data-type=ADT_ICC_arr_BackLanes, implementation-data-type=IDT_ICC_arr_BackLanes
      application-data-type=ADT_LAC, implementation-data-type=IDT_LAC
      application-data-type=ADT_ADAS_val_vehicleSpd, implementation-data-type=IDT_ADAS_val_vehicleSpd
      application-data-type=ADT_ADAS_ProfShort_CtrlPoint, implementation-data-type=IDT_ADAS_ProfShort_CtrlPoint
      application-data-type=ADT_ADAS_strt_VPAEntrance, implementation-data-type=IDT_ADAS_strt_VPAEntrance
      application-data-type=ADT_ADAS_strt_ACCSupplementInfo, implementation-data-type=IDT_ADAS_strt_ACCSupplementInfo
      application-data-type=ADT_TimeInfoHour, implementation-data-type=IDT_TimeInfoHour
      application-data-type=ADT_ICC_enum_ApaOperationId, implementation-data-type=IDT_ICC_enum_ApaOperationId
      application-data-type=ADT_ADAS_Seg_CycCnt, implementation-data-type=IDT_ADAS_Seg_CycCnt
      application-data-type=ADT_ICC_enum_ParkingSpeedSet, implementation-data-type=IDT_ICC_enum_ParkingSpeedSet
      application-data-type=ADT_ADAS_enum_VPAFloor, implementation-data-type=IDT_ADAS_enum_VPAFloor
      application-data-type=ADT_GnssRawInfoElement, implementation-data-type=IDT_GnssRawInfoElement
      application-data-type=ADT_ADAS_ProfShort_CycCnt, implementation-data-type=IDT_ADAS_ProfShort_CycCnt
      application-data-type=ADT_ADSHMIBasicElement, implementation-data-type=IDT_ADSHMIBasicElement
      application-data-type=ADT_Struct_CertificateIssuedMark, implementation-data-type=IDT_Struct_CertificateIssuedMark
      application-data-type=ADT_HPATraining_arr_Reserved, implementation-data-type=IDT_HPATraining_arr_Reserved
      application-data-type=ADT_SimSwitchCheckResult, implementation-data-type=IDT_SimSwitchCheckResult
      application-data-type=ADT_ADAS_val_HPAVPAGiveWayVehTimes, implementation-data-type=IDT_ADAS_val_HPAVPAGiveWayVehTimes
      application-data-type=ADT_ICC_arr_NaviSubCameraExt, implementation-data-type=IDT_ICC_arr_NaviSubCameraExt
      application-data-type=ADT_ADAS_enum_ACCTextMessage, implementation-data-type=IDT_ADAS_enum_ACCTextMessage
      application-data-type=ADT_SentryModePlanStartTime_date, implementation-data-type=IDT_SentryModePlanStartTime_date
      application-data-type=ADT_ADAS_ProfShort_PathIdx, implementation-data-type=IDT_ADAS_ProfShort_PathIdx
      application-data-type=ADT_ICC_enum_IntelligentEvasionBtnSt, implementation-data-type=IDT_ICC_enum_IntelligentEvasionBtnSt
      application-data-type=ADT_ICC_arr_NaviCameraRes, implementation-data-type=IDT_ICC_arr_NaviCameraRes
      application-data-type=ADT_Enum_MicState, implementation-data-type=IDT_Enum_MicState
      application-data-type=ADT_ADAS_enum_ICAConfidence, implementation-data-type=IDT_ADAS_enum_ICAConfidence
      application-data-type=ADT_ICC_int32_Dist, implementation-data-type=IDT_ICC_int32_Dist
      application-data-type=ADT_ICC_int32_AssistAction, implementation-data-type=IDT_ICC_int32_AssistAction
      application-data-type=ADT_ICC_strt_TollGateInfo, implementation-data-type=IDT_ICC_strt_TollGateInfo
      application-data-type=ADT_MNPInfo_arr_Reserved, implementation-data-type=IDT_MNPInfo_arr_Reserved
      application-data-type=ADT_ICC_enum_DOWSettingSt, implementation-data-type=IDT_ICC_enum_DOWSettingSt
      application-data-type=ADT_Dbl_PDOPInfo, implementation-data-type=IDT_Dbl_PDOPInfo
      application-data-type=ADT_ADAS_strt_MNPInfo, implementation-data-type=IDT_ADAS_strt_MNPInfo
      application-data-type=ADT_Enum_SatelIdNrInfo, implementation-data-type=IDT_Enum_SatelIdNrInfo
      application-data-type=ADT_Struct_LogFTPSts, implementation-data-type=IDT_Struct_LogFTPSts
      application-data-type=ADT_ADAS_strt_StaticObject, implementation-data-type=IDT_ADAS_strt_StaticObject
      application-data-type=ADT_ADAS_Seg_PartOfCalcRoute, implementation-data-type=IDT_ADAS_Seg_PartOfCalcRoute
      application-data-type=ADT_ICC_strt_LaneInfo, implementation-data-type=IDT_ICC_strt_LaneInfo
      application-data-type=ADT_ICC_boolean_Unobstructed, implementation-data-type=IDT_ICC_boolean_Unobstructed
      application-data-type=ADT_ADAS_string_VPAParkingLotAddress, implementation-data-type=IDT_ADAS_string_VPAParkingLotAddress
      application-data-type=ADT_Gen_val_ID, implementation-data-type=IDT_Gen_val_ID
      application-data-type=ADT_ICC_enum_VoiceRemindSettingMode, implementation-data-type=IDT_ICC_enum_VoiceRemindSettingMode
      application-data-type=ADT_ICC_enum_SetHPAPathType, implementation-data-type=IDT_ICC_enum_SetHPAPathType
      application-data-type=ADT_SimMode, implementation-data-type=IDT_SimMode
      application-data-type=ADT_ADAS_enum_ESSSts, implementation-data-type=IDT_ADAS_enum_ESSSts
      application-data-type=ADT_SentryModePlanTime, implementation-data-type=IDT_SentryModePlanTime
      application-data-type=ADT_ICC_string_SetPathName, implementation-data-type=IDT_ICC_string_SetPathName
      application-data-type=ADT_ICC_enum_MNPDelRouteIDBtnSt, implementation-data-type=IDT_ICC_enum_MNPDelRouteIDBtnSt
      application-data-type=ADT_ICC_enum_ApaModeReq, implementation-data-type=IDT_ICC_enum_ApaModeReq
      application-data-type=ADT_ADSHMISettingMessage, implementation-data-type=IDT_ADSHMISettingMessage
      application-data-type=ADT_ADAS_strt_HPAOnWayLabel, implementation-data-type=IDT_ADAS_strt_HPAOnWayLabel
      application-data-type=ADT_Reserved_int32_Type, implementation-data-type=IDT_Reserved_int32_Type
      application-data-type=ADT_LCM_IMU_Gyro_Y, implementation-data-type=IDT_LCM_IMU_Gyro_Y
      application-data-type=ADT_ICC_int32_Penalty, implementation-data-type=IDT_ICC_int32_Penalty
      application-data-type=ADT_LCM_IMU_Gyro_Z, implementation-data-type=IDT_LCM_IMU_Gyro_Z
      application-data-type=ADT_StrVar_HardwareVersion, implementation-data-type=IDT_StrVar_HardwareVersion
      application-data-type=ADT_LCM_IMU_Gyro_X, implementation-data-type=IDT_LCM_IMU_Gyro_X
      application-data-type=ADT_ADAS_arr_VPASelfBuildMap, implementation-data-type=IDT_ADAS_arr_VPASelfBuildMap
      application-data-type=ADT_ICC_arr_MixForkInfoList, implementation-data-type=IDT_ICC_arr_MixForkInfoList
      application-data-type=ADT_ADAS_enum_HODWarnSettingStFb, implementation-data-type=IDT_ADAS_enum_HODWarnSettingStFb
      application-data-type=ADT_NotAvoid_arr_Reserved, implementation-data-type=IDT_NotAvoid_arr_Reserved
      application-data-type=ADT_ICC_enum_MRAOperationId, implementation-data-type=IDT_ICC_enum_MRAOperationId
      application-data-type=ADT_ADAS_enum_Percent, implementation-data-type=IDT_ADAS_enum_Percent
      application-data-type=ADT_ADAS_val_SetSpd, implementation-data-type=IDT_ADAS_val_SetSpd
      application-data-type=ADT_WiFiDownloadDataStatus, implementation-data-type=IDT_WiFiDownloadDataStatus
      application-data-type=ADT_ADAS_enum_LineColor, implementation-data-type=IDT_ADAS_enum_LineColor
      application-data-type=ADT_ADAS_enum_TolAccessRemitramp, implementation-data-type=IDT_ADAS_enum_TolAccessRemitramp
      application-data-type=ADT_TrafficLight_arr_Reserved, implementation-data-type=IDT_TrafficLight_arr_Reserved
      application-data-type=ADT_StrVar_BleSlaverLeftMac, implementation-data-type=IDT_StrVar_BleSlaverLeftMac
      application-data-type=ADT_ADAS_strt_MNPMemRoutePointsInfo, implementation-data-type=IDT_ADAS_strt_MNPMemRoutePointsInfo
      application-data-type=ADT_ADAS_enum_DrivingSoundWarn, implementation-data-type=IDT_ADAS_enum_DrivingSoundWarn
      application-data-type=ADT_Str_ProductID, implementation-data-type=IDT_Str_ProductID
      application-data-type=ADT_ADAS_enum_iLOASts, implementation-data-type=IDT_ADAS_enum_iLOASts
      application-data-type=ADT_ADAS_Seg_NumOfLaneOppDir, implementation-data-type=IDT_ADAS_Seg_NumOfLaneOppDir
      application-data-type=ADT_ICC_strt_TrafficLightInfo, implementation-data-type=IDT_ICC_strt_TrafficLightInfo
      application-data-type=ADT_ADAS_enum_LSSTextInfo, implementation-data-type=IDT_ADAS_enum_LSSTextInfo
      application-data-type=ADT_NaviRoadInfo_arr_Reserved, implementation-data-type=IDT_NaviRoadInfo_arr_Reserved
      application-data-type=ADT_ADAS_arr_VPARange, implementation-data-type=IDT_ADAS_arr_VPARange
      application-data-type=ADT_ValetParkingPoinNetArray, implementation-data-type=IDT_ValetParkingPoinNetArray
      application-data-type=ADT_ICC_string_SoundInfo, implementation-data-type=IDT_ICC_string_SoundInfo
      application-data-type=ADT_TBOX_ReturnCode, implementation-data-type=IDT_TBOX_ReturnCode
      application-data-type=ADT_Struct_NOA_SDMapPosInfo, implementation-data-type=IDT_Struct_NOA_SDMapPosInfo
      application-data-type=ADT_ValetParkingStatus, implementation-data-type=IDT_ValetParkingStatus
      application-data-type=ADT_ADAS_enum_DriverHandsoffWarning, implementation-data-type=IDT_ADAS_enum_DriverHandsoffWarning
      application-data-type=ADT_ICC_strt_CongestionExtend, implementation-data-type=IDT_ICC_strt_CongestionExtend
      application-data-type=ADT_ADAS_enum_IsSlotHasWheelStopper, implementation-data-type=IDT_ADAS_enum_IsSlotHasWheelStopper
      application-data-type=ADT_ApaRpaFcn_arr_Reserved, implementation-data-type=IDT_ApaRpaFcn_arr_Reserved
      application-data-type=ADT_Progress, implementation-data-type=IDT_Progress
      application-data-type=ADT_ADAS_enum_ALCSoundWarn, implementation-data-type=IDT_ADAS_enum_ALCSoundWarn
      application-data-type=ADT_ADAS_Stub_CmplxInsct, implementation-data-type=IDT_ADAS_Stub_CmplxInsct
      application-data-type=ADT_ICC_int32_StandardType, implementation-data-type=IDT_ICC_int32_StandardType
      application-data-type=ADT_ADAS_enum_TolAPANum, implementation-data-type=IDT_ADAS_enum_TolAPANum
      application-data-type=ADT_ICC_enum_IHCEnableBtnSt, implementation-data-type=IDT_ICC_enum_IHCEnableBtnSt
      application-data-type=ADT_ADAS_enum_AMAPSts, implementation-data-type=IDT_ADAS_enum_AMAPSts
      application-data-type=ADT_IncomingTotalTime, implementation-data-type=IDT_IncomingTotalTime
      application-data-type=ADT_Enum_MatchingMode, implementation-data-type=IDT_Enum_MatchingMode
      application-data-type=ADT_INI_ReturnCode, implementation-data-type=IDT_INI_ReturnCode
      application-data-type=ADT_ADAS_enum_FCTBWarnActSt, implementation-data-type=IDT_ADAS_enum_FCTBWarnActSt
      application-data-type=ADT_ICC_int32_TmcInfoStatus, implementation-data-type=IDT_ICC_int32_TmcInfoStatus
      application-data-type=ADT_ADAS_enum_ICATextInfo, implementation-data-type=IDT_ADAS_enum_ICATextInfo
      application-data-type=ADT_ADAS_strt_RoadMarker, implementation-data-type=IDT_ADAS_strt_RoadMarker
      application-data-type=ADT_ADAS_enum_HandsOnReq, implementation-data-type=IDT_ADAS_enum_HandsOnReq
      application-data-type=ADT_NaviStatus_arr_Reserved, implementation-data-type=IDT_NaviStatus_arr_Reserved
      application-data-type=ADT_Enum_CallOperation, implementation-data-type=IDT_Enum_CallOperation
      application-data-type=ADT_ADAS_Posn_Idx, implementation-data-type=IDT_ADAS_Posn_Idx
      application-data-type=ADT_ADAS_arr_MNPRoutesStateInfo, implementation-data-type=IDT_ADAS_arr_MNPRoutesStateInfo
      application-data-type=ADT_ADAS_arr_RoadMarker_2, implementation-data-type=IDT_ADAS_arr_RoadMarker_2
      application-data-type=ADT_ADAS_strt_DrivingSoundInfo, implementation-data-type=IDT_ADAS_strt_DrivingSoundInfo
      application-data-type=ADT_ICC_int32_CameraPriority, implementation-data-type=IDT_ICC_int32_CameraPriority
      application-data-type=ADT_AccState, implementation-data-type=IDT_AccState
      application-data-type=ADT_ADAS_enum_ALCAbortReason, implementation-data-type=IDT_ADAS_enum_ALCAbortReason
      application-data-type=ADT_ADAS_ProfShort_ProfType, implementation-data-type=IDT_ADAS_ProfShort_ProfType
      application-data-type=ADT_ICC_enum_ParkingFuncModReq, implementation-data-type=IDT_ICC_enum_ParkingFuncModReq
      application-data-type=ADT_HPARepaly_arr_Reserved, implementation-data-type=IDT_HPARepaly_arr_Reserved
      application-data-type=ADT_HDMapInfo_arr_Reserved, implementation-data-type=IDT_HDMapInfo_arr_Reserved
      application-data-type=ADT_ADAS_Seg_EffSpdLmtType, implementation-data-type=IDT_ADAS_Seg_EffSpdLmtType
      application-data-type=ADT_ADAS_Posn_CurLane, implementation-data-type=IDT_ADAS_Posn_CurLane
      application-data-type=ADT_NaviInfoPanel_arr_Reserved, implementation-data-type=IDT_NaviInfoPanel_arr_Reserved
      application-data-type=ADT_ADAS_enum_ParkingSpeedSet, implementation-data-type=IDT_ADAS_enum_ParkingSpeedSet
      application-data-type=ADT_ADAS_Stub_PathIdx, implementation-data-type=IDT_ADAS_Stub_PathIdx
      application-data-type=ADT_ScheduleTime, implementation-data-type=IDT_ScheduleTime
      application-data-type=ADT_ADAS_enum_TolRespondCongestion, implementation-data-type=IDT_ADAS_enum_TolRespondCongestion
      application-data-type=ADT_Arr_CamStreamSwtReqResd, implementation-data-type=IDT_Arr_CamStreamSwtReqResd
      application-data-type=ADT_ICC_enum_NOPLaneChangeStyle, implementation-data-type=IDT_ICC_enum_NOPLaneChangeStyle
      application-data-type=ADT_ADAS_strt_ActiveSafetyFcnInfo, implementation-data-type=IDT_ADAS_strt_ActiveSafetyFcnInfo
      application-data-type=ADT_ADAS_val_ParkingProgressBarInd, implementation-data-type=IDT_ADAS_val_ParkingProgressBarInd
      application-data-type=ADT_ADAS_strt_SDmapInfo_international, implementation-data-type=IDT_ADAS_strt_SDmapInfo_international
      application-data-type=ADT_ICC_arr_FrontLaneTypes, implementation-data-type=IDT_ICC_arr_FrontLaneTypes
      application-data-type=ADT_TimeZoneInfo, implementation-data-type=IDT_TimeZoneInfo
      application-data-type=ADT_ADAS_enum_ObjectColor, implementation-data-type=IDT_ADAS_enum_ObjectColor
      application-data-type=ADT_ICC_Strt_ADASSettingInfo, implementation-data-type=IDT_ICC_Strt_ADASSettingInfo
      application-data-type=ADT_ADAS_enum_LCPermitSt, implementation-data-type=IDT_ADAS_enum_LCPermitSt
      application-data-type=ADT_ADAS_enum_FDMSt, implementation-data-type=IDT_ADAS_enum_FDMSt
      application-data-type=ADT_ADAS_strt_AebTargetObjInfo_2, implementation-data-type=IDT_ADAS_strt_AebTargetObjInfo_2
      application-data-type=ADT_ADAS_strt_EgoFusionPose, implementation-data-type=IDT_ADAS_strt_EgoFusionPose
      application-data-type=ADT_ADAS_enum_LightStatus, implementation-data-type=IDT_ADAS_enum_LightStatus
      application-data-type=ADT_ADAS_arr_DrivingTrajectoryPointList, implementation-data-type=IDT_ADAS_arr_DrivingTrajectoryPointList
      application-data-type=ADT_Enum_DataConnection, implementation-data-type=IDT_Enum_DataConnection
      application-data-type=ADT_ADAS_arr_MNPRoutesInfo, implementation-data-type=IDT_ADAS_arr_MNPRoutesInfo
      application-data-type=ADT_ADAS_enum_APAActiveFuncInd, implementation-data-type=IDT_ADAS_enum_APAActiveFuncInd
      application-data-type=ADT_ADAS_val_MemRouteCreatTime, implementation-data-type=IDT_ADAS_val_MemRouteCreatTime
      application-data-type=ADT_AllSimDetailInfo, implementation-data-type=IDT_AllSimDetailInfo
      application-data-type=ADT_Flt_GndSpdInfo, implementation-data-type=IDT_Flt_GndSpdInfo
      application-data-type=ADT_Enum_TBOXOTARemoteAPPTCancel, implementation-data-type=IDT_Enum_TBOXOTARemoteAPPTCancel
      application-data-type=ADT_EphemerisDataByteArray, implementation-data-type=IDT_EphemerisDataByteArray
      application-data-type=ADT_ADAS_enum_NOPALCReqDriverConf, implementation-data-type=IDT_ADAS_enum_NOPALCReqDriverConf
      application-data-type=ADT_GreenWave_arr_Reserved, implementation-data-type=IDT_GreenWave_arr_Reserved
      application-data-type=ADT_CruiseInfo_arr_Reserved, implementation-data-type=IDT_CruiseInfo_arr_Reserved
      application-data-type=ADT_Struct_UploadBEICALLSts, implementation-data-type=IDT_Struct_UploadBEICALLSts
      application-data-type=ADT_SimSwitchRequest, implementation-data-type=IDT_SimSwitchRequest
      application-data-type=ADT_Struct_TBOXVersionInfo, implementation-data-type=IDT_Struct_TBOXVersionInfo
      application-data-type=ADT_ADAS_arr_ParkingDynamicObjects_2, implementation-data-type=IDT_ADAS_arr_ParkingDynamicObjects_2
      application-data-type=ADT_Enum_Data_ID, implementation-data-type=IDT_Enum_Data_ID
      application-data-type=ADT_ICC_val_Distance, implementation-data-type=IDT_ICC_val_Distance
      application-data-type=ADT_ADAS_enum_SglU_turnsNum, implementation-data-type=IDT_ADAS_enum_SglU_turnsNum
      application-data-type=ADT_ICC_int64_Index, implementation-data-type=IDT_ICC_int64_Index
      application-data-type=ADT_ADAS_arr_MNPMemRoutesNum, implementation-data-type=IDT_ADAS_arr_MNPMemRoutesNum
      application-data-type=ADT_ICC_strt_NaviInfoPanel, implementation-data-type=IDT_ICC_strt_NaviInfoPanel
      application-data-type=ADT_ADAS_strt_MNPMemRoutePosition, implementation-data-type=IDT_ADAS_strt_MNPMemRoutePosition
      application-data-type=ADT_ESSInfo_arr_Reserved, implementation-data-type=IDT_ESSInfo_arr_Reserved
      application-data-type=ADT_ADAS_enum_ESSActiveSt, implementation-data-type=IDT_ADAS_enum_ESSActiveSt
      application-data-type=ADT_ADAS_strt_LaneLine, implementation-data-type=IDT_ADAS_strt_LaneLine
      application-data-type=ADT_ICC_enum_WeatherID, implementation-data-type=IDT_ICC_enum_WeatherID
      application-data-type=ADT_ICC_enum_ISLICruiseSpdRelOffset, implementation-data-type=IDT_ICC_enum_ISLICruiseSpdRelOffset
      application-data-type=ADT_Enum_MobileNetworkType, implementation-data-type=IDT_Enum_MobileNetworkType
      application-data-type=ADT_ADAS_Seg_RelProbb, implementation-data-type=IDT_ADAS_Seg_RelProbb
      application-data-type=ADT_ICC_strt_HPAPathInfo, implementation-data-type=IDT_ICC_strt_HPAPathInfo
      application-data-type=ADT_Enum_RouteMMError, implementation-data-type=IDT_Enum_RouteMMError
      application-data-type=ADT_StrVar_BleSlaverRightMac, implementation-data-type=IDT_StrVar_BleSlaverRightMac
      application-data-type=ADT_SurfaceMesh_arr_Reserved, implementation-data-type=IDT_SurfaceMesh_arr_Reserved
      application-data-type=ADT_ADAS_enum_VPASpotLabel, implementation-data-type=IDT_ADAS_enum_VPASpotLabel
      application-data-type=ADT_ADAS_ProfLong_CtrlPoint, implementation-data-type=IDT_ADAS_ProfLong_CtrlPoint
      application-data-type=ADT_quitFactoryResetResponse, implementation-data-type=IDT_quitFactoryResetResponse
      application-data-type=ADT_Gen_uint64_ID, implementation-data-type=IDT_Gen_uint64_ID
      application-data-type=ADT_ICC_enum_NavSpeedLimitType, implementation-data-type=IDT_ICC_enum_NavSpeedLimitType
      application-data-type=ADT_Bool_CarrierFrq, implementation-data-type=IDT_Bool_CarrierFrq
      application-data-type=ADT_Struct_TBOXAPPT, implementation-data-type=IDT_Struct_TBOXAPPT
      application-data-type=ADT_ADAS_enum_Confidencelevel, implementation-data-type=IDT_ADAS_enum_Confidencelevel
      application-data-type=ADT_ICC_enum_DrivingVoiceRemindSettingSt, implementation-data-type=IDT_ICC_enum_DrivingVoiceRemindSettingSt
      application-data-type=ADT_ADAS_ProfShort_Update, implementation-data-type=IDT_ADAS_ProfShort_Update
      application-data-type=ADT_ICC_enum_HPASettingSt, implementation-data-type=IDT_ICC_enum_HPASettingSt
      application-data-type=ADT_ADAS_val_HNOACruiseSpdOffsetPercentFb, implementation-data-type=IDT_ADAS_val_HNOACruiseSpdOffsetPercentFb
      application-data-type=ADT_ADAS_enum_HNOPScenariosReminder, implementation-data-type=IDT_ADAS_enum_HNOPScenariosReminder
      application-data-type=ADT_SentryModePlanStartTime_minute, implementation-data-type=IDT_SentryModePlanStartTime_minute
      application-data-type=ADT_TLRInfo_arr_Reserved, implementation-data-type=IDT_TLRInfo_arr_Reserved
      application-data-type=ADT_ADAS_Posn_PosConfdc, implementation-data-type=IDT_ADAS_Posn_PosConfdc
      application-data-type=ADT_ADAS_Meta_RegionCode, implementation-data-type=IDT_ADAS_Meta_RegionCode
      application-data-type=ADT_ICC_int32_RoadStatus, implementation-data-type=IDT_ICC_int32_RoadStatus
      application-data-type=ADT_SimNum, implementation-data-type=IDT_SimNum
      application-data-type=ADT_ADAS_arr_PathPoint_2, implementation-data-type=IDT_ADAS_arr_PathPoint_2
      application-data-type=ADT_ICC_enum_SelectZoneFloor, implementation-data-type=IDT_ICC_enum_SelectZoneFloor
      application-data-type=ADT_Enum_TBOXOTAAPPTSet, implementation-data-type=IDT_Enum_TBOXOTAAPPTSet
      application-data-type=ADT_ADAS_enum_VPADropOffPosSelectReq, implementation-data-type=IDT_ADAS_enum_VPADropOffPosSelectReq
      application-data-type=ADT_Enum_UpdateFTPSts, implementation-data-type=IDT_Enum_UpdateFTPSts
      application-data-type=ADT_Strength, implementation-data-type=IDT_Strength
      application-data-type=ADT_StrVar_State, implementation-data-type=IDT_StrVar_State
      application-data-type=ADT_TimeStamp64, implementation-data-type=IDT_TimeStamp64
      application-data-type=ADT_ADAS_enum_SglAccessRemitramp, implementation-data-type=IDT_ADAS_enum_SglAccessRemitramp
      application-data-type=ADT_ADAS_strt_PlannedPath, implementation-data-type=IDT_ADAS_strt_PlannedPath
      application-data-type=ADT_ADAS_strt_ESSInfo, implementation-data-type=IDT_ADAS_strt_ESSInfo
      application-data-type=ADT_Enum_SatelTotNrInfo, implementation-data-type=IDT_Enum_SatelTotNrInfo
      application-data-type=ADT_ICC_int64_Dist, implementation-data-type=IDT_ICC_int64_Dist
      application-data-type=ADT_ICC_enum_MNPNewBtnSt, implementation-data-type=IDT_ICC_enum_MNPNewBtnSt
      application-data-type=ADT_ICC_enum_ELKSettingSt, implementation-data-type=IDT_ICC_enum_ELKSettingSt
      application-data-type=ADT_ADAS_strt_HNOPfunctionInfo, implementation-data-type=IDT_ADAS_strt_HNOPfunctionInfo
      application-data-type=ADT_Enum_SPKState, implementation-data-type=IDT_Enum_SPKState
      application-data-type=ADT_ICC_Navi_Longitude, implementation-data-type=IDT_ICC_Navi_Longitude
      application-data-type=ADT_ICC_int32_LinkType, implementation-data-type=IDT_ICC_int32_LinkType
      application-data-type=ADT_CruiseFacility_arr_Reserved, implementation-data-type=IDT_CruiseFacility_arr_Reserved
      application-data-type=ADT_FCM_val_CamParameter, implementation-data-type=IDT_FCM_val_CamParameter
      application-data-type=ADT_ADAS_strt_ParkingHMIInfo, implementation-data-type=IDT_ADAS_strt_ParkingHMIInfo
      application-data-type=ADT_ICC_strt_LightState, implementation-data-type=IDT_ICC_strt_LightState
      application-data-type=ADT_HNOPSupplementInfo_arr_Reserved, implementation-data-type=IDT_HNOPSupplementInfo_arr_Reserved
      application-data-type=ADT_SentryModePlanEndTime_minute, implementation-data-type=IDT_SentryModePlanEndTime_minute
      application-data-type=ADT_NaviInfo_arr_Reserved, implementation-data-type=IDT_NaviInfo_arr_Reserved
      application-data-type=ADT_StrVar_TBOXOTARemoteInstall, implementation-data-type=IDT_StrVar_TBOXOTARemoteInstall
      application-data-type=ADT_FactoryResetSartCode, implementation-data-type=IDT_FactoryResetSartCode
      application-data-type=ADT_ADAS_enum_VPAFailureReasonInd, implementation-data-type=IDT_ADAS_enum_VPAFailureReasonInd
      application-data-type=ADT_ADAS_arr_HPAOnWayLabelReplay, implementation-data-type=IDT_ADAS_arr_HPAOnWayLabelReplay
      application-data-type=ADT_ADAS_arr_VPASpotLabel, implementation-data-type=IDT_ADAS_arr_VPASpotLabel
      application-data-type=ADT_ICC_enum_RCTAWarnType, implementation-data-type=IDT_ICC_enum_RCTAWarnType
      application-data-type=ADT_SentryModeAlarm, implementation-data-type=IDT_SentryModeAlarm
      application-data-type=ADT_ADAS_enum_UNOPSts, implementation-data-type=IDT_ADAS_enum_UNOPSts
      application-data-type=ADT_ADAS_strt_MNPRoutesInfo, implementation-data-type=IDT_ADAS_strt_MNPRoutesInfo
      application-data-type=ADT_ADAS_strt_LaneLine_2, implementation-data-type=IDT_ADAS_strt_LaneLine_2
      application-data-type=ADT_ADAS_enum_RoadMarkerColor, implementation-data-type=IDT_ADAS_enum_RoadMarkerColor
      application-data-type=ADT_ICC_arr_ExtensionLanes, implementation-data-type=IDT_ICC_arr_ExtensionLanes
      application-data-type=ADT_ICC_enum_HandsOffWarningStyle, implementation-data-type=IDT_ICC_enum_HandsOffWarningStyle
      application-data-type=ADT_ADAS_enum_SglLCCMileage, implementation-data-type=IDT_ADAS_enum_SglLCCMileage
      application-data-type=ADT_ADAS_strt_OCCPosition, implementation-data-type=IDT_ADAS_strt_OCCPosition
      application-data-type=ADT_SimOperator, implementation-data-type=IDT_SimOperator
      application-data-type=ADT_ADAS_strt_DrivingTrajectoryPointList, implementation-data-type=IDT_ADAS_strt_DrivingTrajectoryPointList
      application-data-type=ADT_ICC_arr_FrontExtenLanes, implementation-data-type=IDT_ICC_arr_FrontExtenLanes
      application-data-type=ADT_APARPAInfo_arr_Reserved, implementation-data-type=IDT_APARPAInfo_arr_Reserved
      application-data-type=ADT_ADAS_strt_TrafficLightPos, implementation-data-type=IDT_ADAS_strt_TrafficLightPos
      application-data-type=ADT_ADAS_enum_ISLISpdOffsetMod, implementation-data-type=IDT_ADAS_enum_ISLISpdOffsetMod
      application-data-type=ADT_StrVar_MSISDN, implementation-data-type=IDT_StrVar_MSISDN
      application-data-type=ADT_ICC_enum_SubCameraExtType, implementation-data-type=IDT_ICC_enum_SubCameraExtType
      application-data-type=ADT_ADAS_arr_DynamicObjects, implementation-data-type=IDT_ADAS_arr_DynamicObjects
      application-data-type=ADT_TimeInfoMsg, implementation-data-type=IDT_TimeInfoMsg
      application-data-type=ADT_ICC_arr_NaviCongestionDetailInfo, implementation-data-type=IDT_ICC_arr_NaviCongestionDetailInfo
      application-data-type=ADT_ephemerisDataIndexTotal, implementation-data-type=IDT_ephemerisDataIndexTotal
      application-data-type=ADT_ADAS_strt_HodDmsInfo, implementation-data-type=IDT_ADAS_strt_HodDmsInfo
      application-data-type=ADT_Gen_enum_CalibrationSts, implementation-data-type=IDT_Gen_enum_CalibrationSts
      application-data-type=ADT_TrafficLightInfo_arr_Reserved, implementation-data-type=IDT_TrafficLightInfo_arr_Reserved
      application-data-type=ADT_ICC_strt_NaviSubCameraExt, implementation-data-type=IDT_ICC_strt_NaviSubCameraExt
      application-data-type=ADT_ResetCommandResponse, implementation-data-type=IDT_ResetCommandResponse
      application-data-type=ADT_ADAS_enum_MNPNewRouteSaving, implementation-data-type=IDT_ADAS_enum_MNPNewRouteSaving
      application-data-type=ADT_ADAS_Stub_NumOfLaneOppDir, implementation-data-type=IDT_ADAS_Stub_NumOfLaneOppDir
      application-data-type=ADT_ICC_string_GateName, implementation-data-type=IDT_ICC_string_GateName
      application-data-type=ADT_ADAS_enum_ParkingFailureReasonInd, implementation-data-type=IDT_ADAS_enum_ParkingFailureReasonInd
      application-data-type=ADT_ADAS_strt_StaticObject_2, implementation-data-type=IDT_ADAS_strt_StaticObject_2
      application-data-type=ADT_ICC_enum_MNPAllRoutesInfoReq, implementation-data-type=IDT_ICC_enum_MNPAllRoutesInfoReq
      application-data-type=ADT_ADAS_val_RemainingTime, implementation-data-type=IDT_ADAS_val_RemainingTime
      application-data-type=ADT_ADAS_ego_vehicleSpd, implementation-data-type=IDT_ADAS_ego_vehicleSpd
      application-data-type=ADT_Bool_Ephemeris, implementation-data-type=IDT_Bool_Ephemeris
      application-data-type=ADT_ADAS_strt_UNOPfunctionInfo, implementation-data-type=IDT_ADAS_strt_UNOPfunctionInfo
      application-data-type=ADT_ADAS_enum_RoadMarkerTrackingSts, implementation-data-type=IDT_ADAS_enum_RoadMarkerTrackingSts
      application-data-type=ADT_Array_CallNumberList, implementation-data-type=IDT_Array_CallNumberList
      application-data-type=ADT_StrVar_NMEA, implementation-data-type=IDT_StrVar_NMEA
      application-data-type=ADT_ICC_enum_HPASlotSearchOperationID, implementation-data-type=IDT_ICC_enum_HPASlotSearchOperationID
      application-data-type=ADT_ICC_arr_BackExtenLanes, implementation-data-type=IDT_ICC_arr_BackExtenLanes
      application-data-type=ADT_ICC_arr_AheadLaneInfoList, implementation-data-type=IDT_ICC_arr_AheadLaneInfoList
      application-data-type=ADT_Gen_val_Pitch, implementation-data-type=IDT_Gen_val_Pitch
      application-data-type=ADT_DrivingSound_arr_Reserved, implementation-data-type=IDT_DrivingSound_arr_Reserved
      application-data-type=ADT_OutgoingTotalTime, implementation-data-type=IDT_OutgoingTotalTime
      application-data-type=ADT_StrVar_ECUHardwareNumber, implementation-data-type=IDT_StrVar_ECUHardwareNumber
      application-data-type=ADT_TunnelInfo_arr_Reserved, implementation-data-type=IDT_TunnelInfo_arr_Reserved
      application-data-type=ADT_ADAS_enum_ParkingPauseInd, implementation-data-type=IDT_ADAS_enum_ParkingPauseInd
      application-data-type=ADT_ICC_int32_LinkRemainDist, implementation-data-type=IDT_ICC_int32_LinkRemainDist
      application-data-type=ADT_ICC_str_NaviCongestionExtend, implementation-data-type=IDT_ICC_str_NaviCongestionExtend
      application-data-type=ADT_TimeInfoMinute, implementation-data-type=IDT_TimeInfoMinute
      application-data-type=ADT_ADSHMINotificationMessage, implementation-data-type=IDT_ADSHMINotificationMessage
      application-data-type=ADT_VhrLogEndTime, implementation-data-type=IDT_VhrLogEndTime
      application-data-type=ADT_AdvPrkg_arr_Reserved, implementation-data-type=IDT_AdvPrkg_arr_Reserved
      application-data-type=ADT_ADAS_ProfShort_Value1, implementation-data-type=IDT_ADAS_ProfShort_Value1
      application-data-type=ADT_ADAS_strt_ActiveSafetyFcnInfo_2, implementation-data-type=IDT_ADAS_strt_ActiveSafetyFcnInfo_2
      application-data-type=ADT_Enum_CamStreamSwt, implementation-data-type=IDT_Enum_CamStreamSwt
      application-data-type=ADT_Enum_SatelTypeInfo, implementation-data-type=IDT_Enum_SatelTypeInfo
      application-data-type=ADT_ADAS_arr_LaneCenterPoint, implementation-data-type=IDT_ADAS_arr_LaneCenterPoint
      application-data-type=ADT_SimSwitchEventReserved, implementation-data-type=IDT_SimSwitchEventReserved
      application-data-type=ADT_ADAS_strt_TLRInfo, implementation-data-type=IDT_ADAS_strt_TLRInfo
      application-data-type=ADT_L3state, implementation-data-type=IDT_L3state
      application-data-type=ADT_ICC_enum_RPASettingSt, implementation-data-type=IDT_ICC_enum_RPASettingSt
      application-data-type=ADT_ADAS_val_heading, implementation-data-type=IDT_ADAS_val_heading
      application-data-type=ADT_RampInfo_arr_Reserved, implementation-data-type=IDT_RampInfo_arr_Reserved
      application-data-type=ADT_ADAS_enum_MNPNewRoute, implementation-data-type=IDT_ADAS_enum_MNPNewRoute
      application-data-type=ADT_FacilityInfo_arr_Reserved, implementation-data-type=IDT_FacilityInfo_arr_Reserved
      application-data-type=ADT_ADAS_strt_TrajectoryPoint, implementation-data-type=IDT_ADAS_strt_TrajectoryPoint
      application-data-type=ADT_ICC_arr_CrossNaviInfo, implementation-data-type=IDT_ICC_arr_CrossNaviInfo
      application-data-type=ADT_Str_CamStreamStResp, implementation-data-type=IDT_Str_CamStreamStResp
      application-data-type=ADT_ICC_boolean_isSpecial, implementation-data-type=IDT_ICC_boolean_isSpecial
      application-data-type=ADT_ADAS_enum_LKSLeftTrackingSt, implementation-data-type=IDT_ADAS_enum_LKSLeftTrackingSt
      application-data-type=ADT_ADAS_val_OCCNum, implementation-data-type=IDT_ADAS_val_OCCNum
      application-data-type=ADT_TimeInfoSecond, implementation-data-type=IDT_TimeInfoSecond
      application-data-type=ADT_ADAS_Seg_NumOfLaneDrvDir, implementation-data-type=IDT_ADAS_Seg_NumOfLaneDrvDir
      application-data-type=ADT_ICC_float_Speed, implementation-data-type=IDT_ICC_float_Speed
      application-data-type=ADT_ICC_enum_MNPRouteInfoReq, implementation-data-type=IDT_ICC_enum_MNPRouteInfoReq
      application-data-type=ADT_ADAS_enum_OutsideParkingBtnStFb, implementation-data-type=IDT_ADAS_enum_OutsideParkingBtnStFb
      application-data-type=ADT_Struct_RouteMMSeg, implementation-data-type=IDT_Struct_RouteMMSeg
      application-data-type=ADT_ICC_int32_CruiseFacilitType, implementation-data-type=IDT_ICC_int32_CruiseFacilitType
      application-data-type=ADT_ADAS_enum_TolRecordUploadBtnFb, implementation-data-type=IDT_ADAS_enum_TolRecordUploadBtnFb
      application-data-type=ADT_ADAS_strt_VPAParkingLotInfo, implementation-data-type=IDT_ADAS_strt_VPAParkingLotInfo
      application-data-type=ADT_ADAS_enum_HPAPopup, implementation-data-type=IDT_ADAS_enum_HPAPopup
      application-data-type=ADT_ADAS_val_ParkingDist, implementation-data-type=IDT_ADAS_val_ParkingDist
      application-data-type=ADT_ADAS_strt_ParkingSlot_2, implementation-data-type=IDT_ADAS_strt_ParkingSlot_2
      application-data-type=ADT_ADAS_enumTargetObjColor, implementation-data-type=IDT_ADAS_enumTargetObjColor
      application-data-type=ADT_ICC_strt_HPAPathOperation, implementation-data-type=IDT_ICC_strt_HPAPathOperation
      application-data-type=ADT_ADAS_strt_TrafficLightInfo, implementation-data-type=IDT_ADAS_strt_TrafficLightInfo
      application-data-type=ADT_ICC_boolean_ScopeFlag_1, implementation-data-type=IDT_ICC_boolean_ScopeFlag_1
      application-data-type=ADT_Struct_ExtMMResWLnk, implementation-data-type=IDT_Struct_ExtMMResWLnk
      application-data-type=ADT_Struct_TBOXOTARemoteAPPTSet, implementation-data-type=IDT_Struct_TBOXOTARemoteAPPTSet
      application-data-type=ADT_ADAS_enum_HPAVPARepalyRemind, implementation-data-type=IDT_ADAS_enum_HPAVPARepalyRemind
      application-data-type=ADT_ADAS_enum_ELKSts, implementation-data-type=IDT_ADAS_enum_ELKSts
      application-data-type=ADT_EcallModeFed, implementation-data-type=IDT_EcallModeFed
      application-data-type=ADT_ICC_enum_NavSpeedLimitStatus, implementation-data-type=IDT_ICC_enum_NavSpeedLimitStatus
      application-data-type=ADT_ICC_string_Address, implementation-data-type=IDT_ICC_string_Address
      application-data-type=ADT_ADAS_enum_LeaveFastLaneSts, implementation-data-type=IDT_ADAS_enum_LeaveFastLaneSts
      application-data-type=ADT_ADAS_enum_FCWAEBTextInfo, implementation-data-type=IDT_ADAS_enum_FCWAEBTextInfo
      application-data-type=ADT_DVRRequest, implementation-data-type=IDT_DVRRequest
      application-data-type=ADT_ADAS_Posn_PosProbb, implementation-data-type=IDT_ADAS_Posn_PosProbb
      application-data-type=ADT_ADAS_Stub_LastStub, implementation-data-type=IDT_ADAS_Stub_LastStub
      application-data-type=ADT_StrVar_BleSlaverRearVer, implementation-data-type=IDT_StrVar_BleSlaverRearVer
      application-data-type=ADT_ADAS_enum_LKS_warning, implementation-data-type=IDT_ADAS_enum_LKS_warning
      application-data-type=ADT_StrVar_ProductID, implementation-data-type=IDT_StrVar_ProductID
      application-data-type=ADT_ICC_enum_NOPEnableBtnSts, implementation-data-type=IDT_ICC_enum_NOPEnableBtnSts
      application-data-type=ADT_VhrLogStartTime, implementation-data-type=IDT_VhrLogStartTime
      application-data-type=ADT_GnssRawInfo, implementation-data-type=IDT_GnssRawInfo
      application-data-type=ADT_ADAS_enum_MNPSts, implementation-data-type=IDT_ADAS_enum_MNPSts
      application-data-type=ADT_ADAS_enum_ParkingButtonSts, implementation-data-type=IDT_ADAS_enum_ParkingButtonSts
      application-data-type=ADT_Dbl_GndHeadInfo, implementation-data-type=IDT_Dbl_GndHeadInfo
      application-data-type=ADT_StrVar_password, implementation-data-type=IDT_StrVar_password
      application-data-type=ADT_ADAS_val_FSRACruiseSpdOffsetPercentFb, implementation-data-type=IDT_ADAS_val_FSRACruiseSpdOffsetPercentFb
      application-data-type=ADT_ValetParkingPointNum, implementation-data-type=IDT_ValetParkingPointNum
      application-data-type=ADT_ICC_enum_Affect, implementation-data-type=IDT_ICC_enum_Affect
      application-data-type=ADT_ADAS_enum_DynamicObjectType, implementation-data-type=IDT_ADAS_enum_DynamicObjectType
      application-data-type=ADT_DataUint64, implementation-data-type=IDT_DataUint64
      application-data-type=ADT_Struct_LogPrepare, implementation-data-type=IDT_Struct_LogPrepare
      application-data-type=ADT_ICC_enum_RADSEnableBtnSt, implementation-data-type=IDT_ICC_enum_RADSEnableBtnSt
      application-data-type=ADT_ICC_enum_DAIEnableBtnSt, implementation-data-type=IDT_ICC_enum_DAIEnableBtnSt
      application-data-type=ADT_ADAS_enum_VPAPauseInd, implementation-data-type=IDT_ADAS_enum_VPAPauseInd
      application-data-type=ADT_Arr_SatelInfo, implementation-data-type=IDT_Arr_SatelInfo
      application-data-type=ADT_ADAS_MsgType, implementation-data-type=IDT_ADAS_MsgType
      application-data-type=ADT_ADAS_Meta_DrvSide, implementation-data-type=IDT_ADAS_Meta_DrvSide
      application-data-type=ADT_ADAS_enum_ISLISpeedLimitUnit, implementation-data-type=IDT_ADAS_enum_ISLISpeedLimitUnit
      application-data-type=ADT_ICC_enum_SpeedLimitValue, implementation-data-type=IDT_ICC_enum_SpeedLimitValue
      application-data-type=ADT_ADAS_Meta_HwVer, implementation-data-type=IDT_ADAS_Meta_HwVer
      application-data-type=ADT_ADAS_val_TrafficLightNum, implementation-data-type=IDT_ADAS_val_TrafficLightNum
      application-data-type=ADT_Bool_PrevPosnUesdInfo, implementation-data-type=IDT_Bool_PrevPosnUesdInfo
      application-data-type=ADT_ADAS_strt_FusionMapInfo, implementation-data-type=IDT_ADAS_strt_FusionMapInfo
      application-data-type=ADT_ValetParkingStatusReserved, implementation-data-type=IDT_ValetParkingStatusReserved
      application-data-type=ADT_ADAS_uint64_laneID, implementation-data-type=IDT_ADAS_uint64_laneID
      application-data-type=ADT_ADAS_strt_HNOPSupplementInfo, implementation-data-type=IDT_ADAS_strt_HNOPSupplementInfo
      application-data-type=ADT_WeatherInfo_arr_Reserved_1, implementation-data-type=IDT_WeatherInfo_arr_Reserved_1
      application-data-type=ADT_ICC_enum_HODWarnSettingSt, implementation-data-type=IDT_ICC_enum_HODWarnSettingSt
      application-data-type=ADT_IcaNcaL3State, implementation-data-type=IDT_IcaNcaL3State
      application-data-type=ADT_LanePositionInfo_offset_Lateral, implementation-data-type=IDT_LanePositionInfo_offset_Lateral
      application-data-type=ADT_ADAS_ProfShort_Value0, implementation-data-type=IDT_ADAS_ProfShort_Value0
      application-data-type=ADT_PermissionConfigState, implementation-data-type=IDT_PermissionConfigState
      application-data-type=ADT_Speed, implementation-data-type=IDT_Speed
      application-data-type=ADT_ADAS_enumTargetObjID, implementation-data-type=IDT_ADAS_enumTargetObjID
      application-data-type=ADT_Gen_int64_ID, implementation-data-type=IDT_Gen_int64_ID
      application-data-type=ADT_ADAS_val_MNPMemRoutePointsNum, implementation-data-type=IDT_ADAS_val_MNPMemRoutePointsNum
      application-data-type=ADT_ICC_strt_CrossNaviInfo, implementation-data-type=IDT_ICC_strt_CrossNaviInfo
      application-data-type=ADT_ADAS_strt_AebTargetObjInfo, implementation-data-type=IDT_ADAS_strt_AebTargetObjInfo
      application-data-type=ADT_SentryModeDuration, implementation-data-type=IDT_SentryModeDuration
      application-data-type=ADT_ADAS_enum_ParkinDirectionSts, implementation-data-type=IDT_ADAS_enum_ParkinDirectionSts
      application-data-type=ADT_ADAS_strt_TrafficSign, implementation-data-type=IDT_ADAS_strt_TrafficSign
      application-data-type=ADT_ADAS_strt_LSSInfo, implementation-data-type=IDT_ADAS_strt_LSSInfo
      application-data-type=ADT_ADAS_arr_VPAParkingSLot, implementation-data-type=IDT_ADAS_arr_VPAParkingSLot
      application-data-type=ADT_ICC_enum_LDWWarnType, implementation-data-type=IDT_ICC_enum_LDWWarnType
      application-data-type=ADT_LinePoint_arr_Reserved, implementation-data-type=IDT_LinePoint_arr_Reserved
      application-data-type=ADT_GetUUIDCodeResponse, implementation-data-type=IDT_GetUUIDCodeResponse
      application-data-type=ADT_Array_DataType, implementation-data-type=IDT_Array_DataType
      application-data-type=ADT_ADAS_strt_HPAPathDetail_2, implementation-data-type=IDT_ADAS_strt_HPAPathDetail_2
      application-data-type=ADT_ICC_float_SelectZonePos_Y, implementation-data-type=IDT_ICC_float_SelectZonePos_Y
      application-data-type=ADT_CellularMcc, implementation-data-type=IDT_CellularMcc
      application-data-type=ADT_ICC_float_SelectZonePos_X, implementation-data-type=IDT_ICC_float_SelectZonePos_X
      application-data-type=ADT_ADAS_enum_VPAStation, implementation-data-type=IDT_ADAS_enum_VPAStation
      application-data-type=ADT_ICC_int32_MainAction, implementation-data-type=IDT_ICC_int32_MainAction
      application-data-type=ADT_ADAS_enum_MNPNewRouteBtnSt, implementation-data-type=IDT_ADAS_enum_MNPNewRouteBtnSt
      application-data-type=ADT_ADAS_enum_TLAONOFFSts, implementation-data-type=IDT_ADAS_enum_TLAONOFFSts
      application-data-type=ADT_LightState_arr_Reserved, implementation-data-type=IDT_LightState_arr_Reserved
      application-data-type=ADT_TimeInfoYear, implementation-data-type=IDT_TimeInfoYear
      application-data-type=ADT_ICC_val_VoiceControlCruiseSpeed, implementation-data-type=IDT_ICC_val_VoiceControlCruiseSpeed
      application-data-type=ADT_StrVar_SIM_ICCID, implementation-data-type=IDT_StrVar_SIM_ICCID
      application-data-type=ADT_ADAS_uint8_Available, implementation-data-type=IDT_ADAS_uint8_Available
      application-data-type=ADT_ADAS_arr_TrafficLightList, implementation-data-type=IDT_ADAS_arr_TrafficLightList
      application-data-type=ADT_ICC_boolean_InnerRoad, implementation-data-type=IDT_ICC_boolean_InnerRoad
      application-data-type=ADT_Struct_SetCallNumber2, implementation-data-type=IDT_Struct_SetCallNumber2
      application-data-type=ADT_Struct_SetCallNumber1, implementation-data-type=IDT_Struct_SetCallNumber1
      application-data-type=ADT_MNPRoutes_arr_Reserved, implementation-data-type=IDT_MNPRoutes_arr_Reserved
      application-data-type=ADT_ICC_strt_ApaFreeSlotInfo, implementation-data-type=IDT_ICC_strt_ApaFreeSlotInfo
      application-data-type=ADT_Gen_enum_SystemSts, implementation-data-type=IDT_Gen_enum_SystemSts
      application-data-type=ADT_ADAS_enum_TrafficLightsType, implementation-data-type=IDT_ADAS_enum_TrafficLightsType
      application-data-type=ADT_AppSrv_ReturnCode, implementation-data-type=IDT_AppSrv_ReturnCode
      application-data-type=ADT_Enum_ElevnInfo, implementation-data-type=IDT_Enum_ElevnInfo
      application-data-type=ADT_SubCameraExt_arr_Reserved, implementation-data-type=IDT_SubCameraExt_arr_Reserved
      application-data-type=ADT_DataUint32, implementation-data-type=IDT_DataUint32
      application-data-type=ADT_ValetParkingNetworkQuality, implementation-data-type=IDT_ValetParkingNetworkQuality
      application-data-type=ADT_CellularCellNum, implementation-data-type=IDT_CellularCellNum
      application-data-type=ADT_ADAS_arr_RoadMarker, implementation-data-type=IDT_ADAS_arr_RoadMarker
      application-data-type=ADT_TimeStampOffset, implementation-data-type=IDT_TimeStampOffset
      application-data-type=ADT_ADAS_enum_StopLineFlag, implementation-data-type=IDT_ADAS_enum_StopLineFlag
      application-data-type=ADT_GpsStatus, implementation-data-type=IDT_GpsStatus
      application-data-type=ADT_ADAS_enum_SetSpdUnit, implementation-data-type=IDT_ADAS_enum_SetSpdUnit
      application-data-type=ADT_ICC_enum_NavCountryCodeInfo, implementation-data-type=IDT_ICC_enum_NavCountryCodeInfo
      application-data-type=ADT_ADAS_strt_ACCInfo, implementation-data-type=IDT_ADAS_strt_ACCInfo
      application-data-type=ADT_ADAS_strt_VPAPointType, implementation-data-type=IDT_ADAS_strt_VPAPointType
      application-data-type=ADT_Enum_TollStationPathStFb, implementation-data-type=IDT_Enum_TollStationPathStFb
      application-data-type=ADT_ADAS_enum_LKSRightTrackingSt, implementation-data-type=IDT_ADAS_enum_LKSRightTrackingSt
      application-data-type=ADT_SimSwitchCheckResponse, implementation-data-type=IDT_SimSwitchCheckResponse
      application-data-type=ADT_ICC_string_Cause, implementation-data-type=IDT_ICC_string_Cause
      application-data-type=ADT_ADAS_enum_APAPopup, implementation-data-type=IDT_ADAS_enum_APAPopup
      application-data-type=ADT_ValetParkingRealtimeInfo, implementation-data-type=IDT_ValetParkingRealtimeInfo
      application-data-type=ADT_ADAS_strt_ParkingGenaralInfo, implementation-data-type=IDT_ADAS_strt_ParkingGenaralInfo
      application-data-type=ADT_ADAS_strt_DAIInfo, implementation-data-type=IDT_ADAS_strt_DAIInfo
      application-data-type=ADT_ICC_enum_TLAEnableBtnSt, implementation-data-type=IDT_ICC_enum_TLAEnableBtnSt
      application-data-type=ADT_ADAS_strt_TLAInfo, implementation-data-type=IDT_ADAS_strt_TLAInfo
      application-data-type=ADT_Count, implementation-data-type=IDT_Count
      application-data-type=ADT_ADAS_enum_ISLIOverSpeedWarn, implementation-data-type=IDT_ADAS_enum_ISLIOverSpeedWarn
      application-data-type=ADT_EphemerisDataLength, implementation-data-type=IDT_EphemerisDataLength
      application-data-type=ADT_Enum_WorkModel, implementation-data-type=IDT_Enum_WorkModel
      application-data-type=ADT_Str_ProductCode, implementation-data-type=IDT_Str_ProductCode
      application-data-type=ADT_ICC_enum_VPASubModReq, implementation-data-type=IDT_ICC_enum_VPASubModReq
      application-data-type=ADT_ADAS_enum_PicPocType, implementation-data-type=IDT_ADAS_enum_PicPocType
      application-data-type=ADT_ADAS_enum_TolAPAParkingTime, implementation-data-type=IDT_ADAS_enum_TolAPAParkingTime
      application-data-type=ADT_StrVar_MCUVersion, implementation-data-type=IDT_StrVar_MCUVersion
      application-data-type=ADT_UpFlow, implementation-data-type=IDT_UpFlow
      application-data-type=ADT_ICC_uint8_PathId, implementation-data-type=IDT_ICC_uint8_PathId
      application-data-type=ADT_StrVar_SIM_IMSI, implementation-data-type=IDT_StrVar_SIM_IMSI
      application-data-type=ADT_ICC_int16_SpeedLimit, implementation-data-type=IDT_ICC_int16_SpeedLimit
      application-data-type=ADT_ADAS_strt_IntelligentEvasionInfo, implementation-data-type=IDT_ADAS_strt_IntelligentEvasionInfo
      application-data-type=ADT_ADAS_enum_ParkingActiveSubFuncSt, implementation-data-type=IDT_ADAS_enum_ParkingActiveSubFuncSt
      application-data-type=ADT_TimezoneUtcHours, implementation-data-type=IDT_TimezoneUtcHours
      application-data-type=ADT_VhrLogString, implementation-data-type=IDT_VhrLogString
      application-data-type=ADT_ICC_enum_ICAplussetting, implementation-data-type=IDT_ICC_enum_ICAplussetting
      application-data-type=ADT_ICC_string_RoadName, implementation-data-type=IDT_ICC_string_RoadName
      application-data-type=ADT_ADAS_enum_TSRSt, implementation-data-type=IDT_ADAS_enum_TSRSt
      application-data-type=ADT_DataUint16, implementation-data-type=IDT_DataUint16
      application-data-type=ADT_ADAS_strt_ISLIInfo, implementation-data-type=IDT_ADAS_strt_ISLIInfo
      application-data-type=ADT_StrVar_HDMap, implementation-data-type=IDT_StrVar_HDMap
      application-data-type=ADT_port, implementation-data-type=IDT_port
      application-data-type=ADT_TrafficSignIdentify_arr_Reserved, implementation-data-type=IDT_TrafficSignIdentify_arr_Reserved
      application-data-type=ADT_ADAS_enum_AutoResumeNotifier, implementation-data-type=IDT_ADAS_enum_AutoResumeNotifier
      application-data-type=ADT_ADAS_enum_MNPMemRouteReadyFlag, implementation-data-type=IDT_ADAS_enum_MNPMemRouteReadyFlag
      application-data-type=ADT_ICC_int32_DestDirection, implementation-data-type=IDT_ICC_int32_DestDirection
      application-data-type=ADT_Light_arr_Reserved, implementation-data-type=IDT_Light_arr_Reserved
      application-data-type=ADT_ADAS_enum_ParkingDriOperateInd, implementation-data-type=IDT_ADAS_enum_ParkingDriOperateInd
      application-data-type=ADT_ResponseVhrRemoteCall, implementation-data-type=IDT_ResponseVhrRemoteCall
      application-data-type=ADT_ADAS_enum_IntelligentEvasionBtnStFb, implementation-data-type=IDT_ADAS_enum_IntelligentEvasionBtnStFb
      application-data-type=ADT_ADAS_Posn_Rehead, implementation-data-type=IDT_ADAS_Posn_Rehead
      application-data-type=ADT_ICC_int32_SubType, implementation-data-type=IDT_ICC_int32_SubType
      application-data-type=ADT_ADAS_enum_OCCType, implementation-data-type=IDT_ADAS_enum_OCCType
      application-data-type=ADT_ADAS_Stub_FormOfWay, implementation-data-type=IDT_ADAS_Stub_FormOfWay
      application-data-type=ADT_ADAS_val_VPATunnel, implementation-data-type=IDT_ADAS_val_VPATunnel
      application-data-type=ADT_ADAS_val_altitude, implementation-data-type=IDT_ADAS_val_altitude
      application-data-type=ADT_ADAS_val_StandardDeviation, implementation-data-type=IDT_ADAS_val_StandardDeviation
      application-data-type=ADT_ADAS_strt_RoadMarker_2, implementation-data-type=IDT_ADAS_strt_RoadMarker_2
      application-data-type=ADT_ADAS_arr_VPASpeedBump, implementation-data-type=IDT_ADAS_arr_VPASpeedBump
      application-data-type=ADT_Struct_GNSSInfo, implementation-data-type=IDT_Struct_GNSSInfo
      application-data-type=ADT_SentryModeAlarmLevel, implementation-data-type=IDT_SentryModeAlarmLevel
      application-data-type=ADT_ADAS_strt_VPAStaticObjects, implementation-data-type=IDT_ADAS_strt_VPAStaticObjects
      application-data-type=ADT_ADAS_Stub_NumOfLaneDrvDir, implementation-data-type=IDT_ADAS_Stub_NumOfLaneDrvDir
      application-data-type=ADT_ADAS_Meta_ProtVer_Minor, implementation-data-type=IDT_ADAS_Meta_ProtVer_Minor
      application-data-type=ADT_ICC_boolean_isMatch, implementation-data-type=IDT_ICC_boolean_isMatch
      application-data-type=ADT_ADAS_enum_LightType, implementation-data-type=IDT_ADAS_enum_LightType
      application-data-type=ADT_ICC_strt_NaviRoadInfo, implementation-data-type=IDT_ICC_strt_NaviRoadInfo
      application-data-type=ADT_ADAS_Meta_ProtVer_MinorSub, implementation-data-type=IDT_ADAS_Meta_ProtVer_MinorSub
      application-data-type=ADT_DownRate, implementation-data-type=IDT_DownRate
      application-data-type=ADT_ICC_strt_HPAPathOperation_2, implementation-data-type=IDT_ICC_strt_HPAPathOperation_2
      application-data-type=ADT_ICC_strt_NaviCongestionInfo, implementation-data-type=IDT_ICC_strt_NaviCongestionInfo
      application-data-type=ADT_ADAS_enum_MEBSts, implementation-data-type=IDT_ADAS_enum_MEBSts
      application-data-type=ADT_ICC_strt_LaneCategoryType, implementation-data-type=IDT_ICC_strt_LaneCategoryType
      application-data-type=ADT_ICC_arr_TrafficLightCountdown, implementation-data-type=IDT_ICC_arr_TrafficLightCountdown
      application-data-type=ADT_ICC_enum_ExtenLaneAction, implementation-data-type=IDT_ICC_enum_ExtenLaneAction
      application-data-type=ADT_ADAS_arr_LightList, implementation-data-type=IDT_ADAS_arr_LightList
      application-data-type=ADT_TimezoneUtcMinutes, implementation-data-type=IDT_TimezoneUtcMinutes
      application-data-type=ADT_TollGateInfo_arr_Reserved, implementation-data-type=IDT_TollGateInfo_arr_Reserved
      application-data-type=ADT_ICC_string_RouteInfo, implementation-data-type=IDT_ICC_string_RouteInfo
      application-data-type=ADT_CellularCellMapArray, implementation-data-type=IDT_CellularCellMapArray
      application-data-type=ADT_ICC_enum_NaviCountryID, implementation-data-type=IDT_ICC_enum_NaviCountryID
      application-data-type=ADT_WiFiUploadDataStatus, implementation-data-type=IDT_WiFiUploadDataStatus
      application-data-type=ADT_CellularCellMapInfo, implementation-data-type=IDT_CellularCellMapInfo
      application-data-type=ADT_ICC_enum_FSRACruiseSpdOffsetSpd, implementation-data-type=IDT_ICC_enum_FSRACruiseSpdOffsetSpd
      application-data-type=ADT_ADSHMIRequestMessage, implementation-data-type=IDT_ADSHMIRequestMessage
      application-data-type=ADT_Struct_CurrenMonthTalkTime, implementation-data-type=IDT_Struct_CurrenMonthTalkTime
      application-data-type=ADT_ADAS_strt_WheelStopInfo, implementation-data-type=IDT_ADAS_strt_WheelStopInfo
      application-data-type=ADT_ADAS_strt_VPARange, implementation-data-type=IDT_ADAS_strt_VPARange
      application-data-type=ADT_Enum_UnixTimestamp, implementation-data-type=IDT_Enum_UnixTimestamp
      application-data-type=ADT_EphemerisDataByteElement, implementation-data-type=IDT_EphemerisDataByteElement
      application-data-type=ADT_Basic_enum_Valid, implementation-data-type=IDT_Basic_enum_Valid
      application-data-type=ADT_CID, implementation-data-type=IDT_CID
      application-data-type=ADT_ADAS_Posn_PathIdx, implementation-data-type=IDT_ADAS_Posn_PathIdx
      application-data-type=ADT_DmsWarning, implementation-data-type=IDT_DmsWarning
      application-data-type=ADT_ICC_enum_TSREnableBtnSt, implementation-data-type=IDT_ICC_enum_TSREnableBtnSt
      application-data-type=ADT_ICC_uint8_SelectPathId, implementation-data-type=IDT_ICC_uint8_SelectPathId
      application-data-type=ADT_ADAS_enum_SglNOAMileage, implementation-data-type=IDT_ADAS_enum_SglNOAMileage
      application-data-type=ADT_StrVar_fileName, implementation-data-type=IDT_StrVar_fileName
      application-data-type=ADT_EphemerisDataType, implementation-data-type=IDT_EphemerisDataType
      application-data-type=ADT_ICC_enum_Trend, implementation-data-type=IDT_ICC_enum_Trend
      application-data-type=ADT_ADAS_enum_TSISgnForb, implementation-data-type=IDT_ADAS_enum_TSISgnForb
      application-data-type=ADT_ICC_strt_ServiceAreaInfo, implementation-data-type=IDT_ICC_strt_ServiceAreaInfo
      application-data-type=ADT_ICC_arr_FrontLanes, implementation-data-type=IDT_ICC_arr_FrontLanes
      application-data-type=ADT_ICC_enum_AMAPSettingSt, implementation-data-type=IDT_ICC_enum_AMAPSettingSt
      application-data-type=ADT_ADAS_strt_ISLIInfo_2, implementation-data-type=IDT_ADAS_strt_ISLIInfo_2
      application-data-type=ADT_Enum_SimCardRegistraionStatus, implementation-data-type=IDT_Enum_SimCardRegistraionStatus
      application-data-type=ADT_Struct_GeoPos2D, implementation-data-type=IDT_Struct_GeoPos2D
      application-data-type=ADT_ADAS_enum_NRAPreScanSts, implementation-data-type=IDT_ADAS_enum_NRAPreScanSts
      application-data-type=ADT_ICC_int32_CongestionStatus, implementation-data-type=IDT_ICC_int32_CongestionStatus
      application-data-type=ADT_ADAS_enum_SglAutoRoadCrossingsNum, implementation-data-type=IDT_ADAS_enum_SglAutoRoadCrossingsNum
      application-data-type=ADT_ICC_strt_CameraSpeed, implementation-data-type=IDT_ICC_strt_CameraSpeed
      application-data-type=ADT_ICC_enum_CongestionStatus, implementation-data-type=IDT_ICC_enum_CongestionStatus
      application-data-type=ADT_ADAS_strt_SlotWheelStopperInfo, implementation-data-type=IDT_ADAS_strt_SlotWheelStopperInfo
      application-data-type=ADT_Enum_Roaming, implementation-data-type=IDT_Enum_Roaming
      application-data-type=ADT_ServiceAreaInfo_arr_Reserved, implementation-data-type=IDT_ServiceAreaInfo_arr_Reserved
      application-data-type=ADT_ADAS_enum_TSINoParkWarn, implementation-data-type=IDT_ADAS_enum_TSINoParkWarn
      application-data-type=ADT_ADAS_enum_MNPStopMemRouteDrawing, implementation-data-type=IDT_ADAS_enum_MNPStopMemRouteDrawing
      application-data-type=ADT_MultiSimSwitchMode, implementation-data-type=IDT_MultiSimSwitchMode
      application-data-type=ADT_LaneInfo_arr_Reserved, implementation-data-type=IDT_LaneInfo_arr_Reserved
      application-data-type=ADT_ADAS_Meta_MapVerQtr, implementation-data-type=IDT_ADAS_Meta_MapVerQtr
      application-data-type=ADT_ICC_strt_MixForkInfoList, implementation-data-type=IDT_ICC_strt_MixForkInfoList
      application-data-type=ADT_TmcInfo_arr_Reserved, implementation-data-type=IDT_TmcInfo_arr_Reserved
      application-data-type=ADT_ADAS_ProfShort_AccurClass, implementation-data-type=IDT_ADAS_ProfShort_AccurClass
      application-data-type=ADT_OTAUtcSecs, implementation-data-type=IDT_OTAUtcSecs
      application-data-type=ADT_Gen_val_float32, implementation-data-type=IDT_Gen_val_float32
      application-data-type=ADT_ICC_strt_LaneAction, implementation-data-type=IDT_ICC_strt_LaneAction
      application-data-type=ADT_ADAS_enum_ELKRightActiveSt, implementation-data-type=IDT_ADAS_enum_ELKRightActiveSt
      application-data-type=ADT_ADAS_val_SpdLimitAbsOffset, implementation-data-type=IDT_ADAS_val_SpdLimitAbsOffset
      application-data-type=ADT_ADAS_enum_VPAWarningInfo, implementation-data-type=IDT_ADAS_enum_VPAWarningInfo
      application-data-type=ADT_StrVar_VPNIPAddress, implementation-data-type=IDT_StrVar_VPNIPAddress
      application-data-type=ADT_ADAS_Seg_Update, implementation-data-type=IDT_ADAS_Seg_Update
      application-data-type=ADT_HPAOnWayLabel_arr_Reserved, implementation-data-type=IDT_HPAOnWayLabel_arr_Reserved
      application-data-type=ADT_Enum_AomCommand, implementation-data-type=IDT_Enum_AomCommand
      application-data-type=ADT_ICC_enum_NavSpeedLimitUnits, implementation-data-type=IDT_ICC_enum_NavSpeedLimitUnits
      application-data-type=ADT_ADAS_enum_TLASts, implementation-data-type=IDT_ADAS_enum_TLASts
      application-data-type=ADT_ICC_enum_SpeedLimitUnit, implementation-data-type=IDT_ICC_enum_SpeedLimitUnit
      application-data-type=ADT_Struct_BEICALL, implementation-data-type=IDT_Struct_BEICALL
      application-data-type=ADT_ADAS_arr_HPAParkingSlot, implementation-data-type=IDT_ADAS_arr_HPAParkingSlot
      application-data-type=ADT_ADAS_enum_SVSSts, implementation-data-type=IDT_ADAS_enum_SVSSts
      application-data-type=ADT_ICC_strt_EndPoiInfo, implementation-data-type=IDT_ICC_strt_EndPoiInfo
      application-data-type=ADT_CameraStreamStatusMessage, implementation-data-type=IDT_CameraStreamStatusMessage
      application-data-type=ADT_ADAS_arr_VPAEntrance, implementation-data-type=IDT_ADAS_arr_VPAEntrance
      application-data-type=ADT_ICC_int32_LaneAction, implementation-data-type=IDT_ICC_int32_LaneAction
      application-data-type=ADT_LanePositionInfo_length, implementation-data-type=IDT_LanePositionInfo_length
      application-data-type=ADT_ADAS_uint64_TargetObjID, implementation-data-type=IDT_ADAS_uint64_TargetObjID
      application-data-type=ADT_ADAS_strt_FreeSpaceList, implementation-data-type=IDT_ADAS_strt_FreeSpaceList
      application-data-type=ADT_ADAS_enum_RPAset, implementation-data-type=IDT_ADAS_enum_RPAset
      application-data-type=ADT_Str_InterVers, implementation-data-type=IDT_Str_InterVers
      application-data-type=ADT_ICC_enum_DetourAroundObstacleBtnSt, implementation-data-type=IDT_ICC_enum_DetourAroundObstacleBtnSt
      application-data-type=ADT_CameraSpeed_arr_Reserved, implementation-data-type=IDT_CameraSpeed_arr_Reserved
      application-data-type=ADT_WiFiLinkedInternet, implementation-data-type=IDT_WiFiLinkedInternet
      application-data-type=ADT_ADAS_strt_TolNtfADDrivingCardinfo, implementation-data-type=IDT_ADAS_strt_TolNtfADDrivingCardinfo
      application-data-type=ADT_ADAS_Stub_RelProbb, implementation-data-type=IDT_ADAS_Stub_RelProbb
      application-data-type=ADT_ADAS_strt_DrivingTrajectoryPoint, implementation-data-type=IDT_ADAS_strt_DrivingTrajectoryPoint
      application-data-type=ADT_Array_Data, implementation-data-type=IDT_Array_Data
      application-data-type=ADT_ICC_string_Affect, implementation-data-type=IDT_ICC_string_Affect
      application-data-type=ADT_Enum_SKLearnFlag, implementation-data-type=IDT_Enum_SKLearnFlag
      application-data-type=ADT_ADAS_ProfLong_CycCnt, implementation-data-type=IDT_ADAS_ProfLong_CycCnt
      application-data-type=ADT_ADAS_enum_NOPQuitReason, implementation-data-type=IDT_ADAS_enum_NOPQuitReason
      application-data-type=ADT_CellularNetworkDetailInfo, implementation-data-type=IDT_CellularNetworkDetailInfo
      application-data-type=ADT_ICC_enum_RecordUploadBtn, implementation-data-type=IDT_ICC_enum_RecordUploadBtn
      application-data-type=ADT_ADAS_enum_ParkingVoiceRemind, implementation-data-type=IDT_ADAS_enum_ParkingVoiceRemind
      application-data-type=ADT_TripUtcSecs, implementation-data-type=IDT_TripUtcSecs
      application-data-type=ADT_ICC_strt_WeatherInfo, implementation-data-type=IDT_ICC_strt_WeatherInfo
      application-data-type=ADT_StrVar_ScheduleID, implementation-data-type=IDT_StrVar_ScheduleID
      application-data-type=ADT_ICC_int32_ExtenLaneAction, implementation-data-type=IDT_ICC_int32_ExtenLaneAction
      application-data-type=ADT_Arr_TollGateInfoReserved, implementation-data-type=IDT_Arr_TollGateInfoReserved
      application-data-type=ADT_Enum_AziInfo, implementation-data-type=IDT_Enum_AziInfo
      application-data-type=ADT_ADAS_uint8_ScoreMap, implementation-data-type=IDT_ADAS_uint8_ScoreMap
      application-data-type=ADT_ADAS_strt_Light, implementation-data-type=IDT_ADAS_strt_Light
      application-data-type=ADT_StrVar_BleSlaverRightVer, implementation-data-type=IDT_StrVar_BleSlaverRightVer
      application-data-type=ADT_ICC_enum_VoiceControlLaneChange, implementation-data-type=IDT_ICC_enum_VoiceControlLaneChange
      application-data-type=ADT_SatelliteNum, implementation-data-type=IDT_SatelliteNum
      application-data-type=ADT_CellularSinr, implementation-data-type=IDT_CellularSinr
      application-data-type=ADT_TLAInfo_arr_Reserved, implementation-data-type=IDT_TLAInfo_arr_Reserved
      application-data-type=ADT_ADAS_strt_TrafficSignIdentify, implementation-data-type=IDT_ADAS_strt_TrafficSignIdentify
package /Communication/DataTransformation
  data transformation set Transformer_Configuration
    data transformation SOME_IP_Default_Transformation: transformer-chain=SOME_IP_Default_Transformer
    data transformation SOMEIP_E2E_Transformer_PROFILE_04_B: execute-despite-data-unavailability=true, transformer-chain=[SOME_IP_Default_Transformer, E2ETransformer_PROFILE_04_B]
    transformation technology SOME_IP_Default_Transformer: buffer-properties=header-length=64, protocol=SOMEIP, someip-transformation-description{alignment=8, byte-order=big-endian, interface-version=1}, transformer-class=SERIALIZER, version=1.0.0
    transformation technology E2ETransformer_PROFILE_04_B:
      buffer-properties={buffer-computation=compu-rational-coeffs={compu-numerator=[12, 1], compu-denominator=1}, header-length=96, in-place=true}
      has-internal-state=true
      needs-original-data=false
      protocol=E2E
      end-to-end-transformation-description{max-delta-counter=2, max-error-state-init=1, max-error-state-invalid=1, max-error-state-valid=1, min-ok-state-init=1, min-ok-state-invalid=2, min-ok-state-valid=1, offset=64, profile-name=PROFILE_04, upper-header-bits-to-shift=64, window-size-init=2, window-size-invalid=3, window-size-valid=3}
      transformer-class=SAFETY
      version=1.0.0
package /Communication/PDUs
  general purpose pdu SdPDU_Tx_VLAN62: category=SD, length=188
  general purpose pdu SdPDU_UnicastRx_VLAN62: category=SD, length=188
  general purpose pdu SdPDU_MulticastRx_VLAN62: category=SD, length=188
  pdu SIGIPDU_Event_NtfParkingFuncModReq_eHMI_ParkingUI: has-dynamic-length=false, length=9, transmission-mode-true-timing=event-controlled-timing=number-of-repetitions=0
    signal SIG_Event_NtfParkingFuncModReq_eHMI_ParkingUI: start 0, 8 bit, opaque, data-transformations=SOME_IP_Default_Transformation, data-type-policy=TRANSFORMING-I-SIGNAL, someip-transformation-i-signal-props{transformer=SOME_IP_Default_Transformer, message-type=NOTIFICATION}, transfer-property=TRIGGERED, to ADCC
  pdu SIGIPDU_Event_NtfApaRpaFcnOperating_eHMI_ParkingUI: has-dynamic-length=false, length=52, transmission-mode-true-timing=event-controlled-timing=number-of-repetitions=0
    signal SIG_Event_NtfApaRpaFcnOperating_eHMI_ParkingUI: start 0, 352 bit, opaque, data-transformations=SOME_IP_Default_Transformation, data-type-policy=TRANSFORMING-I-SIGNAL, someip-transformation-i-signal-props{transformer=SOME_IP_Default_Transformer, message-type=NOTIFICATION}, transfer-property=TRIGGERED, to ADCC
  pdu SIGIPDU_Event_NtfHpaFcnOperating_eHMI_ParkingUI: has-dynamic-length=false, length=44, transmission-mode-true-timing=event-controlled-timing=number-of-repetitions=0
    signal SIG_Event_NtfHpaFcnOperating_eHMI_ParkingUI: start 0, 288 bit, opaque, data-transformations=SOME_IP_Default_Transformation, data-type-policy=TRANSFORMING-I-SIGNAL, someip-transformation-i-signal-props{transformer=SOME_IP_Default_Transformer, message-type=NOTIFICATION}, transfer-property=TRIGGERED, to ADCC
  pdu SIGIPDU_Event_NtfVpaFcnOperating_eHMI_ParkingUI: has-dynamic-length=false, length=16596, transmission-mode-true-timing=event-controlled-timing=number-of-repetitions=0
    signal SIG_Event_NtfVpaFcnOperating_eHMI_ParkingUI: start 0, 132704 bit, opaque, data-transformations=SOME_IP_Default_Transformation, data-type-policy=TRANSFORMING-I-SIGNAL, someip-transformation-i-signal-props{transformer=SOME_IP_Default_Transformer, message-type=NOTIFICATION}, transfer-property=TRIGGERED, to ADCC
  general purpose i pdu TPSIGIPDU_Event_NtfVpaFcnOperating_eHMI_ParkingUI: category=SOMEIP_SEGMENTED_IPDU, length=1400
  pdu SIGIPDU_Event_NtfMraFcnOperating_eHMI_ParkingUI: has-dynamic-length=false, length=9, transmission-mode-true-timing=event-controlled-timing=number-of-repetitions=0
    signal SIG_Event_NtfMraFcnOperating_eHMI_ParkingUI: start 0, 8 bit, opaque, data-transformations=SOME_IP_Default_Transformation, data-type-policy=TRANSFORMING-I-SIGNAL, someip-transformation-i-signal-props{transformer=SOME_IP_Default_Transformer, message-type=NOTIFICATION}, transfer-property=TRIGGERED, to ADCC
  pdu SIGIPDU_Event_NtfSVSStatus_eHMI_ParkingUI: has-dynamic-length=false, length=9, transmission-mode-true-timing=event-controlled-timing=number-of-repetitions=0
    signal SIG_Event_NtfSVSStatus_eHMI_ParkingUI: start 0, 8 bit, opaque, data-transformations=SOME_IP_Default_Transformation, data-type-policy=TRANSFORMING-I-SIGNAL, someip-transformation-i-signal-props{transformer=SOME_IP_Default_Transformer, message-type=NOTIFICATION}, transfer-property=TRIGGERED, to ADCC
  pdu SIGIPDU_Event_NtfApaRpaFcnOperating_2_eHMI_ParkingUI: has-dynamic-length=false, length=100, transmission-mode-true-timing=event-controlled-timing=number-of-repetitions=0
    signal SIG_Event_NtfApaRpaFcnOperating_2_eHMI_ParkingUI: start 0, 736 bit, opaque, data-transformations=SOME_IP_Default_Transformation, data-type-policy=TRANSFORMING-I-SIGNAL, someip-transformation-i-signal-props{transformer=SOME_IP_Default_Transformer, message-type=NOTIFICATION}, transfer-property=TRIGGERED, to ADCC
  pdu SIGIPDU_Event_NtfHpaFcnOperating_2_eHMI_ParkingUI: has-dynamic-length=false, length=180, transmission-mode-true-timing=event-controlled-timing=number-of-repetitions=0
    signal SIG_Event_NtfHpaFcnOperating_2_eHMI_ParkingUI: start 0, 1376 bit, opaque, data-transformations=SOME_IP_Default_Transformation, data-type-policy=TRANSFORMING-I-SIGNAL, someip-transformation-i-signal-props{transformer=SOME_IP_Default_Transformer, message-type=NOTIFICATION}, transfer-property=TRIGGERED, to ADCC
  pdu SIGIPDU_Event_NtfADASSettingInfo_eHMI_ADASSetting: has-dynamic-length=false, length=43, transmission-mode-true-timing=event-controlled-timing=number-of-repetitions=0
    signal SIG_Event_NtfADASSettingInfo_eHMI_ADASSetting: start 0, 280 bit, opaque, data-transformations=SOME_IP_Default_Transformation, data-type-policy=TRANSFORMING-I-SIGNAL, someip-transformation-i-signal-props{transformer=SOME_IP_Default_Transformer, message-type=NOTIFICATION}, transfer-property=TRIGGERED, to ADCC
  pdu SIGIPDU_Event_NtfADASSettingInfo_2_eHMI_ADASSetting: has-dynamic-length=false, length=148, transmission-mode-true-timing=event-controlled-timing=number-of-repetitions=0
    signal SIG_Event_NtfADASSettingInfo_2_eHMI_ADASSetting: start 0, 1120 bit, opaque, data-transformations=SOME_IP_Default_Transformation, data-type-policy=TRANSFORMING-I-SIGNAL, someip-transformation-i-signal-props{transformer=SOME_IP_Default_Transformer, message-type=NOTIFICATION}, transfer-property=TRIGGERED, to ADCC
  pdu SIGIPDU_Event_NtfADASSettingInfo_3_eHMI_ADASSetting: has-dynamic-length=false, length=936, transmission-mode-true-timing=event-controlled-timing=number-of-repetitions=0
    signal SIG_Event_NtfADASSettingInfo_3_eHMI_ADASSetting: start 0, 7424 bit, opaque, data-transformations=SOME_IP_Default_Transformation, data-type-policy=TRANSFORMING-I-SIGNAL, someip-transformation-i-signal-props{transformer=SOME_IP_Default_Transformer, message-type=NOTIFICATION}, transfer-property=TRIGGERED, to ADCC
  pdu SIGIPDU_Event_NtfADASSettingInfo_eHMI_ADASSetting_1: has-dynamic-length=false, length=43, transmission-mode-true-timing=event-controlled-timing=number-of-repetitions=0
    signal SIG_Event_NtfADASSettingInfo_eHMI_ADASSetting_1: start 0, 280 bit, opaque, data-transformations=SOME_IP_Default_Transformation, data-type-policy=TRANSFORMING-I-SIGNAL, someip-transformation-i-signal-props{transformer=SOME_IP_Default_Transformer, message-type=NOTIFICATION}, transfer-property=TRIGGERED, to FCM
  pdu SIGIPDU_Event_NtfADASSettingInfo_2_eHMI_ADASSetting_1: has-dynamic-length=false, length=148, transmission-mode-true-timing=event-controlled-timing=number-of-repetitions=0
    signal SIG_Event_NtfADASSettingInfo_2_eHMI_ADASSetting_1: start 0, 1120 bit, opaque, data-transformations=SOME_IP_Default_Transformation, data-type-policy=TRANSFORMING-I-SIGNAL, someip-transformation-i-signal-props{transformer=SOME_IP_Default_Transformer, message-type=NOTIFICATION}, transfer-property=TRIGGERED, to FCM
  pdu SIGIPDU_Event_NtfADASSettingInfo_3_eHMI_ADASSetting_1: has-dynamic-length=false, length=936, transmission-mode-true-timing=event-controlled-timing=number-of-repetitions=0
    signal SIG_Event_NtfADASSettingInfo_3_eHMI_ADASSetting_1: start 0, 7424 bit, opaque, data-transformations=SOME_IP_Default_Transformation, data-type-policy=TRANSFORMING-I-SIGNAL, someip-transformation-i-signal-props{transformer=SOME_IP_Default_Transformer, message-type=NOTIFICATION}, transfer-property=TRIGGERED, to FCM
  pdu SIGIPDU_Event_notifyDVRRequest_eHMI_DVRSet: has-dynamic-length=false, length=9, transmission-mode-true-timing=event-controlled-timing=number-of-repetitions=0
    signal SIG_Event_notifyDVRRequest_eHMI_DVRSet: start 0, 8 bit, opaque, data-transformations=SOME_IP_Default_Transformation, data-type-policy=TRANSFORMING-I-SIGNAL, someip-transformation-i-signal-props{transformer=SOME_IP_Default_Transformer, message-type=NOTIFICATION}, transfer-property=TRIGGERED, to FCM
  pdu SIGIPDU_Event_notifyTimeManagement_TBOX_TimeManagement: has-dynamic-length=false, length=26, transmission-mode-true-timing=event-controlled-timing=number-of-repetitions=0
    signal SIG_Event_notifyTimeManagement_TBOX_TimeManagement: start 0, 144 bit, opaque, data-transformations=SOME_IP_Default_Transformation, data-type-policy=TRANSFORMING-I-SIGNAL, someip-transformation-i-signal-props{transformer=SOME_IP_Default_Transformer, message-type=NOTIFICATION}, transfer-property=TRIGGERED, to ICC_8155_Android
  pdu SIGIPDU_Event_notify5GSwtSts_Fb_TBOX_ResSwtSts: has-dynamic-length=false, length=9, transmission-mode-true-timing=event-controlled-timing=number-of-repetitions=0
    signal SIG_Event_notify5GSwtSts_Fb_TBOX_ResSwtSts: start 0, 8 bit, opaque, data-transformations=SOME_IP_Default_Transformation, data-type-policy=TRANSFORMING-I-SIGNAL, someip-transformation-i-signal-props{transformer=SOME_IP_Default_Transformer, message-type=NOTIFICATION}, transfer-property=TRIGGERED, to ICC_8155_Android
  pdu SIGIPDU_Event_notifyV2XSwtSts_Fb_TBOX_ResSwtSts: has-dynamic-length=false, length=9, transmission-mode-true-timing=event-controlled-timing=number-of-repetitions=0
    signal SIG_Event_notifyV2XSwtSts_Fb_TBOX_ResSwtSts: start 0, 8 bit, opaque, data-transformations=SOME_IP_Default_Transformation, data-type-policy=TRANSFORMING-I-SIGNAL, someip-transformation-i-signal-props{transformer=SOME_IP_Default_Transformer, message-type=NOTIFICATION}, transfer-property=TRIGGERED, to ICC_8155_Android
  pdu SIGIPDU_Event_notifyDownLogSwtSts_Fb_TBOX_ResSwtSts: has-dynamic-length=false, length=9, transmission-mode-true-timing=event-controlled-timing=number-of-repetitions=0
    signal SIG_Event_notifyDownLogSwtSts_Fb_TBOX_ResSwtSts: start 0, 8 bit, opaque, data-transformations=SOME_IP_Default_Transformation, data-type-policy=TRANSFORMING-I-SIGNAL, someip-transformation-i-signal-props{transformer=SOME_IP_Default_Transformer, message-type=NOTIFICATION}, transfer-property=TRIGGERED, to ICC_8155_Android
  pdu SIGIPDU_Event_notifyUSBUpdateSwtSts_Fb_TBOX_ResSwtSts: has-dynamic-length=false, length=9, transmission-mode-true-timing=event-controlled-timing=number-of-repetitions=0
    signal SIG_Event_notifyUSBUpdateSwtSts_Fb_TBOX_ResSwtSts: start 0, 8 bit, opaque, data-transformations=SOME_IP_Default_Transformation, data-type-policy=TRANSFORMING-I-SIGNAL, someip-transformation-i-signal-props{transformer=SOME_IP_Default_Transformer, message-type=NOTIFICATION}, transfer-property=TRIGGERED, to ICC_8155_Android
  pdu SIGIPDU_Event_notifyResumeFactorySet_Fb_TBOX_ResSwtSts: has-dynamic-length=false, length=9, transmission-mode-true-timing=event-controlled-timing=number-of-repetitions=0
    signal SIG_Event_notifyResumeFactorySet_Fb_TBOX_ResSwtSts: start 0, 8 bit, opaque, data-transformations=SOME_IP_Default_Transformation, data-type-policy=TRANSFORMING-I-SIGNAL, someip-transformation-i-signal-props{transformer=SOME_IP_Default_Transformer, message-type=NOTIFICATION}, transfer-property=TRIGGERED, to ICC_8155_Android
  pdu SIGIPDU_RR_get5GSwtSts_Fb_call_Cis_ICC_8155_Android_TBOX_ResSwtSts: has-dynamic-length=true, length=8, transmission-mode-true-timing=event-controlled-timing=number-of-repetitions=0
    signal SIG_RR_get5GSwtSts_Fb_call_Cis_ICC_8155_Android_TBOX_ResSwtSts: start 0, 0 bit, opaque, data-transformations=SOME_IP_Default_Transformation, data-type-policy=TRANSFORMING-I-SIGNAL, someip-transformation-i-signal-props{transformer=SOME_IP_Default_Transformer, message-type=REQUEST}, dynamic-length=true, transfer-property=TRIGGERED, to TBOX
  pdu SIGIPDU_RR_get5GSwtSts_Fb_return_Cis_ICC_8155_Android_TBOX_ResSwtSts: has-dynamic-length=false, length=9, transmission-mode-true-timing=event-controlled-timing=number-of-repetitions=0
    signal SIG_RR_get5GSwtSts_Fb_return_Cis_ICC_8155_Android_TBOX_ResSwtSts: start 0, 8 bit, opaque, data-transformations=SOME_IP_Default_Transformation, data-type-policy=TRANSFORMING-I-SIGNAL, someip-transformation-i-signal-props{transformer=SOME_IP_Default_Transformer, message-type=RESPONSE}, transfer-property=TRIGGERED, to ICC_8155_Android
  pdu SIGIPDU_RR_getV2XSwtSts_Fb_call_Cis_ICC_8155_Android_TBOX_ResSwtSts: has-dynamic-length=true, length=8, transmission-mode-true-timing=event-controlled-timing=number-of-repetitions=0
    signal SIG_RR_getV2XSwtSts_Fb_call_Cis_ICC_8155_Android_TBOX_ResSwtSts: start 0, 0 bit, opaque, data-transformations=SOME_IP_Default_Transformation, data-type-policy=TRANSFORMING-I-SIGNAL, someip-transformation-i-signal-props{transformer=SOME_IP_Default_Transformer, message-type=REQUEST}, dynamic-length=true, transfer-property=TRIGGERED, to TBOX
  pdu SIGIPDU_RR_getV2XSwtSts_Fb_return_Cis_ICC_8155_Android_TBOX_ResSwtSts: has-dynamic-length=false, length=9, transmission-mode-true-timing=event-controlled-timing=number-of-repetitions=0
    signal SIG_RR_getV2XSwtSts_Fb_return_Cis_ICC_8155_Android_TBOX_ResSwtSts: start 0, 8 bit, opaque, data-transformations=SOME_IP_Default_Transformation, data-type-policy=TRANSFORMING-I-SIGNAL, someip-transformation-i-signal-props{transformer=SOME_IP_Default_Transformer, message-type=RESPONSE}, transfer-property=TRIGGERED, to ICC_8155_Android
  pdu SIGIPDU_RR_getDownLogSwtSts_Fb_call_Cis_ICC_8155_Android_TBOX_ResSwtSts: has-dynamic-length=true, length=8, transmission-mode-true-timing=event-controlled-timing=number-of-repetitions=0
    signal SIG_RR_getDownLogSwtSts_Fb_call_Cis_ICC_8155_Android_TBOX_ResSwtSts: start 0, 0 bit, opaque, data-transformations=SOME_IP_Default_Transformation, data-type-policy=TRANSFORMING-I-SIGNAL, someip-transformation-i-signal-props{transformer=SOME_IP_Default_Transformer, message-type=REQUEST}, dynamic-length=true, transfer-property=TRIGGERED, to TBOX
  pdu SIGIPDU_RR_getDownLogSwtSts_Fb_return_Cis_ICC_8155_Android_TBOX_ResSwtSts: has-dynamic-length=false, length=9, transmission-mode-true-timing=event-controlled-timing=number-of-repetitions=0
    signal SIG_RR_getDownLogSwtSts_Fb_return_Cis_ICC_8155_Android_TBOX_ResSwtSts: start 0, 8 bit, opaque, data-transformations=SOME_IP_Default_Transformation, data-type-policy=TRANSFORMING-I-SIGNAL, someip-transformation-i-signal-props{transformer=SOME_IP_Default_Transformer, message-type=RESPONSE}, transfer-property=TRIGGERED, to ICC_8155_Android
  pdu SIGIPDU_RR_getUSBUpdateSwtSts_Fb_call_Cis_ICC_8155_Android_TBOX_ResSwtSts: has-dynamic-length=true, length=8, transmission-mode-true-timing=event-controlled-timing=number-of-repetitions=0
    signal SIG_RR_getUSBUpdateSwtSts_Fb_call_Cis_ICC_8155_Android_TBOX_ResSwtSts: start 0, 0 bit, opaque, data-transformations=SOME_IP_Default_Transformation, data-type-policy=TRANSFORMING-I-SIGNAL, someip-transformation-i-signal-props{transformer=SOME_IP_Default_Transformer, message-type=REQUEST}, dynamic-length=true, transfer-property=TRIGGERED, to TBOX
  pdu SIGIPDU_RR_getUSBUpdateSwtSts_Fb_return_Cis_ICC_8155_Android_TBOX_ResSwtSts: has-dynamic-length=false, length=9, transmission-mode-true-timing=event-controlled-timing=number-of-repetitions=0
    signal SIG_RR_getUSBUpdateSwtSts_Fb_return_Cis_ICC_8155_Android_TBOX_ResSwtSts: start 0, 8 bit, opaque, data-transformations=SOME_IP_Default_Transformation, data-type-policy=TRANSFORMING-I-SIGNAL, someip-transformation-i-signal-props{transformer=SOME_IP_Default_Transformer, message-type=RESPONSE}, transfer-property=TRIGGERED, to ICC_8155_Android
  pdu SIGIPDU_RR_getResumeFactorySet_Fb_call_Cis_ICC_8155_Android_TBOX_ResSwtSts: has-dynamic-length=true, length=8, transmission-mode-true-timing=event-controlled-timing=number-of-repetitions=0
    signal SIG_RR_getResumeFactorySet_Fb_call_Cis_ICC_8155_Android_TBOX_ResSwtSts: start 0, 0 bit, opaque, data-transformations=SOME_IP_Default_Transformation, data-type-policy=TRANSFORMING-I-SIGNAL, someip-transformation-i-signal-props{transformer=SOME_IP_Default_Transformer, message-type=REQUEST}, dynamic-length=true, transfer-property=TRIGGERED, to TBOX
  pdu SIGIPDU_RR_getResumeFactorySet_Fb_return_Cis_ICC_8155_Android_TBOX_ResSwtSts: has-dynamic-length=false, length=9, transmission-mode-true-timing=event-controlled-timing=number-of-repetitions=0
    signal SIG_RR_getResumeFactorySet_Fb_return_Cis_ICC_8155_Android_TBOX_ResSwtSts: start 0, 8 bit, opaque, data-transformations=SOME_IP_Default_Transformation, data-type-policy=TRANSFORMING-I-SIGNAL, someip-transformation-i-signal-props{transformer=SOME_IP_Default_Transformer, message-type=RESPONSE}, transfer-property=TRIGGERED, to ICC_8155_Android
  pdu SIGIPDU_RR_set5GSwtSts_call_Cis_ICC_8155_Android_TBOX_ResSwtSts: has-dynamic-length=false, length=9, transmission-mode-true-timing=event-controlled-timing=number-of-repetitions=0
    signal SIG_RR_set5GSwtSts_call_Cis_ICC_8155_Android_TBOX_ResSwtSts: start 0, 8 bit, opaque, data-transformations=SOME_IP_Default_Transformation, data-type-policy=TRANSFORMING-I-SIGNAL, someip-transformation-i-signal-props{transformer=SOME_IP_Default_Transformer, message-type=REQUEST}, transfer-property=TRIGGERED, to TBOX
  pdu SIGIPDU_RR_set5GSwtSts_return_Cis_ICC_8155_Android_TBOX_ResSwtSts: has-dynamic-length=false, length=9, transmission-mode-true-timing=event-controlled-timing=number-of-repetitions=0
    signal SIG_RR_set5GSwtSts_return_Cis_ICC_8155_Android_TBOX_ResSwtSts: start 0, 8 bit, opaque, data-transformations=SOME_IP_Default_Transformation, data-type-policy=TRANSFORMING-I-SIGNAL, someip-transformation-i-signal-props{transformer=SOME_IP_Default_Transformer, message-type=RESPONSE}, transfer-property=TRIGGERED, to ICC_8155_Android
  pdu SIGIPDU_RR_setV2XSwtSts_call_Cis_ICC_8155_Android_TBOX_ResSwtSts: has-dynamic-length=false, length=9, transmission-mode-true-timing=event-controlled-timing=number-of-repetitions=0
    signal SIG_RR_setV2XSwtSts_call_Cis_ICC_8155_Android_TBOX_ResSwtSts: start 0, 8 bit, opaque, data-transformations=SOME_IP_Default_Transformation, data-type-policy=TRANSFORMING-I-SIGNAL, someip-transformation-i-signal-props{transformer=SOME_IP_Default_Transformer, message-type=REQUEST}, transfer-property=TRIGGERED, to TBOX
  pdu SIGIPDU_RR_setV2XSwtSts_return_Cis_ICC_8155_Android_TBOX_ResSwtSts: has-dynamic-length=false, length=9, transmission-mode-true-timing=event-controlled-timing=number-of-repetitions=0
    signal SIG_RR_setV2XSwtSts_return_Cis_ICC_8155_Android_TBOX_ResSwtSts: start 0, 8 bit, opaque, data-transformations=SOME_IP_Default_Transformation, data-type-policy=TRANSFORMING-I-SIGNAL, someip-transformation-i-signal-props{transformer=SOME_IP_Default_Transformer, message-type=RESPONSE}, transfer-property=TRIGGERED, to ICC_8155_Android
  pdu SIGIPDU_RR_setDownLogSwtSts_call_Cis_ICC_8155_Android_TBOX_ResSwtSts: has-dynamic-length=false, length=9, transmission-mode-true-timing=event-controlled-timing=number-of-repetitions=0
    signal SIG_RR_setDownLogSwtSts_call_Cis_ICC_8155_Android_TBOX_ResSwtSts: start 0, 8 bit, opaque, data-transformations=SOME_IP_Default_Transformation, data-type-policy=TRANSFORMING-I-SIGNAL, someip-transformation-i-signal-props{transformer=SOME_IP_Default_Transformer, message-type=REQUEST}, transfer-property=TRIGGERED, to TBOX
  pdu SIGIPDU_RR_setDownLogSwtSts_return_Cis_ICC_8155_Android_TBOX_ResSwtSts: has-dynamic-length=false, length=9, transmission-mode-true-timing=event-controlled-timing=number-of-repetitions=0
    signal SIG_RR_setDownLogSwtSts_return_Cis_ICC_8155_Android_TBOX_ResSwtSts: start 0, 8 bit, opaque, data-transformations=SOME_IP_Default_Transformation, data-type-policy=TRANSFORMING-I-SIGNAL, someip-transformation-i-signal-props{transformer=SOME_IP_Default_Transformer, message-type=RESPONSE}, transfer-property=TRIGGERED, to ICC_8155_Android
  pdu SIGIPDU_RR_setUSBUpdateSwtSts_call_Cis_ICC_8155_Android_TBOX_ResSwtSts: has-dynamic-length=false, length=9, transmission-mode-true-timing=event-controlled-timing=number-of-repetitions=0
    signal SIG_RR_setUSBUpdateSwtSts_call_Cis_ICC_8155_Android_TBOX_ResSwtSts: start 0, 8 bit, opaque, data-transformations=SOME_IP_Default_Transformation, data-type-policy=TRANSFORMING-I-SIGNAL, someip-transformation-i-signal-props{transformer=SOME_IP_Default_Transformer, message-type=REQUEST}, transfer-property=TRIGGERED, to TBOX
  pdu SIGIPDU_RR_setUSBUpdateSwtSts_return_Cis_ICC_8155_Android_TBOX_ResSwtSts: has-dynamic-length=false, length=9, transmission-mode-true-timing=event-controlled-timing=number-of-repetitions=0
    signal SIG_RR_setUSBUpdateSwtSts_return_Cis_ICC_8155_Android_TBOX_ResSwtSts: start 0, 8 bit, opaque, data-transformations=SOME_IP_Default_Transformation, data-type-policy=TRANSFORMING-I-SIGNAL, someip-transformation-i-signal-props{transformer=SOME_IP_Default_Transformer, message-type=RESPONSE}, transfer-property=TRIGGERED, to ICC_8155_Android
  pdu SIGIPDU_RR_setResumeFactorySet_call_Cis_ICC_8155_Android_TBOX_ResSwtSts: has-dynamic-length=false, length=9, transmission-mode-true-timing=event-controlled-timing=number-of-repetitions=0
    signal SIG_RR_setResumeFactorySet_call_Cis_ICC_8155_Android_TBOX_ResSwtSts: start 0, 8 bit, opaque, data-transformations=SOME_IP_Default_Transformation, data-type-policy=TRANSFORMING-I-SIGNAL, someip-transformation-i-signal-props{transformer=SOME_IP_Default_Transformer, message-type=REQUEST}, transfer-property=TRIGGERED, to TBOX
  pdu SIGIPDU_RR_setResumeFactorySet_return_Cis_ICC_8155_Android_TBOX_ResSwtSts: has-dynamic-length=false, length=9, transmission-mode-true-timing=event-controlled-timing=number-of-repetitions=0
    signal SIG_RR_setResumeFactorySet_return_Cis_ICC_8155_Android_TBOX_ResSwtSts: start 0, 8 bit, opaque, data-transformations=SOME_IP_Default_Transformation, data-type-policy=TRANSFORMING-I-SIGNAL, someip-transformation-i-signal-props{transformer=SOME_IP_Default_Transformer, message-type=RESPONSE}, transfer-property=TRIGGERED, to ICC_8155_Android
  pdu SIGIPDU_Event_Event_NetworkStatus_TBOX_SystemInfo: has-dynamic-length=false, length=88, transmission-mode-true-timing=event-controlled-timing=number-of-repetitions=0
    signal SIG_Event_Event_NetworkStatus_TBOX_SystemInfo: start 0, 640 bit, opaque, data-transformations=SOME_IP_Default_Transformation, data-type-policy=TRANSFORMING-I-SIGNAL, someip-transformation-i-signal-props{transformer=SOME_IP_Default_Transformer, message-type=NOTIFICATION}, transfer-property=TRIGGERED, to ADCC
  pdu SIGIPDU_Event_Event_VehicleDiagStatus_TBOX_SystemInfo: has-dynamic-length=false, length=11, transmission-mode-true-timing=event-controlled-timing=number-of-repetitions=0
    signal SIG_Event_Event_VehicleDiagStatus_TBOX_SystemInfo: start 0, 24 bit, opaque, data-transformations=SOME_IP_Default_Transformation, data-type-policy=TRANSFORMING-I-SIGNAL, someip-transformation-i-signal-props{transformer=SOME_IP_Default_Transformer, message-type=NOTIFICATION}, transfer-property=TRIGGERED, to ADCC
  pdu SIGIPDU_RR_RR_TBoxVersionInfo_call_Cis_ADCC_TBOX_SystemInfo: has-dynamic-length=true, length=8, transmission-mode-true-timing=event-controlled-timing=number-of-repetitions=0
    signal SIG_RR_RR_TBoxVersionInfo_call_Cis_ADCC_TBOX_SystemInfo: start 0, 0 bit, opaque, data-transformations=SOME_IP_Default_Transformation, data-type-policy=TRANSFORMING-I-SIGNAL, someip-transformation-i-signal-props{transformer=SOME_IP_Default_Transformer, message-type=REQUEST}, dynamic-length=true, transfer-property=TRIGGERED, to TBOX
  pdu SIGIPDU_RR_RR_TBoxVersionInfo_return_Cis_ADCC_TBOX_SystemInfo: has-dynamic-length=false, length=188, transmission-mode-true-timing=event-controlled-timing=number-of-repetitions=0
    signal SIG_RR_RR_TBoxVersionInfo_return_Cis_ADCC_TBOX_SystemInfo: start 0, 1440 bit, opaque, data-transformations=SOME_IP_Default_Transformation, data-type-policy=TRANSFORMING-I-SIGNAL, someip-transformation-i-signal-props{transformer=SOME_IP_Default_Transformer, message-type=RESPONSE}, transfer-property=TRIGGERED, to ADCC
  pdu SIGIPDU_RR_RR_BleModuleInfo_call_Cis_ADCC_TBOX_SystemInfo: has-dynamic-length=true, length=8, transmission-mode-true-timing=event-controlled-timing=number-of-repetitions=0
    signal SIG_RR_RR_BleModuleInfo_call_Cis_ADCC_TBOX_SystemInfo: start 0, 0 bit, opaque, data-transformations=SOME_IP_Default_Transformation, data-type-policy=TRANSFORMING-I-SIGNAL, someip-transformation-i-signal-props{transformer=SOME_IP_Default_Transformer, message-type=REQUEST}, dynamic-length=true, transfer-property=TRIGGERED, to TBOX
  pdu SIGIPDU_RR_RR_BleModuleInfo_return_Cis_ADCC_TBOX_SystemInfo: has-dynamic-length=false, length=236, transmission-mode-true-timing=event-controlled-timing=number-of-repetitions=0
    signal SIG_RR_RR_BleModuleInfo_return_Cis_ADCC_TBOX_SystemInfo: start 0, 1824 bit, opaque, data-transformations=SOME_IP_Default_Transformation, data-type-policy=TRANSFORMING-I-SIGNAL, someip-transformation-i-signal-props{transformer=SOME_IP_Default_Transformer, message-type=RESPONSE}, transfer-property=TRIGGERED, to ADCC
  pdu SIGIPDU_RR_RR_VIN_call_Cis_ADCC_TBOX_SystemInfo: has-dynamic-length=true, length=8, transmission-mode-true-timing=event-controlled-timing=number-of-repetitions=0
    signal SIG_RR_RR_VIN_call_Cis_ADCC_TBOX_SystemInfo: start 0, 0 bit, opaque, data-transformations=SOME_IP_Default_Transformation, data-type-policy=TRANSFORMING-I-SIGNAL, someip-transformation-i-signal-props{transformer=SOME_IP_Default_Transformer, message-type=REQUEST}, dynamic-length=true, transfer-property=TRIGGERED, to TBOX
  pdu SIGIPDU_RR_RR_VIN_return_Cis_ADCC_TBOX_SystemInfo: has-dynamic-length=true, length=32, transmission-mode-true-timing=event-controlled-timing=number-of-repetitions=0
    signal SIG_RR_RR_VIN_return_Cis_ADCC_TBOX_SystemInfo: start 0, 192 bit, opaque, data-transformations=SOME_IP_Default_Transformation, data-type-policy=TRANSFORMING-I-SIGNAL, someip-transformation-i-signal-props{transformer=SOME_IP_Default_Transformer, message-type=RESPONSE}, dynamic-length=true, transfer-property=TRIGGERED, to ADCC
  pdu SIGIPDU_RR_RR_SIMCardinfo_call_Cis_ADCC_TBOX_SystemInfo: has-dynamic-length=true, length=8, transmission-mode-true-timing=event-controlled-timing=number-of-repetitions=0
    signal SIG_RR_RR_SIMCardinfo_call_Cis_ADCC_TBOX_SystemInfo: start 0, 0 bit, opaque, data-transformations=SOME_IP_Default_Transformation, data-type-policy=TRANSFORMING-I-SIGNAL, someip-transformation-i-signal-props{transformer=SOME_IP_Default_Transformer, message-type=REQUEST}, dynamic-length=true, transfer-property=TRIGGERED, to TBOX
  pdu SIGIPDU_RR_RR_SIMCardinfo_return_Cis_ADCC_TBOX_SystemInfo: has-dynamic-length=false, length=76, transmission-mode-true-timing=event-controlled-timing=number-of-repetitions=0
    signal SIG_RR_RR_SIMCardinfo_return_Cis_ADCC_TBOX_SystemInfo: start 0, 544 bit, opaque, data-transformations=SOME_IP_Default_Transformation, data-type-policy=TRANSFORMING-I-SIGNAL, someip-transformation-i-signal-props{transformer=SOME_IP_Default_Transformer, message-type=RESPONSE}, transfer-property=TRIGGERED, to ADCC
  pdu SIGIPDU_RR_RR_IMEIInfo_call_Cis_ADCC_TBOX_SystemInfo: has-dynamic-length=true, length=8, transmission-mode-true-timing=event-controlled-timing=number-of-repetitions=0
    signal SIG_RR_RR_IMEIInfo_call_Cis_ADCC_TBOX_SystemInfo: start 0, 0 bit, opaque, data-transformations=SOME_IP_Default_Transformation, data-type-policy=TRANSFORMING-I-SIGNAL, someip-transformation-i-signal-props{transformer=SOME_IP_Default_Transformer, message-type=REQUEST}, dynamic-length=true, transfer-property=TRIGGERED, to TBOX
  pdu SIGIPDU_RR_RR_IMEIInfo_return_Cis_ADCC_TBOX_SystemInfo: has-dynamic-length=true, length=28, transmission-mode-true-timing=event-controlled-timing=number-of-repetitions=0
    signal SIG_RR_RR_IMEIInfo_return_Cis_ADCC_TBOX_SystemInfo: start 0, 160 bit, opaque, data-transformations=SOME_IP_Default_Transformation, data-type-policy=TRANSFORMING-I-SIGNAL, someip-transformation-i-signal-props{transformer=SOME_IP_Default_Transformer, message-type=RESPONSE}, dynamic-length=true, transfer-property=TRIGGERED, to ADCC
  pdu SIGIPDU_RR_RR_CallNumberList_call_Cis_ADCC_TBOX_SystemInfo: has-dynamic-length=true, length=8, transmission-mode-true-timing=event-controlled-timing=number-of-repetitions=0
    signal SIG_RR_RR_CallNumberList_call_Cis_ADCC_TBOX_SystemInfo: start 0, 0 bit, opaque, data-transformations=SOME_IP_Default_Transformation, data-type-policy=TRANSFORMING-I-SIGNAL, someip-transformation-i-signal-props{transformer=SOME_IP_Default_Transformer, message-type=REQUEST}, dynamic-length=true, transfer-property=TRIGGERED, to TBOX
  pdu SIGIPDU_RR_RR_CallNumberList_return_Cis_ADCC_TBOX_SystemInfo: has-dynamic-length=true, length=84, transmission-mode-true-timing=event-controlled-timing=number-of-repetitions=0
    signal SIG_RR_RR_CallNumberList_return_Cis_ADCC_TBOX_SystemInfo: start 0, 608 bit, opaque, data-transformations=SOME_IP_Default_Transformation, data-type-policy=TRANSFORMING-I-SIGNAL, someip-transformation-i-signal-props{transformer=SOME_IP_Default_Transformer, message-type=RESPONSE}, dynamic-length=true, transfer-property=TRIGGERED, to ADCC
  pdu SIGIPDU_RR_RR_WorkModel_call_Cis_ADCC_TBOX_SystemInfo: has-dynamic-length=true, length=8, transmission-mode-true-timing=event-controlled-timing=number-of-repetitions=0
    signal SIG_RR_RR_WorkModel_call_Cis_ADCC_TBOX_SystemInfo: start 0, 0 bit, opaque, data-transformations=SOME_IP_Default_Transformation, data-type-policy=TRANSFORMING-I-SIGNAL, someip-transformation-i-signal-props{transformer=SOME_IP_Default_Transformer, message-type=REQUEST}, dynamic-length=true, transfer-property=TRIGGERED, to TBOX
  pdu SIGIPDU_RR_RR_WorkModel_return_Cis_ADCC_TBOX_SystemInfo: has-dynamic-length=false, length=9, transmission-mode-true-timing=event-controlled-timing=number-of-repetitions=0
    signal SIG_RR_RR_WorkModel_return_Cis_ADCC_TBOX_SystemInfo: start 0, 8 bit, opaque, data-transformations=SOME_IP_Default_Transformation, data-type-policy=TRANSFORMING-I-SIGNAL, someip-transformation-i-signal-props{transformer=SOME_IP_Default_Transformer, message-type=RESPONSE}, transfer-property=TRIGGERED, to ADCC
  pdu SIGIPDU_RR_RR_CertificateIssuedMark_call_Cis_ADCC_TBOX_SystemInfo: has-dynamic-length=true, length=8, transmission-mode-true-timing=event-controlled-timing=number-of-repetitions=0
    signal SIG_RR_RR_CertificateIssuedMark_call_Cis_ADCC_TBOX_SystemInfo: start 0, 0 bit, opaque, data-transformations=SOME_IP_Default_Transformation, data-type-policy=TRANSFORMING-I-SIGNAL, someip-transformation-i-signal-props{transformer=SOME_IP_Default_Transformer, message-type=REQUEST}, dynamic-length=true, transfer-property=TRIGGERED, to TBOX
  pdu SIGIPDU_RR_RR_CertificateIssuedMark_return_Cis_ADCC_TBOX_SystemInfo: has-dynamic-length=false, length=11, transmission-mode-true-timing=event-controlled-timing=number-of-repetitions=0
    signal SIG_RR_RR_CertificateIssuedMark_return_Cis_ADCC_TBOX_SystemInfo: start 0, 24 bit, opaque, data-transformations=SOME_IP_Default_Transformation, data-type-policy=TRANSFORMING-I-SIGNAL, someip-transformation-i-signal-props{transformer=SOME_IP_Default_Transformer, message-type=RESPONSE}, transfer-property=TRIGGERED, to ADCC
  pdu SIGIPDU_RR_RR_SetCallNumber_call_Cis_ADCC_TBOX_SystemInfo: has-dynamic-length=false, length=32, transmission-mode-true-timing=event-controlled-timing=number-of-repetitions=0
    signal SIG_RR_RR_SetCallNumber_call_Cis_ADCC_TBOX_SystemInfo: start 0, 192 bit, opaque, data-transformations=SOME_IP_Default_Transformation, data-type-policy=TRANSFORMING-I-SIGNAL, someip-transformation-i-signal-props{transformer=SOME_IP_Default_Transformer, message-type=REQUEST}, transfer-property=TRIGGERED, to TBOX
  pdu SIGIPDU_RR_RR_SetCallNumber_return_Cis_ADCC_TBOX_SystemInfo: has-dynamic-length=false, length=32, transmission-mode-true-timing=event-controlled-timing=number-of-repetitions=0
    signal SIG_RR_RR_SetCallNumber_return_Cis_ADCC_TBOX_SystemInfo: start 0, 192 bit, opaque, data-transformations=SOME_IP_Default_Transformation, data-type-policy=TRANSFORMING-I-SIGNAL, someip-transformation-i-signal-props{transformer=SOME_IP_Default_Transformer, message-type=RESPONSE}, transfer-property=TRIGGERED, to ADCC
  pdu SIGIPDU_RR_RR_Cellinfo_call_Cis_ADCC_TBOX_SystemInfo: has-dynamic-length=true, length=8, transmission-mode-true-timing=event-controlled-timing=number-of-repetitions=0
    signal SIG_RR_RR_Cellinfo_call_Cis_ADCC_TBOX_SystemInfo: start 0, 0 bit, opaque, data-transformations=SOME_IP_Default_Transformation, data-type-policy=TRANSFORMING-I-SIGNAL, someip-transformation-i-signal-props{transformer=SOME_IP_Default_Transformer, message-type=REQUEST}, dynamic-length=true, transfer-property=TRIGGERED, to TBOX
  pdu SIGIPDU_RR_RR_Cellinfo_return_Cis_ADCC_TBOX_SystemInfo: has-dynamic-length=false, length=36, transmission-mode-true-timing=event-controlled-timing=number-of-repetitions=0
    signal SIG_RR_RR_Cellinfo_return_Cis_ADCC_TBOX_SystemInfo: start 0, 224 bit, opaque, data-transformations=SOME_IP_Default_Transformation, data-type-policy=TRANSFORMING-I-SIGNAL, someip-transformation-i-signal-props{transformer=SOME_IP_Default_Transformer, message-type=RESPONSE}, transfer-property=TRIGGERED, to ADCC
  pdu SIGIPDU_RR_RR_VehicleDiag_call_Cis_ADCC_TBOX_SystemInfo: has-dynamic-length=true, length=8, transmission-mode-true-timing=event-controlled-timing=number-of-repetitions=0
    signal SIG_RR_RR_VehicleDiag_call_Cis_ADCC_TBOX_SystemInfo: start 0, 0 bit, opaque, data-transformations=SOME_IP_Default_Transformation, data-type-policy=TRANSFORMING-I-SIGNAL, someip-transformation-i-signal-props{transformer=SOME_IP_Default_Transformer, message-type=REQUEST}, dynamic-length=true, transfer-property=TRIGGERED, to TBOX
  pdu SIGIPDU_RR_RR_VehicleDiag_return_Cis_ADCC_TBOX_SystemInfo: has-dynamic-length=false, length=9, transmission-mode-true-timing=event-controlled-timing=number-of-repetitions=0
    signal SIG_RR_RR_VehicleDiag_return_Cis_ADCC_TBOX_SystemInfo: start 0, 8 bit, opaque, data-transformations=SOME_IP_Default_Transformation, data-type-policy=TRANSFORMING-I-SIGNAL, someip-transformation-i-signal-props{transformer=SOME_IP_Default_Transformer, message-type=RESPONSE}, transfer-property=TRIGGERED, to ADCC
  pdu SIGIPDU_RR_RR_CurrenMonthTalkTime_call_Cis_ADCC_TBOX_SystemInfo: has-dynamic-length=true, length=8, transmission-mode-true-timing=event-controlled-timing=number-of-repetitions=0
    signal SIG_RR_RR_CurrenMonthTalkTime_call_Cis_ADCC_TBOX_SystemInfo: start 0, 0 bit, opaque, data-transformations=SOME_IP_Default_Transformation, data-type-policy=TRANSFORMING-I-SIGNAL, someip-transformation-i-signal-props{transformer=SOME_IP_Default_Transformer, message-type=REQUEST}, dynamic-length=true, transfer-property=TRIGGERED, to TBOX
  pdu SIGIPDU_RR_RR_CurrenMonthTalkTime_return_Cis_ADCC_TBOX_SystemInfo: has-dynamic-length=false, length=20, transmission-mode-true-timing=event-controlled-timing=number-of-repetitions=0
    signal SIG_RR_RR_CurrenMonthTalkTime_return_Cis_ADCC_TBOX_SystemInfo: start 0, 96 bit, opaque, data-transformations=SOME_IP_Default_Transformation, data-type-policy=TRANSFORMING-I-SIGNAL, someip-transformation-i-signal-props{transformer=SOME_IP_Default_Transformer, message-type=RESPONSE}, transfer-property=TRIGGERED, to ADCC
  pdu SIGIPDU_RR_RR_TSPConnectionState_call_Cis_ADCC_TBOX_SystemInfo: has-dynamic-length=true, length=8, transmission-mode-true-timing=event-controlled-timing=number-of-repetitions=0
    signal SIG_RR_RR_TSPConnectionState_call_Cis_ADCC_TBOX_SystemInfo: start 0, 0 bit, opaque, data-transformations=SOME_IP_Default_Transformation, data-type-policy=TRANSFORMING-I-SIGNAL, someip-transformation-i-signal-props{transformer=SOME_IP_Default_Transformer, message-type=REQUEST}, dynamic-length=true, transfer-property=TRIGGERED, to TBOX
  pdu SIGIPDU_RR_RR_TSPConnectionState_return_Cis_ADCC_TBOX_SystemInfo: has-dynamic-length=false, length=9, transmission-mode-true-timing=event-controlled-timing=number-of-repetitions=0
    signal SIG_RR_RR_TSPConnectionState_return_Cis_ADCC_TBOX_SystemInfo: start 0, 8 bit, opaque, data-transformations=SOME_IP_Default_Transformation, data-type-policy=TRANSFORMING-I-SIGNAL, someip-transformation-i-signal-props{transformer=SOME_IP_Default_Transformer, message-type=RESPONSE}, transfer-property=TRIGGERED, to ADCC
  pdu SIGIPDU_RR_RR_MicState_call_Cis_ADCC_TBOX_SystemInfo: has-dynamic-length=true, length=8, transmission-mode-true-timing=event-controlled-timing=number-of-repetitions=0
    signal SIG_RR_RR_MicState_call_Cis_ADCC_TBOX_SystemInfo: start 0, 0 bit, opaque, data-transformations=SOME_IP_Default_Transformation, data-type-policy=TRANSFORMING-I-SIGNAL, someip-transformation-i-signal-props{transformer=SOME_IP_Default_Transformer, message-type=REQUEST}, dynamic-length=true, transfer-property=TRIGGERED, to TBOX
  pdu SIGIPDU_RR_RR_MicState_return_Cis_ADCC_TBOX_SystemInfo: has-dynamic-length=false, length=9, transmission-mode-true-timing=event-controlled-timing=number-of-repetitions=0
    signal SIG_RR_RR_MicState_return_Cis_ADCC_TBOX_SystemInfo: start 0, 8 bit, opaque, data-transformations=SOME_IP_Default_Transformation, data-type-policy=TRANSFORMING-I-SIGNAL, someip-transformation-i-signal-props{transformer=SOME_IP_Default_Transformer, message-type=RESPONSE}, transfer-property=TRIGGERED, to ADCC
  pdu SIGIPDU_RR_RR_ECUVersion_call_Cis_ADCC_TBOX_SystemInfo: has-dynamic-length=true, length=8, transmission-mode-true-timing=event-controlled-timing=number-of-repetitions=0
    signal SIG_RR_RR_ECUVersion_call_Cis_ADCC_TBOX_SystemInfo: start 0, 0 bit, opaque, data-transformations=SOME_IP_Default_Transformation, data-type-policy=TRANSFORMING-I-SIGNAL, someip-transformation-i-signal-props{transformer=SOME_IP_Default_Transformer, message-type=REQUEST}, dynamic-length=true, transfer-property=TRIGGERED, to TBOX
  pdu SIGIPDU_RR_RR_ECUVersion_return_Cis_ADCC_TBOX_SystemInfo: has-dynamic-length=false, length=80, transmission-mode-true-timing=event-controlled-timing=number-of-repetitions=0
    signal SIG_RR_RR_ECUVersion_return_Cis_ADCC_TBOX_SystemInfo: start 0, 576 bit, opaque, data-transformations=SOME_IP_Default_Transformation, data-type-policy=TRANSFORMING-I-SIGNAL, someip-transformation-i-signal-props{transformer=SOME_IP_Default_Transformer, message-type=RESPONSE}, transfer-property=TRIGGERED, to ADCC
  pdu SIGIPDU_RR_RR_CanConfig_call_Cis_ADCC_TBOX_SystemInfo: has-dynamic-length=true, length=8, transmission-mode-true-timing=event-controlled-timing=number-of-repetitions=0
    signal SIG_RR_RR_CanConfig_call_Cis_ADCC_TBOX_SystemInfo: start 0, 0 bit, opaque, data-transformations=SOME_IP_Default_Transformation, data-type-policy=TRANSFORMING-I-SIGNAL, someip-transformation-i-signal-props{transformer=SOME_IP_Default_Transformer, message-type=REQUEST}, dynamic-length=true, transfer-property=TRIGGERED, to TBOX
  pdu SIGIPDU_RR_RR_CanConfig_return_Cis_ADCC_TBOX_SystemInfo: has-dynamic-length=true, length=268, transmission-mode-true-timing=event-controlled-timing=number-of-repetitions=0
    signal SIG_RR_RR_CanConfig_return_Cis_ADCC_TBOX_SystemInfo: start 0, 2080 bit, opaque, data-transformations=SOME_IP_Default_Transformation, data-type-policy=TRANSFORMING-I-SIGNAL, someip-transformation-i-signal-props{transformer=SOME_IP_Default_Transformer, message-type=RESPONSE}, dynamic-length=true, transfer-property=TRIGGERED, to ADCC
  pdu SIGIPDU_RR_RR_KL15State_call_Cis_ADCC_TBOX_SystemInfo: has-dynamic-length=true, length=8, transmission-mode-true-timing=event-controlled-timing=number-of-repetitions=0
    signal SIG_RR_RR_KL15State_call_Cis_ADCC_TBOX_SystemInfo: start 0, 0 bit, opaque, data-transformations=SOME_IP_Default_Transformation, data-type-policy=TRANSFORMING-I-SIGNAL, someip-transformation-i-signal-props{transformer=SOME_IP_Default_Transformer, message-type=REQUEST}, dynamic-length=true, transfer-property=TRIGGERED, to TBOX
  pdu SIGIPDU_RR_RR_KL15State_return_Cis_ADCC_TBOX_SystemInfo: has-dynamic-length=false, length=9, transmission-mode-true-timing=event-controlled-timing=number-of-repetitions=0
    signal SIG_RR_RR_KL15State_return_Cis_ADCC_TBOX_SystemInfo: start 0, 8 bit, opaque, data-transformations=SOME_IP_Default_Transformation, data-type-policy=TRANSFORMING-I-SIGNAL, someip-transformation-i-signal-props{transformer=SOME_IP_Default_Transformer, message-type=RESPONSE}, transfer-property=TRIGGERED, to ADCC
  pdu SIGIPDU_RR_RR_SPKState_call_Cis_ADCC_TBOX_SystemInfo: has-dynamic-length=true, length=8, transmission-mode-true-timing=event-controlled-timing=number-of-repetitions=0
    signal SIG_RR_RR_SPKState_call_Cis_ADCC_TBOX_SystemInfo: start 0, 0 bit, opaque, data-transformations=SOME_IP_Default_Transformation, data-type-policy=TRANSFORMING-I-SIGNAL, someip-transformation-i-signal-props{transformer=SOME_IP_Default_Transformer, message-type=REQUEST}, dynamic-length=true, transfer-property=TRIGGERED, to TBOX
  pdu SIGIPDU_RR_RR_SPKState_return_Cis_ADCC_TBOX_SystemInfo: has-dynamic-length=false, length=9, transmission-mode-true-timing=event-controlled-timing=number-of-repetitions=0
    signal SIG_RR_RR_SPKState_return_Cis_ADCC_TBOX_SystemInfo: start 0, 8 bit, opaque, data-transformations=SOME_IP_Default_Transformation, data-type-policy=TRANSFORMING-I-SIGNAL, someip-transformation-i-signal-props{transformer=SOME_IP_Default_Transformer, message-type=RESPONSE}, transfer-property=TRIGGERED, to ADCC
  pdu SIGIPDU_RR_RR_AntState_call_Cis_ADCC_TBOX_SystemInfo: has-dynamic-length=true, length=8, transmission-mode-true-timing=event-controlled-timing=number-of-repetitions=0
    signal SIG_RR_RR_AntState_call_Cis_ADCC_TBOX_SystemInfo: start 0, 0 bit, opaque, data-transformations=SOME_IP_Default_Transformation, data-type-policy=TRANSFORMING-I-SIGNAL, someip-transformation-i-signal-props{transformer=SOME_IP_Default_Transformer, message-type=REQUEST}, dynamic-length=true, transfer-property=TRIGGERED, to TBOX
  pdu SIGIPDU_RR_RR_AntState_return_Cis_ADCC_TBOX_SystemInfo: has-dynamic-length=false, length=9, transmission-mode-true-timing=event-controlled-timing=number-of-repetitions=0
    signal SIG_RR_RR_AntState_return_Cis_ADCC_TBOX_SystemInfo: start 0, 8 bit, opaque, data-transformations=SOME_IP_Default_Transformation, data-type-policy=TRANSFORMING-I-SIGNAL, someip-transformation-i-signal-props{transformer=SOME_IP_Default_Transformer, message-type=RESPONSE}, transfer-property=TRIGGERED, to ADCC
  pdu SIGIPDU_Event_Event_NetworkStatus_TBOX_SystemInfo_1: has-dynamic-length=false, length=88, transmission-mode-true-timing=event-controlled-timing=number-of-repetitions=0
    signal SIG_Event_Event_NetworkStatus_TBOX_SystemInfo_1: start 0, 640 bit, opaque, data-transformations=SOME_IP_Default_Transformation, data-type-policy=TRANSFORMING-I-SIGNAL, someip-transformation-i-signal-props{transformer=SOME_IP_Default_Transformer, message-type=NOTIFICATION}, transfer-property=TRIGGERED, to LCM
  pdu SIGIPDU_Event_Event_VehicleDiagStatus_TBOX_SystemInfo_1: has-dynamic-length=false, length=11, transmission-mode-true-timing=event-controlled-timing=number-of-repetitions=0
    signal SIG_Event_Event_VehicleDiagStatus_TBOX_SystemInfo_1: start 0, 24 bit, opaque, data-transformations=SOME_IP_Default_Transformation, data-type-policy=TRANSFORMING-I-SIGNAL, someip-transformation-i-signal-props{transformer=SOME_IP_Default_Transformer, message-type=NOTIFICATION}, transfer-property=TRIGGERED, to LCM
  pdu SIGIPDU_RR_RR_TBoxVersionInfo_call_Cis_LCM_TBOX_SystemInfo: has-dynamic-length=true, length=8, transmission-mode-true-timing=event-controlled-timing=number-of-repetitions=0
    signal SIG_RR_RR_TBoxVersionInfo_call_Cis_LCM_TBOX_SystemInfo: start 0, 0 bit, opaque, data-transformations=SOME_IP_Default_Transformation, data-type-policy=TRANSFORMING-I-SIGNAL, someip-transformation-i-signal-props{transformer=SOME_IP_Default_Transformer, message-type=REQUEST}, dynamic-length=true, transfer-property=TRIGGERED, to TBOX
  pdu SIGIPDU_RR_RR_TBoxVersionInfo_return_Cis_LCM_TBOX_SystemInfo: has-dynamic-length=false, length=188, transmission-mode-true-timing=event-controlled-timing=number-of-repetitions=0
    signal SIG_RR_RR_TBoxVersionInfo_return_Cis_LCM_TBOX_SystemInfo: start 0, 1440 bit, opaque, data-transformations=SOME_IP_Default_Transformation, data-type-policy=TRANSFORMING-I-SIGNAL, someip-transformation-i-signal-props{transformer=SOME_IP_Default_Transformer, message-type=RESPONSE}, transfer-property=TRIGGERED, to LCM
