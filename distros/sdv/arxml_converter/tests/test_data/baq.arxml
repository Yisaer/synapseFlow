[part 11 of 11: packages /DataTypes/ImplementationDataTypes to /VOS_Platform/SwBaseTypes]
AUTOSAR XML (schema 00048)
package /DataTypes/ImplementationDataTypes  (continued)
  1376 x impl type:  (continued)
    IDT_ADAS_strt_StaticObject: category=STRUCTURE
      9 x element, all with category=TYPE_REFERENCE:
        DTE_objectId: implementation-data-type=IDT_Gen_val_ID  # 目标id
        DTE_objectType: implementation-data-type=IDT_ADAS_enum_StaticObjectType  # 目标类型
        DTE_objectPoseX: implementation-data-type=IDT_Gen_val_Coordinate_X  # 目标位置X坐标
        DTE_objectPoseY: implementation-data-type=IDT_Gen_val_Coordinate_Y  # 目标位置Y坐标
        DTE_objectYaw: implementation-data-type=IDT_Gen_val_Yaw  # 目标位姿
        DTE_objectLength: implementation-data-type=IDT_Gen_val_Length  # 目标长度
        DTE_objecWidth: implementation-data-type=IDT_Gen_val_Width  # 目标宽度
        DTE_timestampnSec: implementation-data-type=IDT_ADAS_val_timestampnSec  # 时间戳-纳秒
        DTE_laneID: implementation-data-type=IDT_ADAS_val_laneID  # 目标所属车道ID
    IDT_ADAS_Seg_PartOfCalcRoute: category=VALUE, base-type=uint8
    IDT_ICC_strt_LaneInfo: category=STRUCTURE
      13 x element, all with category=TYPE_REFERENCE:
        DTE_BackLanes: implementation-data-type=IDT_ICC_arr_BackLanes  # 背景车道 (巡航、导航都有效)
        DTE_FrontLanes: implementation-data-type=IDT_ICC_arr_FrontLanes  # 前景车道 (仅导航有效)
        DTE_OptimalLane: implementation-data-type=IDT_ICC_arr_OptimalLane  # 建议车道（仅在线导航有效）
        DTE_BackExtenLanes: implementation-data-type=IDT_ICC_arr_BackExtenLanes  # 背景扩展车道信息（巡航、导航都有效）
        DTE_FrontExtenLanes: implementation-data-type=IDT_ICC_arr_FrontExtenLanes  # 前景扩展车道信息（无效字段）
        DTE_ExtensionLanes: implementation-data-type=IDT_ICC_arr_ExtensionLanes  # 扩展车道信息（仅在线导航有效）
        DTE_FrontLaneTypes: implementation-data-type=IDT_ICC_arr_FrontLaneTypes  # 前景分时车道类型（仅在线导航有效）
        DTE_BackLaneTypes: implementation-data-type=IDT_ICC_arr_BackLaneTypes  # 背景分时车道类型（仅在线导航有效）
        DTE_LanePoint: implementation-data-type=IDT_ICC_strt_Coord2DDouble  # 车道坐标点（仅巡航场景有效）
        DTE_LaneSegmentIdx: implementation-data-type=IDT_ICC_int32_Index  # 所在导航段索引（只有导航有效）
        DTE_LaneLinkIdx: implementation-data-type=IDT_ICC_int32_Index  # 所在link索引（只有导航有效）
        DTE_Lanetimestamp: implementation-data-type=IDT_ICC_uint64_Time  # 导航软件获取到车道信息的时间
        DTE_LaneInfoReserved: implementation-data-type=IDT_LaneInfo_arr_Reserved  # 预留
    IDT_ICC_boolean_Unobstructed: category=VALUE, base-type=sint32  # 是否通畅
    IDT_ADAS_string_VPAParkingLotAddress: category=STRUCTURE, dynamic-array-size-profile=VSA_LINEAR
      element sizeIndicator: implementation-data-type=specialIDT_DynamicLengthField_uint32
      element IDT_ADAS_string_VPAParkingLotAddress: category=ARRAY
        element IDT_ADAS_string_VPAParkingLotAddress: array-size=100, array-size-handling=ALL-INDICES-SAME-ARRAY-SIZE, array-size-semantics=VARIABLE-SIZE, implementation-data-type=specialIDT_StringRef
    IDT_Gen_val_ID: category=VALUE, base-type=uint8
    IDT_ICC_enum_VoiceRemindSettingMode: category=VALUE, base-type=uint8  # 语音播报模式
    IDT_ICC_enum_SetHPAPathType: category=VALUE, base-type=uint8
    IDT_SimMode: category=VALUE, base-type=uint32  # 切换到指定模式
    IDT_ADAS_enum_ESSSts: category=VALUE, base-type=uint8
    IDT_SentryModePlanTime: category=STRUCTURE
      8 x element, all with category=TYPE_REFERENCE:
        DTE_sentryModePlanTime_flag: implementation-data-type=IDT_SentryModePlanTime_flag  # 哨兵模式预约开启开关
        DTE_sentryModePlanStartTime_date: implementation-data-type=IDT_SentryModePlanStartTime_date  # 哨兵模式预约开启时间（年月日）
        DTE_sentryModePlanStartTime_hour: implementation-data-type=IDT_SentryModePlanStartTime_hour  # 哨兵模式预约开启时间（时）
        DTE_sentryModePlanStartTime_minute: implementation-data-type=IDT_SentryModePlanStartTime_minute  # 哨兵模式预约开启时间（分）
        DTE_sentryModePlanEndTime_flag: implementation-data-type=IDT_SentryModePlanEndTime_flag  # 哨兵模式预约结束时间标识
        DTE_sentryModePlanEndTime_date: implementation-data-type=IDT_SentryModePlanEndTime_date  # 哨兵模式预约结束时间（年月日）
        DTE_sentryModePlanEndTime_hour: implementation-data-type=IDT_SentryModePlanEndTime_hour  # 哨兵模式预约结束时间（时）
        DTE_sentryModePlanEndTime_minute: implementation-data-type=IDT_SentryModePlanEndTime_minute  # 哨兵模式预约结束时间（分）
    IDT_ICC_string_SetPathName: category=STRUCTURE, dynamic-array-size-profile=VSA_LINEAR
      element sizeIndicator: implementation-data-type=specialIDT_DynamicLengthField_uint32
      element IDT_ICC_string_SetPathName: category=ARRAY
        element IDT_ICC_string_SetPathName: array-size=20, array-size-handling=ALL-INDICES-SAME-ARRAY-SIZE, array-size-semantics=VARIABLE-SIZE, implementation-data-type=specialIDT_StringRef
    IDT_ICC_enum_MNPDelRouteIDBtnSt: category=VALUE, base-type=uint8  # 删除的记忆路线ID
    IDT_ICC_enum_ApaModeReq: category=VALUE, base-type=uint8
    IDT_ADSHMISettingMessage: category=STRUCTURE, dynamic-array-size-profile=VSA_LINEAR  # HMI Server(ADS)到设置项的通知事件
      element sizeIndicator: implementation-data-type=specialIDT_DynamicLengthField_uint32
      element IDT_ADSHMISettingMessage: category=ARRAY
        element IDT_ADSHMISettingMessage: array-size=1048576, array-size-handling=ALL-INDICES-SAME-ARRAY-SIZE, array-size-semantics=VARIABLE-SIZE, implementation-data-type=IDT_ADSHMIBasicElement
    IDT_ADAS_strt_HPAOnWayLabel: category=STRUCTURE
      5 x element, all with category=TYPE_REFERENCE:
        DTE_HPAOnWayLabelID: implementation-data-type=IDT_Gen_val_ID  # 记忆泊车路径标签ID
        DTE_HPAOnWayLabelType: implementation-data-type=IDT_ADAS_enum_HPAPathLabeType  # 记忆泊车路径标签类型
        DTE_HPAOnWayLabelPoint: implementation-data-type=IDT_ADAS_strt_HPAVPAPathInfo  # 记忆泊车路径标签坐标
        DTE_HPAOnWayLabelPointNum: implementation-data-type=IDT_Gen_val_unit8  # 记忆泊车路径标签数量
        DTE_HPAOnWayLabelReserved: implementation-data-type=IDT_HPAOnWayLabel_arr_Reserved  # 预留
    IDT_Reserved_int32_Type: category=VALUE, base-type=sint32
    IDT_LCM_IMU_Gyro_Y: category=VALUE, base-type=float32
    IDT_ICC_int32_Penalty: category=VALUE, base-type=sint32  # 电子眼的详细违章类型
    IDT_LCM_IMU_Gyro_Z: category=VALUE, base-type=float32
    IDT_StrVar_HardwareVersion: category=STRUCTURE, dynamic-array-size-profile=VSA_LINEAR  # 硬件版本号
      element sizeIndicator: implementation-data-type=specialIDT_DynamicLengthField_uint32
      element IDT_StrVar_HardwareVersion: category=ARRAY
        element IDT_StrVar_HardwareVersion: array-size=10, array-size-handling=ALL-INDICES-SAME-ARRAY-SIZE, array-size-semantics=VARIABLE-SIZE, implementation-data-type=specialIDT_StringRef
    IDT_LCM_IMU_Gyro_X: category=VALUE, base-type=float32
    IDT_ADAS_arr_VPASelfBuildMap: category=STRUCTURE, dynamic-array-size-profile=VSA_LINEAR
      element sizeIndicator: implementation-data-type=specialIDT_DynamicLengthField_uint32
      element IDT_ADAS_arr_VPASelfBuildMap: category=ARRAY
        element IDT_ADAS_arr_VPASelfBuildMap: array-size=50, array-size-handling=ALL-INDICES-SAME-ARRAY-SIZE, array-size-semantics=VARIABLE-SIZE, implementation-data-type=IDT_ADAS_strt_VPASelfBuildMap
    IDT_ICC_arr_MixForkInfoList: category=STRUCTURE, dynamic-array-size-profile=VSA_LINEAR  # 混淆路口
      element sizeIndicator: implementation-data-type=specialIDT_DynamicLengthField_uint32
      element IDT_ICC_arr_MixForkInfoList: category=ARRAY
        element IDT_ICC_arr_MixForkInfoList: array-size=6, array-size-handling=ALL-INDICES-SAME-ARRAY-SIZE, array-size-semantics=VARIABLE-SIZE, implementation-data-type=IDT_ICC_strt_MixForkInfoList
    IDT_ADAS_enum_HODWarnSettingStFb: category=VALUE, base-type=uint8  # 脱手模式
    IDT_NotAvoid_arr_Reserved: category=ARRAY
      element Reserved_int32_Type: array-size=20, array-size-semantics=FIXED-SIZE, implementation-data-type=IDT_Reserved_int32_Type
    IDT_ICC_enum_MRAOperationId: category=VALUE, base-type=uint8
    IDT_ADAS_enum_Percent: category=VALUE, base-type=uint8
    IDT_ADAS_val_SetSpd: category=VALUE, base-type=uint8
    IDT_WiFiDownloadDataStatus: category=VALUE, base-type=sint32
    IDT_ADAS_enum_LineColor: category=VALUE, base-type=uint8
    IDT_ADAS_enum_TolAccessRemitramp: category=VALUE, base-type=uint64  # 汇入汇出匝道
    IDT_TrafficLight_arr_Reserved: category=ARRAY
      element Reserved_int32_Type: array-size=20, array-size-semantics=FIXED-SIZE, implementation-data-type=IDT_Reserved_int32_Type
    IDT_StrVar_BleSlaverLeftMac: category=STRUCTURE, dynamic-array-size-profile=VSA_LINEAR  # 蓝牙左从模块 MAC 地址
      element sizeIndicator: implementation-data-type=specialIDT_DynamicLengthField_uint32
      element IDT_StrVar_BleSlaverLeftMac: category=ARRAY
        element IDT_StrVar_BleSlaverLeftMac: array-size=24, array-size-handling=ALL-INDICES-SAME-ARRAY-SIZE, array-size-semantics=VARIABLE-SIZE, implementation-data-type=specialIDT_StringRef
    IDT_ADAS_strt_MNPMemRoutePointsInfo: category=STRUCTURE  # 路线轨迹点信息
      element DTE_MNPMemRoutePointsNum: implementation-data-type=IDT_ADAS_val_MNPMemRoutePointsNum  # 路线轨迹点数量
      element DTE_MNPMemRoutePoints: implementation-data-type=IDT_ADAS_arr_MNPMemRoutePosition  # 路线轨迹点数组
    IDT_ADAS_enum_DrivingSoundWarn: category=VALUE, base-type=uint8  # chiem音报警
    IDT_Str_ProductID: category=STRUCTURE, dynamic-array-size-profile=VSA_LINEAR  # ADAS产品唯一ID（产品序列号/唯一码） ADAS Product Unique ID (Product Serial Number/Unique Code)
      element sizeIndicator: implementation-data-type=specialIDT_DynamicLengthField_uint32
      element IDT_Str_ProductID: category=ARRAY
        element IDT_Str_ProductID: array-size=40, array-size-handling=ALL-INDICES-SAME-ARRAY-SIZE, array-size-semantics=VARIABLE-SIZE, implementation-data-type=specialIDT_StringRef
    IDT_ADAS_enum_iLOASts: category=VALUE, base-type=uint8
    IDT_ADAS_Seg_NumOfLaneOppDir: category=VALUE, base-type=uint8
    IDT_ICC_strt_TrafficLightInfo: category=STRUCTURE
      8 x element, all with category=TYPE_REFERENCE:
        DTE_TrafficLightWaitNum: implementation-data-type=IDT_Gen_val_int64  # 等红绿灯轮数
        DTE_TrafficLightDir: implementation-data-type=IDT_ICC_int32_LightDir  # 红绿指示方向
        DTE_TrafficLightStates: implementation-data-type=IDT_ICC_strt_LightState  # 灯态
        DTE_TrafficLightDesc: implementation-data-type=IDT_ICC_string_LightDesc  # 灯态列表
        DTE_TrafficLightShowType: implementation-data-type=IDT_ICC_int32_ShowType  # 显示形态标识
        DTE_TrafficLightPhase: implementation-data-type=IDT_ICC_int32_LightPhase  # 左转和直行是否同相位
        DTE_StandardType: implementation-data-type=IDT_ICC_int32_StandardType  # 灯规格类型
        DTE_TrafficLightReserved: implementation-data-type=IDT_TrafficLight_arr_Reserved  # 预留
    IDT_ADAS_enum_LSSTextInfo: category=VALUE, base-type=uint8  # LSS文言提示信息
    IDT_NaviRoadInfo_arr_Reserved: category=ARRAY
      element Reserved_int32_Type: array-size=20, array-size-semantics=FIXED-SIZE, implementation-data-type=IDT_Reserved_int32_Type
    IDT_ADAS_arr_VPARange: category=STRUCTURE, dynamic-array-size-profile=VSA_LINEAR  # VPA地图范围列表
      element sizeIndicator: implementation-data-type=specialIDT_DynamicLengthField_uint32
      element IDT_ADAS_arr_VPARange: category=ARRAY
        element IDT_ADAS_arr_VPARange: array-size=100, array-size-handling=ALL-INDICES-SAME-ARRAY-SIZE, array-size-semantics=VARIABLE-SIZE, implementation-data-type=IDT_ADAS_strt_VPARange
    IDT_ValetParkingPoinNetArray: category=STRUCTURE, dynamic-array-size-profile=VSA_LINEAR  # 代客泊车各点小区信息数组
      element sizeIndicator: implementation-data-type=specialIDT_DynamicLengthField_uint32
      element IDT_ValetParkingPoinNetArray: category=ARRAY
        element IDT_ValetParkingPoinNetArray: array-size=1024, array-size-handling=ALL-INDICES-SAME-ARRAY-SIZE, array-size-semantics=VARIABLE-SIZE, implementation-data-type=IDT_RoadPointCellStruct
    IDT_ICC_string_SoundInfo: category=STRUCTURE, dynamic-array-size-profile=VSA_LINEAR  # TTS 播报
      element sizeIndicator: implementation-data-type=specialIDT_DynamicLengthField_uint32
      element IDT_ICC_string_SoundInfo: category=ARRAY
        element IDT_ICC_string_SoundInfo: array-size=1000, array-size-handling=ALL-INDICES-SAME-ARRAY-SIZE, array-size-semantics=VARIABLE-SIZE, implementation-data-type=specialIDT_StringRef
    IDT_TBOX_ReturnCode: category=VALUE, base-type=uint8  # TBOX返回值
    IDT_Struct_NOA_SDMapPosInfo: category=STRUCTURE  # 标准地图信息
      11 x element, all with category=TYPE_REFERENCE:
        DTE_Posn_MsgType: implementation-data-type=IDT_ADAS_MsgType  # 标识该消息类型为PositionMessage
        DTE_Posn_CycCnt: implementation-data-type=IDT_ADAS_Posn_CycCnt  # PositionMessage的循环计数器:重构器Reconstructor可以使用这个值来检测丢失的消息
        DTE_Posn_PathIdx: implementation-data-type=IDT_ADAS_Posn_PathIdx  # 当前Path的索引号:如果这个值与前一个索引为0的POSITION消息中的值有变化，车辆已经离开了当前path； 0-7的标记有特殊含义
        DTE_Posn_Offset: implementation-data-type=IDT_ADAS_Posn_Offset  # 车辆距路径起点位置
        DTE_Posn_Idx: implementation-data-type=IDT_ADAS_Posn_Idx  # 如果Av2HP支持Positioning备选，则为Position候选的索引号。 候选0总是最可能的位置候选，候选1位第二可能，以此类推。 如果AVHP不支持Positioning备选，则常为0。
        DTE_Posn_Age: implementation-data-type=IDT_ADAS_Posn_Age  # 从消息被发出，到车辆位置已被positioning子系统算出时，两者之间的时间差:
        DTE_Posn_Spd: implementation-data-type=IDT_ADAS_Posn_Spd  # 车辆沿Path行驶的预计速度
        DTE_Posn_Rehead: implementation-data-type=IDT_ADAS_Posn_Rehead  # 相对于path的车头朝向
        DTE_Posn_PosProbb: implementation-data-type=IDT_ADAS_Posn_PosProbb  # 这个值由ADASISv2 Horizon生成器的Positioning模块算出，不同的Av2HPs将使用不同的算法来计算这个值取值0代表未知unknown；取值31代表N/A
        DTE_Posn_PosConfdc: implementation-data-type=IDT_ADAS_Posn_PosConfdc  # Position置信度
        DTE_Posn_CurLane: implementation-data-type=IDT_ADAS_Posn_CurLane  # 当前车道
    IDT_ValetParkingStatus: category=STRUCTURE  # 代客泊车状态信息
      element DTE_valetParkingActiveStatus: implementation-data-type=IDT_ValetParkingActiveStatus  # 代客泊车运行激活状态
      element DTE_reserved: implementation-data-type=IDT_ValetParkingStatusReserved  # 预留字段
    IDT_ADAS_enum_DriverHandsoffWarning: category=VALUE, base-type=uint8  # 脱手报警
    IDT_ICC_strt_CongestionExtend: category=STRUCTURE  # 拥堵扩展信息
      7 x element, all with category=TYPE_REFERENCE:
        DTE_CongestionTrend: implementation-data-type=IDT_ICC_string_Trend  # 趋势
        DTE_CongestionAffect: implementation-data-type=IDT_ICC_string_Affect  # 影响
        DTE_CongestionCause: implementation-data-type=IDT_ICC_string_Cause  # 原因
        DTE_CongestionEventId: implementation-data-type=IDT_ICC_string_EventId  # 拥堵事件 Id
        DTE_HeavyTraffic: implementation-data-type=IDT_ICC_int64_HeavyTraffic  # 是否为严重拥堵。拥堵长度大于800米且通行时间大于4分钟，透出1。否则为0。
        DTE_CongestionId: implementation-data-type=IDT_ICC_string_CongestionId  # 拥堵段 id
        DTE_CongestionExtendReserved: implementation-data-type=IDT_CongestionExtend_arr_Reserved  # 预留
    IDT_ADAS_enum_IsSlotHasWheelStopper: category=VALUE, base-type=uint8  # 车位是否有轮挡
    IDT_ApaRpaFcn_arr_Reserved: category=ARRAY  # 预留
      element Reserved_uint8_Type: array-size=50, array-size-semantics=FIXED-SIZE, implementation-data-type=IDT_Reserved_uint8_Type
    IDT_Progress: category=VALUE, base-type=uint8  # TBOX升级进度
    IDT_ADAS_enum_ALCSoundWarn: category=VALUE, base-type=uint8
    IDT_ADAS_Stub_CmplxInsct: category=VALUE, base-type=uint8
    IDT_ICC_int32_StandardType: category=VALUE, base-type=sint32  # 灯规格类型
    IDT_ADAS_enum_TolAPANum: category=VALUE, base-type=uint64  # APA次数
    IDT_ICC_enum_IHCEnableBtnSt: category=VALUE, base-type=uint8  # IHC功能使能开关
    IDT_ADAS_enum_AMAPSts: category=VALUE, base-type=uint8
    IDT_IncomingTotalTime: category=VALUE, base-type=uint32  # 拨入电话时长总计
    IDT_Enum_MatchingMode: category=VALUE, base-type=uint8  # 车线匹配状态
    IDT_INI_ReturnCode: category=VALUE, base-type=uint16  # 操作返回值
    IDT_ADAS_enum_FCTBWarnActSt: category=VALUE, base-type=uint8  # FCTB报警执行状态
    IDT_ICC_int32_TmcInfoStatus: category=VALUE, base-type=sint32
    IDT_ADAS_enum_ICATextInfo: category=VALUE, base-type=uint8
    IDT_ADAS_strt_RoadMarker: category=STRUCTURE
      8 x element, all with category=TYPE_REFERENCE:
        DTE_RoadMarkerType: implementation-data-type=IDT_ADAS_enum_RoadMarkerType  # 路面标记类型
        DTE_RoadMarkerID: implementation-data-type=IDT_Gen_val_ID  # 路面标记ID
        DTE_RoadMarkerTrackingSts: implementation-data-type=IDT_ADAS_enum_RoadMarkerTrackingSts  # 路面标记跟踪状态
        DTE_RoadMarkerPose1X: implementation-data-type=IDT_Gen_val_Coordinate_X  # 路面标记点1X坐标
        DTE_RoadMarkerPose1Y: implementation-data-type=IDT_Gen_val_Coordinate_Y  # 路面标记点1Y坐标
        DTE_RoadMarkerPose2X: implementation-data-type=IDT_Gen_val_Coordinate_X  # 路面标记点2X坐标
        DTE_RoadMarkerPose2Y: implementation-data-type=IDT_Gen_val_Coordinate_Y  # 路面标记点2Y坐标
        DTE_RoadMarkerWidth: implementation-data-type=IDT_Gen_val_Width  # 路面标记(人行道）宽度
    IDT_ADAS_enum_HandsOnReq: category=VALUE, base-type=uint8  # 请求驾驶员握住方向盘提示
    IDT_NaviStatus_arr_Reserved: category=ARRAY
      element Reserved_int32_Type: array-size=20, array-size-semantics=FIXED-SIZE, implementation-data-type=IDT_Reserved_int32_Type
    IDT_Enum_CallOperation: category=VALUE, base-type=uint8  # 电话操作
    IDT_ADAS_Posn_Idx: category=VALUE, base-type=uint8
    IDT_ADAS_arr_MNPRoutesStateInfo: category=STRUCTURE, dynamic-array-size-profile=VSA_LINEAR  # 记忆路线状态信息数组
      element sizeIndicator: implementation-data-type=specialIDT_DynamicLengthField_uint32
      element IDT_ADAS_arr_MNPRoutesStateInfo: category=ARRAY
        element IDT_ADAS_arr_MNPRoutesStateInfo: array-size=20, array-size-handling=ALL-INDICES-SAME-ARRAY-SIZE, array-size-semantics=VARIABLE-SIZE, implementation-data-type=IDT_ADAS_strt_MNPRouteStateInfo
    IDT_ADAS_arr_RoadMarker_2: category=STRUCTURE, dynamic-array-size-profile=VSA_LINEAR
      element sizeIndicator: implementation-data-type=specialIDT_DynamicLengthField_uint32
      element IDT_ADAS_arr_RoadMarker_2: category=ARRAY
        element IDT_ADAS_arr_RoadMarker_2: array-size=28, array-size-handling=ALL-INDICES-SAME-ARRAY-SIZE, array-size-semantics=VARIABLE-SIZE, implementation-data-type=IDT_ADAS_strt_RoadMarker_2
    IDT_ADAS_strt_DrivingSoundInfo: category=STRUCTURE
      element DTE_DrivingSoundWarn: implementation-data-type=IDT_ADAS_enum_DrivingSoundWarn  # chime音报警
      element DTE_DrivingSoundReserved: implementation-data-type=IDT_DrivingSound_arr_Reserved  # 预留
    IDT_ICC_int32_CameraPriority: category=VALUE, base-type=sint32  # 电子眼显示优先级
    IDT_AccState: category=VALUE, base-type=uint8  # ACC激活状态信息
    IDT_ADAS_enum_ALCAbortReason: category=VALUE, base-type=uint8
    IDT_ADAS_ProfShort_ProfType: category=VALUE, base-type=uint8
    IDT_ICC_enum_ParkingFuncModReq: category=VALUE, base-type=uint8
    IDT_HPARepaly_arr_Reserved: category=ARRAY  # 预留
      element Reserved_uint8_Type: array-size=30, array-size-semantics=FIXED-SIZE, implementation-data-type=IDT_Reserved_uint8_Type
    IDT_HDMapInfo_arr_Reserved: category=ARRAY
      element Reserved_uint8_Type: array-size=30, array-size-semantics=FIXED-SIZE, implementation-data-type=IDT_Reserved_uint8_Type
    IDT_ADAS_Seg_EffSpdLmtType: category=VALUE, base-type=uint8
    IDT_ADAS_Posn_CurLane: category=VALUE, base-type=uint8
    IDT_NaviInfoPanel_arr_Reserved: category=ARRAY
      element Reserved_int32_Type: array-size=20, array-size-semantics=FIXED-SIZE, implementation-data-type=IDT_Reserved_int32_Type
    IDT_ADAS_enum_ParkingSpeedSet: category=VALUE, base-type=uint8
    IDT_ADAS_Stub_PathIdx: category=VALUE, base-type=uint8
    IDT_ScheduleTime: category=VALUE, base-type=uint32  # OTA的任务时间
    IDT_ADAS_enum_TolRespondCongestion: category=VALUE, base-type=uint64  # 应对加塞
    IDT_Arr_CamStreamSwtReqResd: category=ARRAY  # 预留 Reserved
      element Reserved_uint8_Type: array-size=20, array-size-semantics=FIXED-SIZE, implementation-data-type=IDT_Reserved_uint8_Type
    IDT_ICC_enum_NOPLaneChangeStyle: category=VALUE, base-type=uint8  # NOP超车变道风格
    IDT_ADAS_strt_ActiveSafetyFcnInfo: category=STRUCTURE
      5 x element, all with category=TYPE_REFERENCE:
        DTE_FcwSts: implementation-data-type=IDT_ADAS_enum_FcwSts  # FCW功能状态
        DTE_AebSts: implementation-data-type=IDT_ADAS_enum_AebSts  # AEB功能状态
        DTE_FcwWarnDist: implementation-data-type=IDT_ADAS_enum_FcwWarnDist  # FCW报警距离
        DTE_FcwAcitveSt: implementation-data-type=IDT_ADAS_enum_FcwAcitveSt  # FCW执行状态
        DTE_AebAcitveSt: implementation-data-type=IDT_ADAS_enum_AebAcitveSt  # AEB执行状态
    IDT_ADAS_val_ParkingProgressBarInd: category=VALUE, base-type=uint8
    IDT_ADAS_strt_SDmapInfo_international: category=STRUCTURE  # 国际SD地图输出信息
      17 x element, all with category=TYPE_REFERENCE:
        DTE_NavSpeedLimitStatus: implementation-data-type=IDT_ICC_enum_NavSpeedLimitStatus  # 导航地图状态
        DTE_NavCountryCodeInfo: implementation-data-type=IDT_ICC_enum_NavCountryCodeInfo  # 导航国家代码
        DTE_NavCurrRoadType: implementation-data-type=IDT_ICC_enum_NavCurrRoadType  # 导航道路类型
        DTE_NavSpeedLimit: implementation-data-type=IDT_ICC_enum_NavSpeedLimit  # 导航限速值
        DTE_NavSpeedLimitUnits: implementation-data-type=IDT_ICC_enum_NavSpeedLimitUnits  # 导航限速单位
        DTE_NavSpeedLimitType: implementation-data-type=IDT_ICC_enum_NavSpeedLimitType  # 导航限速类型
        DTE_NavRampInfo: implementation-data-type=IDT_ICC_enum_NavRampInfo  # 前方路口匝道信息
        DTE_NavRampDistance: implementation-data-type=IDT_DataUint16  # 前方匝道距离
        DTE_NavRoundabouts: implementation-data-type=IDT_Gen_val_unit8  # 圆环限速信息
        DTE_NavJunctions: implementation-data-type=IDT_Gen_val_unit8  # 交叉口距离信息
        DTE_NavWinding: implementation-data-type=IDT_DataUint16  # 前方道路弯曲角度
        DTE_NavTrafficlights: implementation-data-type=IDT_Gen_val_unit8  # 前方红绿灯距离信息
        DTE_NavRainSpeedLimit: implementation-data-type=IDT_Gen_val_unit8  # 雨天道路限速值
        DTE_NavSnowSpeedLimit: implementation-data-type=IDT_Gen_val_unit8  # 雪天道路限速值
        DTE_NavFogSpeedLimit: implementation-data-type=IDT_Gen_val_unit8  # 大雾道路限速值
        DTE_NavIsTimeSpeedLimit: implementation-data-type=IDT_ICC_enum_NavIsTimeSpeedLimit  # 时间限速状态
        DTE_NavTimeSpeedLimit: implementation-data-type=IDT_Gen_val_unit8  # 时间条件道路限速值
    IDT_ICC_arr_FrontLaneTypes: category=STRUCTURE, dynamic-array-size-profile=VSA_LINEAR
      element sizeIndicator: implementation-data-type=specialIDT_DynamicLengthField_uint32
      element IDT_ICC_arr_FrontLaneTypes: category=ARRAY
        element IDT_ICC_arr_FrontLaneTypes: array-size=32, array-size-handling=ALL-INDICES-SAME-ARRAY-SIZE, array-size-semantics=VARIABLE-SIZE, implementation-data-type=IDT_ICC_strt_LaneCategoryType
    IDT_TimeZoneInfo: category=STRUCTURE  # 包含时区的小时和分钟信息
      4 x element, all with category=TYPE_REFERENCE:
        DTE_timezoneValidFlag: implementation-data-type=IDT_TimeValidFlag  # 时区信息有效性
        DTE_timezoneUtcHour: implementation-data-type=IDT_TimezoneUtcHours  # 时区小时偏差信息
        DTE_timezoneUtcMinute: implementation-data-type=IDT_TimezoneUtcMinutes  # 时区分钟偏差信息
        DTE_dstFlag: implementation-data-type=IDT_DSTFlag  # 表示当前是否处于夏令时
    IDT_ADAS_enum_ObjectColor: category=VALUE, base-type=uint8
    IDT_ICC_Strt_ADASSettingInfo: category=STRUCTURE
      35 x element, all with category=TYPE_REFERENCE:
        DTE_ICAEnableBtnSts: implementation-data-type=IDT_ICC_enum_ICAEnableBtnSts  # ICA功能使能开关
        DTE_FSRASpdSetMod: implementation-data-type=IDT_ICC_enum_FSRASpdSetMod  # 巡航速度调整方式设置（无开关）
        DTE_FSRACruiseSpdMod: implementation-data-type=IDT_ICC_enum_FSRACruiseSpdMod  # 设定巡航车速模式
        DTE_FSRACruiseSpdOffsetMod: implementation-data-type=IDT_ICC_enum_FSRACruiseSpdOffsetMod  # 设定偏移方式
        DTE_FSRACruiseSpdOffsetSpd: implementation-data-type=IDT_ICC_enum_FSRACruiseSpdOffsetSpd  # 固定偏移速度
        DTE_FSRACruiseSpdOffsetPercent: implementation-data-type=IDT_ICC_enum_FSRACruiseSpdOffsetPercent  # 百分比偏移速度
        DTE_ISLIWarnMod: implementation-data-type=IDT_ICC_enum_ISLIWarnMod  # 智能限速提醒方式
        DTE_ISLISpdOffsetMod: implementation-data-type=IDT_ICC_enum_ISLISpdOffsetMod  # 限速设置方式（预留）
        DTE_ISLICruiseSpdRelOffset: implementation-data-type=IDT_ICC_enum_ISLICruiseSpdRelOffset  # 相对限制值（预留）
        DTE_ISLICruiseSpdAbdOffset: implementation-data-type=IDT_ICC_enum_ISLICruiseSpdAbdOffset  # 绝对限制值（预留）
        DTE_FCWWarnDistance: implementation-data-type=IDT_ICC_enum_FCWWarnDistance  # FCW报警距离限制
        DTE_FCWSettingSt: implementation-data-type=IDT_ICC_enum_FCWSettingSt  # FCW功能设置状态
        DTE_AEBSettingSt: implementation-data-type=IDT_ICC_enum_AEBSettingSt  # AEB功能设置状态
        DTE_LKSSettingSt: implementation-data-type=IDT_ICC_enum_LKSSettingSt  # LDW/LDP功能设置状态
        DTE_LDWWarnType: implementation-data-type=IDT_ICC_enum_LDWWarnType  # LDW/LDP报警方式
        DTE_ELKSettingSt: implementation-data-type=IDT_ICC_enum_ELKSettingSt  # ELK功能设置状态
        DTE_BSDSettingSt: implementation-data-type=IDT_ICC_enum_BSDSettingSt  # BSD/LCW功能设置状态
        DTE_DOWSettingSt: implementation-data-type=IDT_ICC_enum_DOWSettingSt  # DOW功能设置状态
        DTE_HODWarnSettingSt: implementation-data-type=IDT_ICC_enum_HODWarnSettingSt  # HOD脱手模式状态
        DTE_FCTAWarnType: implementation-data-type=IDT_ICC_enum_FCTAWarnType  # FCTA报警方式
        DTE_RCTAWarnType: implementation-data-type=IDT_ICC_enum_RCTAWarnType  # RCTA报警方式
        DTE_ESASettingSt: implementation-data-type=IDT_ICC_enum_ESASettingSt  # ESA功能设置状态
        DTE_AMAPSettingSt: implementation-data-type=IDT_ICC_enum_AMAPSettingSt  # AMAP功能设置状态
        DTE_NOPEnableBtnSts: implementation-data-type=IDT_ICC_enum_NOPEnableBtnSts  # NOP功能使能开关
        DTE_VoiceRemindSettingMode: implementation-data-type=IDT_ICC_enum_VoiceRemindSettingMode  # 语音播报模式
        DTE_NOPLaneChangeStyle: implementation-data-type=IDT_ICC_enum_NOPLaneChangeStyle  # NOP超车变道风格
        DTE_NOPLaneChangeMod: implementation-data-type=IDT_ICC_enum_NOPLaneChangeMod  # NOP变道模式
        DTE_NOPLaneChangeWarnType: implementation-data-type=IDT_ICC_enum_NOPLaneChangeWarnType  # NOP变道提醒模式
        DTE_U_NOPEnableBtnSts: implementation-data-type=IDT_ICC_enum_U_NOPEnableBtnSts  # 城区NOP功能使能开关
        DTE_HPASettingSt: implementation-data-type=IDT_ICC_enum_HPASettingSt  # 记忆泊车功能使能开关
        DTE_VPASettingSt: implementation-data-type=IDT_ICC_enum_VPASettingSt  # 代客泊车功能使能开关
        DTE_APASettingSt: implementation-data-type=IDT_ICC_enum_APASettingSt  # 自动泊车功能使能开关
        DTE_VoiceRemindSettingSt: implementation-data-type=IDT_ICC_enum_VoiceRemindSettingSt  # 语音播报功能设置开关
        DTE_DrivingVoiceRemindSettingSt: implementation-data-type=IDT_ICC_enum_DrivingVoiceRemindSettingSt  # 行车语音播报功能设置开关
        DTE_NRASettingSt: implementation-data-type=IDT_ICC_enum_NRASettingSt  # 窄路辅助使能开关
    IDT_ADAS_enum_LCPermitSt: category=VALUE, base-type=uint8
    IDT_ADAS_enum_FDMSt: category=VALUE, base-type=uint8
    IDT_ADAS_strt_AebTargetObjInfo_2: category=STRUCTURE  # FCW AEB目标信息
      6 x element, all with category=TYPE_REFERENCE:
        DTE_TargetObjID: implementation-data-type=IDT_ADAS_uint64_TargetObjID  # 目标ID
        DTE_TargetObjColor: implementation-data-type=IDT_ADAS_enumTargetObjColor  # 目标颜色
        DTE_TargetObjType: implementation-data-type=IDT_ADAS_enumTargetObjType  # 目标类型
        DTE_TargetObjPosX: implementation-data-type=IDT_Gen_val_Coordinate_X  # 目标X向距离
        DTE_TargetObjPosY: implementation-data-type=IDT_Gen_val_Coordinate_Y  # 目标Y向距离
        DTE_TargetObjSpdX: implementation-data-type=IDT_ADAS_val_vehicleSpd  # 目标纵向速度
    IDT_ADAS_strt_EgoFusionPose: category=STRUCTURE
      10 x element, all with category=TYPE_REFERENCE:
        DTE_longitude: implementation-data-type=IDT_ADAS_val_longitude  # 经度
        DTE_latitude: implementation-data-type=IDT_ADAS_val_latitude  # 纬度
        DTE_altitude: implementation-data-type=IDT_ADAS_val_altitude  # 高度
        DTE_heading: implementation-data-type=IDT_ADAS_val_heading  # 航向角
        DTE_vehicleSpeed: implementation-data-type=IDT_ADAS_ego_vehicleSpd  # 车辆本身车速，单位:km/h
        DTE_FusionlocalizationSD: implementation-data-type=IDT_ADAS_val_StandardDeviation  # 融合位置标准差
        DTE_altitudeSD: implementation-data-type=IDT_ADAS_val_StandardDeviation  # 高度标准差
        DTE_headingSD: implementation-data-type=IDT_ADAS_val_StandardDeviation  # 航向角标准差
        DTE_vehicleSpeedSD: implementation-data-type=IDT_ADAS_val_StandardDeviation  # 车辆本身车速标准差
        DTE_timestampmSec: implementation-data-type=IDT_ADAS_val_timestampmSec  # 时间戳-毫秒
    IDT_ADAS_enum_LightStatus: category=VALUE, base-type=uint8
    IDT_ADAS_arr_DrivingTrajectoryPointList: category=STRUCTURE, dynamic-array-size-profile=VSA_LINEAR  # 轨迹形点数组
      element sizeIndicator: implementation-data-type=specialIDT_DynamicLengthField_uint32
      element IDT_ADAS_arr_DrivingTrajectoryPointList: category=ARRAY
        element IDT_ADAS_arr_DrivingTrajectoryPointList: array-size=1000, array-size-handling=ALL-INDICES-SAME-ARRAY-SIZE, array-size-semantics=VARIABLE-SIZE, implementation-data-type=IDT_ADAS_strt_DrivingTrajectoryPoint
    IDT_Enum_DataConnection: category=VALUE, base-type=uint8  # 数据连接是否有效
    IDT_ADAS_arr_MNPRoutesInfo: category=STRUCTURE, dynamic-array-size-profile=VSA_LINEAR  # 记忆路线信息数组
      element sizeIndicator: implementation-data-type=specialIDT_DynamicLengthField_uint32
      element IDT_ADAS_arr_MNPRoutesInfo: category=ARRAY
        element IDT_ADAS_arr_MNPRoutesInfo: array-size=20, array-size-handling=ALL-INDICES-SAME-ARRAY-SIZE, array-size-semantics=VARIABLE-SIZE, implementation-data-type=IDT_ADAS_strt_MNPRouteInfo
    IDT_ADAS_enum_APAActiveFuncInd: category=VALUE, base-type=uint8
    IDT_ADAS_val_MemRouteCreatTime: category=VALUE, base-type=uint64  # 路线创建时间
    IDT_AllSimDetailInfo: category=STRUCTURE  # 车辆Sim卡信息
      4 x element, all with category=TYPE_REFERENCE:
        DTE_simNum: implementation-data-type=IDT_SimNum  # 支持的sim数量
        DTE_multiSimSwitchMode: implementation-data-type=IDT_MultiSimSwitchMode  # 多SIM切换模式
        DTE_reserved: implementation-data-type=IDT_AllSimDetailInfoReserved  # 预留字段
        DTE_simDetailInfoArray: implementation-data-type=IDT_SimDetailInfoArray  # sim卡详细信息数组
    IDT_Flt_GndSpdInfo: category=VALUE, base-type=float32  # 地面速度 (米每秒)信息 Ground velocity (meters per second) information
    IDT_Enum_TBOXOTARemoteAPPTCancel: category=VALUE, base-type=uint8  # 远控取消OTA预约升级
    IDT_EphemerisDataByteArray: category=ARRAY  # 星历数据消息通道
      element EphemerisDataByteElement: array-size=1024, array-size-semantics=FIXED-SIZE, implementation-data-type=IDT_EphemerisDataByteElement
    IDT_ADAS_enum_NOPALCReqDriverConf: category=VALUE, base-type=uint8
    IDT_GreenWave_arr_Reserved: category=ARRAY
      element Reserved_int32_Type: array-size=15, array-size-semantics=FIXED-SIZE, implementation-data-type=IDT_Reserved_int32_Type
    IDT_CruiseInfo_arr_Reserved: category=ARRAY
      element Reserved_int32_Type: array-size=20, array-size-semantics=FIXED-SIZE, implementation-data-type=IDT_Reserved_int32_Type
    IDT_Struct_UploadBEICALLSts: category=STRUCTURE  # 上报紧急救援通话状态
      4 x element, all with category=TYPE_REFERENCE:
        DTE_CallType: implementation-data-type=IDT_Enum_CallType  # 呼叫号码列表
        DTE_PhoneNumber: implementation-data-type=IDT_StrVar_PhoneNumber  # 电话号码
        DTE_State: implementation-data-type=IDT_Enum_State  # 通话状态
        DTE_Millisecond: implementation-data-type=IDT_Millisecond  # 通话时间
    IDT_SimSwitchRequest: category=STRUCTURE  # 切换Sim卡命令
      element DTE_simSwitchMode: implementation-data-type=IDT_SimMode  # 切换到指定模式
      element DTE_simSwitchOperator: implementation-data-type=IDT_SimOperator  # 切换到指定运营商
    IDT_Struct_TBOXVersionInfo: category=STRUCTURE  # TBOX版本信息
      8 x element, all with category=TYPE_REFERENCE:
        DTE_TBoxVersion: implementation-data-type=IDT_StrVar_TBoxVersion  # TBOX版本号
        DTE_ECUHardwareNumber: implementation-data-type=IDT_StrVar_ECUHardwareNumber  # ECU硬件号
        DTE_ECUSoftwareNumber: implementation-data-type=IDT_StrVar_ECUSoftwareNumber  # ECU软件号
        DTE_ProductID: implementation-data-type=IDT_StrVar_ProductID  # TBOX产品唯一ID
        DTE_HardwareVersion: implementation-data-type=IDT_StrVar_HardwareVersion  # 硬件版本号
        DTE_MCUVersion: implementation-data-type=IDT_StrVar_MCUVersion  # MCU版本号
        DTE_ARMVersion: implementation-data-type=IDT_StrVar_ARMVersion  # ARM版本号
        DTE_ModemVersion: implementation-data-type=IDT_StrVar_ModemVersion  # Modem版本号
    IDT_ADAS_arr_ParkingDynamicObjects_2: category=STRUCTURE, dynamic-array-size-profile=VSA_LINEAR  # 泊车动态目标数组
      element sizeIndicator: implementation-data-type=specialIDT_DynamicLengthField_uint32
      element IDT_ADAS_arr_ParkingDynamicObjects_2: category=ARRAY
        element IDT_ADAS_arr_ParkingDynamicObjects_2: array-size=150, array-size-handling=ALL-INDICES-SAME-ARRAY-SIZE, array-size-semantics=VARIABLE-SIZE, implementation-data-type=IDT_ADAS_strt_DynamicObject_2
    IDT_Enum_Data_ID: category=VALUE, base-type=uint32  # 数据闭环埋点ID Data closed-loop tracking ID
    IDT_ICC_val_Distance: category=VALUE, base-type=float32
    IDT_ADAS_enum_SglU_turnsNum: category=VALUE, base-type=uint16  # 掉头次数
    IDT_ICC_int64_Index: category=VALUE, base-type=sint64
    IDT_ADAS_arr_MNPMemRoutesNum: category=VALUE, base-type=uint8  # 已记忆路线数量
    IDT_ICC_strt_NaviInfoPanel: category=STRUCTURE
      7 x element, all with category=TYPE_REFERENCE:
        DTE_PanelManeuverID: implementation-data-type=IDT_Gen_int32_ManeuverID  # 动态转向ID,满足顺行展示距离时为顺行图标
        DTE_PanelSegmentRemain: implementation-data-type=IDT_ICC_strt_TimeAndDist  # 当前导航段剩余距离（单位米）和剩余时间（单位秒）
        DTE_PanelNextRouteName: implementation-data-type=IDT_ICC_string_RoadName  # 下条道路名称
        DTE_PnlNextRoadNameSegIdx: implementation-data-type=IDT_ICC_int32_Index  # 下条道路名称所在的SegIdx
        DTE_PnlNextRoadNameLinkIdx: implementation-data-type=IDT_ICC_int32_Index  # 下条道路名称所在的linkIdx
        DTE_NaviInfoPanelSplit: implementation-data-type=IDT_ICC_int32_NaviSplit  # 当前导航段是否被拆分
        DTE_NaviInfoPanelReserved: implementation-data-type=IDT_NaviInfoPanel_arr_Reserved  # 预留
    IDT_ADAS_strt_MNPMemRoutePosition: category=STRUCTURE  # 路线轨迹点坐标
      element DTE_MemRoutePointX: implementation-data-type=IDT_ADAS_val_longitude  # 记忆路线轨迹点坐标X
      element DTE_MemRoutePointY: implementation-data-type=IDT_ADAS_val_latitude  # 记忆路线轨迹点坐标Y
      element DTE_MemRoutePointZ: implementation-data-type=IDT_ADAS_val_altitude  # 记忆路线轨迹点坐标Z
    IDT_ESSInfo_arr_Reserved: category=ARRAY  # 预留
      element Reserved_uint8_Type: array-size=100, array-size-semantics=FIXED-SIZE, implementation-data-type=IDT_Reserved_uint8_Type
    IDT_ADAS_enum_ESSActiveSt: category=VALUE, base-type=uint8
    IDT_ADAS_strt_LaneLine: category=STRUCTURE
      13 x element, all with category=TYPE_REFERENCE:
        DTE_lineIndex: implementation-data-type=IDT_ADAS_enum_LinePositionIndex  # 车道线索引
        DTE_lineId: implementation-data-type=IDT_Gen_val_ID  # 车道线ID
        DTE_lineColor: implementation-data-type=IDT_ADAS_enum_LineColor  # 车道线颜色
        DTE_lineType: implementation-data-type=IDT_ADAS_enum_LineType  # 车道线类型
        DTE_lineEquation_C{0..3}: implementation-data-type=IDT_ADAS_val_LineEquation_C{0..3}  # 车道线方程C{0..3}
        DTE_laneLineWidth: implementation-data-type=IDT_Gen_val_float32  # 车道线宽度
        DTE_lineStart_X: implementation-data-type=IDT_Gen_val_Coordinate_X  # 车道线起点X坐标
        DTE_lineStart_Y: implementation-data-type=IDT_Gen_val_Coordinate_Y  # 车道线起点Y坐标
        DTE_lineEnd_X: implementation-data-type=IDT_Gen_val_Coordinate_X  # 车道线终止点X坐标
        DTE_lineEnd_Y: implementation-data-type=IDT_Gen_val_Coordinate_Y  # 车道线终止点Y坐标
    IDT_ICC_enum_WeatherID: category=VALUE, base-type=uint16
    IDT_ICC_enum_ISLICruiseSpdRelOffset: category=VALUE, base-type=sint8  # 相对限制值（预留）
    IDT_Enum_MobileNetworkType: category=VALUE, base-type=uint8  # 移动网络类型
    IDT_ADAS_Seg_RelProbb: category=VALUE, base-type=uint8
    IDT_ICC_strt_HPAPathInfo: category=STRUCTURE
      4 x element, all with category=TYPE_REFERENCE:
        DTE_Coordinate_X: implementation-data-type=IDT_Gen_val_Coordinate_X  # X坐标
        DTE_Coordinate_Y: implementation-data-type=IDT_Gen_val_Coordinate_Y  # Y坐标
        DTE_Coordinate_Z: implementation-data-type=IDT_Gen_val_Coordinate_Z  # Z坐标
        DTE_HPAPathInfoReserved: implementation-data-type=IDT_HPAPathInfo_arr_Reserved  # 预留
    IDT_Enum_RouteMMError: category=VALUE, base-type=uint8  # HD路线匹配错误
    IDT_StrVar_BleSlaverRightMac: category=STRUCTURE, dynamic-array-size-profile=VSA_LINEAR  # 蓝牙右从模块 MAC 地址
      element sizeIndicator: implementation-data-type=specialIDT_DynamicLengthField_uint32
      element IDT_StrVar_BleSlaverRightMac: category=ARRAY
        element IDT_StrVar_BleSlaverRightMac: array-size=24, array-size-handling=ALL-INDICES-SAME-ARRAY-SIZE, array-size-semantics=VARIABLE-SIZE, implementation-data-type=specialIDT_StringRef
    IDT_SurfaceMesh_arr_Reserved: category=ARRAY  # 预留
      element Reserved_uint8_Type: array-size=100, array-size-semantics=FIXED-SIZE, implementation-data-type=IDT_Reserved_uint8_Type
    IDT_ADAS_enum_VPASpotLabel: category=VALUE, base-type=uint8  # 用户特殊车位的标签类型
    IDT_ADAS_ProfLong_CtrlPoint: category=VALUE, base-type=uint8
    IDT_quitFactoryResetResponse: category=VALUE, base-type=uint32  # 退出恢厂状态响应
    IDT_Gen_uint64_ID: category=VALUE, base-type=uint64
    IDT_ICC_enum_NavSpeedLimitType: category=VALUE, base-type=uint8  # 导航限速类型
    IDT_Bool_CarrierFrq: category=VALUE, base-type=uint8  # 载波频率是否有效信息 Information on whether the carrier frequency is valid
    IDT_Struct_TBOXAPPT: category=STRUCTURE  # TBOX已预约时间
      element DTE_TripUtcSecs: implementation-data-type=IDT_TripUtcSecs  # 预约出行时间
      element DTE_ChargingUtcSecs: implementation-data-type=IDT_ChargingUtcSecs  # 预约充电时间
      element DTE_OTAUtcSecs: implementation-data-type=IDT_OTAUtcSecs  # 预约升级时间
    IDT_ADAS_enum_Confidencelevel: category=VALUE, base-type=uint8
    IDT_ICC_enum_DrivingVoiceRemindSettingSt: category=VALUE, base-type=uint8  # 行车语音播报功能设置状态
    IDT_ADAS_ProfShort_Update: category=VALUE, base-type=uint8
    IDT_ICC_enum_HPASettingSt: category=VALUE, base-type=uint8  # HPA功能设置状态
    IDT_ADAS_val_HNOACruiseSpdOffsetPercentFb: category=VALUE, base-type=sint8  # 百分比偏移速度反馈
    IDT_ADAS_enum_HNOPScenariosReminder: category=VALUE, base-type=uint8
    IDT_SentryModePlanStartTime_minute: category=VALUE, base-type=uint32  # 哨兵模式预约开启时间（分）
    IDT_TLRInfo_arr_Reserved: category=ARRAY
      element Reserved_uint8_Type: array-size=30, array-size-semantics=FIXED-SIZE, implementation-data-type=IDT_Reserved_uint8_Type
    IDT_ADAS_Posn_PosConfdc: category=VALUE, base-type=uint8
    IDT_ADAS_Meta_RegionCode: category=VALUE, base-type=uint16
    IDT_ICC_int32_RoadStatus: category=VALUE, base-type=sint32
    IDT_SimNum: category=VALUE, base-type=uint32  # 支持的sim数量，表示车辆支持的运营商数量（包括eSIM支持的运营商）
    IDT_ADAS_arr_PathPoint_2: category=STRUCTURE, dynamic-array-size-profile=VSA_LINEAR
      element sizeIndicator: implementation-data-type=specialIDT_DynamicLengthField_uint32
      element IDT_ADAS_arr_PathPoint_2: category=ARRAY
        element IDT_ADAS_arr_PathPoint_2: array-size=5000, array-size-handling=ALL-INDICES-SAME-ARRAY-SIZE, array-size-semantics=VARIABLE-SIZE, implementation-data-type=IDT_ADAS_strt_HPAVPAPathInfo
    IDT_ICC_enum_SelectZoneFloor: category=VALUE, base-type=uint8
    IDT_Enum_TBOXOTAAPPTSet: category=VALUE, base-type=uint8  # 设置预约升级时间
    IDT_ADAS_enum_VPADropOffPosSelectReq: category=VALUE, base-type=uint8
    IDT_Enum_UpdateFTPSts: category=VALUE, base-type=uint8  # FTP状态
    IDT_Strength: category=VALUE, base-type=uint8
    IDT_StrVar_State: category=STRUCTURE, dynamic-array-size-profile=VSA_LINEAR
      element sizeIndicator: implementation-data-type=specialIDT_DynamicLengthField_uint32
      element IDT_StrVar_State: category=ARRAY
        element IDT_StrVar_State: array-size=460, array-size-handling=ALL-INDICES-SAME-ARRAY-SIZE, array-size-semantics=VARIABLE-SIZE, implementation-data-type=specialIDT_StringRef
    IDT_TimeStamp64: category=VALUE, base-type=uint64  # UTC 时间
    IDT_ADAS_enum_SglAccessRemitramp: category=VALUE, base-type=uint16  # 汇入汇出匝道
    IDT_ADAS_strt_PlannedPath: category=STRUCTURE
      5 x element, all with category=TYPE_REFERENCE, implementation-data-type=IDT_ADAS_arr_TrajectoryPoint:
        DTE_Planned_path_0  # 规划轨迹1
        DTE_Planned_path_1  # 规划轨迹2
        DTE_Planned_path_2  # 规划轨迹3
        DTE_Planned_path_3  # 规划轨迹4
        DTE_Planned_path_4  # 规划轨迹5
    IDT_ADAS_strt_ESSInfo: category=STRUCTURE
      4 x element, all with category=TYPE_REFERENCE:
        DTE_ESSSts: implementation-data-type=IDT_ADAS_enum_ESSSts  # ESS 功能状态
        DTE_ESSDirection: implementation-data-type=IDT_ADAS_enum_ESSDirection  # ESS激活方向
        DTE_AESSts: implementation-data-type=IDT_ADAS_enum_AESSts  # AES 功能状态
        DTE_AESDirection: implementation-data-type=IDT_ADAS_enum_AESDirection  # AES激活方向
    IDT_Enum_SatelTotNrInfo: category=VALUE, base-type=uint16  # 卫星总个数信息 Total number of satellites information
    IDT_ICC_int64_Dist: category=VALUE, base-type=sint64
    IDT_ICC_enum_MNPNewBtnSt: category=VALUE, base-type=uint8  # 新建路线按钮
    IDT_ICC_enum_ELKSettingSt: category=VALUE, base-type=uint8  # ELK功能设置状态
    IDT_ADAS_strt_HNOPfunctionInfo: category=STRUCTURE
      16 x element, all with category=TYPE_REFERENCE:
        DTE_HNOPSts: implementation-data-type=IDT_ADAS_enum_HNOPSts  # 高速领航辅助状态
        DTE_NOPLaneChangeMod: implementation-data-type=IDT_ADAS_enum_NOPLaneChangeMod  # 领航辅助变道模式
        DTE_NOPLaneChangeStyle: implementation-data-type=IDT_ADAS_enum_NOPLaneChangeStyle  # 领航辅助速控模式
        DTE_NOPLaneChangeInfo: implementation-data-type=IDT_ADAS_enum_NOPLaneChangeInfo  # 领航辅助变道状态信息
        DTE_SafeStopReminder: implementation-data-type=IDT_ADAS_enum_SafeStopReminder  # 领航辅助执行安全停车提示
        DTE_NOPQuitReason: implementation-data-type=IDT_ADAS_enum_NOPQuitReason  # 领航辅助退出原因
        DTE_NOPALCReqDriverConf: implementation-data-type=IDT_ADAS_enum_NOPALCReqDriverConf  # 推荐变道请求确认
        DTE_NOPDegradeReminder: implementation-data-type=IDT_ADAS_enum_DegradeReminder  # 领航辅助升降级行为提示
        DTE_NOPStReminder: implementation-data-type=IDT_ADAS_enum_NOPStReminder  # 领航辅助状态提示
        DTE_NOPLaneChangeReason: implementation-data-type=IDT_ADAS_enum_NOPLaneChangeReason  # 领航辅助变道原因
        DTE_HNOPScenariosReminder: implementation-data-type=IDT_ADAS_enum_HNOPScenariosReminder  # HNOP场景提示信息
        DTE_Confidencelevel: implementation-data-type=IDT_ADAS_enum_Confidencelevel  # 场景控制置信度
        DTE_TrajectoryPoint: implementation-data-type=IDT_ADAS_arr_TrajectoryPoint  # 决策引导线
        DTE_LeaveFastLaneSts: implementation-data-type=IDT_ADAS_enum_LeaveFastLaneSts  # 驶离快车道模式设置状态反馈
        DTE_NOPLaneChangeWarnTypeFb: implementation-data-type=IDT_ADAS_enum_NOPLaneChangeWarnType  # 领航辅助变道报警类型
        DTE_NOPLCPermitSt: implementation-data-type=IDT_ADAS_enum_LCPermitSt  # 领航辅助变道允许状态
    IDT_Enum_SPKState: category=VALUE, base-type=uint8
    IDT_ICC_Navi_Longitude: category=VALUE, base-type=float32
    IDT_ICC_int32_LinkType: category=VALUE, base-type=sint32
    IDT_CruiseFacility_arr_Reserved: category=ARRAY
      element Reserved_int32_Type: array-size=20, array-size-semantics=FIXED-SIZE, implementation-data-type=IDT_Reserved_int32_Type
    IDT_FCM_val_CamParameter: category=VALUE, base-type=float64
    IDT_ADAS_strt_ParkingHMIInfo: category=STRUCTURE
      5 x element, all with category=TYPE_REFERENCE:
        DTE_ApaCorridor_left: implementation-data-type=IDT_ADAS_arr_TrajectoryPoint  # 左侧泊车路径通道
        DTE_ApaCorridor_right: implementation-data-type=IDT_ADAS_arr_TrajectoryPoint  # 右侧泊车路径通道
        DTE_RemainingPercentage: implementation-data-type=IDT_ADAS_enum_Percent  # 剩余距离百分比
        DTE_PlannedPath: implementation-data-type=IDT_ADAS_strt_PlannedPath  # 一次性规划轨迹
        DTE_Occ_point: implementation-data-type=IDT_ADAS_arr_OccPoint  # 道路边缘显示
    IDT_ICC_strt_LightState: category=STRUCTURE  # 灯态
      5 x element, all with category=TYPE_REFERENCE:
        DTE_LightType: implementation-data-type=IDT_ICC_int32_LightType  # 红绿灯状态类型
        DTE_LastSeconds: implementation-data-type=IDT_ICC_int32_LastSeconds
        DTE_LightStateStime: implementation-data-type=IDT_ICC_int64_Time  # 灯态开始时间戳，单位秒,1970,utc+8
        DTE_LightStateEtime: implementation-data-type=IDT_ICC_int64_Time  # 灯态结束时间戳，单位秒,1970,utc+8
        DTE_LightStateReserved: implementation-data-type=IDT_LightState_arr_Reserved  # 预留
    IDT_HNOPSupplementInfo_arr_Reserved: category=ARRAY
      element Reserved_uint8_Type: array-size=49, array-size-semantics=FIXED-SIZE, implementation-data-type=IDT_Reserved_uint8_Type
    IDT_SentryModePlanEndTime_minute: category=VALUE, base-type=uint32  # 哨兵模式预约结束时间（分）
    IDT_NaviInfo_arr_Reserved: category=ARRAY
      element Reserved_int32_Type: array-size=20, array-size-semantics=FIXED-SIZE, implementation-data-type=IDT_Reserved_int32_Type
    IDT_StrVar_TBOXOTARemoteInstall: category=STRUCTURE, dynamic-array-size-profile=VSA_LINEAR  # OTA立即升级
      element sizeIndicator: implementation-data-type=specialIDT_DynamicLengthField_uint32
      element IDT_StrVar_TBOXOTARemoteInstall: category=ARRAY
        element IDT_StrVar_TBOXOTARemoteInstall: array-size=16, array-size-handling=ALL-INDICES-SAME-ARRAY-SIZE, array-size-semantics=VARIABLE-SIZE, implementation-data-type=specialIDT_StringRef
    IDT_FactoryResetSartCode: category=VALUE, base-type=uint32  # 恢厂指令接收码
    IDT_ADAS_enum_VPAFailureReasonInd: category=VALUE, base-type=uint8
    IDT_ADAS_arr_HPAOnWayLabelReplay: category=STRUCTURE, dynamic-array-size-profile=VSA_LINEAR
      element sizeIndicator: implementation-data-type=specialIDT_DynamicLengthField_uint32
      element IDT_ADAS_arr_HPAOnWayLabelReplay: category=ARRAY
        element IDT_ADAS_arr_HPAOnWayLabelReplay: array-size=10, array-size-handling=ALL-INDICES-SAME-ARRAY-SIZE, array-size-semantics=VARIABLE-SIZE, implementation-data-type=IDT_ADAS_strt_HPAOnWayLabel
    IDT_ADAS_arr_VPASpotLabel: category=STRUCTURE, dynamic-array-size-profile=VSA_LINEAR  # 用户特殊车位的标签类型列表
      element sizeIndicator: implementation-data-type=specialIDT_DynamicLengthField_uint32
      element IDT_ADAS_arr_VPASpotLabel: category=ARRAY
        element IDT_ADAS_arr_VPASpotLabel: array-size=100, array-size-handling=ALL-INDICES-SAME-ARRAY-SIZE, array-size-semantics=VARIABLE-SIZE, implementation-data-type=IDT_ADAS_enum_VPASpotLabel
    IDT_ICC_enum_RCTAWarnType: category=VALUE, base-type=uint8  # RCTA报警方式
    IDT_SentryModeAlarm: category=STRUCTURE  # 哨兵模式告警
      element DTE_sentryModeAlarmLevel: implementation-data-type=IDT_SentryModeAlarmLevel  # 哨兵模式告警等级
      element DTE_sentryModeAlarmReason: implementation-data-type=IDT_SentryModeAlarmReason  # 哨兵模式告警原因
    IDT_ADAS_enum_UNOPSts: category=VALUE, base-type=uint8
    IDT_ADAS_strt_MNPRoutesInfo: category=STRUCTURE
      element DTE_MNPMemRoutes: implementation-data-type=IDT_ADAS_arr_MNPMemRoutes  # 记忆路线信息数组
      element DTE_MNPMemRoutePoints: implementation-data-type=IDT_ADAS_arr_MNPMemRoutePoints  # 需要在SD显示的路线轨迹点
      element DTE_MNPRoutesReserved: implementation-data-type=IDT_MNPRoutes_arr_Reserved  # 预留
    IDT_ADAS_strt_LaneLine_2: category=STRUCTURE
      15 x element, all with category=TYPE_REFERENCE:
        DTE_lineIndex: implementation-data-type=IDT_ADAS_enum_LinePositionIndex  # 车道线索引
        DTE_lineId: implementation-data-type=IDT_Gen_uint64_ID  # 车道线ID
        DTE_lineColor: implementation-data-type=IDT_ADAS_enum_LineColor  # 车道线颜色
        DTE_lineType: implementation-data-type=IDT_ADAS_enum_LineType  # 车道线类型
        DTE_lineEquation_C{0..3}: implementation-data-type=IDT_ADAS_val_LineEquation_C{0..3}  # 车道线方程C{0..3}
        DTE_laneLineWidth: implementation-data-type=IDT_Gen_val_float32  # 车道线宽度
        DTE_lineStart_X: implementation-data-type=IDT_Gen_val_Coordinate_X  # 车道线起点X坐标
        DTE_lineStart_Y: implementation-data-type=IDT_Gen_val_Coordinate_Y  # 车道线起点Y坐标
        DTE_lineEnd_X: implementation-data-type=IDT_Gen_val_Coordinate_X  # 车道线终止点X坐标
        DTE_lineEnd_Y: implementation-data-type=IDT_Gen_val_Coordinate_Y  # 车道线终止点Y坐标
        DTE_LinePointList: implementation-data-type=IDT_ADAS_arr_LinePoint  # 车道线形点数组
        DTE_LaneLineReserved: implementation-data-type=IDT_LaneLine_arr_Reserved  # 预留
    IDT_ADAS_enum_RoadMarkerColor: category=VALUE, base-type=uint8  # 路面标记颜色
    IDT_ICC_arr_ExtensionLanes: category=STRUCTURE, dynamic-array-size-profile=VSA_LINEAR
      element sizeIndicator: implementation-data-type=specialIDT_DynamicLengthField_uint32
      element IDT_ICC_arr_ExtensionLanes: category=ARRAY
        element IDT_ICC_arr_ExtensionLanes: array-size=32, array-size-handling=ALL-INDICES-SAME-ARRAY-SIZE, array-size-semantics=VARIABLE-SIZE, implementation-data-type=IDT_ICC_strt_ExtenLaneAction
    IDT_ICC_enum_HandsOffWarningStyle: category=VALUE, base-type=uint8  # 脱手报警风格
    IDT_ADAS_enum_SglLCCMileage: category=VALUE, base-type=float32  # LCC行驶里程
    IDT_ADAS_strt_OCCPosition: category=STRUCTURE  # OCC位置
      element DTE_OCCPositionX: implementation-data-type=IDT_Gen_val_Coordinate_X  # OCC位置X
      element DTE_OCCPositionY: implementation-data-type=IDT_Gen_val_Coordinate_Y  # OCC位置Y
      element DTE_OCCPositionZ: implementation-data-type=IDT_Gen_val_Coordinate_Z  # OCC位置Z
    IDT_SimOperator: category=VALUE, base-type=uint32  # 切换到指定运营商
    IDT_ADAS_strt_DrivingTrajectoryPointList: category=STRUCTURE  # 引导面/引导线行点
      element DTE_DrivingTrajectoryPointNum: implementation-data-type=IDT_ADAS_val_DrivingTrajectoryPointNum  # 轨迹形点个数
      element DTE_DrivingTrajectoryPointList: implementation-data-type=IDT_ADAS_arr_DrivingTrajectoryPointList  # 轨迹形点数组
    IDT_ICC_arr_FrontExtenLanes: category=STRUCTURE, dynamic-array-size-profile=VSA_LINEAR
      element sizeIndicator: implementation-data-type=specialIDT_DynamicLengthField_uint32
      element IDT_ICC_arr_FrontExtenLanes: category=ARRAY
        element IDT_ICC_arr_FrontExtenLanes: array-size=32, array-size-handling=ALL-INDICES-SAME-ARRAY-SIZE, array-size-semantics=VARIABLE-SIZE, implementation-data-type=IDT_ICC_strt_ExtenLaneAction
    IDT_APARPAInfo_arr_Reserved: category=ARRAY  # 预留
      element Reserved_uint8_Type: array-size=48, array-size-semantics=FIXED-SIZE, implementation-data-type=IDT_Reserved_uint8_Type
    IDT_ADAS_strt_TrafficLightPos: category=STRUCTURE  # 交通灯箱位置
      element DTE_TrafficLightPosX: implementation-data-type=IDT_Gen_val_Coordinate_X  # 交通灯箱位置X
      element DTE_TrafficLightPosY: implementation-data-type=IDT_Gen_val_Coordinate_Y  # 交通灯箱位置Y
      element DTE_TrafficLightPosZ: implementation-data-type=IDT_Gen_val_Coordinate_Z  # 交通灯箱位置Z
    IDT_ADAS_enum_ISLISpdOffsetMod: category=VALUE, base-type=uint8
    IDT_StrVar_MSISDN: category=STRUCTURE, dynamic-array-size-profile=VSA_LINEAR  # 15位移动电话号码
      element sizeIndicator: implementation-data-type=specialIDT_DynamicLengthField_uint32
      element IDT_StrVar_MSISDN: category=ARRAY
        element IDT_StrVar_MSISDN: array-size=15, array-size-handling=ALL-INDICES-SAME-ARRAY-SIZE, array-size-semantics=VARIABLE-SIZE, implementation-data-type=specialIDT_StringRef
    IDT_ICC_enum_SubCameraExtType: category=VALUE, base-type=sint8
    IDT_ADAS_arr_DynamicObjects: category=STRUCTURE, dynamic-array-size-profile=VSA_LINEAR  # 行车动态目标数组
      element sizeIndicator: implementation-data-type=specialIDT_DynamicLengthField_uint32
      element IDT_ADAS_arr_DynamicObjects: category=ARRAY
        element IDT_ADAS_arr_DynamicObjects: array-size=42, array-size-handling=ALL-INDICES-SAME-ARRAY-SIZE, array-size-semantics=VARIABLE-SIZE, implementation-data-type=IDT_ADAS_strt_DynamicObject
    IDT_TimeInfoMsg: category=STRUCTURE  # 年月日时分秒
      7 x element, all with category=TYPE_REFERENCE:
        DTE_TimeInfoDay: implementation-data-type=IDT_TimeInfoDay  # 日
        DTE_TimeInfoHour: implementation-data-type=IDT_TimeInfoHour  # 时
        DTE_TimeInfoMinute: implementation-data-type=IDT_TimeInfoMinute  # 分
        DTE_TimeInfoMonth: implementation-data-type=IDT_TimeInfoMonth  # 月
        DTE_TimeInfoSecond: implementation-data-type=IDT_TimeInfoSecond  # 秒
        DTE_TimeInfoYear: implementation-data-type=IDT_TimeInfoYear  # 年
        DTE_TimeValid: implementation-data-type=IDT_Basic_enum_Valid  # 时间有效位
    IDT_ICC_arr_NaviCongestionDetailInfo: category=STRUCTURE, dynamic-array-size-profile=VSA_LINEAR
      element sizeIndicator: implementation-data-type=specialIDT_DynamicLengthField_uint32
      element IDT_ICC_arr_NaviCongestionDetailInfo: category=ARRAY
        element IDT_ICC_arr_NaviCongestionDetailInfo: array-size=10, array-size-handling=ALL-INDICES-SAME-ARRAY-SIZE, array-size-semantics=VARIABLE-SIZE, implementation-data-type=IDT_ICC_strt_NaviCongestionDetailInfo
    IDT_ephemerisDataIndexTotal: category=VALUE, base-type=uint8  # 星历数据一共有几包，A/P填写实际包个数；实时星历，固定填0
    IDT_ADAS_strt_HodDmsInfo: category=STRUCTURE
      4 x element, all with category=TYPE_REFERENCE:
        DTE_DriverhandsoffWarning: implementation-data-type=IDT_ADAS_enum_DriverHandsoffWarning  # 脱手报警
        DTE_DMSWarning: implementation-data-type=IDT_ADAS_enum_DMSWarning  # 脱眼报警
        DTE_HandsOnReq: implementation-data-type=IDT_ADAS_enum_HandsOnReq  # 请求驾驶员握住方向盘提示
        DTE_HODWarnSettingStFb: implementation-data-type=IDT_ADAS_enum_HODWarnSettingStFb  # 脱手模式
    IDT_Gen_enum_CalibrationSts: category=VALUE, base-type=uint8
    IDT_TrafficLightInfo_arr_Reserved: category=ARRAY
      element Reserved_uint8_Type: array-size=20, array-size-semantics=FIXED-SIZE, implementation-data-type=IDT_Reserved_uint8_Type
    IDT_ICC_strt_NaviSubCameraExt: category=STRUCTURE
      11 x element, all with category=TYPE_REFERENCE:
        DTE_SubCameraId: implementation-data-type=IDT_Gen_int32_ID  # 细类电子眼id
        DTE_BuswayTimeEnable: implementation-data-type=IDT_ICC_int32_Busway  # 公交车道是否生效
        DTE_SubType: implementation-data-type=IDT_ICC_int32_SubType  # 电子眼的详细违章类型
        DTE_Penalty: implementation-data-type=IDT_ICC_int32_Penalty  # 高罚数据是否生效
        DTE_CameraPriority: implementation-data-type=IDT_ICC_int32_CameraPriority  # 电子眼显示优先级
        DTE_CameraisNew: implementation-data-type=IDT_ICC_boolean_isNew  # 是否是新增电子眼
        DTE_CameraisVariableSpeed: implementation-data-type=IDT_ICC_boolean_isVariable  # 是否可变限速电子眼
        DTE_CameraisMatch: implementation-data-type=IDT_ICC_boolean_isMatch  # 区间测速是否配对:仅对区间测速电子眼生效
        DTE_CameraisSpecial: implementation-data-type=IDT_ICC_boolean_isSpecial  # 城市特色电子眼标识
        DTE_CameraSpeedLimit: implementation-data-type=IDT_ICC_arr_CameraSpeed  # 电子眼限速
        DTE_SubCameraExtReserved: implementation-data-type=IDT_SubCameraExt_arr_Reserved  # 预留
    IDT_ResetCommandResponse: category=STRUCTURE  # 恢厂指令响应
      element DTE_FactoryResetSartCode: implementation-data-type=IDT_FactoryResetSartCode  # 恢厂指令接收码
      element DTE_FactoryResetTimeLength: implementation-data-type=IDT_FactoryResetTimeLength  # 恢厂所需时间
    IDT_ADAS_enum_MNPNewRouteSaving: category=VALUE, base-type=uint8  # 记忆路线保存进度
    IDT_ADAS_Stub_NumOfLaneOppDir: category=VALUE, base-type=uint8
    IDT_ICC_string_GateName: category=STRUCTURE, dynamic-array-size-profile=VSA_LINEAR
      element sizeIndicator: implementation-data-type=specialIDT_DynamicLengthField_uint32
      element IDT_ICC_string_GateName: category=ARRAY
        element IDT_ICC_string_GateName: array-size=300, array-size-handling=ALL-INDICES-SAME-ARRAY-SIZE, array-size-semantics=VARIABLE-SIZE, implementation-data-type=specialIDT_StringRef
    IDT_ADAS_enum_ParkingFailureReasonInd: category=VALUE, base-type=uint8
    IDT_ADAS_strt_StaticObject_2: category=STRUCTURE
      9 x element, all with category=TYPE_REFERENCE:
        DTE_objectId: implementation-data-type=IDT_Gen_uint64_ID  # 目标id
        DTE_objectType: implementation-data-type=IDT_ADAS_enum_StaticObjectType  # 目标类型
        DTE_objectPoseX: implementation-data-type=IDT_Gen_val_Coordinate_X  # 目标位置X坐标
        DTE_objectPoseY: implementation-data-type=IDT_Gen_val_Coordinate_Y  # 目标位置Y坐标
        DTE_objectYaw: implementation-data-type=IDT_Gen_val_Yaw  # 目标位姿
        DTE_objectLength: implementation-data-type=IDT_Gen_val_Length  # 目标长度
        DTE_objecWidth: implementation-data-type=IDT_Gen_val_Width  # 目标宽度
        DTE_timestampnSec: implementation-data-type=IDT_ADAS_val_timestampnSec  # 时间戳-纳秒
        DTE_laneID: implementation-data-type=IDT_ADAS_uint64_laneID  # 目标所属车道ID
    IDT_ICC_enum_MNPAllRoutesInfoReq: category=VALUE, base-type=uint8  # 请求获取全部记忆路线信息
    IDT_ADAS_val_RemainingTime: category=VALUE, base-type=uint8  # 红绿灯剩余时间
    IDT_ADAS_ego_vehicleSpd: category=VALUE, base-type=float32
    IDT_Bool_Ephemeris: category=VALUE, base-type=uint8  # 是否有星历信息 Is there any ephemeris information
    IDT_ADAS_strt_UNOPfunctionInfo: category=STRUCTURE
      7 x element, all with category=TYPE_REFERENCE:
        DTE_UNOPSts: implementation-data-type=IDT_ADAS_enum_UNOPSts  # 城市领航辅助状态
        DTE_SidePassConfirmReq: implementation-data-type=IDT_ADAS_enum_SidePassConfirmReq  # 绕行请求驾驶员确认
        DTE_SidePassSt: implementation-data-type=IDT_ADAS_enum_SidePassSt  # 绕行功能状态
        DTE_IntersectionDriBehavior: implementation-data-type=IDT_ADAS_enum_IntersectionDriBehavior  # 十字路口行为
        DTE_UNOPScenariosReminder: implementation-data-type=IDT_ADAS_enum_UNOPScenariosReminder  # HNOP场景提示信息
        DTE_UrbanTrafficLight: implementation-data-type=IDT_ADAS_arr_TrafficLight  # 城区交通灯信息
        DTE_TLRFcnSts: implementation-data-type=IDT_Gen_enum_OnOffSts  # 交通灯状态反馈
    IDT_ADAS_enum_RoadMarkerTrackingSts: category=VALUE, base-type=uint8  # 路面标记跟踪状态
    IDT_Array_CallNumberList: category=STRUCTURE, dynamic-array-size-profile=VSA_LINEAR  # 电话号码列表
      element sizeIndicator: implementation-data-type=specialIDT_DynamicLengthField_uint32
      element IDT_Array_CallNumberList: category=ARRAY
        element IDT_Array_CallNumberList: array-size=3, array-size-handling=ALL-INDICES-SAME-ARRAY-SIZE, array-size-semantics=VARIABLE-SIZE, implementation-data-type=IDT_Struct_CallNumberList
    IDT_StrVar_NMEA: category=STRUCTURE, dynamic-array-size-profile=VSA_LINEAR
      element sizeIndicator: implementation-data-type=specialIDT_DynamicLengthField_uint32
      element IDT_StrVar_NMEA: category=ARRAY
        element IDT_StrVar_NMEA: array-size=3072, array-size-handling=ALL-INDICES-SAME-ARRAY-SIZE, array-size-semantics=VARIABLE-SIZE, implementation-data-type=specialIDT_StringRef
    IDT_ICC_enum_HPASlotSearchOperationID: category=VALUE, base-type=uint8
    IDT_ICC_arr_BackExtenLanes: category=STRUCTURE, dynamic-array-size-profile=VSA_LINEAR
      element sizeIndicator: implementation-data-type=specialIDT_DynamicLengthField_uint32
      element IDT_ICC_arr_BackExtenLanes: category=ARRAY
        element IDT_ICC_arr_BackExtenLanes: array-size=32, array-size-handling=ALL-INDICES-SAME-ARRAY-SIZE, array-size-semantics=VARIABLE-SIZE, implementation-data-type=IDT_ICC_strt_ExtenLaneAction
    IDT_ICC_arr_AheadLaneInfoList: category=STRUCTURE, dynamic-array-size-profile=VSA_LINEAR  # 前方路口信息列表
      element sizeIndicator: implementation-data-type=specialIDT_DynamicLengthField_uint32
      element IDT_ICC_arr_AheadLaneInfoList: category=ARRAY
        element IDT_ICC_arr_AheadLaneInfoList: array-size=6, array-size-handling=ALL-INDICES-SAME-ARRAY-SIZE, array-size-semantics=VARIABLE-SIZE, implementation-data-type=IDT_ICC_strt_LaneInfo
    IDT_Gen_val_Pitch: category=VALUE, base-type=float32  # 俯仰角
    IDT_DrivingSound_arr_Reserved: category=ARRAY  # 预留
      element Reserved_uint8_Type: array-size=30, array-size-semantics=FIXED-SIZE, implementation-data-type=IDT_Reserved_uint8_Type
    IDT_OutgoingTotalTime: category=VALUE, base-type=uint32  # 拨出电话时长总计
    IDT_StrVar_ECUHardwareNumber: category=STRUCTURE, dynamic-array-size-profile=VSA_LINEAR  # ECU硬件号
      element sizeIndicator: implementation-data-type=specialIDT_DynamicLengthField_uint32
      element IDT_StrVar_ECUHardwareNumber: category=ARRAY
        element IDT_StrVar_ECUHardwareNumber: array-size=5, array-size-handling=ALL-INDICES-SAME-ARRAY-SIZE, array-size-semantics=VARIABLE-SIZE, implementation-data-type=specialIDT_StringRef
    IDT_TunnelInfo_arr_Reserved: category=ARRAY  # 预留
      element Reserved_int32_Type: array-size=100, array-size-semantics=FIXED-SIZE, implementation-data-type=IDT_Reserved_int32_Type
    IDT_ADAS_enum_ParkingPauseInd: category=VALUE, base-type=uint8
    IDT_ICC_int32_LinkRemainDist: category=VALUE, base-type=sint32
    IDT_ICC_str_NaviCongestionExtend: category=STRUCTURE
      4 x element, all with category=TYPE_REFERENCE:
        DTE_cause: implementation-data-type=IDT_ICC_enum_Cause  # 拥堵原因:车祸、车道变窄、更换高速 0-无 icon 不展示 1-施工，2-交通事故，3-管制调 度,4-积水，5-积冰，6-积雪，7-红绿灯
        DTE_trend: implementation-data-type=IDT_ICC_enum_Trend  # 拥堵趋势
        DTE_EventID: implementation-data-type=IDT_ICC_val_ID  # 拥堵事件ID
        DTE_CongestionAffect: implementation-data-type=IDT_ICC_enum_Affect  # 拥堵影响车道
    IDT_TimeInfoMinute: category=VALUE, base-type=uint8  # 分
    IDT_ADSHMINotificationMessage: category=STRUCTURE, dynamic-array-size-profile=VSA_LINEAR  # ADS HMI数据通道通知
      element sizeIndicator: implementation-data-type=specialIDT_DynamicLengthField_uint32
      element IDT_ADSHMINotificationMessage: category=ARRAY
        element IDT_ADSHMINotificationMessage: array-size=1048576, array-size-handling=ALL-INDICES-SAME-ARRAY-SIZE, array-size-semantics=VARIABLE-SIZE, implementation-data-type=IDT_ADSHMIBasicElement
    IDT_VhrLogEndTime: category=VALUE, base-type=sint64
    IDT_AdvPrkg_arr_Reserved: category=ARRAY  # 预留
      element Reserved_uint8_Type: array-size=50, array-size-semantics=FIXED-SIZE, implementation-data-type=IDT_Reserved_uint8_Type
    IDT_ADAS_ProfShort_Value1: category=VALUE, base-type=uint16
    IDT_ADAS_strt_ActiveSafetyFcnInfo_2: category=STRUCTURE
      10 x element, all with category=TYPE_REFERENCE:
        DTE_FcwSts: implementation-data-type=IDT_ADAS_enum_FcwSts  # FCW功能状态
        DTE_AebSts: implementation-data-type=IDT_ADAS_enum_AebSts  # AEB功能状态
        DTE_FcwWarnDist: implementation-data-type=IDT_ADAS_enum_FcwWarnDist  # FCW报警距离
        DTE_FcwAcitveSt: implementation-data-type=IDT_ADAS_enum_FcwAcitveSt  # FCW执行状态
        DTE_AebAcitveSt: implementation-data-type=IDT_ADAS_enum_AebAcitveSt  # AEB执行状态
        DTE_FCWAEBTextInfomation: implementation-data-type=IDT_ADAS_enum_FCWAEBTextInfo  # FCW/AEB文言提示信息
        DTE_FCTAWarnTypeSts: implementation-data-type=IDT_ADAS_enum_FCTAWarnTypeSts  # FCTA报警类型状态
        DTE_FCTAWarningActiveSt: implementation-data-type=IDT_ADAS_enum_FCTAWarnActSt  # FCTA报警执行状态
        DTE_FCTBWarningActiveSt: implementation-data-type=IDT_ADAS_enum_FCTBWarnActSt  # FCTB报警执行状态
        DTE_ActiveSafetyFcnReserved: implementation-data-type=IDT_ActiveSafetyFcn_arr_Reserved  # 预留
    IDT_Enum_CamStreamSwt: category=VALUE, base-type=uint8  # 相机视频流开关请求 Camera Video Stream Switch Request
    IDT_Enum_SatelTypeInfo: category=VALUE, base-type=uint8  # 卫星类型信息 Satellite type information
    IDT_ADAS_arr_LaneCenterPoint: category=ARRAY
      element ADAS_strt_LaneCenterPoint: array-size=64, array-size-semantics=FIXED-SIZE, implementation-data-type=IDT_ADAS_strt_LaneCenterPoint
    IDT_SimSwitchEventReserved: category=ARRAY  # 切卡事件通知预留
      element INI_ReservedUnit8: array-size=16, array-size-semantics=FIXED-SIZE, implementation-data-type=IDT_INI_ReservedUnit8
    IDT_ADAS_strt_TLRInfo: category=STRUCTURE  # TLR功能输出信息
      6 x element, all with category=TYPE_REFERENCE:
        DTE_TLRONOFFSts: implementation-data-type=IDT_ADAS_enum_TLRONOFFSts  # 交通灯识别系统开关状态
        DTE_TLRSts: implementation-data-type=IDT_ADAS_enum_TLRSts  # 交通灯识别功能状态
        DTE_LeftTrafficLight: implementation-data-type=IDT_ADAS_strt_Light  # 左转红绿灯信息
        DTE_StraightTrafficLight: implementation-data-type=IDT_ADAS_strt_Light  # 直行红绿灯信息
        DTE_RightTrafficLight: implementation-data-type=IDT_ADAS_strt_Light  # 右转红绿灯信息
        DTE_TLRInfoReserved: implementation-data-type=IDT_TLRInfo_arr_Reserved  # 预留
    IDT_L3state: category=VALUE, base-type=uint8  # L3智驾状态信息
    IDT_ICC_enum_RPASettingSt: category=VALUE, base-type=uint8  # 遥控泊车设置状态
    IDT_ADAS_val_heading: category=VALUE, base-type=float32
    IDT_RampInfo_arr_Reserved: category=ARRAY  # 预留
      element Reserved_int32_Type: array-size=100, array-size-semantics=FIXED-SIZE, implementation-data-type=IDT_Reserved_int32_Type
    IDT_ADAS_enum_MNPNewRoute: category=VALUE, base-type=uint8  # 可以新建路线提示
    IDT_FacilityInfo_arr_Reserved: category=ARRAY  # 预留
      element Reserved_int32_Type: array-size=100, array-size-semantics=FIXED-SIZE, implementation-data-type=IDT_Reserved_int32_Type
    IDT_ADAS_strt_TrajectoryPoint: category=STRUCTURE
      element DTE_Coordinate_X: implementation-data-type=IDT_Gen_val_Coordinate_X  # X坐标
      element DTE_Coordinate_Y: implementation-data-type=IDT_Gen_val_Coordinate_Y  # Y坐标
    IDT_ICC_arr_CrossNaviInfo: category=STRUCTURE, dynamic-array-size-profile=VSA_LINEAR
      element sizeIndicator: implementation-data-type=specialIDT_DynamicLengthField_uint32
      element IDT_ICC_arr_CrossNaviInfo: category=ARRAY
        element IDT_ICC_arr_CrossNaviInfo: array-size=10, array-size-handling=ALL-INDICES-SAME-ARRAY-SIZE, array-size-semantics=VARIABLE-SIZE, implementation-data-type=IDT_ICC_strt_CrossNaviInfo
    IDT_Str_CamStreamStResp: category=STRUCTURE  # 摄像头视频状态反馈 Camera Video Status Response
      element DTE_CamStreamOrntn: implementation-data-type=IDT_Enum_CamStreamOrntn  # 相机视频流方位 Camera Video Stream Orientation
      element DTE_CamStreamStResp: implementation-data-type=IDT_Enum_CamStreamSt  # 相机视频流状态反馈 Camera Video Stream Status Response
      element DTE_CamStreamStRespResd: implementation-data-type=IDT_Arr_CamStreamStRespResd  # 预留 Reserved
    IDT_ICC_boolean_isSpecial: category=VALUE, base-type=sint32  # 城市特色电子眼标识
    IDT_ADAS_enum_LKSLeftTrackingSt: category=VALUE, base-type=uint8
    IDT_ADAS_val_OCCNum: category=VALUE, base-type=uint16  # freespace个数
    IDT_TimeInfoSecond: category=VALUE, base-type=uint8  # 秒
    IDT_ADAS_Seg_NumOfLaneDrvDir: category=VALUE, base-type=uint8
    IDT_ICC_float_Speed: category=VALUE, base-type=float32
    IDT_ICC_enum_MNPRouteInfoReq: category=STRUCTURE, dynamic-array-size-profile=VSA_LINEAR  # 请求当前记忆路线信息
      element sizeIndicator: implementation-data-type=specialIDT_DynamicLengthField_uint32
      element IDT_ICC_enum_MNPRouteInfoReq: category=ARRAY
        element IDT_ICC_enum_MNPRouteInfoReq: array-size=100, array-size-handling=ALL-INDICES-SAME-ARRAY-SIZE, array-size-semantics=VARIABLE-SIZE, implementation-data-type=specialIDT_StringRef
    IDT_ADAS_enum_OutsideParkingBtnStFb: category=VALUE, base-type=uint8  # 离车泊入开关设置反馈
    IDT_Struct_RouteMMSeg: category=STRUCTURE  # HD路线匹配段落
      7 x element, all with category=TYPE_REFERENCE:
        DTE_startMatchedLinkIdx: implementation-data-type=IDT_DataUint32  # 段落开始对应SDLink的index
        DTE_startShapePointIdx: implementation-data-type=IDT_DataUint32  # 段落开始对应SDLink形点的index
        DTE_startMatchedPoint: implementation-data-type=IDT_Struct_GeoPos2D  # 段落开始点坐标
        DTE_endMatchedLinkIdx: implementation-data-type=IDT_DataUint32  # 段落结束对应SDLink的index
        DTE_endShapePointIdx: implementation-data-type=IDT_DataUint32  # 段落结束对应SDLink形点的index
        DTE_endMatchedPoint: implementation-data-type=IDT_Struct_GeoPos2D  # 段落结束点坐标
        DTE_segLength: implementation-data-type=IDT_DataUint32  # 段落长度
    IDT_ICC_int32_CruiseFacilitType: category=VALUE, base-type=sint32
    IDT_ADAS_enum_TolRecordUploadBtnFb: category=VALUE, base-type=uint8  # 录音上传状态反馈
    IDT_ADAS_strt_VPAParkingLotInfo: category=STRUCTURE  # VPA停车场信息
      element DTE_VPAParkingLotList: implementation-data-type=IDT_ADAS_arr_VPAParkingLotInfo  # VPA的状态
    IDT_ADAS_enum_HPAPopup: category=VALUE, base-type=uint8
    IDT_ADAS_val_ParkingDist: category=VALUE, base-type=float32
    IDT_ADAS_strt_ParkingSlot_2: category=STRUCTURE
      10 x element, all with category=TYPE_REFERENCE:
        DTE_SlotID: implementation-data-type=IDT_ADAS_val_SlotID  # 车位ID
        DTE_SlotType: implementation-data-type=IDT_ADAS_enum_SlotType  # 车位类型
        DTE_SlotStatus: implementation-data-type=IDT_ADAS_enum_SlotStatus  # 车位可用状态
        DTE_SlotPointTop1: implementation-data-type=IDT_ADAS_strt_HPAVPAPathInfo  # 车位顶点1
        DTE_SlotPointTop2: implementation-data-type=IDT_ADAS_strt_HPAVPAPathInfo  # 车位顶点2
        DTE_SlotPointBottom1: implementation-data-type=IDT_ADAS_strt_HPAVPAPathInfo  # 车位顶点3
        DTE_SlotPointBottom2: implementation-data-type=IDT_ADAS_strt_HPAVPAPathInfo  # 车位顶点4
        DTE_SlotNum: implementation-data-type=IDT_Gen_val_ID  # 车位序号
        DTE_SlotFloor: implementation-data-type=IDT_ADAS_enum_HPAFloor  # 车位楼层
        DTE_ParkingSlotReserved: implementation-data-type=IDT_PrkgSlot_arr_Reserved  # 预留
    IDT_ADAS_enumTargetObjColor: category=VALUE, base-type=uint8  # 目标颜色
    IDT_ICC_strt_HPAPathOperation: category=STRUCTURE
      4 x element, all with category=TYPE_REFERENCE:
        DTE_PathOperationId: implementation-data-type=IDT_ICC_enum_PathOperationId  # 路线操作指令
        DTE_PathId: implementation-data-type=IDT_ICC_uint8_PathId  # 路线ID
        DTE_SetPathName: implementation-data-type=IDT_ICC_string_SetPathName  # 路线名称
        DTE_SetPathLabel: implementation-data-type=IDT_ICC_enum_SetPathLabel  # 路线标签
    IDT_ADAS_strt_TrafficLightInfo: category=STRUCTURE  # 交通灯信息
      6 x element, all with category=TYPE_REFERENCE:
        DTE_TrafficLightId: implementation-data-type=IDT_Gen_val_ID  # 交通灯箱ID
        DTE_TrafficLightPos: implementation-data-type=IDT_ADAS_strt_TrafficLightPos  # 交通灯箱位置
        DTE_TrafficLightType: implementation-data-type=IDT_ADAS_enum_TrafficLightsType  # 交通灯箱类型
        DTE_LightNum: implementation-data-type=IDT_ADAS_val_LightNum  # 红绿灯个数
        DTE_LightList: implementation-data-type=IDT_ADAS_arr_LightList  # 红绿灯数组
        DTE_TrafficLightInfoReserved: implementation-data-type=IDT_TrafficLightInfo_arr_Reserved  # 预留
    IDT_ICC_boolean_ScopeFlag_1: category=VALUE, base-type=sint32
    IDT_Struct_ExtMMResWLnk: category=STRUCTURE  # 车道级地图匹配结果
      element DTE_timestamp: implementation-data-type=IDT_DataUint64  # 时间戳ms
      element DTE_mode: implementation-data-type=IDT_Enum_MatchingMode  # map match mode state, defined by enum MatchingMode
      element DTE_lane: implementation-data-type=IDT_Struct_LanePositionInfo  # Lane匹配信息 ，onlane，offlane状态参考mode
    IDT_Struct_TBOXOTARemoteAPPTSet: category=STRUCTURE  # 远控OTA预约升级
      element DTE_ScheduleID: implementation-data-type=IDT_StrVar_ScheduleID  # OTA的任务ID
      element DTE_OTAAPPTSecs: implementation-data-type=IDT_OTAAPPTSecs  # 预约升级时间
    IDT_ADAS_enum_HPAVPARepalyRemind: category=VALUE, base-type=uint8
    IDT_ADAS_enum_ELKSts: category=VALUE, base-type=uint8
    IDT_EcallModeFed: category=VALUE, base-type=uint8  # Ecall触发方式反馈
    IDT_ICC_enum_NavSpeedLimitStatus: category=VALUE, base-type=uint8  # 导航地图状态
    IDT_ICC_string_Address: category=STRUCTURE, dynamic-array-size-profile=VSA_LINEAR
      element sizeIndicator: implementation-data-type=specialIDT_DynamicLengthField_uint32
      element IDT_ICC_string_Address: category=ARRAY
        element IDT_ICC_string_Address: array-size=1000, array-size-handling=ALL-INDICES-SAME-ARRAY-SIZE, array-size-semantics=VARIABLE-SIZE, implementation-data-type=specialIDT_StringRef
    IDT_ADAS_enum_LeaveFastLaneSts: category=VALUE, base-type=uint8
    IDT_ADAS_enum_FCWAEBTextInfo: category=VALUE, base-type=uint8  # FCW/AEB文言提示信息
    IDT_DVRRequest: category=VALUE, base-type=uint8
    IDT_ADAS_Posn_PosProbb: category=VALUE, base-type=uint8
    IDT_ADAS_Stub_LastStub: category=VALUE, base-type=uint8
    IDT_StrVar_BleSlaverRearVer: category=STRUCTURE, dynamic-array-size-profile=VSA_LINEAR  # 蓝牙后从模块软件版本
      element sizeIndicator: implementation-data-type=specialIDT_DynamicLengthField_uint32
      element IDT_StrVar_BleSlaverRearVer: category=ARRAY
        element IDT_StrVar_BleSlaverRearVer: array-size=24, array-size-handling=ALL-INDICES-SAME-ARRAY-SIZE, array-size-semantics=VARIABLE-SIZE, implementation-data-type=specialIDT_StringRef
    IDT_ADAS_enum_LKS_warning: category=VALUE, base-type=uint8
    IDT_StrVar_ProductID: category=STRUCTURE, dynamic-array-size-profile=VSA_LINEAR  # TBOX产品唯一ID
      element sizeIndicator: implementation-data-type=specialIDT_DynamicLengthField_uint32
      element IDT_StrVar_ProductID: category=ARRAY
        element IDT_StrVar_ProductID: array-size=16, array-size-handling=ALL-INDICES-SAME-ARRAY-SIZE, array-size-semantics=VARIABLE-SIZE, implementation-data-type=specialIDT_StringRef
    IDT_ICC_enum_NOPEnableBtnSts: category=VALUE, base-type=uint8  # NOP功能使能开关
    IDT_VhrLogStartTime: category=VALUE, base-type=sint64
    IDT_GnssRawInfo: category=STRUCTURE, dynamic-array-size-profile=VSA_LINEAR  # GNSS原始数据上报
      element sizeIndicator: implementation-data-type=specialIDT_DynamicLengthField_uint32
      element IDT_GnssRawInfo: category=ARRAY
        element IDT_GnssRawInfo: array-size=65535, array-size-handling=ALL-INDICES-SAME-ARRAY-SIZE, array-size-semantics=VARIABLE-SIZE, implementation-data-type=IDT_GnssRawInfoElement
    IDT_ADAS_enum_MNPSts: category=VALUE, base-type=uint8  # MNP工作状态
    IDT_ADAS_enum_ParkingButtonSts: category=VALUE, base-type=uint8
    IDT_Dbl_GndHeadInfo: category=VALUE, base-type=float64  # 地面航向信息 Ground course information
    IDT_StrVar_password: category=STRUCTURE, dynamic-array-size-profile=VSA_LINEAR
      element sizeIndicator: implementation-data-type=specialIDT_DynamicLengthField_uint32
      element IDT_StrVar_password: category=ARRAY
        element IDT_StrVar_password: array-size=15, array-size-handling=ALL-INDICES-SAME-ARRAY-SIZE, array-size-semantics=VARIABLE-SIZE, implementation-data-type=specialIDT_StringRef
    IDT_ADAS_val_FSRACruiseSpdOffsetPercentFb: category=VALUE, base-type=sint8
    IDT_ValetParkingPointNum: category=VALUE, base-type=uint32  # 代客泊车路点个数
    IDT_ICC_enum_Affect: category=STRUCTURE, dynamic-array-size-profile=VSA_LINEAR  # 拥堵影响车道
      element sizeIndicator: implementation-data-type=specialIDT_DynamicLengthField_uint32
      element IDT_ICC_enum_Affect: category=ARRAY
        element IDT_ICC_enum_Affect: array-size=50, array-size-handling=ALL-INDICES-SAME-ARRAY-SIZE, array-size-semantics=VARIABLE-SIZE, implementation-data-type=specialIDT_StringRef
    IDT_ADAS_enum_DynamicObjectType: category=VALUE, base-type=uint8  # 目标类型
    IDT_DataUint64: category=VALUE, base-type=uint64  # 无符号64位整型
    IDT_Struct_LogPrepare: category=STRUCTURE  # TBOX日志上传准备状态
      element DTE_LogPrepareState: implementation-data-type=IDT_Enum_LogPrepareState  # 日志上传是否准备好
      element DTE_fileName: implementation-data-type=IDT_StrVar_fileName  # log文件名称
    IDT_ICC_enum_RADSEnableBtnSt: category=VALUE, base-type=uint8  # 循迹倒车软开关
    IDT_ICC_enum_DAIEnableBtnSt: category=VALUE, base-type=uint8  # DAI功能使能开关
    IDT_ADAS_enum_VPAPauseInd: category=VALUE, base-type=uint8
    IDT_Arr_SatelInfo: category=STRUCTURE, dynamic-array-size-profile=VSA_LINEAR  # 卫星信息 satellites information
      element sizeIndicator: implementation-data-type=specialIDT_DynamicLengthField_uint32
      element IDT_Arr_SatelInfo: category=ARRAY
        element IDT_Arr_SatelInfo: array-size=100, array-size-handling=ALL-INDICES-SAME-ARRAY-SIZE, array-size-semantics=VARIABLE-SIZE, implementation-data-type=IDT_Strt_SatelInfo
    IDT_ADAS_MsgType: category=VALUE, base-type=uint8
    IDT_ADAS_Meta_DrvSide: category=VALUE, base-type=uint8
    IDT_ADAS_enum_ISLISpeedLimitUnit: category=VALUE, base-type=uint8
    IDT_ICC_enum_SpeedLimitValue: category=VALUE, base-type=uint8
    IDT_ADAS_Meta_HwVer: category=VALUE, base-type=uint16
    IDT_ADAS_val_TrafficLightNum: category=VALUE, base-type=uint8  # 交通灯箱个数
    IDT_Bool_PrevPosnUesdInfo: category=VALUE, base-type=uint8  # 是否在前次定位中使用过信息 Was the information used in the previous positioning
    IDT_ADAS_strt_FusionMapInfo: category=STRUCTURE  # HMI app用于地图元素渲染的数据，主要是服务端经过复杂的三角剖分处理，分担app的计算性能。
      7 x element, all with category=TYPE_REFERENCE:
        DTE_Boundary: implementation-data-type=IDT_ADAS_strt_FusionMapPoint  # 车道线信息(包含停止线)
        DTE_Curb: implementation-data-type=IDT_ADAS_strt_FusionMapPoint  # 路沿信息
        DTE_RoadLine: implementation-data-type=IDT_ADAS_strt_FusionMapPoint  # 车行驶的中间道路信息
        DTE_CrossWalk: implementation-data-type=IDT_ADAS_strt_FusionMapPoint  # 斑马线信息
        DTE_FreeSpace: implementation-data-type=IDT_ADAS_strt_FusionMapPoint  # 可行驶区域
        DTE_NOPLaneChangeTargetPosition: implementation-data-type=IDT_ADAS_strt_EgoPose  # 领航辅助变道的目标位置
        DTE_NOPLaneChangeLaneCenterPoint: implementation-data-type=IDT_ADAS_arr_LaneCenterPoint  # 领航辅助变道的中心线
    IDT_ValetParkingStatusReserved: category=ARRAY  # 代客泊车实时信息预留
      element ADS_ReservedUnit8: array-size=16, array-size-semantics=FIXED-SIZE, implementation-data-type=IDT_ADS_ReservedUnit8
    IDT_ADAS_uint64_laneID: category=VALUE, base-type=uint64  # 目标所属车道ID
    IDT_ADAS_strt_HNOPSupplementInfo: category=STRUCTURE
      26 x element, all with category=TYPE_REFERENCE:
        DTE_HNOPSts: implementation-data-type=IDT_ADAS_enum_HNOPSts  # 高速领航辅助状态
        DTE_NOPLaneChangeMod: implementation-data-type=IDT_ADAS_enum_NOPLaneChangeMod  # 领航辅助变道模式
        DTE_NOPLaneChangeStyle: implementation-data-type=IDT_ADAS_enum_NOPLaneChangeStyle  # 领航辅助速控模式
        DTE_NOPLaneChangeInfo: implementation-data-type=IDT_ADAS_enum_NOPLaneChangeInfo  # 领航辅助变道状态信息
        DTE_SafeStopReminder: implementation-data-type=IDT_ADAS_enum_SafeStopReminder  # 领航辅助执行安全停车提示
        DTE_NOPQuitReason: implementation-data-type=IDT_ADAS_enum_NOPQuitReason  # 领航辅助退出原因
        DTE_NOPALCReqDriverConf: implementation-data-type=IDT_ADAS_enum_NOPALCReqDriverConf  # 推荐变道请求确认
        DTE_NOPDegradeReminder: implementation-data-type=IDT_ADAS_enum_DegradeReminder  # 领航辅助升降级行为提示
        DTE_NOPStReminder: implementation-data-type=IDT_ADAS_enum_NOPStReminder  # 领航辅助状态提示
        DTE_NOPLaneChangeReason: implementation-data-type=IDT_ADAS_enum_NOPLaneChangeReason  # 领航辅助变道原因
        DTE_HNOPScenariosReminder: implementation-data-type=IDT_ADAS_enum_HNOPScenariosReminder  # HNOP场景提示信息
        DTE_Confidencelevel: implementation-data-type=IDT_ADAS_enum_Confidencelevel  # 场景控制置信度
        DTE_TrajectoryPoint: implementation-data-type=IDT_ADAS_arr_TrajectoryPoint  # 决策引导线
        DTE_LeaveFastLaneSts: implementation-data-type=IDT_ADAS_enum_LeaveFastLaneSts  # 驶离快车道模式设置状态反馈
        DTE_NOPLaneChangeWarnTypeFb: implementation-data-type=IDT_ADAS_enum_NOPLaneChangeWarnType  # 领航辅助变道报警类型
        DTE_NOPLCPermitSt: implementation-data-type=IDT_ADAS_enum_LCPermitSt  # 领航辅助变道允许状态
        DTE_HNOACruiseSpdOffsetModFb: implementation-data-type=IDT_ADAS_enum_HNOACruiseSpdOffsetModFb  # 车速偏移方式反馈
        DTE_HNOACruiseSpdOffsetSpdFb: implementation-data-type=IDT_ADAS_val_HNOACruiseSpdOffsetSpdFb  # 固定偏移速度反馈
        DTE_HNOACruiseSpdOffsetPercentFb: implementation-data-type=IDT_ADAS_val_HNOACruiseSpdOffsetPercentFb  # 百分比偏移速度反馈
        DTE_DrivingTrajectoryPointList: implementation-data-type=IDT_ADAS_strt_DrivingTrajectoryPointList  # 决策引导线
        DTE_StopLineFlag: implementation-data-type=IDT_ADAS_enum_StopLineFlag  # 引导线中的停止线是否生效标志
        DTE_DrivingGuidingSurfacePointList: implementation-data-type=IDT_ADAS_strt_DrivingTrajectoryPointList  # 引导面
        DTE_NOALCCSwitchBtnONOFFSts: implementation-data-type=IDT_ADAS_enum_NOALCCSwitchBtnONOFFSts  # NOA与LCC切换按钮显示状态
        DTE_NOARemainingMileageFromODD: implementation-data-type=IDT_ADAS_enum_NOARemainingMileageFromODD  # 距离前方ODD终点里程数
        DTE_HNOPConfidence: implementation-data-type=IDT_ADAS_enum_HNOPConfidence  # 高速领航辅助置信度
        DTE_HNOPSupplementInfoReserved: implementation-data-type=IDT_HNOPSupplementInfo_arr_Reserved  # 预留
    IDT_WeatherInfo_arr_Reserved_1: category=ARRAY
      element Reserved_int32_Type: array-size=15, array-size-semantics=FIXED-SIZE, implementation-data-type=IDT_Reserved_int32_Type
    IDT_ICC_enum_HODWarnSettingSt: category=VALUE, base-type=uint8  # HOD脱手模式状态
    IDT_IcaNcaL3State: category=STRUCTURE  # ICA/L2NCA/L3智驾激活与否状态信息扩展
      4 x element, all with category=TYPE_REFERENCE:
        DTE_icaState: implementation-data-type=IDT_IcaState  # ICA状态信息
        DTE_l2NCAState: implementation-data-type=IDT_L2NCAState  # L2NCA状态信息
        DTE_l3state: implementation-data-type=IDT_L3state  # L3智驾状态信息
        DTE_reserved: implementation-data-type=IDT_IcaNcaL3StateReserved  # 预留字段
    IDT_LanePositionInfo_offset_Lateral: category=VALUE, base-type=float32
    IDT_ADAS_ProfShort_Value0: category=VALUE, base-type=uint16
    IDT_PermissionConfigState: category=VALUE, base-type=boolean  # 权限的开关值
    IDT_Speed: category=VALUE, base-type=float32
    IDT_ADAS_enumTargetObjID: category=VALUE, base-type=uint8  # 目标ID
    IDT_Gen_int64_ID: category=VALUE, base-type=sint64
    IDT_ADAS_val_MNPMemRoutePointsNum: category=VALUE, base-type=uint16  # 路线轨迹点数量
    IDT_ICC_strt_CrossNaviInfo: category=STRUCTURE
      14 x element, all with category=TYPE_REFERENCE:
        DTE_CrossNaviPathID: implementation-data-type=IDT_Gen_int64_ID  # path唯一id
        DTE_CrossNaviSegIdx: implementation-data-type=IDT_ICC_int32_Index  # 所在segment段，从0开始
        DTE_CrossNaviMainAction: implementation-data-type=IDT_ICC_int32_MainAction  # 导航动作
        DTE_CrossNaviAssistAction: implementation-data-type=IDT_ICC_int32_AssistAction  # 导航辅助动作
        DTE_CrossManeuverId: implementation-data-type=IDT_Gen_int32_ManeuverID  # 路口转向ID
        DTE_CrossNaviDestDirection: implementation-data-type=IDT_ICC_int32_DestDirection  # 途经点、充电站、目的地相对路径的位置关系
        DTE_CrossNaviTunnelFlag: implementation-data-type=IDT_ICC_int32_TunnelFlag  # 是否为隧道内外分叉
        DTE_CrossNaviOutCnt: implementation-data-type=IDT_Gen_val_int32  # 进入环岛时为环岛出口数；隧道内分叉为分叉个数
        DTE_CrossNaviManeuverID: implementation-data-type=IDT_Gen_int32_ManeuverID  # 满足顺行展示距离时为顺行图标，否则见枚举值
        DTE_CrossNextRoadName: implementation-data-type=IDT_ICC_string_RoadName  # 下条道路名称，途经点为途经点或者目的地名称
        DTE_CrossCurToSegmentDist: implementation-data-type=IDT_ICC_int32_Dist  # 当前车位所在导航段终点到segIdx终点的距离（单位米）
        DTE_CrossCurToSegmentTime: implementation-data-type=IDT_ICC_int32_Time  # 当前车位所在导航段终点到segIdx终点的时间（单位秒）
        DTE_CrossViaNum: implementation-data-type=IDT_Gen_val_int16  # 途经点、充电站编号
        DTE_CrossNaviReserved: implementation-data-type=IDT_CrossNavi_arr_Reserved  # 预留
    IDT_ADAS_strt_AebTargetObjInfo: category=STRUCTURE  # FCW AEB目标信息
      6 x element, all with category=TYPE_REFERENCE:
        DTE_TargetObjID: implementation-data-type=IDT_ADAS_enumTargetObjID  # 目标ID
        DTE_TargetObjColor: implementation-data-type=IDT_ADAS_enumTargetObjColor  # 目标颜色
        DTE_TargetObjType: implementation-data-type=IDT_ADAS_enumTargetObjType  # 目标类型
        DTE_TargetObjPosX: implementation-data-type=IDT_Gen_val_Coordinate_X  # 目标X向距离
        DTE_TargetObjPosY: implementation-data-type=IDT_Gen_val_Coordinate_Y  # 目标Y向距离
        DTE_TargetObjSpdX: implementation-data-type=IDT_ADAS_val_vehicleSpd  # 目标纵向速度
    IDT_SentryModeDuration: category=VALUE, base-type=uint32  # 哨兵模式时长参数
    IDT_ADAS_enum_ParkinDirectionSts: category=VALUE, base-type=uint8
    IDT_ADAS_strt_TrafficSign: category=STRUCTURE
      6 x element, all with category=TYPE_REFERENCE:
        DTE_TSRSt: implementation-data-type=IDT_ADAS_enum_TSRSt  # TSR功能状态
        DTE_TrafficSignId: implementation-data-type=IDT_Gen_val_ID  # 交通标志ID
        DTE_TrafficSignType: implementation-data-type=IDT_ADAS_enum_TrafficSignType  # 交通标志类型
        DTE_TrafficSignPosX: implementation-data-type=IDT_Gen_val_Coordinate_X  # 交通标志位置X
        DTE_TrafficSignPosY: implementation-data-type=IDT_Gen_val_Coordinate_Y  # 交通标志位置Y
        DTE_TrafficSignPosZ: implementation-data-type=IDT_Gen_val_Coordinate_Z  # 交通标志位置Z
    IDT_ADAS_strt_LSSInfo: category=STRUCTURE
      8 x element, all with category=TYPE_REFERENCE:
        DTE_LKSSts: implementation-data-type=IDT_ADAS_enum_LKSSts  # 车道辅助系统状态
        DTE_LKSMod: implementation-data-type=IDT_ADAS_enum_LKSMod  # 车道辅助模式
        DTE_ELKSts: implementation-data-type=IDT_ADAS_enum_ELKSts  # 紧急车道保持状态
        DTE_LKSLeftTrackingSt: implementation-data-type=IDT_ADAS_enum_LKSLeftTrackingSt  # 左侧跟踪状态
        DTE_LKSRightTrackingSt: implementation-data-type=IDT_ADAS_enum_LKSRightTrackingSt  # 右侧跟踪状态
        DTE_ELKLeftActiveSt: implementation-data-type=IDT_ADAS_enum_ELKLeftActiveSt  # ELK 左侧激活状态
        DTE_ELKRightActiveSt: implementation-data-type=IDT_ADAS_enum_ELKRightActiveSt  # ELK 右侧激活状态
        DTE_LKSwarning: implementation-data-type=IDT_ADAS_enum_LKS_warning  # LDP声音报警信号
    IDT_ADAS_arr_VPAParkingSLot: category=STRUCTURE, dynamic-array-size-profile=VSA_LINEAR  # VPA停车位列表
      element sizeIndicator: implementation-data-type=specialIDT_DynamicLengthField_uint32
      element IDT_ADAS_arr_VPAParkingSLot: category=ARRAY
        element IDT_ADAS_arr_VPAParkingSLot: array-size=2000, array-size-handling=ALL-INDICES-SAME-ARRAY-SIZE, array-size-semantics=VARIABLE-SIZE, implementation-data-type=IDT_ADAS_strt_VPAParkingSLot
    IDT_ICC_enum_LDWWarnType: category=VALUE, base-type=uint8  # LDW/LDP报警方式
    IDT_LinePoint_arr_Reserved: category=ARRAY  # 预留
      element Reserved_uint8_Type: array-size=5, array-size-semantics=FIXED-SIZE, implementation-data-type=IDT_Reserved_uint8_Type
    IDT_GetUUIDCodeResponse: category=STRUCTURE  # 获取车辆的用户唯一识别码
      element DTE_VehUUIDCode: implementation-data-type=IDT_UUIDCode  # 车辆用户唯一识别码
    IDT_Array_DataType: category=STRUCTURE, dynamic-array-size-profile=VSA_LINEAR  # 数据类型
      element sizeIndicator: implementation-data-type=specialIDT_DynamicLengthField_uint32
      element IDT_Array_DataType: category=ARRAY
        element IDT_Array_DataType: array-size=1300, array-size-handling=ALL-INDICES-SAME-ARRAY-SIZE, array-size-semantics=VARIABLE-SIZE, implementation-data-type=IDT_DataUint8
    IDT_ADAS_strt_HPAPathDetail_2: category=STRUCTURE
      13 x element, all with category=TYPE_REFERENCE:
        DTE_HpaPathID: implementation-data-type=IDT_Gen_val_ID  # 路线ID
        DTE_PathState: implementation-data-type=IDT_ADAS_enum_PathState  # 路线学习状态
        DTE_PathName: implementation-data-type=IDT_ADAS_string_PathName  # 路线名称
        DTE_PathSaveProgress: implementation-data-type=IDT_ADAS_val_PathSaveProgress  # 路线保存进度
        DTE_PathLength: implementation-data-type=IDT_ADAS_val_ParkingDist  # 路线长度
        DTE_LinePoint: implementation-data-type=IDT_ADAS_arr_PathPoint_2  # 路线学习点集
        DTE_PathMatchSts: implementation-data-type=IDT_ADAS_enum_PathMatchSts  # 路线匹配状态
        DTE_PathLabel: implementation-data-type=IDT_ADAS_enum_PathLabel  # 路线标签
        DTE_HPAPathType: implementation-data-type=IDT_ADAS_enum_HPAPathType  # 路线模式
        DTE_HPAOnWayLabelReplay: implementation-data-type=IDT_ADAS_arr_HPAOnWayLabelReplay  # HPA沿途标签显示
        DTE_HPAPathDetailSlot: implementation-data-type=IDT_ADAS_arr_HPAPathslot_2  # 显示路线中车位
        DTE_HPAPathStaticObject: implementation-data-type=IDT_ADAS_arr_HPAParkingStaticObjects  # 显示路线中静态障碍物
        DTE_HPAPathReserved: implementation-data-type=IDT_HPAPath_arr_Reserved  # 预留
    IDT_ICC_float_SelectZonePos_Y: category=VALUE, base-type=float32
    IDT_CellularMcc: category=VALUE, base-type=uint32  # 移动国家码
    IDT_ICC_float_SelectZonePos_X: category=VALUE, base-type=float32
    IDT_ADAS_enum_VPAStation: category=VALUE, base-type=uint8
    IDT_ICC_int32_MainAction: category=VALUE, base-type=sint32
    IDT_ADAS_enum_MNPNewRouteBtnSt: category=VALUE, base-type=uint8  # 新建路线按钮高亮提示
    IDT_ADAS_enum_TLAONOFFSts: category=VALUE, base-type=uint8  # 红绿灯提醒系统开关状态
    IDT_LightState_arr_Reserved: category=ARRAY
      element Reserved_int32_Type: array-size=20, array-size-semantics=FIXED-SIZE, implementation-data-type=IDT_Reserved_int32_Type
    IDT_TimeInfoYear: category=VALUE, base-type=uint16  # 年
    IDT_ICC_val_VoiceControlCruiseSpeed: category=VALUE, base-type=uint8  # 语音巡航调节速度值
    IDT_StrVar_SIM_ICCID: category=STRUCTURE, dynamic-array-size-profile=VSA_LINEAR  # 20位数字组成的集成电路卡识别码
      element sizeIndicator: implementation-data-type=specialIDT_DynamicLengthField_uint32
      element IDT_StrVar_SIM_ICCID: category=ARRAY
        element IDT_StrVar_SIM_ICCID: array-size=20, array-size-handling=ALL-INDICES-SAME-ARRAY-SIZE, array-size-semantics=VARIABLE-SIZE, implementation-data-type=specialIDT_StringRef
    IDT_ADAS_uint8_Available: category=VALUE, base-type=uint8
    IDT_ADAS_arr_TrafficLightList: category=STRUCTURE, dynamic-array-size-profile=VSA_LINEAR  # 交通灯箱数组
      element sizeIndicator: implementation-data-type=specialIDT_DynamicLengthField_uint32
      element IDT_ADAS_arr_TrafficLightList: category=ARRAY
        element IDT_ADAS_arr_TrafficLightList: array-size=10, array-size-handling=ALL-INDICES-SAME-ARRAY-SIZE, array-size-semantics=VARIABLE-SIZE, implementation-data-type=IDT_ADAS_strt_TrafficLightInfo
    IDT_ICC_boolean_InnerRoad: category=VALUE, base-type=sint32
    IDT_Struct_SetCallNumber2: category=STRUCTURE  # 设置TBOX的call呼叫号码
      element DTE_SetCallNumber: implementation-data-type=IDT_Enum_SetCallNumber  # 设置call呼叫号码
      element DTE_PhoneNumber: implementation-data-type=IDT_StrVar_PhoneNumber  # 具体的电话号码
      element DTE_Result: implementation-data-type=IDT_Enum_Result  # 是否设置成功
    IDT_Struct_SetCallNumber1: category=STRUCTURE  # 设置TBOX的call呼叫号码
      element DTE_SetCallNumber: implementation-data-type=IDT_Enum_SetCallNumber  # 设置call呼叫号码
      element DTE_PhoneNumber: implementation-data-type=IDT_StrVar_PhoneNumber  # 具体的电话号码
    IDT_MNPRoutes_arr_Reserved: category=ARRAY  # 预留
      element Reserved_uint8_Type: array-size=30, array-size-semantics=FIXED-SIZE, implementation-data-type=IDT_Reserved_uint8_Type
    IDT_ICC_strt_ApaFreeSlotInfo: category=STRUCTURE
      5 x element, all with category=TYPE_REFERENCE:
        DTE_FreeSlotType: implementation-data-type=IDT_ICC_enum_FreeSlotType  # 自选车位的类型
        DTE_FreeSlotPoint0Top1: implementation-data-type=IDT_ICC_strt_SlotPoint  # 自选车位的角点0位置
        DTE_FreeSlotPoint1Top2: implementation-data-type=IDT_ICC_strt_SlotPoint  # 自选车位的角点1位置
        DTE_FreeSlotPoint2Bottom1: implementation-data-type=IDT_ICC_strt_SlotPoint  # 自选车位的角点2位置
        DTE_FreeSlotPoint3Bottom2: implementation-data-type=IDT_ICC_strt_SlotPoint  # 自选车位的角点3位置
    IDT_Gen_enum_SystemSts: category=VALUE, base-type=uint8
    IDT_ADAS_enum_TrafficLightsType: category=VALUE, base-type=uint8  # 交通灯箱类型
    IDT_AppSrv_ReturnCode: category=VALUE, base-type=uint8  # 操作返回值
    IDT_Enum_ElevnInfo: category=VALUE, base-type=sint8  # 仰角信息 Elevation information
    IDT_SubCameraExt_arr_Reserved: category=ARRAY
      element Reserved_int32_Type: array-size=20, array-size-semantics=FIXED-SIZE, implementation-data-type=IDT_Reserved_int32_Type
    IDT_DataUint32: category=VALUE, base-type=uint32  # 无符号32位整型
    IDT_ValetParkingNetworkQuality: category=VALUE, base-type=uint32  # 代客泊车感知网络质量状态
    IDT_CellularCellNum: category=VALUE, base-type=uint32  # 小区数量
    IDT_ADAS_arr_RoadMarker: category=STRUCTURE, dynamic-array-size-profile=VSA_LINEAR
      element sizeIndicator: implementation-data-type=specialIDT_DynamicLengthField_uint32
      element IDT_ADAS_arr_RoadMarker: category=ARRAY
        element IDT_ADAS_arr_RoadMarker: array-size=28, array-size-handling=ALL-INDICES-SAME-ARRAY-SIZE, array-size-semantics=VARIABLE-SIZE, implementation-data-type=IDT_ADAS_strt_RoadMarker
    IDT_TimeStampOffset: category=STRUCTURE  # 包含秒，纳秒差值及时间有效性
      element DTE_timeValidFlag: implementation-data-type=IDT_TimeValidFlag  # 时间信息有效性
      element DTE_secondOffset: implementation-data-type=IDT_SecondTimeStampOffset  # 秒差值
      element DTE_nanoSecondOffset: implementation-data-type=IDT_NanoSecondTimeStampOffset  # 纳秒差值
    IDT_ADAS_enum_StopLineFlag: category=VALUE, base-type=uint8  # 引导线中的停止线是否生效标志
    IDT_GpsStatus: category=VALUE, base-type=sint32
    IDT_ADAS_enum_SetSpdUnit: category=VALUE, base-type=uint8
    IDT_ICC_enum_NavCountryCodeInfo: category=VALUE, base-type=uint8  # 导航国家代码
    IDT_ADAS_strt_ACCInfo: category=STRUCTURE
      18 x element, all with category=TYPE_REFERENCE:
        DTE_ACCSts: implementation-data-type=IDT_ADAS_enum_ACCSts  # ACC功能状态
        DTE_AutoResumeNotifier: implementation-data-type=IDT_ADAS_enum_AutoResumeNotifier  # 巡航自动恢复提示
        DTE_SetSpeed: implementation-data-type=IDT_ADAS_val_SetSpd  # 巡航车速
        DTE_SetSpeedUnit: implementation-data-type=IDT_ADAS_enum_SetSpdUnit  # 巡航车速单位
        DTE_TimeGapSet: implementation-data-type=IDT_ADAS_enum_TimeGapSet  # 跟车时距
        DTE_LongitudinalTakeOverRequest: implementation-data-type=IDT_ADAS_enum_LongiTakeOverReq  # 接管请求
        DTE_ACCGoNotifier: implementation-data-type=IDT_ADAS_enum_GoNotifier  # 起步提醒
        DTE_ACCTextMessage: implementation-data-type=IDT_ADAS_enum_ACCTextMessage  # ACC提示信息
        DTE_ACCQuitReason: implementation-data-type=IDT_ADAS_enum_ACCQuitReason  # ACC退出原因
        DTE_FSRACruiseSpdModFb: implementation-data-type=IDT_ADAS_enum_FSRACruiseSpdModFb  # 初始巡航车速模式反馈
        DTE_FSRACruiseSpdOffsetModFb: implementation-data-type=IDT_ADAS_enum_FSRACruiseSpdOffsetModFb  # 初始巡航车速偏差模式反馈
        DTE_SetACCSetSpdOffset: implementation-data-type=IDT_ADAS_val_FSRACruiseSpdOffsetSpdFb  # 巡航车速固定值offset值反馈
        DTE_SetACCSetSpdPercOffset: implementation-data-type=IDT_ADAS_val_FSRACruiseSpdOffsetPercentFb  # 巡航车速百分比offcet值反馈
        DTE_ACCholdSts: implementation-data-type=IDT_ADAS_enum_ACCholdSts  # 巡航保压状态
        DTE_FSRASpdSetMod: implementation-data-type=IDT_ADAS_enum_FSRASpdSetMod  # 巡航车速开关调节模式反馈
        DTE_FDMSt: implementation-data-type=IDT_ADAS_enum_FDMSt  # 前车距离检测功能反馈
        DTE_FDMDist: implementation-data-type=IDT_Gen_val_unit8  # 前车距离检测距离值反馈
        DTE_CruiseAccelerateSts: implementation-data-type=IDT_ADAS_enum_CruiseAccelerateSts  # 巡航跟车加减速状态指示
    IDT_ADAS_strt_VPAPointType: category=STRUCTURE  # vpa点类型
      element DTE_Coordinate_X: implementation-data-type=IDT_Gen_val_Coordinate_X  # X坐标
      element DTE_Coordinate_Y: implementation-data-type=IDT_Gen_val_Coordinate_Y  # Y坐标
      element DTE_Coordinate_Z: implementation-data-type=IDT_Gen_val_Coordinate_Z  # Z坐标
    IDT_Enum_TollStationPathStFb: category=VALUE, base-type=uint8  # 收费通道选择状态 Toll Station Path select status
    IDT_ADAS_enum_LKSRightTrackingSt: category=VALUE, base-type=uint8
    IDT_SimSwitchCheckResponse: category=STRUCTURE  # 切换Sim卡检查结果
      element DTE_simSwitchCheckResult: implementation-data-type=IDT_SimSwitchCheckResult  # 切换Sim卡检查结果
      element DTE_simSwitchCheckFailReason: implementation-data-type=IDT_SimSwitchCheckFailReason  # 切卡检查失败原因
    IDT_ICC_string_Cause: category=STRUCTURE, dynamic-array-size-profile=VSA_LINEAR
      element sizeIndicator: implementation-data-type=specialIDT_DynamicLengthField_uint32
      element IDT_ICC_string_Cause: category=ARRAY
        element IDT_ICC_string_Cause: array-size=1000, array-size-handling=ALL-INDICES-SAME-ARRAY-SIZE, array-size-semantics=VARIABLE-SIZE, implementation-data-type=specialIDT_StringRef
    IDT_ADAS_enum_APAPopup: category=VALUE, base-type=uint8
    IDT_ValetParkingRealtimeInfo: category=STRUCTURE  # 代客泊车实时信息
      4 x element, all with category=TYPE_REFERENCE:
        DTE_valetParkingNetworkQuality: implementation-data-type=IDT_ValetParkingNetworkQuality  # 代客泊车感知网络质量状态
        DTE_valetParkingCurrentIndex: implementation-data-type=IDT_ValetParkingCurrentIndex  # 代客泊车当前所处索引点
        DTE_valetParkingLayer: implementation-data-type=IDT_ValetParkingLayer  # 楼层
        DTE_reserved: implementation-data-type=IDT_ValetParkingRealtimeInfoReserved  # 预留字段
    IDT_ADAS_strt_ParkingGenaralInfo: category=STRUCTURE
      6 x element, all with category=TYPE_REFERENCE:
        DTE_ParkingActiveSubFuncSt: implementation-data-type=IDT_ADAS_enum_ParkingActiveSubFuncSt  # 泊车子功能激活状态
        DTE_ParkingQuitInd: implementation-data-type=IDT_ADAS_enum_ParkingQuitInd  # 泊车退出提示
        DTE_ParkingDriOperateInd: implementation-data-type=IDT_ADAS_enum_ParkingDriOperateInd  # 驾驶员操作提示
        DTE_ParkingPauseInd: implementation-data-type=IDT_ADAS_enum_ParkingPauseInd  # 泊车暂停提示
        DTE_ParkingFailureReasonInd: implementation-data-type=IDT_ADAS_enum_ParkingFailureReasonInd  # 泊车故障原因
        DTE_ParkingVoiceRemind: implementation-data-type=IDT_ADAS_enum_ParkingVoiceRemind  # 泊车语音提示
    IDT_ADAS_strt_DAIInfo: category=STRUCTURE
      element DTE_DAISts: implementation-data-type=IDT_ADAS_enum_DAISts  # 起步提醒功能状态
      element DTE_DAIReminder: implementation-data-type=IDT_ADAS_enum_DAIReminder  # 起步提醒
    IDT_ICC_enum_TLAEnableBtnSt: category=VALUE, base-type=uint8  # TLA功能使能开关
    IDT_ADAS_strt_TLAInfo: category=STRUCTURE  # TLA功能输出信息
      4 x element, all with category=TYPE_REFERENCE:
        DTE_TLAONOFFSts: implementation-data-type=IDT_ADAS_enum_TLAONOFFSts  # 红绿灯提醒系统开关状态
        DTE_TLASts: implementation-data-type=IDT_ADAS_enum_TLASts  # 红绿灯提醒功能状态
        DTE_TLATextInfo: implementation-data-type=IDT_ADAS_enum_TLATextInfo  # TLA提示信息
        DTE_TLAInfoReserved: implementation-data-type=IDT_TLAInfo_arr_Reserved  # 预留
    IDT_Count: category=VALUE, base-type=uint8  # 基站信息个数
    IDT_ADAS_enum_ISLIOverSpeedWarn: category=VALUE, base-type=uint8
    IDT_EphemerisDataLength: category=VALUE, base-type=uint32  # 星历数据长度
    IDT_Enum_WorkModel: category=VALUE, base-type=uint8  # TBOX工作模式
    IDT_Str_ProductCode: category=STRUCTURE, dynamic-array-size-profile=VSA_LINEAR  # ADAS供应商代码 ADAS supplier code
      element sizeIndicator: implementation-data-type=specialIDT_DynamicLengthField_uint32
      element IDT_Str_ProductCode: category=ARRAY
        element IDT_Str_ProductCode: array-size=40, array-size-handling=ALL-INDICES-SAME-ARRAY-SIZE, array-size-semantics=VARIABLE-SIZE, implementation-data-type=specialIDT_StringRef
    IDT_ICC_enum_VPASubModReq: category=VALUE, base-type=uint8
    IDT_ADAS_enum_PicPocType: category=VALUE, base-type=uint8
    IDT_ADAS_enum_TolAPAParkingTime: category=VALUE, base-type=uint64  # APA泊入时长
    IDT_StrVar_MCUVersion: category=STRUCTURE, dynamic-array-size-profile=VSA_LINEAR  # MCU版本号
      element sizeIndicator: implementation-data-type=specialIDT_DynamicLengthField_uint32
      element IDT_StrVar_MCUVersion: category=ARRAY
        element IDT_StrVar_MCUVersion: array-size=16, array-size-handling=ALL-INDICES-SAME-ARRAY-SIZE, array-size-semantics=VARIABLE-SIZE, implementation-data-type=specialIDT_StringRef
    IDT_UpFlow: category=VALUE, base-type=sint64
    IDT_ICC_uint8_PathId: category=VALUE, base-type=uint8
    IDT_StrVar_SIM_IMSI: category=STRUCTURE, dynamic-array-size-profile=VSA_LINEAR  # 15位的国际移动用户识别码
      element sizeIndicator: implementation-data-type=specialIDT_DynamicLengthField_uint32
      element IDT_StrVar_SIM_IMSI: category=ARRAY
        element IDT_StrVar_SIM_IMSI: array-size=15, array-size-handling=ALL-INDICES-SAME-ARRAY-SIZE, array-size-semantics=VARIABLE-SIZE, implementation-data-type=specialIDT_StringRef
    IDT_ICC_int16_SpeedLimit: category=VALUE, base-type=sint16
    IDT_ADAS_strt_IntelligentEvasionInfo: category=STRUCTURE
      element DTE_iLOASts: implementation-data-type=IDT_ADAS_enum_iLOASts  # 智慧躲闪功能状态
      element DTE_iLOAActdirection: implementation-data-type=IDT_ADAS_enum_iLOAActdirection  # 智慧躲闪方向
      element DTE_iLOATextInfo: implementation-data-type=IDT_ADAS_enum_iLOATextInfo  # 智慧躲闪提示信息
    IDT_ADAS_enum_ParkingActiveSubFuncSt: category=VALUE, base-type=uint8
    IDT_TimezoneUtcHours: category=VALUE, base-type=sint8  # 时区小时偏差信息
    IDT_VhrLogString: category=STRUCTURE, dynamic-array-size-profile=VSA_LINEAR
      element sizeIndicator: implementation-data-type=specialIDT_DynamicLengthField_uint32
      element IDT_VhrLogString: category=ARRAY
        element IDT_VhrLogString: array-size=50, array-size-handling=ALL-INDICES-SAME-ARRAY-SIZE, array-size-semantics=VARIABLE-SIZE, implementation-data-type=specialIDT_StringRef
    IDT_ICC_enum_ICAplussetting: category=VALUE, base-type=uint8  # 直行红绿灯启停设置状态
    IDT_ICC_string_RoadName: category=STRUCTURE, dynamic-array-size-profile=VSA_LINEAR
      element sizeIndicator: implementation-data-type=specialIDT_DynamicLengthField_uint32
      element IDT_ICC_string_RoadName: category=ARRAY
        element IDT_ICC_string_RoadName: array-size=1000, array-size-handling=ALL-INDICES-SAME-ARRAY-SIZE, array-size-semantics=VARIABLE-SIZE, implementation-data-type=specialIDT_StringRef
    IDT_ADAS_enum_TSRSt: category=VALUE, base-type=uint8
    IDT_DataUint16: category=VALUE, base-type=uint16  # 无符号16位整型
    IDT_ADAS_strt_ISLIInfo: category=STRUCTURE
      8 x element, all with category=TYPE_REFERENCE:
        DTE_ISLISt: implementation-data-type=IDT_ADAS_enum_ISLISt  # 超速报警功能状态
        DTE_ISLISpeedLimitSign: implementation-data-type=IDT_ADAS_enum_ISLISpeedLimitSign  # 限速标志
        DTE_ISLISpeedLimitUnit: implementation-data-type=IDT_ADAS_enum_ISLISpeedLimitUnit  # 限速标志单位
        DTE_ISLIOverSpeedWarn: implementation-data-type=IDT_ADAS_enum_ISLIOverSpeedWarn  # 超速报警状态
        DTE_ISLIWarningModFb: implementation-data-type=IDT_ADAS_enum_ISLIWarningMod  # 超速报警模式反馈
        DTE_ISLISpdLimType: implementation-data-type=IDT_ADAS_enum_ISLISpdLimType  # 超速限制类型
        DTE_ISLICruiseSpdAbsOffsetFb: implementation-data-type=IDT_ADAS_val_SpdLimitAbsOffset  # 限速绝对偏差值反馈
        DTE_ISLICruiseSpdRelOffsetFb: implementation-data-type=IDT_ADAS_val_SpdLimitRelOffset  # 限速相对偏差值反馈
    IDT_StrVar_HDMap: category=STRUCTURE, dynamic-array-size-profile=VSA_LINEAR
      element sizeIndicator: implementation-data-type=specialIDT_DynamicLengthField_uint32
      element IDT_StrVar_HDMap: category=ARRAY
        element IDT_StrVar_HDMap: array-size=128, array-size-handling=ALL-INDICES-SAME-ARRAY-SIZE, array-size-semantics=VARIABLE-SIZE, implementation-data-type=specialIDT_StringRef
    IDT_port: category=VALUE, base-type=uint16  # 端口号
    IDT_TrafficSignIdentify_arr_Reserved: category=ARRAY
      element Reserved_uint8_Type: array-size=30, array-size-semantics=FIXED-SIZE, implementation-data-type=IDT_Reserved_uint8_Type
    IDT_ADAS_enum_AutoResumeNotifier: category=VALUE, base-type=uint8
    IDT_ADAS_enum_MNPMemRouteReadyFlag: category=VALUE, base-type=uint8  # 路线是否可用
    IDT_ICC_int32_DestDirection: category=VALUE, base-type=sint32
    IDT_Light_arr_Reserved: category=ARRAY
      element Reserved_uint8_Type: array-size=10, array-size-semantics=FIXED-SIZE, implementation-data-type=IDT_Reserved_uint8_Type
    IDT_ADAS_enum_ParkingDriOperateInd: category=VALUE, base-type=uint8
    IDT_ResponseVhrRemoteCall: category=VALUE, base-type=sint32  # VHR日志远程调取--响应
    IDT_ADAS_enum_IntelligentEvasionBtnStFb: category=VALUE, base-type=uint8  # 智慧躲闪软开关设置反馈
    IDT_ADAS_Posn_Rehead: category=VALUE, base-type=uint8
    IDT_ICC_int32_SubType: category=VALUE, base-type=sint32
    IDT_ADAS_enum_OCCType: category=VALUE, base-type=uint8  # OCC类型
    IDT_ADAS_Stub_FormOfWay: category=VALUE, base-type=uint8
    IDT_ADAS_val_VPATunnel: category=STRUCTURE, dynamic-array-size-profile=VSA_LINEAR  # VPA通道名
      element sizeIndicator: implementation-data-type=specialIDT_DynamicLengthField_uint32
      element IDT_ADAS_val_VPATunnel: category=ARRAY
        element IDT_ADAS_val_VPATunnel: array-size=50, array-size-handling=ALL-INDICES-SAME-ARRAY-SIZE, array-size-semantics=VARIABLE-SIZE, implementation-data-type=specialIDT_StringRef
    IDT_ADAS_val_altitude: category=VALUE, base-type=float32
    IDT_ADAS_val_StandardDeviation: category=VALUE, base-type=float32
    IDT_ADAS_strt_RoadMarker_2: category=STRUCTURE
      8 x element, all with category=TYPE_REFERENCE:
        DTE_RoadMarkerType: implementation-data-type=IDT_ADAS_enum_RoadMarkerType  # 路面标记类型
        DTE_RoadMarkerID: implementation-data-type=IDT_Gen_uint64_ID  # 路面标记ID
        DTE_RoadMarkerTrackingSts: implementation-data-type=IDT_ADAS_enum_RoadMarkerTrackingSts  # 路面标记跟踪状态
        DTE_RoadMarkerPose1X: implementation-data-type=IDT_Gen_val_Coordinate_X  # 路面标记点1X坐标
        DTE_RoadMarkerPose1Y: implementation-data-type=IDT_Gen_val_Coordinate_Y  # 路面标记点1Y坐标
        DTE_RoadMarkerPose2X: implementation-data-type=IDT_Gen_val_Coordinate_X  # 路面标记点2X坐标
        DTE_RoadMarkerPose2Y: implementation-data-type=IDT_Gen_val_Coordinate_Y  # 路面标记点2Y坐标
        DTE_RoadMarkerWidth: implementation-data-type=IDT_Gen_val_Width  # 路面标记(人行道）宽度
    IDT_ADAS_arr_VPASpeedBump: category=STRUCTURE, dynamic-array-size-profile=VSA_LINEAR  # 减速带列表
      element sizeIndicator: implementation-data-type=specialIDT_DynamicLengthField_uint32
      element IDT_ADAS_arr_VPASpeedBump: category=ARRAY
        element IDT_ADAS_arr_VPASpeedBump: array-size=200, array-size-handling=ALL-INDICES-SAME-ARRAY-SIZE, array-size-semantics=VARIABLE-SIZE, implementation-data-type=IDT_ADAS_strt_VPASpeedBump
    IDT_Struct_GNSSInfo: category=STRUCTURE  # GNSS位置信息
      element DTE_NMEA: implementation-data-type=IDT_StrVar_NMEA  # 位置信息
      element DTE_ACCURACY: implementation-data-type=IDT_ACCURACY  # 精度
      element DTE_SeqNum: implementation-data-type=IDT_SeqNum  # 序列号
    IDT_SentryModeAlarmLevel: category=VALUE, base-type=uint32  # 哨兵模式告警等级
    IDT_ADAS_strt_VPAStaticObjects: category=STRUCTURE  # VPA静态障碍物
      element DTE_StaticObjects: implementation-data-type=IDT_ADAS_strt_StaticObject  # 静态障碍物
      element DTE_StaticObjectsFloor: implementation-data-type=IDT_ADAS_enum_VPAFloor  # 静态障碍物所属楼层
    IDT_ADAS_Stub_NumOfLaneDrvDir: category=VALUE, base-type=uint8
    IDT_ADAS_Meta_ProtVer_Minor: category=VALUE, base-type=uint8
    IDT_ICC_boolean_isMatch: category=VALUE, base-type=sint32  # 区间测速是否配对:仅对区间测速电子眼生效
    IDT_ADAS_enum_LightType: category=VALUE, base-type=uint8  # 红绿灯类型
    IDT_ICC_strt_NaviRoadInfo: category=STRUCTURE  # 导航道路信息
      5 x element, all with category=TYPE_REFERENCE:
        DTE_NaviRoadName: implementation-data-type=IDT_ICC_string_RoadName  # 道路名称
        DTE_NaviRoadClass: implementation-data-type=IDT_ICC_int32_RoadClass  # 当前自车所在道路等级
        DTE_Navicurrentroadspd: implementation-data-type=IDT_ICC_int32_Speed  # 道路限速
        DTE_NaviFormWay: implementation-data-type=IDT_ICC_int32_FormWay  # 道路属性
        DTE_NaviRoadInfoReserved: implementation-data-type=IDT_NaviRoadInfo_arr_Reserved  # 预留
    specialIDT_StringRef: category=VALUE, base-type=uint8
    IDT_ADAS_Meta_ProtVer_MinorSub: category=VALUE, base-type=uint8
    IDT_DownRate: category=VALUE, base-type=uint32
    IDT_ICC_strt_HPAPathOperation_2: category=STRUCTURE
      6 x element, all with category=TYPE_REFERENCE:
        DTE_PathOperationId: implementation-data-type=IDT_ICC_enum_PathOperationId  # 路线操作指令
        DTE_PathId: implementation-data-type=IDT_ICC_uint8_PathId  # 路线ID
        DTE_SetPathName: implementation-data-type=IDT_ICC_string_SetPathName  # 路线名称
        DTE_SetPathLabel: implementation-data-type=IDT_ICC_enum_SetPathLabel  # 路线标签
        DTE_SetHPAPathType: implementation-data-type=IDT_ICC_enum_SetHPAPathType  # 设置路线类型
        DTE_HPAPathOperationReserved: implementation-data-type=IDT_HPAPathOperation_arr_Reserved  # 预留
    IDT_ICC_strt_NaviCongestionInfo: category=STRUCTURE  # 交通拥堵
      7 x element, all with category=TYPE_REFERENCE:
        DTE_CongestionPathID: implementation-data-type=IDT_Gen_int64_ID  # 路线ID
        DTE_TotalTimeOfSeconds: implementation-data-type=IDT_ICC_int64_Time  # 预计通过拥堵时段时间
        DTE_TotalRemainDist: implementation-data-type=IDT_ICC_int64_Dist  # 拥堵剩余距离
        DTE_Unobstructed: implementation-data-type=IDT_ICC_boolean_Unobstructed  # 是否通畅
        DTE_CongestionInfos: implementation-data-type=IDT_ICC_arr_CongestionInfo  # 拥堵时长和原因详细信息
        DTE_CongestionExtend: implementation-data-type=IDT_ICC_strt_CongestionExtend  # 拥堵扩展信息
        DTE_NaviCongestionReserved: implementation-data-type=IDT_NaviCongestion_arr_Reserved  # 预留
    IDT_ADAS_enum_MEBSts: category=VALUE, base-type=uint8
    IDT_ICC_strt_LaneCategoryType: category=STRUCTURE
      element DTE_LaneCategoryType: implementation-data-type=IDT_ICC_int32_LaneCategoryType  # 车道信息
    IDT_ICC_arr_TrafficLightCountdown: category=STRUCTURE, dynamic-array-size-profile=VSA_LINEAR
      element sizeIndicator: implementation-data-type=specialIDT_DynamicLengthField_uint32
      element IDT_ICC_arr_TrafficLightCountdown: category=ARRAY
        element IDT_ICC_arr_TrafficLightCountdown: array-size=10, array-size-handling=ALL-INDICES-SAME-ARRAY-SIZE, array-size-semantics=VARIABLE-SIZE, implementation-data-type=IDT_ICC_strt_TrafficLightCountdown
    IDT_ICC_enum_ExtenLaneAction: category=VALUE, base-type=uint8
    IDT_ADAS_arr_LightList: category=STRUCTURE, dynamic-array-size-profile=VSA_LINEAR  # 红绿灯数组
      element sizeIndicator: implementation-data-type=specialIDT_DynamicLengthField_uint32
      element IDT_ADAS_arr_LightList: category=ARRAY
        element IDT_ADAS_arr_LightList: array-size=3, array-size-handling=ALL-INDICES-SAME-ARRAY-SIZE, array-size-semantics=VARIABLE-SIZE, implementation-data-type=IDT_ADAS_strt_Light
    IDT_TimezoneUtcMinutes: category=VALUE, base-type=sint8  # 时区分钟偏差信息
    IDT_TollGateInfo_arr_Reserved: category=ARRAY  # 预留
      element Reserved_int32_Type: array-size=100, array-size-semantics=FIXED-SIZE, implementation-data-type=IDT_Reserved_int32_Type
    IDT_ICC_string_RouteInfo: category=STRUCTURE, dynamic-array-size-profile=VSA_LINEAR
      element sizeIndicator: implementation-data-type=specialIDT_DynamicLengthField_uint32
      element IDT_ICC_string_RouteInfo: category=ARRAY
        element IDT_ICC_string_RouteInfo: array-size=100000000, array-size-handling=ALL-INDICES-SAME-ARRAY-SIZE, array-size-semantics=VARIABLE-SIZE, implementation-data-type=specialIDT_StringRef
    IDT_CellularCellMapArray: category=STRUCTURE, dynamic-array-size-profile=VSA_LINEAR  # 小区网络地图数组
      element sizeIndicator: implementation-data-type=specialIDT_DynamicLengthField_uint32
      element IDT_CellularCellMapArray: category=ARRAY
        element IDT_CellularCellMapArray: array-size=32, array-size-handling=ALL-INDICES-SAME-ARRAY-SIZE, array-size-semantics=VARIABLE-SIZE, implementation-data-type=IDT_CellularCellMapInfo
    IDT_ICC_enum_NaviCountryID: category=VALUE, base-type=uint8
    IDT_WiFiUploadDataStatus: category=VALUE, base-type=sint32
    IDT_CellularCellMapInfo: category=STRUCTURE  # 小区网络地图信息
      7 x element, all with category=TYPE_REFERENCE:
        DTE_cellId: implementation-data-type=IDT_CellularCellId  # 小区信息
        DTE_mcc: implementation-data-type=IDT_CellularMcc  # 移动国家码
        DTE_mnc: implementation-data-type=IDT_CellularMnc  # 移动网络码
        DTE_rat: implementation-data-type=IDT_CellularRat  # 网络制式
        DTE_frequency: implementation-data-type=IDT_CellularFrequency  # 频点
        DTE_pci: implementation-data-type=IDT_CellularPci  # PCI
        DTE_reservedByteArray: implementation-data-type=IDT_CellularCellMapInfoReserved  # 预留字段
    IDT_ICC_enum_FSRACruiseSpdOffsetSpd: category=VALUE, base-type=sint8  # 固定偏移速度
    IDT_ADSHMIRequestMessage: category=STRUCTURE, dynamic-array-size-profile=VSA_LINEAR  # ADS HMI数据通道请求
      element sizeIndicator: implementation-data-type=specialIDT_DynamicLengthField_uint32
      element IDT_ADSHMIRequestMessage: category=ARRAY
        element IDT_ADSHMIRequestMessage: array-size=1048576, array-size-handling=ALL-INDICES-SAME-ARRAY-SIZE, array-size-semantics=VARIABLE-SIZE, implementation-data-type=IDT_ADSHMIBasicElement
    IDT_Struct_CurrenMonthTalkTime: category=STRUCTURE  # TBOX的当月通话时长
      element DTE_TotalTalkTime: implementation-data-type=IDT_TotalTalkTime  # 通话时长总计
      element DTE_OutgoingTotalTime: implementation-data-type=IDT_OutgoingTotalTime  # 拨出电话时长总计
      element DTE_IncomingTotalTime: implementation-data-type=IDT_IncomingTotalTime  # 拨入电话时长总计
    IDT_ADAS_strt_WheelStopInfo: category=STRUCTURE  # 轮挡信息
      element DTE_WheelStopperStartPoint: implementation-data-type=IDT_ADAS_strt_SlotPoint  # 轮挡端点1
      element DTE_WheelStopperEndPoint: implementation-data-type=IDT_ADAS_strt_SlotPoint  # 轮挡端点2
      element DTE_WheelStopperWidth: implementation-data-type=IDT_Gen_val_Width  # 轮挡宽度(cm)
    IDT_ADAS_strt_VPARange: category=STRUCTURE  # VPA地图范围
      element DTE_VPARangeFloor: implementation-data-type=IDT_ADAS_enum_VPAFloor  # 范围所属楼层
      element DTE_VPARangeMinPoint: implementation-data-type=IDT_ADAS_strt_VPAPointType  # 最小点
      element DTE_VPARangeMaxPoint: implementation-data-type=IDT_ADAS_strt_VPAPointType  # 最大点
    IDT_Enum_UnixTimestamp: category=VALUE, base-type=uint64  # Unix绝对时间戳 Unix absolute timestamp
    IDT_EphemerisDataByteElement: category=VALUE, base-type=uint8  # 星历数据消息元素
    IDT_Basic_enum_Valid: category=VALUE, base-type=uint8  # 时间有效位
    IDT_CID: category=VALUE, base-type=uint32  # 基站编号0开始的整数
    IDT_ADAS_Posn_PathIdx: category=VALUE, base-type=uint8
    IDT_DmsWarning: category=VALUE, base-type=uint8  # 智驾状态下的疲劳分神提醒
    IDT_ICC_enum_TSREnableBtnSt: category=VALUE, base-type=uint8  # TSR功能使能开关
    IDT_ICC_uint8_SelectPathId: category=VALUE, base-type=uint8
    IDT_ADAS_enum_SglNOAMileage: category=VALUE, base-type=float32  # NOA行驶里程
    IDT_StrVar_fileName: category=STRUCTURE, dynamic-array-size-profile=VSA_LINEAR  # log文件名称
      element sizeIndicator: implementation-data-type=specialIDT_DynamicLengthField_uint32
      element IDT_StrVar_fileName: category=ARRAY
        element IDT_StrVar_fileName: array-size=32, array-size-handling=ALL-INDICES-SAME-ARRAY-SIZE, array-size-semantics=VARIABLE-SIZE, implementation-data-type=specialIDT_StringRef
    IDT_EphemerisDataType: category=VALUE, base-type=uint32  # 星历数据类型
    IDT_ICC_enum_Trend: category=VALUE, base-type=uint8  # 拥堵趋势
    IDT_ADAS_enum_TSISgnForb: category=VALUE, base-type=uint8  # TSR禁止类标识牌
    IDT_ICC_strt_ServiceAreaInfo: category=STRUCTURE  # 服务区信息
      element DTE_ServiceAreaExists: implementation-data-type=IDT_ICC_boolean_exists
      element DTE_ServiceAreaDistance: implementation-data-type=IDT_ICC_int32_Dist
      element DTE_ServiceAreaInfoReserved: implementation-data-type=IDT_ServiceAreaInfo_arr_Reserved  # 预留
    IDT_ICC_arr_FrontLanes: category=STRUCTURE, dynamic-array-size-profile=VSA_LINEAR
      element sizeIndicator: implementation-data-type=specialIDT_DynamicLengthField_uint32
      element IDT_ICC_arr_FrontLanes: category=ARRAY
        element IDT_ICC_arr_FrontLanes: array-size=32, array-size-handling=ALL-INDICES-SAME-ARRAY-SIZE, array-size-semantics=VARIABLE-SIZE, implementation-data-type=IDT_ICC_strt_LaneAction
    IDT_ICC_enum_AMAPSettingSt: category=VALUE, base-type=uint8  # AMAP功能设置状态
    IDT_ADAS_strt_ISLIInfo_2: category=STRUCTURE
      12 x element, all with category=TYPE_REFERENCE:
        DTE_ISLISt: implementation-data-type=IDT_ADAS_enum_ISLISt  # 超速报警功能状态
        DTE_ISLISpeedLimitSign: implementation-data-type=IDT_ADAS_enum_ISLISpeedLimitSign  # 限速标志
        DTE_ISLISpeedLimitUnit: implementation-data-type=IDT_ADAS_enum_ISLISpeedLimitUnit  # 限速标志单位
        DTE_ISLIOverSpeedWarn: implementation-data-type=IDT_ADAS_enum_ISLIOverSpeedWarn  # 超速报警状态
        DTE_ISLIWarningModFb: implementation-data-type=IDT_ADAS_enum_ISLIWarningMod  # 超速报警模式反馈
        DTE_ISLISpdLimType: implementation-data-type=IDT_ADAS_enum_ISLISpdLimType  # 超速限制类型
        DTE_ISLICruiseSpdAbsOffsetFb: implementation-data-type=IDT_ADAS_val_SpdLimitAbsOffset  # 限速绝对偏差值反馈
        DTE_ISLICruiseSpdRelOffsetFb: implementation-data-type=IDT_ADAS_val_SpdLimitRelOffset  # 限速相对偏差值反馈
        DTE_ISLISpdOffsetMod: implementation-data-type=IDT_ADAS_enum_ISLISpdOffsetMod  # 限速提醒偏移方式
        DTE_ISLICruiseSpdOffsetAbs: implementation-data-type=IDT_ADAS_val_SpdLimitOffsetAbs  # 固定限速偏移量
        DTE_ISLITextInfomation: implementation-data-type=IDT_ADAS_enum_ISLITextInfo  # ISLI文言提示信息
        DTE_ISLIInfoReserved: implementation-data-type=IDT_ISLIInfo_arr_Reserved  # 预留
    IDT_Enum_SimCardRegistraionStatus: category=VALUE, base-type=uint8  # Sim卡注册状态
    IDT_Struct_GeoPos2D: category=STRUCTURE  # 2D点位置
      element DTE_lon: implementation-data-type=IDT_DataInt32  # 经度
      element DTE_lat: implementation-data-type=IDT_DataInt32  # 纬度
    IDT_ADAS_enum_NRAPreScanSts: category=VALUE, base-type=uint8
    IDT_ICC_int32_CongestionStatus: category=VALUE, base-type=sint32  # 拥堵程度
    IDT_ADAS_enum_SglAutoRoadCrossingsNum: category=VALUE, base-type=uint16  # 自动过路口数量
    IDT_ICC_strt_CameraSpeed: category=STRUCTURE
      element DTE_SpeedLimitInfo: implementation-data-type=IDT_ICC_int16_SpeedLimit  # 电子眼限速信息
      element DTE_CameraSpeedReserved: implementation-data-type=IDT_CameraSpeed_arr_Reserved  # 预留
    IDT_ICC_enum_CongestionStatus: category=VALUE, base-type=uint8  # 拥堵程度:
    IDT_ADAS_strt_SlotWheelStopperInfo: category=STRUCTURE  # 轮挡信息
      element DTE_IsSlotHasWheelStopper: implementation-data-type=IDT_ADAS_enum_IsSlotHasWheelStopper  # 轮挡是否存在
      element DTE_WheelStopInfo: implementation-data-type=IDT_ADAS_strt_WheelStopInfo  # 轮挡信息
    IDT_Enum_Roaming: category=VALUE, base-type=uint8  # 是否出于漫游中
    IDT_ServiceAreaInfo_arr_Reserved: category=ARRAY  # 预留
      element Reserved_int32_Type: array-size=100, array-size-semantics=FIXED-SIZE, implementation-data-type=IDT_Reserved_int32_Type
    IDT_ADAS_enum_TSINoParkWarn: category=VALUE, base-type=uint8  # 禁止停车提示
    IDT_ADAS_enum_MNPStopMemRouteDrawing: category=VALUE, base-type=uint8  # 通知导航停止记忆路线的描画
    IDT_MultiSimSwitchMode: category=VALUE, base-type=uint32  # 多SIM切换模式
    IDT_LaneInfo_arr_Reserved: category=ARRAY
      element Reserved_int32_Type: array-size=20, array-size-semantics=FIXED-SIZE, implementation-data-type=IDT_Reserved_int32_Type
    IDT_ADAS_Meta_MapVerQtr: category=VALUE, base-type=uint8
    IDT_ICC_strt_MixForkInfoList: category=STRUCTURE
      5 x element, all with category=TYPE_REFERENCE:
        DTE_MixForkDist: implementation-data-type=IDT_ICC_int32_Dist  # 混淆路口到导航点距离
        DTE_MixForkPos: implementation-data-type=IDT_ICC_strt_Coord2DDouble  # 混淆路口的经纬度
        DTE_MixForkRoadClass: implementation-data-type=IDT_ICC_int32_RoadClass  # 混淆道路的roadclass
        DTE_MixForkSegmentIndex: implementation-data-type=IDT_ICC_int32_Index  # 混淆道路所在segment索引
        DTE_MixForkInfoReserved: implementation-data-type=IDT_MixForkInfo_arr_Reserved  # 预留
    IDT_TmcInfo_arr_Reserved: category=ARRAY
      element Reserved_int32_Type: array-size=20, array-size-semantics=FIXED-SIZE, implementation-data-type=IDT_Reserved_int32_Type
    specialIDT_DynamicLengthField_uint32: category=VALUE, base-type=uint32
    IDT_ADAS_ProfShort_AccurClass: category=VALUE, base-type=uint8
    IDT_OTAUtcSecs: category=VALUE, base-type=uint32  # 预约升级时间
    IDT_Gen_val_float32: category=VALUE, base-type=float32  # float32浮点数
    IDT_ICC_strt_LaneAction: category=STRUCTURE
      element DTE_LaneAction: implementation-data-type=IDT_ICC_int32_LaneAction  # 车道信息
    IDT_ADAS_enum_ELKRightActiveSt: category=VALUE, base-type=uint8
    IDT_ADAS_val_SpdLimitAbsOffset: category=VALUE, base-type=uint8
    IDT_ADAS_enum_VPAWarningInfo: category=VALUE, base-type=uint8
    IDT_StrVar_VPNIPAddress: category=STRUCTURE, dynamic-array-size-profile=VSA_LINEAR  # VPN IP
      element sizeIndicator: implementation-data-type=specialIDT_DynamicLengthField_uint32
      element IDT_StrVar_VPNIPAddress: category=ARRAY
        element IDT_StrVar_VPNIPAddress: array-size=30, array-size-handling=ALL-INDICES-SAME-ARRAY-SIZE, array-size-semantics=VARIABLE-SIZE, implementation-data-type=specialIDT_StringRef
    IDT_ADAS_Seg_Update: category=VALUE, base-type=uint8
    IDT_HPAOnWayLabel_arr_Reserved: category=ARRAY  # 预留
      element Reserved_uint8_Type: array-size=30, array-size-semantics=FIXED-SIZE, implementation-data-type=IDT_Reserved_uint8_Type
    IDT_Enum_AomCommand: category=VALUE, base-type=uint8  # 高精画页中用户对NOP和ICA的控制命令
    IDT_ICC_enum_NavSpeedLimitUnits: category=VALUE, base-type=uint8  # 导航限速单位
    IDT_ADAS_enum_TLASts: category=VALUE, base-type=uint8  # 红绿灯提醒功能状态
    IDT_ICC_enum_SpeedLimitUnit: category=VALUE, base-type=uint8
    IDT_Struct_BEICALL: category=STRUCTURE  # 请求电话操作（B/E/I call）
      element DTE_CallType: implementation-data-type=IDT_Enum_CallType  # 呼叫号码列表
      element DTE_CallOperation: implementation-data-type=IDT_Enum_CallOperation  # 电话操作
      element DTE_Telephonenumber: implementation-data-type=IDT_StrVar_Telephonenumber  # 电话号码
    IDT_ADAS_arr_HPAParkingSlot: category=STRUCTURE, dynamic-array-size-profile=VSA_LINEAR
      element sizeIndicator: implementation-data-type=specialIDT_DynamicLengthField_uint32
      element IDT_ADAS_arr_HPAParkingSlot: category=ARRAY
        element IDT_ADAS_arr_HPAParkingSlot: array-size=2000, array-size-handling=ALL-INDICES-SAME-ARRAY-SIZE, array-size-semantics=VARIABLE-SIZE, implementation-data-type=IDT_ADAS_strt_ParkingSlot_2
    IDT_ADAS_enum_SVSSts: category=VALUE, base-type=uint8
    IDT_ICC_strt_EndPoiInfo: category=STRUCTURE
      4 x element, all with category=TYPE_REFERENCE:
        DTE_EndPoiName: implementation-data-type=IDT_ICC_string_Name  # 名称
        DTE_EndPoiAddress: implementation-data-type=IDT_ICC_string_Address  # 地址
        DTE_EndPoNaviPos: implementation-data-type=IDT_ICC_strt_Coord2DDouble  # 经纬度信息
        DTE_EndPoiReserved: implementation-data-type=IDT_EndPoi_arr_Reserved  # 预留
    IDT_CameraStreamStatusMessage: category=STRUCTURE, dynamic-array-size-profile=VSA_LINEAR  # ADS到CDC的视频流状态消息
      element sizeIndicator: implementation-data-type=specialIDT_DynamicLengthField_uint32
      element IDT_CameraStreamStatusMessage: category=ARRAY
        element IDT_CameraStreamStatusMessage: array-size=1048576, array-size-handling=ALL-INDICES-SAME-ARRAY-SIZE, array-size-semantics=VARIABLE-SIZE, implementation-data-type=IDT_CameraStreamBasicElement
    IDT_ADAS_arr_VPAEntrance: category=STRUCTURE, dynamic-array-size-profile=VSA_LINEAR  # VPA的出入口列表
      element sizeIndicator: implementation-data-type=specialIDT_DynamicLengthField_uint32
      element IDT_ADAS_arr_VPAEntrance: category=ARRAY
        element IDT_ADAS_arr_VPAEntrance: array-size=100, array-size-handling=ALL-INDICES-SAME-ARRAY-SIZE, array-size-semantics=VARIABLE-SIZE, implementation-data-type=IDT_ADAS_strt_VPAEntrance
    IDT_ICC_int32_LaneAction: category=VALUE, base-type=sint32
    IDT_LanePositionInfo_length: category=VALUE, base-type=float32
    IDT_ADAS_uint64_TargetObjID: category=VALUE, base-type=uint64  # 目标ID
    IDT_ADAS_strt_FreeSpaceList: category=STRUCTURE  # FreeSpace信息数组
      element DTE_OCCNum: implementation-data-type=IDT_ADAS_val_OCCNum  # freespace个数
      element DTE_OCCInfoList: implementation-data-type=IDT_ADAS_arr_OCCInfoList  # freespace数组
    IDT_ADAS_enum_RPAset: category=VALUE, base-type=uint8
    IDT_Str_InterVers: category=STRUCTURE, dynamic-array-size-profile=VSA_LINEAR  # ADAS内部版本号 ADAS Internal version number
      element sizeIndicator: implementation-data-type=specialIDT_DynamicLengthField_uint32
      element IDT_Str_InterVers: category=ARRAY
        element IDT_Str_InterVers: array-size=40, array-size-handling=ALL-INDICES-SAME-ARRAY-SIZE, array-size-semantics=VARIABLE-SIZE, implementation-data-type=specialIDT_StringRef
    IDT_ICC_enum_DetourAroundObstacleBtnSt: category=VALUE, base-type=uint8  # 借道绕行障碍物软开关
    IDT_CameraSpeed_arr_Reserved: category=ARRAY
      element Reserved_int32_Type: array-size=10, array-size-semantics=FIXED-SIZE, implementation-data-type=IDT_Reserved_int32_Type
    IDT_WiFiLinkedInternet: category=VALUE, base-type=sint32  # 是否可以上网
    IDT_ADAS_strt_TolNtfADDrivingCardinfo: category=STRUCTURE
      14 x element, all with category=TYPE_REFERENCE:
        DTE_TolDatauploadBtnFb: implementation-data-type=IDT_ADAS_enum_TolDatauploadBtnFb  # 一键数据回传信息反馈
        DTE_TolRecordUploadBtnFb: implementation-data-type=IDT_ADAS_enum_TolRecordUploadBtnFb  # 录音上传状态反馈
        DTE_TolNOAMileage: implementation-data-type=IDT_ADAS_enum_TolNOAMileage  # NOA行驶里程
        DTE_TolLCCMileage: implementation-data-type=IDT_ADAS_enum_TolLCCMileage  # LCC行驶里程
        DTE_TolAutoRoadCrossingsNum: implementation-data-type=IDT_ADAS_enum_TolAutoRoadCrossingsNum  # 自动过路口数量
        DTE_TolAutoMergeChangeLane: implementation-data-type=IDT_ADAS_enum_TolAutoMergeChangeLane  # 自动并道换道
        DTE_TolAccessRemitramp: implementation-data-type=IDT_ADAS_enum_TolAccessRemitramp  # 汇入汇出匝道
        DTE_TolAutoAvoidObstacle: implementation-data-type=IDT_ADAS_enum_TolAutoAvoidObstacle  # 自动避障（避障变道和避障bypass）
        DTE_TolRespondCongestion: implementation-data-type=IDT_ADAS_enum_TolRespondCongestion  # 应对加塞
        DTE_TolU_turnsNum: implementation-data-type=IDT_ADAS_enum_TolU_turnsNum  # 掉头次数
        DTE_TolAPANum: implementation-data-type=IDT_ADAS_enum_TolAPANum  # APA次数
        DTE_TolAPAParkingTime: implementation-data-type=IDT_ADAS_enum_TolAPAParkingTime  # APA泊入时长
        DTE_TolAPAParkedOutTime: implementation-data-type=IDT_ADAS_enum_TolAPAParkedOutTime  # APA泊出时长
        DTE_TolNtfADDrivingCardinfoReserved: implementation-data-type=IDT_TolNtfADDrivingCardinfo_arr_Reserved  # 预留
    IDT_ADAS_Stub_RelProbb: category=VALUE, base-type=uint8
    IDT_ADAS_strt_DrivingTrajectoryPoint: category=STRUCTURE  # 轨迹点位置
      element DTE_TrajectoryPointX: implementation-data-type=IDT_Gen_val_Coordinate_X  # 轨迹形点X坐标
      element DTE_TrajectoryPointY: implementation-data-type=IDT_Gen_val_Coordinate_Y  # 轨迹形点Y坐标
    IDT_Array_Data: category=STRUCTURE, dynamic-array-size-profile=VSA_LINEAR  # 打包的数据
      element sizeIndicator: implementation-data-type=specialIDT_DynamicLengthField_uint32
      element IDT_Array_Data: category=ARRAY
        element IDT_Array_Data: array-size=2097152, array-size-handling=ALL-INDICES-SAME-ARRAY-SIZE, array-size-semantics=VARIABLE-SIZE, implementation-data-type=IDT_DataUint8
    IDT_ICC_string_Affect: category=STRUCTURE, dynamic-array-size-profile=VSA_LINEAR
      element sizeIndicator: implementation-data-type=specialIDT_DynamicLengthField_uint32
      element IDT_ICC_string_Affect: category=ARRAY
        element IDT_ICC_string_Affect: array-size=1000, array-size-handling=ALL-INDICES-SAME-ARRAY-SIZE, array-size-semantics=VARIABLE-SIZE, implementation-data-type=specialIDT_StringRef
    IDT_Enum_SKLearnFlag: category=VALUE, base-type=uint8  # SK学习标识
    IDT_ADAS_ProfLong_CycCnt: category=VALUE, base-type=uint8
    IDT_ADAS_enum_NOPQuitReason: category=VALUE, base-type=uint8
    IDT_CellularNetworkDetailInfo: category=STRUCTURE  # 蜂窝网详细信息状态上报
      8 x element, all with category=TYPE_REFERENCE:
        DTE_cellId: implementation-data-type=IDT_CellularCellId  # 小区信息
        DTE_mcc: implementation-data-type=IDT_CellularMcc  # 移动国家码
        DTE_mnc: implementation-data-type=IDT_CellularMnc  # 移动网络码
        DTE_rat: implementation-data-type=IDT_CellularRat  # 网络制式
        DTE_rsrp: implementation-data-type=IDT_CellularRsrp  # 电平（兼容4G/5G制式）
        DTE_sinr: implementation-data-type=IDT_CellularSinr  # 质量（兼容4G/5G制式）
        DTE_frequency: implementation-data-type=IDT_CellularFrequency  # 频点
        DTE_pci: implementation-data-type=IDT_CellularPci  # PCI
    IDT_ICC_enum_RecordUploadBtn: category=VALUE, base-type=uint8  # 录音数据回传按钮
    IDT_ADAS_enum_ParkingVoiceRemind: category=VALUE, base-type=uint8
    IDT_TripUtcSecs: category=VALUE, base-type=uint32  # 预约出行时间
    IDT_ICC_strt_WeatherInfo: category=STRUCTURE
      element DTE_WeatherID: implementation-data-type=IDT_ICC_enum_WeatherID  # 天气类型
      element DTE_WeatherDistance: implementation-data-type=IDT_ICC_val_Distance  # 自车距离天气区域的距离
    IDT_StrVar_ScheduleID: category=STRUCTURE, dynamic-array-size-profile=VSA_LINEAR
      element sizeIndicator: implementation-data-type=specialIDT_DynamicLengthField_uint32
      element IDT_StrVar_ScheduleID: category=ARRAY
        element IDT_StrVar_ScheduleID: array-size=64, array-size-handling=ALL-INDICES-SAME-ARRAY-SIZE, array-size-semantics=VARIABLE-SIZE, implementation-data-type=specialIDT_StringRef
    IDT_ICC_int32_ExtenLaneAction: category=VALUE, base-type=sint32
    IDT_Arr_TollGateInfoReserved: category=ARRAY  # 预留 Reserved
      element Reserved_int32_Type: array-size=20, array-size-semantics=FIXED-SIZE, implementation-data-type=IDT_Reserved_int32_Type
    IDT_Enum_AziInfo: category=VALUE, base-type=uint16  # 方位角信息 Azimuth information
    IDT_ADAS_uint8_ScoreMap: category=VALUE, base-type=uint8
    IDT_ADAS_strt_Light: category=STRUCTURE  # 红绿灯信息
      4 x element, all with category=TYPE_REFERENCE:
        DTE_LightType: implementation-data-type=IDT_ADAS_enum_LightType  # 红绿灯类型
        DTE_LightColor: implementation-data-type=IDT_ADAS_enum_LightColor  # 红绿灯颜色
        DTE_RemainingTime: implementation-data-type=IDT_ADAS_val_RemainingTime  # 红绿灯剩余时间
        DTE_LightReserved: implementation-data-type=IDT_Light_arr_Reserved  # 预留
    IDT_StrVar_BleSlaverRightVer: category=STRUCTURE, dynamic-array-size-profile=VSA_LINEAR  # 蓝牙右从模块软件版本
      element sizeIndicator: implementation-data-type=specialIDT_DynamicLengthField_uint32
      element IDT_StrVar_BleSlaverRightVer: category=ARRAY
        element IDT_StrVar_BleSlaverRightVer: array-size=24, array-size-handling=ALL-INDICES-SAME-ARRAY-SIZE, array-size-semantics=VARIABLE-SIZE, implementation-data-type=specialIDT_StringRef
    IDT_ICC_enum_VoiceControlLaneChange: category=VALUE, base-type=uint8  # 语音变道指令
    IDT_SatelliteNum: category=VALUE, base-type=sint32
    IDT_CellularSinr: category=VALUE, base-type=sint32  # 质量（兼容4G/5G制式）
    IDT_TLAInfo_arr_Reserved: category=ARRAY
      element Reserved_uint8_Type: array-size=30, array-size-semantics=FIXED-SIZE, implementation-data-type=IDT_Reserved_uint8_Type
    IDT_ADAS_strt_TrafficSignIdentify: category=STRUCTURE
      5 x element, all with category=TYPE_REFERENCE:
        DTE_TSISgnGiWay: implementation-data-type=IDT_ADAS_enum_TSISgnGiWay  # TSR让行类标识牌
        DTE_TSISgnLongStay: implementation-data-type=IDT_ADAS_enum_TSISgnLongStay  # TSR长时类标识牌
        DTE_TSISgnForb: implementation-data-type=IDT_ADAS_enum_TSISgnForb  # TSR禁止类标识牌
        DTE_TSINoParkWarn: implementation-data-type=IDT_ADAS_enum_TSINoParkWarn  # 禁止停车提示
        DTE_TrafficSignIdentifyReserved: implementation-data-type=IDT_TrafficSignIdentify_arr_Reserved  # 预留
package /DataTypes/Units
  127 x unit:
    U_Progress: display-name=%
    U_ICC_float_Percent: display-name=%
    U_ICC_int32_Speed: display-name=km/h
    U_Dbl_GndHeadInfo: display-name=deg
    U_Gen_val_Pitch: display-name=deg
    U_ADAS_enum_TolAPAParkedOutTime: display-name=s
    U_ADAS_enum_SglU_turnsNum: display-name=pcs
    U_ICC_enum_ISLICruiseSpdOffsetAbd: display-name=kph
    U_ADAS_Posn_Spd: display-name=m/s
    U_ADAS_Stub_TurnAngl: display-name=°
    U_ADAS_enum_TolAutoAvoidObstacle: display-name=pcs
    U_DownFlow: display-name=byte
    U_ICC_val_Time: display-name=s
    U_ICC_val_Distance: display-name=m
    U_ADAS_val_laneID: display-name=/
    U_NanoSecondTimeStampOffset: display-name=ns
    U_ADAS_val_MemRouteCreatTime: display-name=ns
    U_ADAS_enum_SglNOAMileage: display-name=km
    U_LCM_IMU_gpsSow: display-name=ms
    U_ICC_Navi_Latitude: display-name=deg
    U_LCM_IMU_Acc_X: display-name=m/s²
    U_ADAS_enum_TolAPANum: display-name=s
    U_ADAS_val_HNOACruiseSpdOffsetPercentFb: display-name=%
    U_ADAS_enum_TolAutoMergeChangeLane: display-name=pcs
    U_LCM_IMU_Acc_Z: display-name=m/s²
    U_LCM_IMU_Acc_Y: display-name=m/s²
    U_ADAS_val_altitude: display-name=m
    U_ADAS_val_latitude: display-name=degree
    U_Enum_SNRInfo: display-name=dBHz
    U_ADAS_val_timestampnSec: display-name=ns
    U_ValetParkingReferDistanceStep: display-name=m
    U_ADAS_val_longitude: display-name=degree
    U_ADAS_val_HPAVPAGiveWayVehTimes: display-name=time
    U_UpFlow: display-name=byte
    U_ADAS_val_FSRACruiseSpdOffsetPercentFb: display-name=%
    U_ADAS_enum_SglAutoRoadCrossingsNum: display-name=pcs
    U_LanePositionInfo_heading: display-name=degree
    U_ICC_int64_Time: display-name=s
    U_ADAS_val_timestampmSec: display-name=ms
    U_ADAS_val_MeterPerPixely: display-name=m
    U_ADAS_val_MeterPerPixelx: display-name=m
    U_ICC_int32_LinkRemainDist: display-name=m
    U_ICC_int32_Dist: display-name=m
    U_ADAS_val_RemainingTime: display-name=s
    U_ICC_uint64_Time: display-name=s
    U_ADAS_enum_TolLCCMileage: display-name=km
    U_ADAS_Posn_Age: display-name=ms
    U_ADAS_val_HNOACruiseSpdOffsetSpdFb: display-name=kph
    U_SentryModeDuration: display-name=min
    U_ICC_int32_Time: display-name=s
    U_ADAS_val_ParkingProcessTakeTime: display-name=s
    U_ICC_int64_Dist: display-name=m
    U_ADAS_val_PathSaveProgress: display-name=%
    U_FactoryResetTimeLength: display-name=s
    U_ADAS_enum_TolU_turnsNum: display-name=pcs
    U_ICC_enum_HNOACruiseSpdOffsetSpd: display-name=kph
    U_ADAS_float_Point: display-name=m
    U_ICC_float_Speed: display-name=km/h
    U_LanePositionInfo_offset_Lateral: display-name=m
    U_ADAS_val_TrafficLightCountdownNumber: display-name=s
    U_ICC_float_Point: display-name=cm
    U_ADAS_val_heading: display-name=degree
    U_ICC_int32_Angle: display-name=degree
    U_ICC_int64_Speed: display-name=km/h
    U_ADAS_val_SlotID: display-name=/
    U_ICC_Navi_Longitude: display-name=deg
    U_Gen_val_Width: display-name=cm
    U_ADAS_enum_TolAPAParkingTime: display-name=s
    U_LCM_IMU_Gyro_Z: display-name=rad/s
    U_ADAS_val_LineEquation_C3: display-name=1/m^2
    U_ADAS_enum_NOARemainingMileageFromODD: display-name=m
    U_LCM_IMU_Gyro_Y: display-name=rad/s
    U_ADAS_val_LineEquation_C2: display-name=1/m
    U_LCM_IMU_Gyro_X: display-name=rad/s
    U_Enum_ElevnInfo: display-name=deg
    U_Gen_val_Coordinate_X: display-name=cm
    U_Gen_val_Coordinate_Y: display-name=cm
    U_SecondTimeStampOffset: display-name=s
    U_ADAS_enum_SglAutoAvoidObstacle: display-name=pcs
    U_ADAS_Posn_Offset: display-name=m
    U_Gen_val_Coordinate_Z: display-name=cm
    U_ADAS_val_vehicleSpd: display-name=m/s
    U_Gen_val_Length: display-name=cm
    U_ICC_enum_ISLICruiseSpdAbdOffset: display-name=kph
    U_TimeStamp64: display-name=ms
    U_ADAS_val_LineEquation_C1: display-name=rad
    U_ADAS_val_LineEquation_C0: display-name=m
    U_ICC_float_SelectZonePos_X: display-name=cm
    U_ICC_float_SelectZonePos_Y: display-name=cm
    U_ADAS_enum_TolRespondCongestion: display-name=pcs
    U_ADAS_Seg_Offset: display-name=m
    U_ICC_enum_FSRACruiseSpdOffsetSpd: display-name=kph
    U_Gen_val_Height: display-name=cm
    U_Enum_UnixTimestamp: display-name=ms
    U_ADAS_val_ParkingDist: display-name=m
    U_Enum_AziInfo: display-name=deg
    U_Gen_val_Yaw: display-name=deg
    U_ADAS_Posn_Rehead: display-name=°
    U_ICC_val_altitude: display-name=m
    U_DataUint64: display-name=ms
    U_DataInt32: display-name=1/2^32 full circle
    U_Gen_val_Roll: display-name=deg
    U_ADAS_val_SpdLimitOffsetAbs: display-name=kph
    U_ADAS_enum_MNPRouteMileage: display-name=km
    U_ADAS_enum_MNPNewRouteSaving: display-name=%
    U_ICC_enum_ISLICruiseSpdRelOffset: display-name=%
    U_ADAS_enum_TolAccessRemitramp: display-name=pcs
    U_ICC_val_latitude: display-name=degree
    U_ADAS_enum_TolAutoRoadCrossingsNum: display-name=pcs
    U_ADAS_enum_TolNOAMileage: display-name=km
    U_LanePositionInfo_offset: display-name=m
    U_ADAS_enum_Percent: display-name=%
    U_ADAS_enum_SglAutoMergeChangeLane: display-name=pcs
    U_ADAS_Seg_EffSpdLmt: display-name=km/h or mph
    U_ADAS_enum_SglRespondCongestion: display-name=pcs
    U_LCM_IMU_gpsWeek: display-name=week
    U_ICC_enum_FSRACruiseSpdOffsetPercent: display-name=%
    U_keeptimelength: display-name=s
    U_ADAS_ego_vehicleSpd: display-name=km/h
    U_ADAS_val_ParkingProgressBarInd: display-name=%
    U_ADAS_enum_SglLCCMileage: display-name=km
    U_LanePositionInfo_length: display-name=m
    U_Flt_GndSpdInfo: display-name=m/s
    U_Enum_CarrierInfo: display-name=MHz
    U_ADAS_val_HPAVPAGiveWayPedTimes: display-name=time
    U_ADAS_enum_SglAccessRemitramp: display-name=pcs
    U_ICC_val_longitude: display-name=degree
package /VOS_Platform/SwBaseTypes
  base type UTF_8: category=FIXED_LENGTH, base-type-size=8, base-type-encoding=UTF-8, native-declaration=unsigned char
