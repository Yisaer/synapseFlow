[part 5 of 11: package /System]
AUTOSAR XML (schema 00048)
package /System  (continued)
  system System_AirMi: category=SYSTEM_DESCRIPTION  (continued)
    system mapping Mappings  (continued)
      data-mappings:  (continued)
        sender-receiver-to-signal-mapping={service-instance=[AEP_VLAN62_ICC_8155_Android_UDP_30501/CSI_ADCC_DrivingHmiEnv_VLAN62_ICC_8155_Android, AEP_VLAN62_ICC_8155_Android_TCP_30501/CSI_ADCC_DrivingHmiEnv_VLAN62_ICC_8155_Android], data-element=AM_CompositionPrototype67.ADCC_DrivingHmiEnvConsumer_ICC_8155_Android.AM_CompositionType1.ADCC_DrivingHmiEnv_NtfRoadMarkerList_2_RcvP.DataElement_NtfRoadMarkerList_2, system-signal=SysSIG_Event_NtfRoadMarkerList_2_ADCC_DrivingHmiEnv}
        sender-receiver-to-signal-mapping={service-instance=[AEP_VLAN62_ADCC_UDP_30500/PSI_ADCC_DrivingHmiEnv_1_VLAN62_ADCC, AEP_VLAN62_ADCC_TCP_30500/PSI_ADCC_DrivingHmiEnv_1_VLAN62_ADCC], data-element=AM_CompositionPrototype67.ADCC_DrivingHmiEnv_Provider.AM_CompositionType1.ADCC_DrivingHmiEnv_NtfRoadSurfaceMes_SndP.DataElement_NtfRoadSurfaceMes, system-signal=SysSIG_Event_NtfRoadSurfaceMes_ADCC_DrivingHmiEnv}
        sender-receiver-to-signal-mapping={service-instance=[AEP_VLAN62_ICC_8155_Android_UDP_30501/CSI_ADCC_DrivingHmiEnv_VLAN62_ICC_8155_Android, AEP_VLAN62_ICC_8155_Android_TCP_30501/CSI_ADCC_DrivingHmiEnv_VLAN62_ICC_8155_Android], data-element=AM_CompositionPrototype67.ADCC_DrivingHmiEnvConsumer_ICC_8155_Android.AM_CompositionType1.ADCC_DrivingHmiEnv_NtfRoadSurfaceMes_RcvP.DataElement_NtfRoadSurfaceMes, system-signal=SysSIG_Event_NtfRoadSurfaceMes_ADCC_DrivingHmiEnv}
        sender-receiver-to-signal-mapping={service-instance=[AEP_VLAN62_ADCC_UDP_30500/PSI_ADCC_DrivingHmiEnv_1_VLAN62_ADCC, AEP_VLAN62_ADCC_TCP_30500/PSI_ADCC_DrivingHmiEnv_1_VLAN62_ADCC], data-element=AM_CompositionPrototype67.ADCC_DrivingHmiEnv_Provider.AM_CompositionType1.ADCC_DrivingHmiEnv_NtfDynamicObjectList_Drvg_SndP.DataElement_NtfDynamicObjectList_Drvg, system-signal=SysSIG_Event_NtfDynamicObjectList_Drvg_ADCC_DrivingHmiEnv_1}
        sender-receiver-to-signal-mapping={service-instance=[AEP_VLAN62_ICC_8155_QNX_UDP_30501/CSI_ADCC_DrivingHmiEnv_VLAN62_ICC_8155_QNX, AEP_VLAN62_ICC_8155_QNX_TCP_30501/CSI_ADCC_DrivingHmiEnv_VLAN62_ICC_8155_QNX], data-element=AM_CompositionPrototype67.ADCC_DrivingHmiEnvConsumer_ICC_8155_QNX.AM_CompositionType1.ADCC_DrivingHmiEnv_NtfDynamicObjectList_Drvg_RcvP.DataElement_NtfDynamicObjectList_Drvg, system-signal=SysSIG_Event_NtfDynamicObjectList_Drvg_ADCC_DrivingHmiEnv_1}
        sender-receiver-to-signal-mapping={service-instance=[AEP_VLAN62_ADCC_UDP_30500/PSI_ADCC_DrivingHmiEnv_1_VLAN62_ADCC, AEP_VLAN62_ADCC_TCP_30500/PSI_ADCC_DrivingHmiEnv_1_VLAN62_ADCC], data-element=AM_CompositionPrototype67.ADCC_DrivingHmiEnv_Provider.AM_CompositionType1.ADCC_DrivingHmiEnv_NtfStaticObjectList_Drvg_SndP.DataElement_NtfStaticObjectList_Drvg, system-signal=SysSIG_Event_NtfStaticObjectList_Drvg_ADCC_DrivingHmiEnv_1}
        sender-receiver-to-signal-mapping={service-instance=[AEP_VLAN62_ICC_8155_QNX_UDP_30501/CSI_ADCC_DrivingHmiEnv_VLAN62_ICC_8155_QNX, AEP_VLAN62_ICC_8155_QNX_TCP_30501/CSI_ADCC_DrivingHmiEnv_VLAN62_ICC_8155_QNX], data-element=AM_CompositionPrototype67.ADCC_DrivingHmiEnvConsumer_ICC_8155_QNX.AM_CompositionType1.ADCC_DrivingHmiEnv_NtfStaticObjectList_Drvg_RcvP.DataElement_NtfStaticObjectList_Drvg, system-signal=SysSIG_Event_NtfStaticObjectList_Drvg_ADCC_DrivingHmiEnv_1}
        sender-receiver-to-signal-mapping={service-instance=[AEP_VLAN62_ADCC_UDP_30500/PSI_ADCC_DrivingHmiEnv_1_VLAN62_ADCC, AEP_VLAN62_ADCC_TCP_30500/PSI_ADCC_DrivingHmiEnv_1_VLAN62_ADCC], data-element=AM_CompositionPrototype67.ADCC_DrivingHmiEnv_Provider.AM_CompositionType1.ADCC_DrivingHmiEnv_NtfLaneLineListt_Drvg_SndP.DataElement_NtfLaneLineListt_Drvg, system-signal=SysSIG_Event_NtfLaneLineListt_Drvg_ADCC_DrivingHmiEnv_1}
        sender-receiver-to-signal-mapping={service-instance=[AEP_VLAN62_ICC_8155_QNX_UDP_30501/CSI_ADCC_DrivingHmiEnv_VLAN62_ICC_8155_QNX, AEP_VLAN62_ICC_8155_QNX_TCP_30501/CSI_ADCC_DrivingHmiEnv_VLAN62_ICC_8155_QNX], data-element=AM_CompositionPrototype67.ADCC_DrivingHmiEnvConsumer_ICC_8155_QNX.AM_CompositionType1.ADCC_DrivingHmiEnv_NtfLaneLineListt_Drvg_RcvP.DataElement_NtfLaneLineListt_Drvg, system-signal=SysSIG_Event_NtfLaneLineListt_Drvg_ADCC_DrivingHmiEnv_1}
        sender-receiver-to-signal-mapping={service-instance=[AEP_VLAN62_ADCC_UDP_30500/PSI_ADCC_DrivingHmiEnv_1_VLAN62_ADCC, AEP_VLAN62_ADCC_TCP_30500/PSI_ADCC_DrivingHmiEnv_1_VLAN62_ADCC], data-element=AM_CompositionPrototype67.ADCC_DrivingHmiEnv_Provider.AM_CompositionType1.ADCC_DrivingHmiEnv_NtfEgoFusionPose_Drvg_SndP.DataElement_NtfEgoFusionPose_Drvg, system-signal=SysSIG_Event_NtfEgoFusionPose_Drvg_ADCC_DrivingHmiEnv_1}
        sender-receiver-to-signal-mapping={service-instance=[AEP_VLAN62_ICC_8155_QNX_UDP_30501/CSI_ADCC_DrivingHmiEnv_VLAN62_ICC_8155_QNX, AEP_VLAN62_ICC_8155_QNX_TCP_30501/CSI_ADCC_DrivingHmiEnv_VLAN62_ICC_8155_QNX], data-element=AM_CompositionPrototype67.ADCC_DrivingHmiEnvConsumer_ICC_8155_QNX.AM_CompositionType1.ADCC_DrivingHmiEnv_NtfEgoFusionPose_Drvg_RcvP.DataElement_NtfEgoFusionPose_Drvg, system-signal=SysSIG_Event_NtfEgoFusionPose_Drvg_ADCC_DrivingHmiEnv_1}
        sender-receiver-to-signal-mapping={service-instance=[AEP_VLAN62_ADCC_UDP_30500/PSI_ADCC_DrivingHmiEnv_1_VLAN62_ADCC, AEP_VLAN62_ADCC_TCP_30500/PSI_ADCC_DrivingHmiEnv_1_VLAN62_ADCC], data-element=AM_CompositionPrototype67.ADCC_DrivingHmiEnv_Provider.AM_CompositionType1.ADCC_DrivingHmiEnv_NtfRoadMarkerList_SndP.DataElement_NtfRoadMarkerList, system-signal=SysSIG_Event_NtfRoadMarkerList_ADCC_DrivingHmiEnv_1}
        sender-receiver-to-signal-mapping={service-instance=[AEP_VLAN62_ICC_8155_QNX_UDP_30501/CSI_ADCC_DrivingHmiEnv_VLAN62_ICC_8155_QNX, AEP_VLAN62_ICC_8155_QNX_TCP_30501/CSI_ADCC_DrivingHmiEnv_VLAN62_ICC_8155_QNX], data-element=AM_CompositionPrototype67.ADCC_DrivingHmiEnvConsumer_ICC_8155_QNX.AM_CompositionType1.ADCC_DrivingHmiEnv_NtfRoadMarkerList_RcvP.DataElement_NtfRoadMarkerList, system-signal=SysSIG_Event_NtfRoadMarkerList_ADCC_DrivingHmiEnv_1}
        sender-receiver-to-signal-mapping={service-instance=[AEP_VLAN62_ADCC_UDP_30500/PSI_ADCC_DrivingHmiEnv_1_VLAN62_ADCC, AEP_VLAN62_ADCC_TCP_30500/PSI_ADCC_DrivingHmiEnv_1_VLAN62_ADCC], data-element=AM_CompositionPrototype67.ADCC_DrivingHmiEnv_Provider.AM_CompositionType1.ADCC_DrivingHmiEnv_NtfLaneLineListt_Drvg_2_SndP.DataElement_NtfLaneLineListt_Drvg_2, system-signal=SysSIG_Event_NtfLaneLineListt_Drvg_2_ADCC_DrivingHmiEnv_1}
        sender-receiver-to-signal-mapping={service-instance=[AEP_VLAN62_ICC_8155_QNX_UDP_30501/CSI_ADCC_DrivingHmiEnv_VLAN62_ICC_8155_QNX, AEP_VLAN62_ICC_8155_QNX_TCP_30501/CSI_ADCC_DrivingHmiEnv_VLAN62_ICC_8155_QNX], data-element=AM_CompositionPrototype67.ADCC_DrivingHmiEnvConsumer_ICC_8155_QNX.AM_CompositionType1.ADCC_DrivingHmiEnv_NtfLaneLineListt_Drvg_2_RcvP.DataElement_NtfLaneLineListt_Drvg_2, system-signal=SysSIG_Event_NtfLaneLineListt_Drvg_2_ADCC_DrivingHmiEnv_1}
        sender-receiver-to-signal-mapping={service-instance=[AEP_VLAN62_ADCC_UDP_30500/PSI_ADCC_DrivingHmiEnv_1_VLAN62_ADCC, AEP_VLAN62_ADCC_TCP_30500/PSI_ADCC_DrivingHmiEnv_1_VLAN62_ADCC], data-element=AM_CompositionPrototype67.ADCC_DrivingHmiEnv_Provider.AM_CompositionType1.ADCC_DrivingHmiEnv_NtfEgoPose_SndP.DataElement_NtfEgoPose, system-signal=SysSIG_Event_NtfEgoPose_ADCC_DrivingHmiEnv_1}
        sender-receiver-to-signal-mapping={service-instance=[AEP_VLAN62_ICC_8155_QNX_UDP_30501/CSI_ADCC_DrivingHmiEnv_VLAN62_ICC_8155_QNX, AEP_VLAN62_ICC_8155_QNX_TCP_30501/CSI_ADCC_DrivingHmiEnv_VLAN62_ICC_8155_QNX], data-element=AM_CompositionPrototype67.ADCC_DrivingHmiEnvConsumer_ICC_8155_QNX.AM_CompositionType1.ADCC_DrivingHmiEnv_NtfEgoPose_RcvP.DataElement_NtfEgoPose, system-signal=SysSIG_Event_NtfEgoPose_ADCC_DrivingHmiEnv_1}
        sender-receiver-to-signal-mapping={service-instance=[AEP_VLAN62_ADCC_UDP_30500/PSI_ADCC_DrivingHmiEnv_1_VLAN62_ADCC, AEP_VLAN62_ADCC_TCP_30500/PSI_ADCC_DrivingHmiEnv_1_VLAN62_ADCC], data-element=AM_CompositionPrototype67.ADCC_DrivingHmiEnv_Provider.AM_CompositionType1.ADCC_DrivingHmiEnv_NtfFusionMapData_SndP.DataElement_NtfFusionMapData, system-signal=SysSIG_Event_NtfFusionMapData_ADCC_DrivingHmiEnv_1}
        sender-receiver-to-signal-mapping={service-instance=[AEP_VLAN62_ICC_8155_QNX_UDP_30501/CSI_ADCC_DrivingHmiEnv_VLAN62_ICC_8155_QNX, AEP_VLAN62_ICC_8155_QNX_TCP_30501/CSI_ADCC_DrivingHmiEnv_VLAN62_ICC_8155_QNX], data-element=AM_CompositionPrototype67.ADCC_DrivingHmiEnvConsumer_ICC_8155_QNX.AM_CompositionType1.ADCC_DrivingHmiEnv_NtfFusionMapData_RcvP.DataElement_NtfFusionMapData, system-signal=SysSIG_Event_NtfFusionMapData_ADCC_DrivingHmiEnv_1}
        sender-receiver-to-signal-mapping={service-instance=[AEP_VLAN62_ADCC_UDP_30500/PSI_ADCC_DrivingHmiEnv_1_VLAN62_ADCC, AEP_VLAN62_ADCC_TCP_30500/PSI_ADCC_DrivingHmiEnv_1_VLAN62_ADCC], data-element=AM_CompositionPrototype67.ADCC_DrivingHmiEnv_Provider.AM_CompositionType1.ADCC_DrivingHmiEnv_NtfRoadMarkerListSupplement_SndP.DataElement_NtfRoadMarkerListSupplement, system-signal=SysSIG_Event_NtfRoadMarkerListSupplement_ADCC_DrivingHmiEnv_1}
        sender-receiver-to-signal-mapping={service-instance=[AEP_VLAN62_ICC_8155_QNX_UDP_30501/CSI_ADCC_DrivingHmiEnv_VLAN62_ICC_8155_QNX, AEP_VLAN62_ICC_8155_QNX_TCP_30501/CSI_ADCC_DrivingHmiEnv_VLAN62_ICC_8155_QNX], data-element=AM_CompositionPrototype67.ADCC_DrivingHmiEnvConsumer_ICC_8155_QNX.AM_CompositionType1.ADCC_DrivingHmiEnv_NtfRoadMarkerListSupplement_RcvP.DataElement_NtfRoadMarkerListSupplement, system-signal=SysSIG_Event_NtfRoadMarkerListSupplement_ADCC_DrivingHmiEnv_1}
        sender-receiver-to-signal-mapping={service-instance=[AEP_VLAN62_ADCC_UDP_30500/PSI_ADCC_DrivingHmiEnv_1_VLAN62_ADCC, AEP_VLAN62_ADCC_TCP_30500/PSI_ADCC_DrivingHmiEnv_1_VLAN62_ADCC], data-element=AM_CompositionPrototype67.ADCC_DrivingHmiEnv_Provider.AM_CompositionType1.ADCC_DrivingHmiEnv_NtfTrafficLightList_Drvg_SndP.DataElement_NtfTrafficLightList_Drvg, system-signal=SysSIG_Event_NtfTrafficLightList_Drvg_ADCC_DrivingHmiEnv_1}
        sender-receiver-to-signal-mapping={service-instance=[AEP_VLAN62_ICC_8155_QNX_UDP_30501/CSI_ADCC_DrivingHmiEnv_VLAN62_ICC_8155_QNX, AEP_VLAN62_ICC_8155_QNX_TCP_30501/CSI_ADCC_DrivingHmiEnv_VLAN62_ICC_8155_QNX], data-element=AM_CompositionPrototype67.ADCC_DrivingHmiEnvConsumer_ICC_8155_QNX.AM_CompositionType1.ADCC_DrivingHmiEnv_NtfTrafficLightList_Drvg_RcvP.DataElement_NtfTrafficLightList_Drvg, system-signal=SysSIG_Event_NtfTrafficLightList_Drvg_ADCC_DrivingHmiEnv_1}
        sender-receiver-to-signal-mapping={service-instance=[AEP_VLAN62_ADCC_UDP_30500/PSI_ADCC_DrivingHmiEnv_1_VLAN62_ADCC, AEP_VLAN62_ADCC_TCP_30500/PSI_ADCC_DrivingHmiEnv_1_VLAN62_ADCC], data-element=AM_CompositionPrototype67.ADCC_DrivingHmiEnv_Provider.AM_CompositionType1.ADCC_DrivingHmiEnv_NtfFreeSpaceList_Drvg_SndP.DataElement_NtfFreeSpaceList_Drvg, system-signal=SysSIG_Event_NtfFreeSpaceList_Drvg_ADCC_DrivingHmiEnv_1}
        sender-receiver-to-signal-mapping={service-instance=[AEP_VLAN62_ICC_8155_QNX_UDP_30501/CSI_ADCC_DrivingHmiEnv_VLAN62_ICC_8155_QNX, AEP_VLAN62_ICC_8155_QNX_TCP_30501/CSI_ADCC_DrivingHmiEnv_VLAN62_ICC_8155_QNX], data-element=AM_CompositionPrototype67.ADCC_DrivingHmiEnvConsumer_ICC_8155_QNX.AM_CompositionType1.ADCC_DrivingHmiEnv_NtfFreeSpaceList_Drvg_RcvP.DataElement_NtfFreeSpaceList_Drvg, system-signal=SysSIG_Event_NtfFreeSpaceList_Drvg_ADCC_DrivingHmiEnv_1}
        sender-receiver-to-signal-mapping={service-instance=[AEP_VLAN62_ADCC_UDP_30500/PSI_ADCC_DrivingHmiEnv_1_VLAN62_ADCC, AEP_VLAN62_ADCC_TCP_30500/PSI_ADCC_DrivingHmiEnv_1_VLAN62_ADCC], data-element=AM_CompositionPrototype67.ADCC_DrivingHmiEnv_Provider.AM_CompositionType1.ADCC_DrivingHmiEnv_Ntf3DTrafficSignList_Drvg_SndP.DataElement_Ntf3DTrafficSignList_Drvg, system-signal=SysSIG_Event_Ntf3DTrafficSignList_Drvg_ADCC_DrivingHmiEnv_1}
        sender-receiver-to-signal-mapping={service-instance=[AEP_VLAN62_ICC_8155_QNX_UDP_30501/CSI_ADCC_DrivingHmiEnv_VLAN62_ICC_8155_QNX, AEP_VLAN62_ICC_8155_QNX_TCP_30501/CSI_ADCC_DrivingHmiEnv_VLAN62_ICC_8155_QNX], data-element=AM_CompositionPrototype67.ADCC_DrivingHmiEnvConsumer_ICC_8155_QNX.AM_CompositionType1.ADCC_DrivingHmiEnv_Ntf3DTrafficSignList_Drvg_RcvP.DataElement_Ntf3DTrafficSignList_Drvg, system-signal=SysSIG_Event_Ntf3DTrafficSignList_Drvg_ADCC_DrivingHmiEnv_1}
        sender-receiver-to-signal-mapping={service-instance=[AEP_VLAN62_ADCC_UDP_30500/PSI_ADCC_DrivingHmiEnv_1_VLAN62_ADCC, AEP_VLAN62_ADCC_TCP_30500/PSI_ADCC_DrivingHmiEnv_1_VLAN62_ADCC], data-element=AM_CompositionPrototype67.ADCC_DrivingHmiEnv_Provider.AM_CompositionType1.ADCC_DrivingHmiEnv_NtfDynamicObjectList_Drvg_2_SndP.DataElement_NtfDynamicObjectList_Drvg_2, system-signal=SysSIG_Event_NtfDynamicObjectList_Drvg_2_ADCC_DrivingHmiEnv_1}
        sender-receiver-to-signal-mapping={service-instance=[AEP_VLAN62_ICC_8155_QNX_UDP_30501/CSI_ADCC_DrivingHmiEnv_VLAN62_ICC_8155_QNX, AEP_VLAN62_ICC_8155_QNX_TCP_30501/CSI_ADCC_DrivingHmiEnv_VLAN62_ICC_8155_QNX], data-element=AM_CompositionPrototype67.ADCC_DrivingHmiEnvConsumer_ICC_8155_QNX.AM_CompositionType1.ADCC_DrivingHmiEnv_NtfDynamicObjectList_Drvg_2_RcvP.DataElement_NtfDynamicObjectList_Drvg_2, system-signal=SysSIG_Event_NtfDynamicObjectList_Drvg_2_ADCC_DrivingHmiEnv_1}
        sender-receiver-to-signal-mapping={service-instance=[AEP_VLAN62_ADCC_UDP_30500/PSI_ADCC_DrivingHmiEnv_1_VLAN62_ADCC, AEP_VLAN62_ADCC_TCP_30500/PSI_ADCC_DrivingHmiEnv_1_VLAN62_ADCC], data-element=AM_CompositionPrototype67.ADCC_DrivingHmiEnv_Provider.AM_CompositionType1.ADCC_DrivingHmiEnv_NtfStaticObjectList_Drvg_2_SndP.DataElement_NtfStaticObjectList_Drvg_2, system-signal=SysSIG_Event_NtfStaticObjectList_Drvg_2_ADCC_DrivingHmiEnv_1}
        sender-receiver-to-signal-mapping={service-instance=[AEP_VLAN62_ICC_8155_QNX_UDP_30501/CSI_ADCC_DrivingHmiEnv_VLAN62_ICC_8155_QNX, AEP_VLAN62_ICC_8155_QNX_TCP_30501/CSI_ADCC_DrivingHmiEnv_VLAN62_ICC_8155_QNX], data-element=AM_CompositionPrototype67.ADCC_DrivingHmiEnvConsumer_ICC_8155_QNX.AM_CompositionType1.ADCC_DrivingHmiEnv_NtfStaticObjectList_Drvg_2_RcvP.DataElement_NtfStaticObjectList_Drvg_2, system-signal=SysSIG_Event_NtfStaticObjectList_Drvg_2_ADCC_DrivingHmiEnv_1}
        sender-receiver-to-signal-mapping={service-instance=[AEP_VLAN62_ADCC_UDP_30500/PSI_ADCC_DrivingHmiEnv_1_VLAN62_ADCC, AEP_VLAN62_ADCC_TCP_30500/PSI_ADCC_DrivingHmiEnv_1_VLAN62_ADCC], data-element=AM_CompositionPrototype67.ADCC_DrivingHmiEnv_Provider.AM_CompositionType1.ADCC_DrivingHmiEnv_NtfRoadMarkerList_2_SndP.DataElement_NtfRoadMarkerList_2, system-signal=SysSIG_Event_NtfRoadMarkerList_2_ADCC_DrivingHmiEnv_1}
        sender-receiver-to-signal-mapping={service-instance=[AEP_VLAN62_ICC_8155_QNX_UDP_30501/CSI_ADCC_DrivingHmiEnv_VLAN62_ICC_8155_QNX, AEP_VLAN62_ICC_8155_QNX_TCP_30501/CSI_ADCC_DrivingHmiEnv_VLAN62_ICC_8155_QNX], data-element=AM_CompositionPrototype67.ADCC_DrivingHmiEnvConsumer_ICC_8155_QNX.AM_CompositionType1.ADCC_DrivingHmiEnv_NtfRoadMarkerList_2_RcvP.DataElement_NtfRoadMarkerList_2, system-signal=SysSIG_Event_NtfRoadMarkerList_2_ADCC_DrivingHmiEnv_1}
        sender-receiver-to-signal-mapping={service-instance=[AEP_VLAN62_ADCC_UDP_30500/PSI_ADCC_DrivingHmiEnv_1_VLAN62_ADCC, AEP_VLAN62_ADCC_TCP_30500/PSI_ADCC_DrivingHmiEnv_1_VLAN62_ADCC], data-element=AM_CompositionPrototype67.ADCC_DrivingHmiEnv_Provider.AM_CompositionType1.ADCC_DrivingHmiEnv_NtfRoadSurfaceMes_SndP.DataElement_NtfRoadSurfaceMes, system-signal=SysSIG_Event_NtfRoadSurfaceMes_ADCC_DrivingHmiEnv_1}
        sender-receiver-to-signal-mapping={service-instance=[AEP_VLAN62_ICC_8155_QNX_UDP_30501/CSI_ADCC_DrivingHmiEnv_VLAN62_ICC_8155_QNX, AEP_VLAN62_ICC_8155_QNX_TCP_30501/CSI_ADCC_DrivingHmiEnv_VLAN62_ICC_8155_QNX], data-element=AM_CompositionPrototype67.ADCC_DrivingHmiEnvConsumer_ICC_8155_QNX.AM_CompositionType1.ADCC_DrivingHmiEnv_NtfRoadSurfaceMes_RcvP.DataElement_NtfRoadSurfaceMes, system-signal=SysSIG_Event_NtfRoadSurfaceMes_ADCC_DrivingHmiEnv_1}
        sender-receiver-to-signal-mapping={service-instance=PSI_ADCC_SensorInfo_1_VLAN62_ADCC, data-element=AM_CompositionPrototype67.ADCC_SensorInfo_Provider.AM_CompositionType1.ADCC_SensorInfo_NtfSensorSt_SndP.DataElement_NtfSensorSt, system-signal=SysSIG_Event_NtfSensorSt_ADCC_SensorInfo}
        sender-receiver-to-signal-mapping={service-instance=CSI_ADCC_SensorInfo_VLAN62_ICC_8155_Android, data-element=AM_CompositionPrototype67.ADCC_SensorInfoConsumer_ICC_8155_Android.AM_CompositionType1.ADCC_SensorInfo_NtfSensorSt_RcvP.DataElement_NtfSensorSt, system-signal=SysSIG_Event_NtfSensorSt_ADCC_SensorInfo}
        sender-receiver-to-signal-mapping={service-instance=PSI_ADCC_SensorInfo_1_VLAN62_ADCC, data-element=AM_CompositionPrototype67.ADCC_SensorInfo_Provider.AM_CompositionType1.ADCC_SensorInfo_CamStreamStResp_SndP.DataElement_CamStreamStResp, system-signal=SysSIG_Event_CamStreamStResp_ADCC_SensorInfo}
        sender-receiver-to-signal-mapping={service-instance=CSI_ADCC_SensorInfo_VLAN62_ICC_8155_Android, data-element=AM_CompositionPrototype67.ADCC_SensorInfoConsumer_ICC_8155_Android.AM_CompositionType1.ADCC_SensorInfo_CamStreamStResp_RcvP.DataElement_CamStreamStResp, system-signal=SysSIG_Event_CamStreamStResp_ADCC_SensorInfo}
        client-server-to-signal-mapping={service-instance=PSI_ADCC_SensorInfo_1_VLAN62_ADCC, call-signal=SysSIG_RR_getAvmCamIntrinsics_call_Cis_ICC_8155_Android_ADCC_SensorInfo, client-server-operation=AM_CompositionType1.AM_CompositionPrototype67.ADCC_SensorInfo_Provider.ServerPort_ADCC_SensorInfo.RROper_getAvmCamIntrinsics, return-signal=SysSIG_RR_getAvmCamIntrinsics_return_Cis_ICC_8155_Android_ADCC_SensorInfo}
        client-server-to-signal-mapping={service-instance=CSI_ADCC_SensorInfo_VLAN62_ICC_8155_Android, call-signal=SysSIG_RR_getAvmCamIntrinsics_call_Cis_ICC_8155_Android_ADCC_SensorInfo, client-server-operation=AM_CompositionType1.AM_CompositionPrototype67.ADCC_SensorInfoConsumer_ICC_8155_Android.ClientPort_ADCC_SensorInfo.RROper_getAvmCamIntrinsics, return-signal=SysSIG_RR_getAvmCamIntrinsics_return_Cis_ICC_8155_Android_ADCC_SensorInfo}
        client-server-to-signal-mapping={service-instance=PSI_ADCC_SensorInfo_1_VLAN62_ADCC, call-signal=SysSIG_RR_getAvmCamCalPrms_call_Cis_ICC_8155_Android_ADCC_SensorInfo, client-server-operation=AM_CompositionType1.AM_CompositionPrototype67.ADCC_SensorInfo_Provider.ServerPort_ADCC_SensorInfo.RROper_getAvmCamCalPrms, return-signal=SysSIG_RR_getAvmCamCalPrms_return_Cis_ICC_8155_Android_ADCC_SensorInfo}
        client-server-to-signal-mapping={service-instance=CSI_ADCC_SensorInfo_VLAN62_ICC_8155_Android, call-signal=SysSIG_RR_getAvmCamCalPrms_call_Cis_ICC_8155_Android_ADCC_SensorInfo, client-server-operation=AM_CompositionType1.AM_CompositionPrototype67.ADCC_SensorInfoConsumer_ICC_8155_Android.ClientPort_ADCC_SensorInfo.RROper_getAvmCamCalPrms, return-signal=SysSIG_RR_getAvmCamCalPrms_return_Cis_ICC_8155_Android_ADCC_SensorInfo}
        sender-receiver-to-signal-mapping={service-instance=PSI_ADCC_SensorInfo_1_VLAN62_ADCC, data-element=AM_CompositionPrototype67.ADCC_SensorInfo_Provider.AM_CompositionType1.ADCC_SensorInfo_CamStreamSwtReq_RcvP.DataElement_CamStreamSwtReq, system-signal=SysSIG_FF_CamStreamSwtReq_Cis_ICC_8155_Android_ADCC_SensorInfo}
        sender-receiver-to-signal-mapping={service-instance=CSI_ADCC_SensorInfo_VLAN62_ICC_8155_Android, data-element=AM_CompositionPrototype67.ADCC_SensorInfoConsumer_ICC_8155_Android.AM_CompositionType1.ADCC_SensorInfo_CamStreamSwtReq_SndP.DataElement_CamStreamSwtReq, system-signal=SysSIG_FF_CamStreamSwtReq_Cis_ICC_8155_Android_ADCC_SensorInfo}
        client-server-to-signal-mapping={service-instance=PSI_ADCC_SensorInfo_1_VLAN62_ADCC, call-signal=SysSIG_RR_RR_ADASVersInfo_call_Cis_ICC_8155_Android_ADCC_SensorInfo, client-server-operation=AM_CompositionType1.AM_CompositionPrototype67.ADCC_SensorInfo_Provider.ServerPort_ADCC_SensorInfo.RROper_RR_ADASVersInfo, return-signal=SysSIG_RR_RR_ADASVersInfo_return_Cis_ICC_8155_Android_ADCC_SensorInfo}
        client-server-to-signal-mapping={service-instance=CSI_ADCC_SensorInfo_VLAN62_ICC_8155_Android, call-signal=SysSIG_RR_RR_ADASVersInfo_call_Cis_ICC_8155_Android_ADCC_SensorInfo, client-server-operation=AM_CompositionType1.AM_CompositionPrototype67.ADCC_SensorInfoConsumer_ICC_8155_Android.ClientPort_ADCC_SensorInfo.RROper_RR_ADASVersInfo, return-signal=SysSIG_RR_RR_ADASVersInfo_return_Cis_ICC_8155_Android_ADCC_SensorInfo}
        sender-receiver-to-signal-mapping={service-instance=PSI_ADCC_SensorInfo_1_VLAN62_ADCC, data-element=AM_CompositionPrototype67.ADCC_SensorInfo_Provider.AM_CompositionType1.ADCC_SensorInfo_NtfSensorSt_SndP.DataElement_NtfSensorSt, system-signal=SysSIG_Event_NtfSensorSt_ADCC_SensorInfo_1}
        sender-receiver-to-signal-mapping={service-instance=CSI_ADCC_SensorInfo_VLAN62_ICC_8155_QNX, data-element=AM_CompositionPrototype67.ADCC_SensorInfoConsumer_ICC_8155_QNX.AM_CompositionType1.ADCC_SensorInfo_NtfSensorSt_RcvP.DataElement_NtfSensorSt, system-signal=SysSIG_Event_NtfSensorSt_ADCC_SensorInfo_1}
        sender-receiver-to-signal-mapping={service-instance=PSI_ADCC_SensorInfo_1_VLAN62_ADCC, data-element=AM_CompositionPrototype67.ADCC_SensorInfo_Provider.AM_CompositionType1.ADCC_SensorInfo_CamStreamStResp_SndP.DataElement_CamStreamStResp, system-signal=SysSIG_Event_CamStreamStResp_ADCC_SensorInfo_1}
        sender-receiver-to-signal-mapping={service-instance=CSI_ADCC_SensorInfo_VLAN62_ICC_8155_QNX, data-element=AM_CompositionPrototype67.ADCC_SensorInfoConsumer_ICC_8155_QNX.AM_CompositionType1.ADCC_SensorInfo_CamStreamStResp_RcvP.DataElement_CamStreamStResp, system-signal=SysSIG_Event_CamStreamStResp_ADCC_SensorInfo_1}
        client-server-to-signal-mapping={service-instance=PSI_ADCC_SensorInfo_1_VLAN62_ADCC, call-signal=SysSIG_RR_getAvmCamIntrinsics_call_Cis_ICC_8155_QNX_ADCC_SensorInfo, client-server-operation=AM_CompositionType1.AM_CompositionPrototype67.ADCC_SensorInfo_Provider.ServerPort_ADCC_SensorInfo.RROper_getAvmCamIntrinsics, return-signal=SysSIG_RR_getAvmCamIntrinsics_return_Cis_ICC_8155_QNX_ADCC_SensorInfo}
        client-server-to-signal-mapping={service-instance=CSI_ADCC_SensorInfo_VLAN62_ICC_8155_QNX, call-signal=SysSIG_RR_getAvmCamIntrinsics_call_Cis_ICC_8155_QNX_ADCC_SensorInfo, client-server-operation=AM_CompositionType1.AM_CompositionPrototype67.ADCC_SensorInfoConsumer_ICC_8155_QNX.ClientPort_ADCC_SensorInfo.RROper_getAvmCamIntrinsics, return-signal=SysSIG_RR_getAvmCamIntrinsics_return_Cis_ICC_8155_QNX_ADCC_SensorInfo}
        client-server-to-signal-mapping={service-instance=PSI_ADCC_SensorInfo_1_VLAN62_ADCC, call-signal=SysSIG_RR_getAvmCamCalPrms_call_Cis_ICC_8155_QNX_ADCC_SensorInfo, client-server-operation=AM_CompositionType1.AM_CompositionPrototype67.ADCC_SensorInfo_Provider.ServerPort_ADCC_SensorInfo.RROper_getAvmCamCalPrms, return-signal=SysSIG_RR_getAvmCamCalPrms_return_Cis_ICC_8155_QNX_ADCC_SensorInfo}
        client-server-to-signal-mapping={service-instance=CSI_ADCC_SensorInfo_VLAN62_ICC_8155_QNX, call-signal=SysSIG_RR_getAvmCamCalPrms_call_Cis_ICC_8155_QNX_ADCC_SensorInfo, client-server-operation=AM_CompositionType1.AM_CompositionPrototype67.ADCC_SensorInfoConsumer_ICC_8155_QNX.ClientPort_ADCC_SensorInfo.RROper_getAvmCamCalPrms, return-signal=SysSIG_RR_getAvmCamCalPrms_return_Cis_ICC_8155_QNX_ADCC_SensorInfo}
        sender-receiver-to-signal-mapping={service-instance=PSI_ADCC_SensorInfo_1_VLAN62_ADCC, data-element=AM_CompositionPrototype67.ADCC_SensorInfo_Provider.AM_CompositionType1.ADCC_SensorInfo_CamStreamSwtReq_RcvP.DataElement_CamStreamSwtReq, system-signal=SysSIG_FF_CamStreamSwtReq_Cis_ICC_8155_QNX_ADCC_SensorInfo}
        sender-receiver-to-signal-mapping={service-instance=CSI_ADCC_SensorInfo_VLAN62_ICC_8155_QNX, data-element=AM_CompositionPrototype67.ADCC_SensorInfoConsumer_ICC_8155_QNX.AM_CompositionType1.ADCC_SensorInfo_CamStreamSwtReq_SndP.DataElement_CamStreamSwtReq, system-signal=SysSIG_FF_CamStreamSwtReq_Cis_ICC_8155_QNX_ADCC_SensorInfo}
        client-server-to-signal-mapping={service-instance=PSI_ADCC_SensorInfo_1_VLAN62_ADCC, call-signal=SysSIG_RR_RR_ADASVersInfo_call_Cis_ICC_8155_QNX_ADCC_SensorInfo, client-server-operation=AM_CompositionType1.AM_CompositionPrototype67.ADCC_SensorInfo_Provider.ServerPort_ADCC_SensorInfo.RROper_RR_ADASVersInfo, return-signal=SysSIG_RR_RR_ADASVersInfo_return_Cis_ICC_8155_QNX_ADCC_SensorInfo}
        client-server-to-signal-mapping={service-instance=CSI_ADCC_SensorInfo_VLAN62_ICC_8155_QNX, call-signal=SysSIG_RR_RR_ADASVersInfo_call_Cis_ICC_8155_QNX_ADCC_SensorInfo, client-server-operation=AM_CompositionType1.AM_CompositionPrototype67.ADCC_SensorInfoConsumer_ICC_8155_QNX.ClientPort_ADCC_SensorInfo.RROper_RR_ADASVersInfo, return-signal=SysSIG_RR_RR_ADASVersInfo_return_Cis_ICC_8155_QNX_ADCC_SensorInfo}
        sender-receiver-to-signal-mapping={service-instance=[AEP_VLAN62_ADCC_UDP_30500/PSI_ADCC_DrivingFuncInfo_1_VLAN62_ADCC, AEP_VLAN62_ADCC_TCP_30500/PSI_ADCC_DrivingFuncInfo_1_VLAN62_ADCC], data-element=AM_CompositionPrototype67.ADCC_DrivingFuncInfo_Provider.AM_CompositionType1.ADCC_DrivingFuncInfo_NtfTrafficSign_Drvg_SndP.DataElement_NtfTrafficSign_Drvg, system-signal=SysSIG_Event_NtfTrafficSign_Drvg_ADCC_DrivingFuncInfo}
        sender-receiver-to-signal-mapping={service-instance=[AEP_VLAN62_ICC_8155_Android_UDP_30501/CSI_ADCC_DrivingFuncInfo_VLAN62_ICC_8155_Android, AEP_VLAN62_ICC_8155_Android_TCP_30501/CSI_ADCC_DrivingFuncInfo_VLAN62_ICC_8155_Android], data-element=AM_CompositionPrototype67.ADCC_DrivingFuncInfoConsumer_ICC_8155_Android.AM_CompositionType1.ADCC_DrivingFuncInfo_NtfTrafficSign_Drvg_RcvP.DataElement_NtfTrafficSign_Drvg, system-signal=SysSIG_Event_NtfTrafficSign_Drvg_ADCC_DrivingFuncInfo}
        sender-receiver-to-signal-mapping={service-instance=[AEP_VLAN62_ADCC_UDP_30500/PSI_ADCC_DrivingFuncInfo_1_VLAN62_ADCC, AEP_VLAN62_ADCC_TCP_30500/PSI_ADCC_DrivingFuncInfo_1_VLAN62_ADCC], data-element=AM_CompositionPrototype67.ADCC_DrivingFuncInfo_Provider.AM_CompositionType1.ADCC_DrivingFuncInfo_NtfISLIInfo_Drvg_SndP.DataElement_NtfISLIInfo_Drvg, system-signal=SysSIG_Event_NtfISLIInfo_Drvg_ADCC_DrivingFuncInfo}
        sender-receiver-to-signal-mapping={service-instance=[AEP_VLAN62_ICC_8155_Android_UDP_30501/CSI_ADCC_DrivingFuncInfo_VLAN62_ICC_8155_Android, AEP_VLAN62_ICC_8155_Android_TCP_30501/CSI_ADCC_DrivingFuncInfo_VLAN62_ICC_8155_Android], data-element=AM_CompositionPrototype67.ADCC_DrivingFuncInfoConsumer_ICC_8155_Android.AM_CompositionType1.ADCC_DrivingFuncInfo_NtfISLIInfo_Drvg_RcvP.DataElement_NtfISLIInfo_Drvg, system-signal=SysSIG_Event_NtfISLIInfo_Drvg_ADCC_DrivingFuncInfo}
        sender-receiver-to-signal-mapping={service-instance=[AEP_VLAN62_ADCC_UDP_30500/PSI_ADCC_DrivingFuncInfo_1_VLAN62_ADCC, AEP_VLAN62_ADCC_TCP_30500/PSI_ADCC_DrivingFuncInfo_1_VLAN62_ADCC], data-element=AM_CompositionPrototype67.ADCC_DrivingFuncInfo_Provider.AM_CompositionType1.ADCC_DrivingFuncInfo_NtfACCInfo_Drvg_SndP.DataElement_NtfACCInfo_Drvg, system-signal=SysSIG_Event_NtfACCInfo_Drvg_ADCC_DrivingFuncInfo}
        sender-receiver-to-signal-mapping={service-instance=[AEP_VLAN62_ICC_8155_Android_UDP_30501/CSI_ADCC_DrivingFuncInfo_VLAN62_ICC_8155_Android, AEP_VLAN62_ICC_8155_Android_TCP_30501/CSI_ADCC_DrivingFuncInfo_VLAN62_ICC_8155_Android], data-element=AM_CompositionPrototype67.ADCC_DrivingFuncInfoConsumer_ICC_8155_Android.AM_CompositionType1.ADCC_DrivingFuncInfo_NtfACCInfo_Drvg_RcvP.DataElement_NtfACCInfo_Drvg, system-signal=SysSIG_Event_NtfACCInfo_Drvg_ADCC_DrivingFuncInfo}
        sender-receiver-to-signal-mapping={service-instance=[AEP_VLAN62_ADCC_UDP_30500/PSI_ADCC_DrivingFuncInfo_1_VLAN62_ADCC, AEP_VLAN62_ADCC_TCP_30500/PSI_ADCC_DrivingFuncInfo_1_VLAN62_ADCC], data-element=AM_CompositionPrototype67.ADCC_DrivingFuncInfo_Provider.AM_CompositionType1.ADCC_DrivingFuncInfo_NtfALCInfo_Drvg_SndP.DataElement_NtfALCInfo_Drvg, system-signal=SysSIG_Event_NtfALCInfo_Drvg_ADCC_DrivingFuncInfo}
        sender-receiver-to-signal-mapping={service-instance=[AEP_VLAN62_ICC_8155_Android_UDP_30501/CSI_ADCC_DrivingFuncInfo_VLAN62_ICC_8155_Android, AEP_VLAN62_ICC_8155_Android_TCP_30501/CSI_ADCC_DrivingFuncInfo_VLAN62_ICC_8155_Android], data-element=AM_CompositionPrototype67.ADCC_DrivingFuncInfoConsumer_ICC_8155_Android.AM_CompositionType1.ADCC_DrivingFuncInfo_NtfALCInfo_Drvg_RcvP.DataElement_NtfALCInfo_Drvg, system-signal=SysSIG_Event_NtfALCInfo_Drvg_ADCC_DrivingFuncInfo}
        sender-receiver-to-signal-mapping={service-instance=[AEP_VLAN62_ADCC_UDP_30500/PSI_ADCC_DrivingFuncInfo_1_VLAN62_ADCC, AEP_VLAN62_ADCC_TCP_30500/PSI_ADCC_DrivingFuncInfo_1_VLAN62_ADCC], data-element=AM_CompositionPrototype67.ADCC_DrivingFuncInfo_Provider.AM_CompositionType1.ADCC_DrivingFuncInfo_NtfICAInfo_Drvg_SndP.DataElement_NtfICAInfo_Drvg, system-signal=SysSIG_Event_NtfICAInfo_Drvg_ADCC_DrivingFuncInfo}
        sender-receiver-to-signal-mapping={service-instance=[AEP_VLAN62_ICC_8155_Android_UDP_30501/CSI_ADCC_DrivingFuncInfo_VLAN62_ICC_8155_Android, AEP_VLAN62_ICC_8155_Android_TCP_30501/CSI_ADCC_DrivingFuncInfo_VLAN62_ICC_8155_Android], data-element=AM_CompositionPrototype67.ADCC_DrivingFuncInfoConsumer_ICC_8155_Android.AM_CompositionType1.ADCC_DrivingFuncInfo_NtfICAInfo_Drvg_RcvP.DataElement_NtfICAInfo_Drvg, system-signal=SysSIG_Event_NtfICAInfo_Drvg_ADCC_DrivingFuncInfo}
        sender-receiver-to-signal-mapping={service-instance=[AEP_VLAN62_ADCC_UDP_30500/PSI_ADCC_DrivingFuncInfo_1_VLAN62_ADCC, AEP_VLAN62_ADCC_TCP_30500/PSI_ADCC_DrivingFuncInfo_1_VLAN62_ADCC], data-element=AM_CompositionPrototype67.ADCC_DrivingFuncInfo_Provider.AM_CompositionType1.ADCC_DrivingFuncInfo_NtfIntelligentEvasionInfo_Drvg_SndP.DataElement_NtfIntelligentEvasionInfo_Drvg, system-signal=SysSIG_Event_NtfIntelligentEvasionInfo_Drvg_ADCC_DrivingFuncInfo}
        sender-receiver-to-signal-mapping={service-instance=[AEP_VLAN62_ICC_8155_Android_UDP_30501/CSI_ADCC_DrivingFuncInfo_VLAN62_ICC_8155_Android, AEP_VLAN62_ICC_8155_Android_TCP_30501/CSI_ADCC_DrivingFuncInfo_VLAN62_ICC_8155_Android], data-element=AM_CompositionPrototype67.ADCC_DrivingFuncInfoConsumer_ICC_8155_Android.AM_CompositionType1.ADCC_DrivingFuncInfo_NtfIntelligentEvasionInfo_Drvg_RcvP.DataElement_NtfIntelligentEvasionInfo_Drvg, system-signal=SysSIG_Event_NtfIntelligentEvasionInfo_Drvg_ADCC_DrivingFuncInfo}
        sender-receiver-to-signal-mapping={service-instance=[AEP_VLAN62_ADCC_UDP_30500/PSI_ADCC_DrivingFuncInfo_1_VLAN62_ADCC, AEP_VLAN62_ADCC_TCP_30500/PSI_ADCC_DrivingFuncInfo_1_VLAN62_ADCC], data-element=AM_CompositionPrototype67.ADCC_DrivingFuncInfo_Provider.AM_CompositionType1.ADCC_DrivingFuncInfo_NtfHNOPfunctionInfo_Drvg_SndP.DataElement_NtfHNOPfunctionInfo_Drvg, system-signal=SysSIG_Event_NtfHNOPfunctionInfo_Drvg_ADCC_DrivingFuncInfo}
        sender-receiver-to-signal-mapping={service-instance=[AEP_VLAN62_ICC_8155_Android_UDP_30501/CSI_ADCC_DrivingFuncInfo_VLAN62_ICC_8155_Android, AEP_VLAN62_ICC_8155_Android_TCP_30501/CSI_ADCC_DrivingFuncInfo_VLAN62_ICC_8155_Android], data-element=AM_CompositionPrototype67.ADCC_DrivingFuncInfoConsumer_ICC_8155_Android.AM_CompositionType1.ADCC_DrivingFuncInfo_NtfHNOPfunctionInfo_Drvg_RcvP.DataElement_NtfHNOPfunctionInfo_Drvg, system-signal=SysSIG_Event_NtfHNOPfunctionInfo_Drvg_ADCC_DrivingFuncInfo}
        sender-receiver-to-signal-mapping={service-instance=[AEP_VLAN62_ADCC_UDP_30500/PSI_ADCC_DrivingFuncInfo_1_VLAN62_ADCC, AEP_VLAN62_ADCC_TCP_30500/PSI_ADCC_DrivingFuncInfo_1_VLAN62_ADCC], data-element=AM_CompositionPrototype67.ADCC_DrivingFuncInfo_Provider.AM_CompositionType1.ADCC_DrivingFuncInfo_NtfUNOPfunctionInfo_Drvg_SndP.DataElement_NtfUNOPfunctionInfo_Drvg, system-signal=SysSIG_Event_NtfUNOPfunctionInfo_Drvg_ADCC_DrivingFuncInfo}
        sender-receiver-to-signal-mapping={service-instance=[AEP_VLAN62_ICC_8155_Android_UDP_30501/CSI_ADCC_DrivingFuncInfo_VLAN62_ICC_8155_Android, AEP_VLAN62_ICC_8155_Android_TCP_30501/CSI_ADCC_DrivingFuncInfo_VLAN62_ICC_8155_Android], data-element=AM_CompositionPrototype67.ADCC_DrivingFuncInfoConsumer_ICC_8155_Android.AM_CompositionType1.ADCC_DrivingFuncInfo_NtfUNOPfunctionInfo_Drvg_RcvP.DataElement_NtfUNOPfunctionInfo_Drvg, system-signal=SysSIG_Event_NtfUNOPfunctionInfo_Drvg_ADCC_DrivingFuncInfo}
        sender-receiver-to-signal-mapping={service-instance=[AEP_VLAN62_ADCC_UDP_30500/PSI_ADCC_DrivingFuncInfo_1_VLAN62_ADCC, AEP_VLAN62_ADCC_TCP_30500/PSI_ADCC_DrivingFuncInfo_1_VLAN62_ADCC], data-element=AM_CompositionPrototype67.ADCC_DrivingFuncInfo_Provider.AM_CompositionType1.ADCC_DrivingFuncInfo_NtfHodDmsInfo_Drvg_SndP.DataElement_NtfHodDmsInfo_Drvg, system-signal=SysSIG_Event_NtfHodDmsInfo_Drvg_ADCC_DrivingFuncInfo}
        sender-receiver-to-signal-mapping={service-instance=[AEP_VLAN62_ICC_8155_Android_UDP_30501/CSI_ADCC_DrivingFuncInfo_VLAN62_ICC_8155_Android, AEP_VLAN62_ICC_8155_Android_TCP_30501/CSI_ADCC_DrivingFuncInfo_VLAN62_ICC_8155_Android], data-element=AM_CompositionPrototype67.ADCC_DrivingFuncInfoConsumer_ICC_8155_Android.AM_CompositionType1.ADCC_DrivingFuncInfo_NtfHodDmsInfo_Drvg_RcvP.DataElement_NtfHodDmsInfo_Drvg, system-signal=SysSIG_Event_NtfHodDmsInfo_Drvg_ADCC_DrivingFuncInfo}
        sender-receiver-to-signal-mapping={service-instance=[AEP_VLAN62_ADCC_UDP_30500/PSI_ADCC_DrivingFuncInfo_1_VLAN62_ADCC, AEP_VLAN62_ADCC_TCP_30500/PSI_ADCC_DrivingFuncInfo_1_VLAN62_ADCC], data-element=AM_CompositionPrototype67.ADCC_DrivingFuncInfo_Provider.AM_CompositionType1.ADCC_DrivingFuncInfo_NtfLSSInfo_Drvg_SndP.DataElement_NtfLSSInfo_Drvg, system-signal=SysSIG_Event_NtfLSSInfo_Drvg_ADCC_DrivingFuncInfo}
        sender-receiver-to-signal-mapping={service-instance=[AEP_VLAN62_ICC_8155_Android_UDP_30501/CSI_ADCC_DrivingFuncInfo_VLAN62_ICC_8155_Android, AEP_VLAN62_ICC_8155_Android_TCP_30501/CSI_ADCC_DrivingFuncInfo_VLAN62_ICC_8155_Android], data-element=AM_CompositionPrototype67.ADCC_DrivingFuncInfoConsumer_ICC_8155_Android.AM_CompositionType1.ADCC_DrivingFuncInfo_NtfLSSInfo_Drvg_RcvP.DataElement_NtfLSSInfo_Drvg, system-signal=SysSIG_Event_NtfLSSInfo_Drvg_ADCC_DrivingFuncInfo}
        sender-receiver-to-signal-mapping={service-instance=[AEP_VLAN62_ADCC_UDP_30500/PSI_ADCC_DrivingFuncInfo_1_VLAN62_ADCC, AEP_VLAN62_ADCC_TCP_30500/PSI_ADCC_DrivingFuncInfo_1_VLAN62_ADCC], data-element=AM_CompositionPrototype67.ADCC_DrivingFuncInfo_Provider.AM_CompositionType1.ADCC_DrivingFuncInfo_NtfESSInfo_Drvg_SndP.DataElement_NtfESSInfo_Drvg, system-signal=SysSIG_Event_NtfESSInfo_Drvg_ADCC_DrivingFuncInfo}
        sender-receiver-to-signal-mapping={service-instance=[AEP_VLAN62_ICC_8155_Android_UDP_30501/CSI_ADCC_DrivingFuncInfo_VLAN62_ICC_8155_Android, AEP_VLAN62_ICC_8155_Android_TCP_30501/CSI_ADCC_DrivingFuncInfo_VLAN62_ICC_8155_Android], data-element=AM_CompositionPrototype67.ADCC_DrivingFuncInfoConsumer_ICC_8155_Android.AM_CompositionType1.ADCC_DrivingFuncInfo_NtfESSInfo_Drvg_RcvP.DataElement_NtfESSInfo_Drvg, system-signal=SysSIG_Event_NtfESSInfo_Drvg_ADCC_DrivingFuncInfo}
        sender-receiver-to-signal-mapping={service-instance=[AEP_VLAN62_ADCC_UDP_30500/PSI_ADCC_DrivingFuncInfo_1_VLAN62_ADCC, AEP_VLAN62_ADCC_TCP_30500/PSI_ADCC_DrivingFuncInfo_1_VLAN62_ADCC], data-element=AM_CompositionPrototype67.ADCC_DrivingFuncInfo_Provider.AM_CompositionType1.ADCC_DrivingFuncInfo_NtfDAIInfo_Drvg_SndP.DataElement_NtfDAIInfo_Drvg, system-signal=SysSIG_Event_NtfDAIInfo_Drvg_ADCC_DrivingFuncInfo}
        sender-receiver-to-signal-mapping={service-instance=[AEP_VLAN62_ICC_8155_Android_UDP_30501/CSI_ADCC_DrivingFuncInfo_VLAN62_ICC_8155_Android, AEP_VLAN62_ICC_8155_Android_TCP_30501/CSI_ADCC_DrivingFuncInfo_VLAN62_ICC_8155_Android], data-element=AM_CompositionPrototype67.ADCC_DrivingFuncInfoConsumer_ICC_8155_Android.AM_CompositionType1.ADCC_DrivingFuncInfo_NtfDAIInfo_Drvg_RcvP.DataElement_NtfDAIInfo_Drvg, system-signal=SysSIG_Event_NtfDAIInfo_Drvg_ADCC_DrivingFuncInfo}
        sender-receiver-to-signal-mapping={service-instance=[AEP_VLAN62_ADCC_UDP_30500/PSI_ADCC_DrivingFuncInfo_1_VLAN62_ADCC, AEP_VLAN62_ADCC_TCP_30500/PSI_ADCC_DrivingFuncInfo_1_VLAN62_ADCC], data-element=AM_CompositionPrototype67.ADCC_DrivingFuncInfo_Provider.AM_CompositionType1.ADCC_DrivingFuncInfo_NtfNRAInfo_Drvg_SndP.DataElement_NtfNRAInfo_Drvg, system-signal=SysSIG_Event_NtfNRAInfo_Drvg_ADCC_DrivingFuncInfo}
        sender-receiver-to-signal-mapping={service-instance=[AEP_VLAN62_ICC_8155_Android_UDP_30501/CSI_ADCC_DrivingFuncInfo_VLAN62_ICC_8155_Android, AEP_VLAN62_ICC_8155_Android_TCP_30501/CSI_ADCC_DrivingFuncInfo_VLAN62_ICC_8155_Android], data-element=AM_CompositionPrototype67.ADCC_DrivingFuncInfoConsumer_ICC_8155_Android.AM_CompositionType1.ADCC_DrivingFuncInfo_NtfNRAInfo_Drvg_RcvP.DataElement_NtfNRAInfo_Drvg, system-signal=SysSIG_Event_NtfNRAInfo_Drvg_ADCC_DrivingFuncInfo}
        sender-receiver-to-signal-mapping={service-instance=[AEP_VLAN62_ADCC_UDP_30500/PSI_ADCC_DrivingFuncInfo_1_VLAN62_ADCC, AEP_VLAN62_ADCC_TCP_30500/PSI_ADCC_DrivingFuncInfo_1_VLAN62_ADCC], data-element=AM_CompositionPrototype67.ADCC_DrivingFuncInfo_Provider.AM_CompositionType1.ADCC_DrivingFuncInfo_NtfDrivingSoundInfo_Drvg_SndP.DataElement_NtfDrivingSoundInfo_Drvg, system-signal=SysSIG_Event_NtfDrivingSoundInfo_Drvg_ADCC_DrivingFuncInfo}
        sender-receiver-to-signal-mapping={service-instance=[AEP_VLAN62_ICC_8155_Android_UDP_30501/CSI_ADCC_DrivingFuncInfo_VLAN62_ICC_8155_Android, AEP_VLAN62_ICC_8155_Android_TCP_30501/CSI_ADCC_DrivingFuncInfo_VLAN62_ICC_8155_Android], data-element=AM_CompositionPrototype67.ADCC_DrivingFuncInfoConsumer_ICC_8155_Android.AM_CompositionType1.ADCC_DrivingFuncInfo_NtfDrivingSoundInfo_Drvg_RcvP.DataElement_NtfDrivingSoundInfo_Drvg, system-signal=SysSIG_Event_NtfDrivingSoundInfo_Drvg_ADCC_DrivingFuncInfo}
        sender-receiver-to-signal-mapping={service-instance=[AEP_VLAN62_ADCC_UDP_30500/PSI_ADCC_DrivingFuncInfo_1_VLAN62_ADCC, AEP_VLAN62_ADCC_TCP_30500/PSI_ADCC_DrivingFuncInfo_1_VLAN62_ADCC], data-element=AM_CompositionPrototype67.ADCC_DrivingFuncInfo_Provider.AM_CompositionType1.ADCC_DrivingFuncInfo_NtfMNPInfo_Drvg_SndP.DataElement_NtfMNPInfo_Drvg, system-signal=SysSIG_Event_NtfMNPInfo_Drvg_ADCC_DrivingFuncInfo}
        sender-receiver-to-signal-mapping={service-instance=[AEP_VLAN62_ICC_8155_Android_UDP_30501/CSI_ADCC_DrivingFuncInfo_VLAN62_ICC_8155_Android, AEP_VLAN62_ICC_8155_Android_TCP_30501/CSI_ADCC_DrivingFuncInfo_VLAN62_ICC_8155_Android], data-element=AM_CompositionPrototype67.ADCC_DrivingFuncInfoConsumer_ICC_8155_Android.AM_CompositionType1.ADCC_DrivingFuncInfo_NtfMNPInfo_Drvg_RcvP.DataElement_NtfMNPInfo_Drvg, system-signal=SysSIG_Event_NtfMNPInfo_Drvg_ADCC_DrivingFuncInfo}
        sender-receiver-to-signal-mapping={service-instance=[AEP_VLAN62_ADCC_UDP_30500/PSI_ADCC_DrivingFuncInfo_1_VLAN62_ADCC, AEP_VLAN62_ADCC_TCP_30500/PSI_ADCC_DrivingFuncInfo_1_VLAN62_ADCC], data-element=AM_CompositionPrototype67.ADCC_DrivingFuncInfo_Provider.AM_CompositionType1.ADCC_DrivingFuncInfo_NtfMNPRoutesInfo_Drvg_SndP.DataElement_NtfMNPRoutesInfo_Drvg, system-signal=SysSIG_Event_NtfMNPRoutesInfo_Drvg_ADCC_DrivingFuncInfo}
        sender-receiver-to-signal-mapping={service-instance=[AEP_VLAN62_ICC_8155_Android_UDP_30501/CSI_ADCC_DrivingFuncInfo_VLAN62_ICC_8155_Android, AEP_VLAN62_ICC_8155_Android_TCP_30501/CSI_ADCC_DrivingFuncInfo_VLAN62_ICC_8155_Android], data-element=AM_CompositionPrototype67.ADCC_DrivingFuncInfoConsumer_ICC_8155_Android.AM_CompositionType1.ADCC_DrivingFuncInfo_NtfMNPRoutesInfo_Drvg_RcvP.DataElement_NtfMNPRoutesInfo_Drvg, system-signal=SysSIG_Event_NtfMNPRoutesInfo_Drvg_ADCC_DrivingFuncInfo}
        sender-receiver-to-signal-mapping={service-instance=[AEP_VLAN62_ADCC_UDP_30500/PSI_ADCC_DrivingFuncInfo_1_VLAN62_ADCC, AEP_VLAN62_ADCC_TCP_30500/PSI_ADCC_DrivingFuncInfo_1_VLAN62_ADCC], data-element=AM_CompositionPrototype67.ADCC_DrivingFuncInfo_Provider.AM_CompositionType1.ADCC_DrivingFuncInfo_NtfIHCInfo_Drvg_SndP.DataElement_NtfIHCInfo_Drvg, system-signal=SysSIG_Event_NtfIHCInfo_Drvg_ADCC_DrivingFuncInfo}
        sender-receiver-to-signal-mapping={service-instance=[AEP_VLAN62_ICC_8155_Android_UDP_30501/CSI_ADCC_DrivingFuncInfo_VLAN62_ICC_8155_Android, AEP_VLAN62_ICC_8155_Android_TCP_30501/CSI_ADCC_DrivingFuncInfo_VLAN62_ICC_8155_Android], data-element=AM_CompositionPrototype67.ADCC_DrivingFuncInfoConsumer_ICC_8155_Android.AM_CompositionType1.ADCC_DrivingFuncInfo_NtfIHCInfo_Drvg_RcvP.DataElement_NtfIHCInfo_Drvg, system-signal=SysSIG_Event_NtfIHCInfo_Drvg_ADCC_DrivingFuncInfo}
        sender-receiver-to-signal-mapping={service-instance=[AEP_VLAN62_ADCC_UDP_30500/PSI_ADCC_DrivingFuncInfo_1_VLAN62_ADCC, AEP_VLAN62_ADCC_TCP_30500/PSI_ADCC_DrivingFuncInfo_1_VLAN62_ADCC], data-element=AM_CompositionPrototype67.ADCC_DrivingFuncInfo_Provider.AM_CompositionType1.ADCC_DrivingFuncInfo_NtfISLIInfo_Drvg_2_SndP.DataElement_NtfISLIInfo_Drvg_2, system-signal=SysSIG_Event_NtfISLIInfo_Drvg_2_ADCC_DrivingFuncInfo}
        sender-receiver-to-signal-mapping={service-instance=[AEP_VLAN62_ICC_8155_Android_UDP_30501/CSI_ADCC_DrivingFuncInfo_VLAN62_ICC_8155_Android, AEP_VLAN62_ICC_8155_Android_TCP_30501/CSI_ADCC_DrivingFuncInfo_VLAN62_ICC_8155_Android], data-element=AM_CompositionPrototype67.ADCC_DrivingFuncInfoConsumer_ICC_8155_Android.AM_CompositionType1.ADCC_DrivingFuncInfo_NtfISLIInfo_Drvg_2_RcvP.DataElement_NtfISLIInfo_Drvg_2, system-signal=SysSIG_Event_NtfISLIInfo_Drvg_2_ADCC_DrivingFuncInfo}
        sender-receiver-to-signal-mapping={service-instance=[AEP_VLAN62_ADCC_UDP_30500/PSI_ADCC_DrivingFuncInfo_1_VLAN62_ADCC, AEP_VLAN62_ADCC_TCP_30500/PSI_ADCC_DrivingFuncInfo_1_VLAN62_ADCC], data-element=AM_CompositionPrototype67.ADCC_DrivingFuncInfo_Provider.AM_CompositionType1.ADCC_DrivingFuncInfo_NtfALCInfo_Drvg_2_SndP.DataElement_NtfALCInfo_Drvg_2, system-signal=SysSIG_Event_NtfALCInfo_Drvg_2_ADCC_DrivingFuncInfo}
        sender-receiver-to-signal-mapping={service-instance=[AEP_VLAN62_ICC_8155_Android_UDP_30501/CSI_ADCC_DrivingFuncInfo_VLAN62_ICC_8155_Android, AEP_VLAN62_ICC_8155_Android_TCP_30501/CSI_ADCC_DrivingFuncInfo_VLAN62_ICC_8155_Android], data-element=AM_CompositionPrototype67.ADCC_DrivingFuncInfoConsumer_ICC_8155_Android.AM_CompositionType1.ADCC_DrivingFuncInfo_NtfALCInfo_Drvg_2_RcvP.DataElement_NtfALCInfo_Drvg_2, system-signal=SysSIG_Event_NtfALCInfo_Drvg_2_ADCC_DrivingFuncInfo}
        sender-receiver-to-signal-mapping={service-instance=[AEP_VLAN62_ADCC_UDP_30500/PSI_ADCC_DrivingFuncInfo_1_VLAN62_ADCC, AEP_VLAN62_ADCC_TCP_30500/PSI_ADCC_DrivingFuncInfo_1_VLAN62_ADCC], data-element=AM_CompositionPrototype67.ADCC_DrivingFuncInfo_Provider.AM_CompositionType1.ADCC_DrivingFuncInfo_NtfICAInfo_Drvg_2_SndP.DataElement_NtfICAInfo_Drvg_2, system-signal=SysSIG_Event_NtfICAInfo_Drvg_2_ADCC_DrivingFuncInfo}
        sender-receiver-to-signal-mapping={service-instance=[AEP_VLAN62_ICC_8155_Android_UDP_30501/CSI_ADCC_DrivingFuncInfo_VLAN62_ICC_8155_Android, AEP_VLAN62_ICC_8155_Android_TCP_30501/CSI_ADCC_DrivingFuncInfo_VLAN62_ICC_8155_Android], data-element=AM_CompositionPrototype67.ADCC_DrivingFuncInfoConsumer_ICC_8155_Android.AM_CompositionType1.ADCC_DrivingFuncInfo_NtfICAInfo_Drvg_2_RcvP.DataElement_NtfICAInfo_Drvg_2, system-signal=SysSIG_Event_NtfICAInfo_Drvg_2_ADCC_DrivingFuncInfo}
        sender-receiver-to-signal-mapping={service-instance=[AEP_VLAN62_ADCC_UDP_30500/PSI_ADCC_DrivingFuncInfo_1_VLAN62_ADCC, AEP_VLAN62_ADCC_TCP_30500/PSI_ADCC_DrivingFuncInfo_1_VLAN62_ADCC], data-element=AM_CompositionPrototype67.ADCC_DrivingFuncInfo_Provider.AM_CompositionType1.ADCC_DrivingFuncInfo_NtfLSSInfo_Drvg_2_SndP.DataElement_NtfLSSInfo_Drvg_2, system-signal=SysSIG_Event_NtfLSSInfo_Drvg_2_ADCC_DrivingFuncInfo}
        sender-receiver-to-signal-mapping={service-instance=[AEP_VLAN62_ICC_8155_Android_UDP_30501/CSI_ADCC_DrivingFuncInfo_VLAN62_ICC_8155_Android, AEP_VLAN62_ICC_8155_Android_TCP_30501/CSI_ADCC_DrivingFuncInfo_VLAN62_ICC_8155_Android], data-element=AM_CompositionPrototype67.ADCC_DrivingFuncInfoConsumer_ICC_8155_Android.AM_CompositionType1.ADCC_DrivingFuncInfo_NtfLSSInfo_Drvg_2_RcvP.DataElement_NtfLSSInfo_Drvg_2, system-signal=SysSIG_Event_NtfLSSInfo_Drvg_2_ADCC_DrivingFuncInfo}
        sender-receiver-to-signal-mapping={service-instance=[AEP_VLAN62_ADCC_UDP_30500/PSI_ADCC_DrivingFuncInfo_1_VLAN62_ADCC, AEP_VLAN62_ADCC_TCP_30500/PSI_ADCC_DrivingFuncInfo_1_VLAN62_ADCC], data-element=AM_CompositionPrototype67.ADCC_DrivingFuncInfo_Provider.AM_CompositionType1.ADCC_DrivingFuncInfo_NtfESSInfo_Drvg_2_SndP.DataElement_NtfESSInfo_Drvg_2, system-signal=SysSIG_Event_NtfESSInfo_Drvg_2_ADCC_DrivingFuncInfo}
        sender-receiver-to-signal-mapping={service-instance=[AEP_VLAN62_ICC_8155_Android_UDP_30501/CSI_ADCC_DrivingFuncInfo_VLAN62_ICC_8155_Android, AEP_VLAN62_ICC_8155_Android_TCP_30501/CSI_ADCC_DrivingFuncInfo_VLAN62_ICC_8155_Android], data-element=AM_CompositionPrototype67.ADCC_DrivingFuncInfoConsumer_ICC_8155_Android.AM_CompositionType1.ADCC_DrivingFuncInfo_NtfESSInfo_Drvg_2_RcvP.DataElement_NtfESSInfo_Drvg_2, system-signal=SysSIG_Event_NtfESSInfo_Drvg_2_ADCC_DrivingFuncInfo}
        sender-receiver-to-signal-mapping={service-instance=[AEP_VLAN62_ADCC_UDP_30500/PSI_ADCC_DrivingFuncInfo_1_VLAN62_ADCC, AEP_VLAN62_ADCC_TCP_30500/PSI_ADCC_DrivingFuncInfo_1_VLAN62_ADCC], data-element=AM_CompositionPrototype67.ADCC_DrivingFuncInfo_Provider.AM_CompositionType1.ADCC_DrivingFuncInfo_NtfTrafficSignIdentify_Drvg_SndP.DataElement_NtfTrafficSignIdentify_Drvg, system-signal=SysSIG_Event_NtfTrafficSignIdentify_Drvg_ADCC_DrivingFuncInfo}
        sender-receiver-to-signal-mapping={service-instance=[AEP_VLAN62_ICC_8155_Android_UDP_30501/CSI_ADCC_DrivingFuncInfo_VLAN62_ICC_8155_Android, AEP_VLAN62_ICC_8155_Android_TCP_30501/CSI_ADCC_DrivingFuncInfo_VLAN62_ICC_8155_Android], data-element=AM_CompositionPrototype67.ADCC_DrivingFuncInfoConsumer_ICC_8155_Android.AM_CompositionType1.ADCC_DrivingFuncInfo_NtfTrafficSignIdentify_Drvg_RcvP.DataElement_NtfTrafficSignIdentify_Drvg, system-signal=SysSIG_Event_NtfTrafficSignIdentify_Drvg_ADCC_DrivingFuncInfo}
        sender-receiver-to-signal-mapping={service-instance=[AEP_VLAN62_ADCC_UDP_30500/PSI_ADCC_DrivingFuncInfo_1_VLAN62_ADCC, AEP_VLAN62_ADCC_TCP_30500/PSI_ADCC_DrivingFuncInfo_1_VLAN62_ADCC], data-element=AM_CompositionPrototype67.ADCC_DrivingFuncInfo_Provider.AM_CompositionType1.ADCC_DrivingFuncInfo_NtfACCSupplementInfo_Drvg_SndP.DataElement_NtfACCSupplementInfo_Drvg, system-signal=SysSIG_Event_NtfACCSupplementInfo_Drvg_ADCC_DrivingFuncInfo}
        sender-receiver-to-signal-mapping={service-instance=[AEP_VLAN62_ICC_8155_Android_UDP_30501/CSI_ADCC_DrivingFuncInfo_VLAN62_ICC_8155_Android, AEP_VLAN62_ICC_8155_Android_TCP_30501/CSI_ADCC_DrivingFuncInfo_VLAN62_ICC_8155_Android], data-element=AM_CompositionPrototype67.ADCC_DrivingFuncInfoConsumer_ICC_8155_Android.AM_CompositionType1.ADCC_DrivingFuncInfo_NtfACCSupplementInfo_Drvg_RcvP.DataElement_NtfACCSupplementInfo_Drvg, system-signal=SysSIG_Event_NtfACCSupplementInfo_Drvg_ADCC_DrivingFuncInfo}
        sender-receiver-to-signal-mapping={service-instance=[AEP_VLAN62_ADCC_UDP_30500/PSI_ADCC_DrivingFuncInfo_1_VLAN62_ADCC, AEP_VLAN62_ADCC_TCP_30500/PSI_ADCC_DrivingFuncInfo_1_VLAN62_ADCC], data-element=AM_CompositionPrototype67.ADCC_DrivingFuncInfo_Provider.AM_CompositionType1.ADCC_DrivingFuncInfo_NtfHNOPSupplementInfo_Drvg_SndP.DataElement_NtfHNOPSupplementInfo_Drvg, system-signal=SysSIG_Event_NtfHNOPSupplementInfo_Drvg_ADCC_DrivingFuncInfo}
        sender-receiver-to-signal-mapping={service-instance=[AEP_VLAN62_ICC_8155_Android_UDP_30501/CSI_ADCC_DrivingFuncInfo_VLAN62_ICC_8155_Android, AEP_VLAN62_ICC_8155_Android_TCP_30501/CSI_ADCC_DrivingFuncInfo_VLAN62_ICC_8155_Android], data-element=AM_CompositionPrototype67.ADCC_DrivingFuncInfoConsumer_ICC_8155_Android.AM_CompositionType1.ADCC_DrivingFuncInfo_NtfHNOPSupplementInfo_Drvg_RcvP.DataElement_NtfHNOPSupplementInfo_Drvg, system-signal=SysSIG_Event_NtfHNOPSupplementInfo_Drvg_ADCC_DrivingFuncInfo}
        sender-receiver-to-signal-mapping={service-instance=[AEP_VLAN62_ADCC_UDP_30500/PSI_ADCC_DrivingFuncInfo_1_VLAN62_ADCC, AEP_VLAN62_ADCC_TCP_30500/PSI_ADCC_DrivingFuncInfo_1_VLAN62_ADCC], data-element=AM_CompositionPrototype67.ADCC_DrivingFuncInfo_Provider.AM_CompositionType1.ADCC_DrivingFuncInfo_NtfMNPAllRoutesInfo_Drvg_SndP.DataElement_NtfMNPAllRoutesInfo_Drvg, system-signal=SysSIG_Event_NtfMNPAllRoutesInfo_Drvg_ADCC_DrivingFuncInfo}
        sender-receiver-to-signal-mapping={service-instance=[AEP_VLAN62_ICC_8155_Android_UDP_30501/CSI_ADCC_DrivingFuncInfo_VLAN62_ICC_8155_Android, AEP_VLAN62_ICC_8155_Android_TCP_30501/CSI_ADCC_DrivingFuncInfo_VLAN62_ICC_8155_Android], data-element=AM_CompositionPrototype67.ADCC_DrivingFuncInfoConsumer_ICC_8155_Android.AM_CompositionType1.ADCC_DrivingFuncInfo_NtfMNPAllRoutesInfo_Drvg_RcvP.DataElement_NtfMNPAllRoutesInfo_Drvg, system-signal=SysSIG_Event_NtfMNPAllRoutesInfo_Drvg_ADCC_DrivingFuncInfo}
        sender-receiver-to-signal-mapping={service-instance=[AEP_VLAN62_ADCC_UDP_30500/PSI_ADCC_DrivingFuncInfo_1_VLAN62_ADCC, AEP_VLAN62_ADCC_TCP_30500/PSI_ADCC_DrivingFuncInfo_1_VLAN62_ADCC], data-element=AM_CompositionPrototype67.ADCC_DrivingFuncInfo_Provider.AM_CompositionType1.ADCC_DrivingFuncInfo_NtfMNPMemRouteInfo_Drvg_SndP.DataElement_NtfMNPMemRouteInfo_Drvg, system-signal=SysSIG_Event_NtfMNPMemRouteInfo_Drvg_ADCC_DrivingFuncInfo}
        sender-receiver-to-signal-mapping={service-instance=[AEP_VLAN62_ICC_8155_Android_UDP_30501/CSI_ADCC_DrivingFuncInfo_VLAN62_ICC_8155_Android, AEP_VLAN62_ICC_8155_Android_TCP_30501/CSI_ADCC_DrivingFuncInfo_VLAN62_ICC_8155_Android], data-element=AM_CompositionPrototype67.ADCC_DrivingFuncInfoConsumer_ICC_8155_Android.AM_CompositionType1.ADCC_DrivingFuncInfo_NtfMNPMemRouteInfo_Drvg_RcvP.DataElement_NtfMNPMemRouteInfo_Drvg, system-signal=SysSIG_Event_NtfMNPMemRouteInfo_Drvg_ADCC_DrivingFuncInfo}
        sender-receiver-to-signal-mapping={service-instance=[AEP_VLAN62_ADCC_UDP_30500/PSI_ADCC_DrivingFuncInfo_1_VLAN62_ADCC, AEP_VLAN62_ADCC_TCP_30500/PSI_ADCC_DrivingFuncInfo_1_VLAN62_ADCC], data-element=AM_CompositionPrototype67.ADCC_DrivingFuncInfo_Provider.AM_CompositionType1.ADCC_DrivingFuncInfo_NtfTLRInfo_Drvg_SndP.DataElement_NtfTLRInfo_Drvg, system-signal=SysSIG_Event_NtfTLRInfo_Drvg_ADCC_DrivingFuncInfo}
        sender-receiver-to-signal-mapping={service-instance=[AEP_VLAN62_ICC_8155_Android_UDP_30501/CSI_ADCC_DrivingFuncInfo_VLAN62_ICC_8155_Android, AEP_VLAN62_ICC_8155_Android_TCP_30501/CSI_ADCC_DrivingFuncInfo_VLAN62_ICC_8155_Android], data-element=AM_CompositionPrototype67.ADCC_DrivingFuncInfoConsumer_ICC_8155_Android.AM_CompositionType1.ADCC_DrivingFuncInfo_NtfTLRInfo_Drvg_RcvP.DataElement_NtfTLRInfo_Drvg, system-signal=SysSIG_Event_NtfTLRInfo_Drvg_ADCC_DrivingFuncInfo}
        sender-receiver-to-signal-mapping={service-instance=[AEP_VLAN62_ADCC_UDP_30500/PSI_ADCC_DrivingFuncInfo_1_VLAN62_ADCC, AEP_VLAN62_ADCC_TCP_30500/PSI_ADCC_DrivingFuncInfo_1_VLAN62_ADCC], data-element=AM_CompositionPrototype67.ADCC_DrivingFuncInfo_Provider.AM_CompositionType1.ADCC_DrivingFuncInfo_NtfTLAInfo_Drvg_SndP.DataElement_NtfTLAInfo_Drvg, system-signal=SysSIG_Event_NtfTLAInfo_Drvg_ADCC_DrivingFuncInfo}
        sender-receiver-to-signal-mapping={service-instance=[AEP_VLAN62_ICC_8155_Android_UDP_30501/CSI_ADCC_DrivingFuncInfo_VLAN62_ICC_8155_Android, AEP_VLAN62_ICC_8155_Android_TCP_30501/CSI_ADCC_DrivingFuncInfo_VLAN62_ICC_8155_Android], data-element=AM_CompositionPrototype67.ADCC_DrivingFuncInfoConsumer_ICC_8155_Android.AM_CompositionType1.ADCC_DrivingFuncInfo_NtfTLAInfo_Drvg_RcvP.DataElement_NtfTLAInfo_Drvg, system-signal=SysSIG_Event_NtfTLAInfo_Drvg_ADCC_DrivingFuncInfo}
        sender-receiver-to-signal-mapping={service-instance=[AEP_VLAN62_ADCC_UDP_30500/PSI_ADCC_DrivingFuncInfo_1_VLAN62_ADCC, AEP_VLAN62_ADCC_TCP_30500/PSI_ADCC_DrivingFuncInfo_1_VLAN62_ADCC], data-element=AM_CompositionPrototype67.ADCC_DrivingFuncInfo_Provider.AM_CompositionType1.ADCC_DrivingFuncInfo_NtfMNPInfo_Drvg_2_SndP.DataElement_NtfMNPInfo_Drvg_2, system-signal=SysSIG_Event_NtfMNPInfo_Drvg_2_ADCC_DrivingFuncInfo}
        sender-receiver-to-signal-mapping={service-instance=[AEP_VLAN62_ICC_8155_Android_UDP_30501/CSI_ADCC_DrivingFuncInfo_VLAN62_ICC_8155_Android, AEP_VLAN62_ICC_8155_Android_TCP_30501/CSI_ADCC_DrivingFuncInfo_VLAN62_ICC_8155_Android], data-element=AM_CompositionPrototype67.ADCC_DrivingFuncInfoConsumer_ICC_8155_Android.AM_CompositionType1.ADCC_DrivingFuncInfo_NtfMNPInfo_Drvg_2_RcvP.DataElement_NtfMNPInfo_Drvg_2, system-signal=SysSIG_Event_NtfMNPInfo_Drvg_2_ADCC_DrivingFuncInfo}
        sender-receiver-to-signal-mapping={service-instance=[AEP_VLAN62_ADCC_UDP_30500/PSI_ADCC_DrivingFuncInfo_1_VLAN62_ADCC, AEP_VLAN62_ADCC_TCP_30500/PSI_ADCC_DrivingFuncInfo_1_VLAN62_ADCC], data-element=AM_CompositionPrototype67.ADCC_DrivingFuncInfo_Provider.AM_CompositionType1.ADCC_DrivingFuncInfo_NtfTrafficSign_Drvg_2_SndP.DataElement_NtfTrafficSign_Drvg_2, system-signal=SysSIG_Event_NtfTrafficSign_Drvg_2_ADCC_DrivingFuncInfo}
        sender-receiver-to-signal-mapping={service-instance=[AEP_VLAN62_ICC_8155_Android_UDP_30501/CSI_ADCC_DrivingFuncInfo_VLAN62_ICC_8155_Android, AEP_VLAN62_ICC_8155_Android_TCP_30501/CSI_ADCC_DrivingFuncInfo_VLAN62_ICC_8155_Android], data-element=AM_CompositionPrototype67.ADCC_DrivingFuncInfoConsumer_ICC_8155_Android.AM_CompositionType1.ADCC_DrivingFuncInfo_NtfTrafficSign_Drvg_2_RcvP.DataElement_NtfTrafficSign_Drvg_2, system-signal=SysSIG_Event_NtfTrafficSign_Drvg_2_ADCC_DrivingFuncInfo}
        sender-receiver-to-signal-mapping={service-instance=[AEP_VLAN62_ADCC_UDP_30500/PSI_ADCC_DrivingFuncInfo_1_VLAN62_ADCC, AEP_VLAN62_ADCC_TCP_30500/PSI_ADCC_DrivingFuncInfo_1_VLAN62_ADCC], data-element=AM_CompositionPrototype67.ADCC_DrivingFuncInfo_Provider.AM_CompositionType1.ADCC_DrivingFuncInfo_TolNtfADDrivingCardinfo_SndP.DataElement_TolNtfADDrivingCardinfo, system-signal=SysSIG_Event_TolNtfADDrivingCardinfo_ADCC_DrivingFuncInfo}
        sender-receiver-to-signal-mapping={service-instance=[AEP_VLAN62_ICC_8155_Android_UDP_30501/CSI_ADCC_DrivingFuncInfo_VLAN62_ICC_8155_Android, AEP_VLAN62_ICC_8155_Android_TCP_30501/CSI_ADCC_DrivingFuncInfo_VLAN62_ICC_8155_Android], data-element=AM_CompositionPrototype67.ADCC_DrivingFuncInfoConsumer_ICC_8155_Android.AM_CompositionType1.ADCC_DrivingFuncInfo_TolNtfADDrivingCardinfo_RcvP.DataElement_TolNtfADDrivingCardinfo, system-signal=SysSIG_Event_TolNtfADDrivingCardinfo_ADCC_DrivingFuncInfo}
        sender-receiver-to-signal-mapping={service-instance=[AEP_VLAN62_ADCC_UDP_30500/PSI_ADCC_DrivingFuncInfo_1_VLAN62_ADCC, AEP_VLAN62_ADCC_TCP_30500/PSI_ADCC_DrivingFuncInfo_1_VLAN62_ADCC], data-element=AM_CompositionPrototype67.ADCC_DrivingFuncInfo_Provider.AM_CompositionType1.ADCC_DrivingFuncInfo_SglNtfADDrivingCardinfo_SndP.DataElement_SglNtfADDrivingCardinfo, system-signal=SysSIG_Event_SglNtfADDrivingCardinfo_ADCC_DrivingFuncInfo}
        sender-receiver-to-signal-mapping={service-instance=[AEP_VLAN62_ICC_8155_Android_UDP_30501/CSI_ADCC_DrivingFuncInfo_VLAN62_ICC_8155_Android, AEP_VLAN62_ICC_8155_Android_TCP_30501/CSI_ADCC_DrivingFuncInfo_VLAN62_ICC_8155_Android], data-element=AM_CompositionPrototype67.ADCC_DrivingFuncInfoConsumer_ICC_8155_Android.AM_CompositionType1.ADCC_DrivingFuncInfo_SglNtfADDrivingCardinfo_RcvP.DataElement_SglNtfADDrivingCardinfo, system-signal=SysSIG_Event_SglNtfADDrivingCardinfo_ADCC_DrivingFuncInfo}
        sender-receiver-to-signal-mapping={service-instance=[AEP_VLAN62_ADCC_UDP_30500/PSI_ADCC_DrivingFuncInfo_1_VLAN62_ADCC, AEP_VLAN62_ADCC_TCP_30500/PSI_ADCC_DrivingFuncInfo_1_VLAN62_ADCC], data-element=AM_CompositionPrototype67.ADCC_DrivingFuncInfo_Provider.AM_CompositionType1.ADCC_DrivingFuncInfo_NtfTrafficSign_Drvg_SndP.DataElement_NtfTrafficSign_Drvg, system-signal=SysSIG_Event_NtfTrafficSign_Drvg_ADCC_DrivingFuncInfo_1}
        sender-receiver-to-signal-mapping={service-instance=[AEP_VLAN62_ICC_8155_QNX_UDP_30501/CSI_ADCC_DrivingFuncInfo_VLAN62_ICC_8155_QNX, AEP_VLAN62_ICC_8155_QNX_TCP_30501/CSI_ADCC_DrivingFuncInfo_VLAN62_ICC_8155_QNX], data-element=AM_CompositionPrototype67.ADCC_DrivingFuncInfoConsumer_ICC_8155_QNX.AM_CompositionType1.ADCC_DrivingFuncInfo_NtfTrafficSign_Drvg_RcvP.DataElement_NtfTrafficSign_Drvg, system-signal=SysSIG_Event_NtfTrafficSign_Drvg_ADCC_DrivingFuncInfo_1}
        sender-receiver-to-signal-mapping={service-instance=[AEP_VLAN62_ADCC_UDP_30500/PSI_ADCC_DrivingFuncInfo_1_VLAN62_ADCC, AEP_VLAN62_ADCC_TCP_30500/PSI_ADCC_DrivingFuncInfo_1_VLAN62_ADCC], data-element=AM_CompositionPrototype67.ADCC_DrivingFuncInfo_Provider.AM_CompositionType1.ADCC_DrivingFuncInfo_NtfISLIInfo_Drvg_SndP.DataElement_NtfISLIInfo_Drvg, system-signal=SysSIG_Event_NtfISLIInfo_Drvg_ADCC_DrivingFuncInfo_1}
        sender-receiver-to-signal-mapping={service-instance=[AEP_VLAN62_ICC_8155_QNX_UDP_30501/CSI_ADCC_DrivingFuncInfo_VLAN62_ICC_8155_QNX, AEP_VLAN62_ICC_8155_QNX_TCP_30501/CSI_ADCC_DrivingFuncInfo_VLAN62_ICC_8155_QNX], data-element=AM_CompositionPrototype67.ADCC_DrivingFuncInfoConsumer_ICC_8155_QNX.AM_CompositionType1.ADCC_DrivingFuncInfo_NtfISLIInfo_Drvg_RcvP.DataElement_NtfISLIInfo_Drvg, system-signal=SysSIG_Event_NtfISLIInfo_Drvg_ADCC_DrivingFuncInfo_1}
        sender-receiver-to-signal-mapping={service-instance=[AEP_VLAN62_ADCC_UDP_30500/PSI_ADCC_DrivingFuncInfo_1_VLAN62_ADCC, AEP_VLAN62_ADCC_TCP_30500/PSI_ADCC_DrivingFuncInfo_1_VLAN62_ADCC], data-element=AM_CompositionPrototype67.ADCC_DrivingFuncInfo_Provider.AM_CompositionType1.ADCC_DrivingFuncInfo_NtfACCInfo_Drvg_SndP.DataElement_NtfACCInfo_Drvg, system-signal=SysSIG_Event_NtfACCInfo_Drvg_ADCC_DrivingFuncInfo_1}
        sender-receiver-to-signal-mapping={service-instance=[AEP_VLAN62_ICC_8155_QNX_UDP_30501/CSI_ADCC_DrivingFuncInfo_VLAN62_ICC_8155_QNX, AEP_VLAN62_ICC_8155_QNX_TCP_30501/CSI_ADCC_DrivingFuncInfo_VLAN62_ICC_8155_QNX], data-element=AM_CompositionPrototype67.ADCC_DrivingFuncInfoConsumer_ICC_8155_QNX.AM_CompositionType1.ADCC_DrivingFuncInfo_NtfACCInfo_Drvg_RcvP.DataElement_NtfACCInfo_Drvg, system-signal=SysSIG_Event_NtfACCInfo_Drvg_ADCC_DrivingFuncInfo_1}
        sender-receiver-to-signal-mapping={service-instance=[AEP_VLAN62_ADCC_UDP_30500/PSI_ADCC_DrivingFuncInfo_1_VLAN62_ADCC, AEP_VLAN62_ADCC_TCP_30500/PSI_ADCC_DrivingFuncInfo_1_VLAN62_ADCC], data-element=AM_CompositionPrototype67.ADCC_DrivingFuncInfo_Provider.AM_CompositionType1.ADCC_DrivingFuncInfo_NtfALCInfo_Drvg_SndP.DataElement_NtfALCInfo_Drvg, system-signal=SysSIG_Event_NtfALCInfo_Drvg_ADCC_DrivingFuncInfo_1}
        sender-receiver-to-signal-mapping={service-instance=[AEP_VLAN62_ICC_8155_QNX_UDP_30501/CSI_ADCC_DrivingFuncInfo_VLAN62_ICC_8155_QNX, AEP_VLAN62_ICC_8155_QNX_TCP_30501/CSI_ADCC_DrivingFuncInfo_VLAN62_ICC_8155_QNX], data-element=AM_CompositionPrototype67.ADCC_DrivingFuncInfoConsumer_ICC_8155_QNX.AM_CompositionType1.ADCC_DrivingFuncInfo_NtfALCInfo_Drvg_RcvP.DataElement_NtfALCInfo_Drvg, system-signal=SysSIG_Event_NtfALCInfo_Drvg_ADCC_DrivingFuncInfo_1}
        sender-receiver-to-signal-mapping={service-instance=[AEP_VLAN62_ADCC_UDP_30500/PSI_ADCC_DrivingFuncInfo_1_VLAN62_ADCC, AEP_VLAN62_ADCC_TCP_30500/PSI_ADCC_DrivingFuncInfo_1_VLAN62_ADCC], data-element=AM_CompositionPrototype67.ADCC_DrivingFuncInfo_Provider.AM_CompositionType1.ADCC_DrivingFuncInfo_NtfICAInfo_Drvg_SndP.DataElement_NtfICAInfo_Drvg, system-signal=SysSIG_Event_NtfICAInfo_Drvg_ADCC_DrivingFuncInfo_1}
        sender-receiver-to-signal-mapping={service-instance=[AEP_VLAN62_ICC_8155_QNX_UDP_30501/CSI_ADCC_DrivingFuncInfo_VLAN62_ICC_8155_QNX, AEP_VLAN62_ICC_8155_QNX_TCP_30501/CSI_ADCC_DrivingFuncInfo_VLAN62_ICC_8155_QNX], data-element=AM_CompositionPrototype67.ADCC_DrivingFuncInfoConsumer_ICC_8155_QNX.AM_CompositionType1.ADCC_DrivingFuncInfo_NtfICAInfo_Drvg_RcvP.DataElement_NtfICAInfo_Drvg, system-signal=SysSIG_Event_NtfICAInfo_Drvg_ADCC_DrivingFuncInfo_1}
        sender-receiver-to-signal-mapping={service-instance=[AEP_VLAN62_ADCC_UDP_30500/PSI_ADCC_DrivingFuncInfo_1_VLAN62_ADCC, AEP_VLAN62_ADCC_TCP_30500/PSI_ADCC_DrivingFuncInfo_1_VLAN62_ADCC], data-element=AM_CompositionPrototype67.ADCC_DrivingFuncInfo_Provider.AM_CompositionType1.ADCC_DrivingFuncInfo_NtfIntelligentEvasionInfo_Drvg_SndP.DataElement_NtfIntelligentEvasionInfo_Drvg, system-signal=SysSIG_Event_NtfIntelligentEvasionInfo_Drvg_ADCC_DrivingFuncInfo_1}
        sender-receiver-to-signal-mapping={service-instance=[AEP_VLAN62_ICC_8155_QNX_UDP_30501/CSI_ADCC_DrivingFuncInfo_VLAN62_ICC_8155_QNX, AEP_VLAN62_ICC_8155_QNX_TCP_30501/CSI_ADCC_DrivingFuncInfo_VLAN62_ICC_8155_QNX], data-element=AM_CompositionPrototype67.ADCC_DrivingFuncInfoConsumer_ICC_8155_QNX.AM_CompositionType1.ADCC_DrivingFuncInfo_NtfIntelligentEvasionInfo_Drvg_RcvP.DataElement_NtfIntelligentEvasionInfo_Drvg, system-signal=SysSIG_Event_NtfIntelligentEvasionInfo_Drvg_ADCC_DrivingFuncInfo_1}
        sender-receiver-to-signal-mapping={service-instance=[AEP_VLAN62_ADCC_UDP_30500/PSI_ADCC_DrivingFuncInfo_1_VLAN62_ADCC, AEP_VLAN62_ADCC_TCP_30500/PSI_ADCC_DrivingFuncInfo_1_VLAN62_ADCC], data-element=AM_CompositionPrototype67.ADCC_DrivingFuncInfo_Provider.AM_CompositionType1.ADCC_DrivingFuncInfo_NtfHNOPfunctionInfo_Drvg_SndP.DataElement_NtfHNOPfunctionInfo_Drvg, system-signal=SysSIG_Event_NtfHNOPfunctionInfo_Drvg_ADCC_DrivingFuncInfo_1}
        sender-receiver-to-signal-mapping={service-instance=[AEP_VLAN62_ICC_8155_QNX_UDP_30501/CSI_ADCC_DrivingFuncInfo_VLAN62_ICC_8155_QNX, AEP_VLAN62_ICC_8155_QNX_TCP_30501/CSI_ADCC_DrivingFuncInfo_VLAN62_ICC_8155_QNX], data-element=AM_CompositionPrototype67.ADCC_DrivingFuncInfoConsumer_ICC_8155_QNX.AM_CompositionType1.ADCC_DrivingFuncInfo_NtfHNOPfunctionInfo_Drvg_RcvP.DataElement_NtfHNOPfunctionInfo_Drvg, system-signal=SysSIG_Event_NtfHNOPfunctionInfo_Drvg_ADCC_DrivingFuncInfo_1}
        sender-receiver-to-signal-mapping={service-instance=[AEP_VLAN62_ADCC_UDP_30500/PSI_ADCC_DrivingFuncInfo_1_VLAN62_ADCC, AEP_VLAN62_ADCC_TCP_30500/PSI_ADCC_DrivingFuncInfo_1_VLAN62_ADCC], data-element=AM_CompositionPrototype67.ADCC_DrivingFuncInfo_Provider.AM_CompositionType1.ADCC_DrivingFuncInfo_NtfUNOPfunctionInfo_Drvg_SndP.DataElement_NtfUNOPfunctionInfo_Drvg, system-signal=SysSIG_Event_NtfUNOPfunctionInfo_Drvg_ADCC_DrivingFuncInfo_1}
        sender-receiver-to-signal-mapping={service-instance=[AEP_VLAN62_ICC_8155_QNX_UDP_30501/CSI_ADCC_DrivingFuncInfo_VLAN62_ICC_8155_QNX, AEP_VLAN62_ICC_8155_QNX_TCP_30501/CSI_ADCC_DrivingFuncInfo_VLAN62_ICC_8155_QNX], data-element=AM_CompositionPrototype67.ADCC_DrivingFuncInfoConsumer_ICC_8155_QNX.AM_CompositionType1.ADCC_DrivingFuncInfo_NtfUNOPfunctionInfo_Drvg_RcvP.DataElement_NtfUNOPfunctionInfo_Drvg, system-signal=SysSIG_Event_NtfUNOPfunctionInfo_Drvg_ADCC_DrivingFuncInfo_1}
        sender-receiver-to-signal-mapping={service-instance=[AEP_VLAN62_ADCC_UDP_30500/PSI_ADCC_DrivingFuncInfo_1_VLAN62_ADCC, AEP_VLAN62_ADCC_TCP_30500/PSI_ADCC_DrivingFuncInfo_1_VLAN62_ADCC], data-element=AM_CompositionPrototype67.ADCC_DrivingFuncInfo_Provider.AM_CompositionType1.ADCC_DrivingFuncInfo_NtfHodDmsInfo_Drvg_SndP.DataElement_NtfHodDmsInfo_Drvg, system-signal=SysSIG_Event_NtfHodDmsInfo_Drvg_ADCC_DrivingFuncInfo_1}
        sender-receiver-to-signal-mapping={service-instance=[AEP_VLAN62_ICC_8155_QNX_UDP_30501/CSI_ADCC_DrivingFuncInfo_VLAN62_ICC_8155_QNX, AEP_VLAN62_ICC_8155_QNX_TCP_30501/CSI_ADCC_DrivingFuncInfo_VLAN62_ICC_8155_QNX], data-element=AM_CompositionPrototype67.ADCC_DrivingFuncInfoConsumer_ICC_8155_QNX.AM_CompositionType1.ADCC_DrivingFuncInfo_NtfHodDmsInfo_Drvg_RcvP.DataElement_NtfHodDmsInfo_Drvg, system-signal=SysSIG_Event_NtfHodDmsInfo_Drvg_ADCC_DrivingFuncInfo_1}
        sender-receiver-to-signal-mapping={service-instance=[AEP_VLAN62_ADCC_UDP_30500/PSI_ADCC_DrivingFuncInfo_1_VLAN62_ADCC, AEP_VLAN62_ADCC_TCP_30500/PSI_ADCC_DrivingFuncInfo_1_VLAN62_ADCC], data-element=AM_CompositionPrototype67.ADCC_DrivingFuncInfo_Provider.AM_CompositionType1.ADCC_DrivingFuncInfo_NtfLSSInfo_Drvg_SndP.DataElement_NtfLSSInfo_Drvg, system-signal=SysSIG_Event_NtfLSSInfo_Drvg_ADCC_DrivingFuncInfo_1}
        sender-receiver-to-signal-mapping={service-instance=[AEP_VLAN62_ICC_8155_QNX_UDP_30501/CSI_ADCC_DrivingFuncInfo_VLAN62_ICC_8155_QNX, AEP_VLAN62_ICC_8155_QNX_TCP_30501/CSI_ADCC_DrivingFuncInfo_VLAN62_ICC_8155_QNX], data-element=AM_CompositionPrototype67.ADCC_DrivingFuncInfoConsumer_ICC_8155_QNX.AM_CompositionType1.ADCC_DrivingFuncInfo_NtfLSSInfo_Drvg_RcvP.DataElement_NtfLSSInfo_Drvg, system-signal=SysSIG_Event_NtfLSSInfo_Drvg_ADCC_DrivingFuncInfo_1}
        sender-receiver-to-signal-mapping={service-instance=[AEP_VLAN62_ADCC_UDP_30500/PSI_ADCC_DrivingFuncInfo_1_VLAN62_ADCC, AEP_VLAN62_ADCC_TCP_30500/PSI_ADCC_DrivingFuncInfo_1_VLAN62_ADCC], data-element=AM_CompositionPrototype67.ADCC_DrivingFuncInfo_Provider.AM_CompositionType1.ADCC_DrivingFuncInfo_NtfESSInfo_Drvg_SndP.DataElement_NtfESSInfo_Drvg, system-signal=SysSIG_Event_NtfESSInfo_Drvg_ADCC_DrivingFuncInfo_1}
        sender-receiver-to-signal-mapping={service-instance=[AEP_VLAN62_ICC_8155_QNX_UDP_30501/CSI_ADCC_DrivingFuncInfo_VLAN62_ICC_8155_QNX, AEP_VLAN62_ICC_8155_QNX_TCP_30501/CSI_ADCC_DrivingFuncInfo_VLAN62_ICC_8155_QNX], data-element=AM_CompositionPrototype67.ADCC_DrivingFuncInfoConsumer_ICC_8155_QNX.AM_CompositionType1.ADCC_DrivingFuncInfo_NtfESSInfo_Drvg_RcvP.DataElement_NtfESSInfo_Drvg, system-signal=SysSIG_Event_NtfESSInfo_Drvg_ADCC_DrivingFuncInfo_1}
        sender-receiver-to-signal-mapping={service-instance=[AEP_VLAN62_ADCC_UDP_30500/PSI_ADCC_DrivingFuncInfo_1_VLAN62_ADCC, AEP_VLAN62_ADCC_TCP_30500/PSI_ADCC_DrivingFuncInfo_1_VLAN62_ADCC], data-element=AM_CompositionPrototype67.ADCC_DrivingFuncInfo_Provider.AM_CompositionType1.ADCC_DrivingFuncInfo_NtfDAIInfo_Drvg_SndP.DataElement_NtfDAIInfo_Drvg, system-signal=SysSIG_Event_NtfDAIInfo_Drvg_ADCC_DrivingFuncInfo_1}
        sender-receiver-to-signal-mapping={service-instance=[AEP_VLAN62_ICC_8155_QNX_UDP_30501/CSI_ADCC_DrivingFuncInfo_VLAN62_ICC_8155_QNX, AEP_VLAN62_ICC_8155_QNX_TCP_30501/CSI_ADCC_DrivingFuncInfo_VLAN62_ICC_8155_QNX], data-element=AM_CompositionPrototype67.ADCC_DrivingFuncInfoConsumer_ICC_8155_QNX.AM_CompositionType1.ADCC_DrivingFuncInfo_NtfDAIInfo_Drvg_RcvP.DataElement_NtfDAIInfo_Drvg, system-signal=SysSIG_Event_NtfDAIInfo_Drvg_ADCC_DrivingFuncInfo_1}
        sender-receiver-to-signal-mapping={service-instance=[AEP_VLAN62_ADCC_UDP_30500/PSI_ADCC_DrivingFuncInfo_1_VLAN62_ADCC, AEP_VLAN62_ADCC_TCP_30500/PSI_ADCC_DrivingFuncInfo_1_VLAN62_ADCC], data-element=AM_CompositionPrototype67.ADCC_DrivingFuncInfo_Provider.AM_CompositionType1.ADCC_DrivingFuncInfo_NtfNRAInfo_Drvg_SndP.DataElement_NtfNRAInfo_Drvg, system-signal=SysSIG_Event_NtfNRAInfo_Drvg_ADCC_DrivingFuncInfo_1}
        sender-receiver-to-signal-mapping={service-instance=[AEP_VLAN62_ICC_8155_QNX_UDP_30501/CSI_ADCC_DrivingFuncInfo_VLAN62_ICC_8155_QNX, AEP_VLAN62_ICC_8155_QNX_TCP_30501/CSI_ADCC_DrivingFuncInfo_VLAN62_ICC_8155_QNX], data-element=AM_CompositionPrototype67.ADCC_DrivingFuncInfoConsumer_ICC_8155_QNX.AM_CompositionType1.ADCC_DrivingFuncInfo_NtfNRAInfo_Drvg_RcvP.DataElement_NtfNRAInfo_Drvg, system-signal=SysSIG_Event_NtfNRAInfo_Drvg_ADCC_DrivingFuncInfo_1}
        sender-receiver-to-signal-mapping={service-instance=[AEP_VLAN62_ADCC_UDP_30500/PSI_ADCC_DrivingFuncInfo_1_VLAN62_ADCC, AEP_VLAN62_ADCC_TCP_30500/PSI_ADCC_DrivingFuncInfo_1_VLAN62_ADCC], data-element=AM_CompositionPrototype67.ADCC_DrivingFuncInfo_Provider.AM_CompositionType1.ADCC_DrivingFuncInfo_NtfDrivingSoundInfo_Drvg_SndP.DataElement_NtfDrivingSoundInfo_Drvg, system-signal=SysSIG_Event_NtfDrivingSoundInfo_Drvg_ADCC_DrivingFuncInfo_1}
        sender-receiver-to-signal-mapping={service-instance=[AEP_VLAN62_ICC_8155_QNX_UDP_30501/CSI_ADCC_DrivingFuncInfo_VLAN62_ICC_8155_QNX, AEP_VLAN62_ICC_8155_QNX_TCP_30501/CSI_ADCC_DrivingFuncInfo_VLAN62_ICC_8155_QNX], data-element=AM_CompositionPrototype67.ADCC_DrivingFuncInfoConsumer_ICC_8155_QNX.AM_CompositionType1.ADCC_DrivingFuncInfo_NtfDrivingSoundInfo_Drvg_RcvP.DataElement_NtfDrivingSoundInfo_Drvg, system-signal=SysSIG_Event_NtfDrivingSoundInfo_Drvg_ADCC_DrivingFuncInfo_1}
        sender-receiver-to-signal-mapping={service-instance=[AEP_VLAN62_ADCC_UDP_30500/PSI_ADCC_DrivingFuncInfo_1_VLAN62_ADCC, AEP_VLAN62_ADCC_TCP_30500/PSI_ADCC_DrivingFuncInfo_1_VLAN62_ADCC], data-element=AM_CompositionPrototype67.ADCC_DrivingFuncInfo_Provider.AM_CompositionType1.ADCC_DrivingFuncInfo_NtfMNPInfo_Drvg_SndP.DataElement_NtfMNPInfo_Drvg, system-signal=SysSIG_Event_NtfMNPInfo_Drvg_ADCC_DrivingFuncInfo_1}
        sender-receiver-to-signal-mapping={service-instance=[AEP_VLAN62_ICC_8155_QNX_UDP_30501/CSI_ADCC_DrivingFuncInfo_VLAN62_ICC_8155_QNX, AEP_VLAN62_ICC_8155_QNX_TCP_30501/CSI_ADCC_DrivingFuncInfo_VLAN62_ICC_8155_QNX], data-element=AM_CompositionPrototype67.ADCC_DrivingFuncInfoConsumer_ICC_8155_QNX.AM_CompositionType1.ADCC_DrivingFuncInfo_NtfMNPInfo_Drvg_RcvP.DataElement_NtfMNPInfo_Drvg, system-signal=SysSIG_Event_NtfMNPInfo_Drvg_ADCC_DrivingFuncInfo_1}
        sender-receiver-to-signal-mapping={service-instance=[AEP_VLAN62_ADCC_UDP_30500/PSI_ADCC_DrivingFuncInfo_1_VLAN62_ADCC, AEP_VLAN62_ADCC_TCP_30500/PSI_ADCC_DrivingFuncInfo_1_VLAN62_ADCC], data-element=AM_CompositionPrototype67.ADCC_DrivingFuncInfo_Provider.AM_CompositionType1.ADCC_DrivingFuncInfo_NtfMNPRoutesInfo_Drvg_SndP.DataElement_NtfMNPRoutesInfo_Drvg, system-signal=SysSIG_Event_NtfMNPRoutesInfo_Drvg_ADCC_DrivingFuncInfo_1}
        sender-receiver-to-signal-mapping={service-instance=[AEP_VLAN62_ICC_8155_QNX_UDP_30501/CSI_ADCC_DrivingFuncInfo_VLAN62_ICC_8155_QNX, AEP_VLAN62_ICC_8155_QNX_TCP_30501/CSI_ADCC_DrivingFuncInfo_VLAN62_ICC_8155_QNX], data-element=AM_CompositionPrototype67.ADCC_DrivingFuncInfoConsumer_ICC_8155_QNX.AM_CompositionType1.ADCC_DrivingFuncInfo_NtfMNPRoutesInfo_Drvg_RcvP.DataElement_NtfMNPRoutesInfo_Drvg, system-signal=SysSIG_Event_NtfMNPRoutesInfo_Drvg_ADCC_DrivingFuncInfo_1}
        sender-receiver-to-signal-mapping={service-instance=[AEP_VLAN62_ADCC_UDP_30500/PSI_ADCC_DrivingFuncInfo_1_VLAN62_ADCC, AEP_VLAN62_ADCC_TCP_30500/PSI_ADCC_DrivingFuncInfo_1_VLAN62_ADCC], data-element=AM_CompositionPrototype67.ADCC_DrivingFuncInfo_Provider.AM_CompositionType1.ADCC_DrivingFuncInfo_NtfIHCInfo_Drvg_SndP.DataElement_NtfIHCInfo_Drvg, system-signal=SysSIG_Event_NtfIHCInfo_Drvg_ADCC_DrivingFuncInfo_1}
        sender-receiver-to-signal-mapping={service-instance=[AEP_VLAN62_ICC_8155_QNX_UDP_30501/CSI_ADCC_DrivingFuncInfo_VLAN62_ICC_8155_QNX, AEP_VLAN62_ICC_8155_QNX_TCP_30501/CSI_ADCC_DrivingFuncInfo_VLAN62_ICC_8155_QNX], data-element=AM_CompositionPrototype67.ADCC_DrivingFuncInfoConsumer_ICC_8155_QNX.AM_CompositionType1.ADCC_DrivingFuncInfo_NtfIHCInfo_Drvg_RcvP.DataElement_NtfIHCInfo_Drvg, system-signal=SysSIG_Event_NtfIHCInfo_Drvg_ADCC_DrivingFuncInfo_1}
        sender-receiver-to-signal-mapping={service-instance=[AEP_VLAN62_ADCC_UDP_30500/PSI_ADCC_DrivingFuncInfo_1_VLAN62_ADCC, AEP_VLAN62_ADCC_TCP_30500/PSI_ADCC_DrivingFuncInfo_1_VLAN62_ADCC], data-element=AM_CompositionPrototype67.ADCC_DrivingFuncInfo_Provider.AM_CompositionType1.ADCC_DrivingFuncInfo_NtfISLIInfo_Drvg_2_SndP.DataElement_NtfISLIInfo_Drvg_2, system-signal=SysSIG_Event_NtfISLIInfo_Drvg_2_ADCC_DrivingFuncInfo_1}
        sender-receiver-to-signal-mapping={service-instance=[AEP_VLAN62_ICC_8155_QNX_UDP_30501/CSI_ADCC_DrivingFuncInfo_VLAN62_ICC_8155_QNX, AEP_VLAN62_ICC_8155_QNX_TCP_30501/CSI_ADCC_DrivingFuncInfo_VLAN62_ICC_8155_QNX], data-element=AM_CompositionPrototype67.ADCC_DrivingFuncInfoConsumer_ICC_8155_QNX.AM_CompositionType1.ADCC_DrivingFuncInfo_NtfISLIInfo_Drvg_2_RcvP.DataElement_NtfISLIInfo_Drvg_2, system-signal=SysSIG_Event_NtfISLIInfo_Drvg_2_ADCC_DrivingFuncInfo_1}
        sender-receiver-to-signal-mapping={service-instance=[AEP_VLAN62_ADCC_UDP_30500/PSI_ADCC_DrivingFuncInfo_1_VLAN62_ADCC, AEP_VLAN62_ADCC_TCP_30500/PSI_ADCC_DrivingFuncInfo_1_VLAN62_ADCC], data-element=AM_CompositionPrototype67.ADCC_DrivingFuncInfo_Provider.AM_CompositionType1.ADCC_DrivingFuncInfo_NtfALCInfo_Drvg_2_SndP.DataElement_NtfALCInfo_Drvg_2, system-signal=SysSIG_Event_NtfALCInfo_Drvg_2_ADCC_DrivingFuncInfo_1}
        sender-receiver-to-signal-mapping={service-instance=[AEP_VLAN62_ICC_8155_QNX_UDP_30501/CSI_ADCC_DrivingFuncInfo_VLAN62_ICC_8155_QNX, AEP_VLAN62_ICC_8155_QNX_TCP_30501/CSI_ADCC_DrivingFuncInfo_VLAN62_ICC_8155_QNX], data-element=AM_CompositionPrototype67.ADCC_DrivingFuncInfoConsumer_ICC_8155_QNX.AM_CompositionType1.ADCC_DrivingFuncInfo_NtfALCInfo_Drvg_2_RcvP.DataElement_NtfALCInfo_Drvg_2, system-signal=SysSIG_Event_NtfALCInfo_Drvg_2_ADCC_DrivingFuncInfo_1}
        sender-receiver-to-signal-mapping={service-instance=[AEP_VLAN62_ADCC_UDP_30500/PSI_ADCC_DrivingFuncInfo_1_VLAN62_ADCC, AEP_VLAN62_ADCC_TCP_30500/PSI_ADCC_DrivingFuncInfo_1_VLAN62_ADCC], data-element=AM_CompositionPrototype67.ADCC_DrivingFuncInfo_Provider.AM_CompositionType1.ADCC_DrivingFuncInfo_NtfICAInfo_Drvg_2_SndP.DataElement_NtfICAInfo_Drvg_2, system-signal=SysSIG_Event_NtfICAInfo_Drvg_2_ADCC_DrivingFuncInfo_1}
        sender-receiver-to-signal-mapping={service-instance=[AEP_VLAN62_ICC_8155_QNX_UDP_30501/CSI_ADCC_DrivingFuncInfo_VLAN62_ICC_8155_QNX, AEP_VLAN62_ICC_8155_QNX_TCP_30501/CSI_ADCC_DrivingFuncInfo_VLAN62_ICC_8155_QNX], data-element=AM_CompositionPrototype67.ADCC_DrivingFuncInfoConsumer_ICC_8155_QNX.AM_CompositionType1.ADCC_DrivingFuncInfo_NtfICAInfo_Drvg_2_RcvP.DataElement_NtfICAInfo_Drvg_2, system-signal=SysSIG_Event_NtfICAInfo_Drvg_2_ADCC_DrivingFuncInfo_1}
        sender-receiver-to-signal-mapping={service-instance=[AEP_VLAN62_ADCC_UDP_30500/PSI_ADCC_DrivingFuncInfo_1_VLAN62_ADCC, AEP_VLAN62_ADCC_TCP_30500/PSI_ADCC_DrivingFuncInfo_1_VLAN62_ADCC], data-element=AM_CompositionPrototype67.ADCC_DrivingFuncInfo_Provider.AM_CompositionType1.ADCC_DrivingFuncInfo_NtfLSSInfo_Drvg_2_SndP.DataElement_NtfLSSInfo_Drvg_2, system-signal=SysSIG_Event_NtfLSSInfo_Drvg_2_ADCC_DrivingFuncInfo_1}
        sender-receiver-to-signal-mapping={service-instance=[AEP_VLAN62_ICC_8155_QNX_UDP_30501/CSI_ADCC_DrivingFuncInfo_VLAN62_ICC_8155_QNX, AEP_VLAN62_ICC_8155_QNX_TCP_30501/CSI_ADCC_DrivingFuncInfo_VLAN62_ICC_8155_QNX], data-element=AM_CompositionPrototype67.ADCC_DrivingFuncInfoConsumer_ICC_8155_QNX.AM_CompositionType1.ADCC_DrivingFuncInfo_NtfLSSInfo_Drvg_2_RcvP.DataElement_NtfLSSInfo_Drvg_2, system-signal=SysSIG_Event_NtfLSSInfo_Drvg_2_ADCC_DrivingFuncInfo_1}
        sender-receiver-to-signal-mapping={service-instance=[AEP_VLAN62_ADCC_UDP_30500/PSI_ADCC_DrivingFuncInfo_1_VLAN62_ADCC, AEP_VLAN62_ADCC_TCP_30500/PSI_ADCC_DrivingFuncInfo_1_VLAN62_ADCC], data-element=AM_CompositionPrototype67.ADCC_DrivingFuncInfo_Provider.AM_CompositionType1.ADCC_DrivingFuncInfo_NtfESSInfo_Drvg_2_SndP.DataElement_NtfESSInfo_Drvg_2, system-signal=SysSIG_Event_NtfESSInfo_Drvg_2_ADCC_DrivingFuncInfo_1}
        sender-receiver-to-signal-mapping={service-instance=[AEP_VLAN62_ICC_8155_QNX_UDP_30501/CSI_ADCC_DrivingFuncInfo_VLAN62_ICC_8155_QNX, AEP_VLAN62_ICC_8155_QNX_TCP_30501/CSI_ADCC_DrivingFuncInfo_VLAN62_ICC_8155_QNX], data-element=AM_CompositionPrototype67.ADCC_DrivingFuncInfoConsumer_ICC_8155_QNX.AM_CompositionType1.ADCC_DrivingFuncInfo_NtfESSInfo_Drvg_2_RcvP.DataElement_NtfESSInfo_Drvg_2, system-signal=SysSIG_Event_NtfESSInfo_Drvg_2_ADCC_DrivingFuncInfo_1}
        sender-receiver-to-signal-mapping={service-instance=[AEP_VLAN62_ADCC_UDP_30500/PSI_ADCC_DrivingFuncInfo_1_VLAN62_ADCC, AEP_VLAN62_ADCC_TCP_30500/PSI_ADCC_DrivingFuncInfo_1_VLAN62_ADCC], data-element=AM_CompositionPrototype67.ADCC_DrivingFuncInfo_Provider.AM_CompositionType1.ADCC_DrivingFuncInfo_NtfTrafficSignIdentify_Drvg_SndP.DataElement_NtfTrafficSignIdentify_Drvg, system-signal=SysSIG_Event_NtfTrafficSignIdentify_Drvg_ADCC_DrivingFuncInfo_1}
        sender-receiver-to-signal-mapping={service-instance=[AEP_VLAN62_ICC_8155_QNX_UDP_30501/CSI_ADCC_DrivingFuncInfo_VLAN62_ICC_8155_QNX, AEP_VLAN62_ICC_8155_QNX_TCP_30501/CSI_ADCC_DrivingFuncInfo_VLAN62_ICC_8155_QNX], data-element=AM_CompositionPrototype67.ADCC_DrivingFuncInfoConsumer_ICC_8155_QNX.AM_CompositionType1.ADCC_DrivingFuncInfo_NtfTrafficSignIdentify_Drvg_RcvP.DataElement_NtfTrafficSignIdentify_Drvg, system-signal=SysSIG_Event_NtfTrafficSignIdentify_Drvg_ADCC_DrivingFuncInfo_1}
        sender-receiver-to-signal-mapping={service-instance=[AEP_VLAN62_ADCC_UDP_30500/PSI_ADCC_DrivingFuncInfo_1_VLAN62_ADCC, AEP_VLAN62_ADCC_TCP_30500/PSI_ADCC_DrivingFuncInfo_1_VLAN62_ADCC], data-element=AM_CompositionPrototype67.ADCC_DrivingFuncInfo_Provider.AM_CompositionType1.ADCC_DrivingFuncInfo_NtfACCSupplementInfo_Drvg_SndP.DataElement_NtfACCSupplementInfo_Drvg, system-signal=SysSIG_Event_NtfACCSupplementInfo_Drvg_ADCC_DrivingFuncInfo_1}
        sender-receiver-to-signal-mapping={service-instance=[AEP_VLAN62_ICC_8155_QNX_UDP_30501/CSI_ADCC_DrivingFuncInfo_VLAN62_ICC_8155_QNX, AEP_VLAN62_ICC_8155_QNX_TCP_30501/CSI_ADCC_DrivingFuncInfo_VLAN62_ICC_8155_QNX], data-element=AM_CompositionPrototype67.ADCC_DrivingFuncInfoConsumer_ICC_8155_QNX.AM_CompositionType1.ADCC_DrivingFuncInfo_NtfACCSupplementInfo_Drvg_RcvP.DataElement_NtfACCSupplementInfo_Drvg, system-signal=SysSIG_Event_NtfACCSupplementInfo_Drvg_ADCC_DrivingFuncInfo_1}
        sender-receiver-to-signal-mapping={service-instance=[AEP_VLAN62_ADCC_UDP_30500/PSI_ADCC_DrivingFuncInfo_1_VLAN62_ADCC, AEP_VLAN62_ADCC_TCP_30500/PSI_ADCC_DrivingFuncInfo_1_VLAN62_ADCC], data-element=AM_CompositionPrototype67.ADCC_DrivingFuncInfo_Provider.AM_CompositionType1.ADCC_DrivingFuncInfo_NtfHNOPSupplementInfo_Drvg_SndP.DataElement_NtfHNOPSupplementInfo_Drvg, system-signal=SysSIG_Event_NtfHNOPSupplementInfo_Drvg_ADCC_DrivingFuncInfo_1}
        sender-receiver-to-signal-mapping={service-instance=[AEP_VLAN62_ICC_8155_QNX_UDP_30501/CSI_ADCC_DrivingFuncInfo_VLAN62_ICC_8155_QNX, AEP_VLAN62_ICC_8155_QNX_TCP_30501/CSI_ADCC_DrivingFuncInfo_VLAN62_ICC_8155_QNX], data-element=AM_CompositionPrototype67.ADCC_DrivingFuncInfoConsumer_ICC_8155_QNX.AM_CompositionType1.ADCC_DrivingFuncInfo_NtfHNOPSupplementInfo_Drvg_RcvP.DataElement_NtfHNOPSupplementInfo_Drvg, system-signal=SysSIG_Event_NtfHNOPSupplementInfo_Drvg_ADCC_DrivingFuncInfo_1}
        sender-receiver-to-signal-mapping={service-instance=[AEP_VLAN62_ADCC_UDP_30500/PSI_ADCC_DrivingFuncInfo_1_VLAN62_ADCC, AEP_VLAN62_ADCC_TCP_30500/PSI_ADCC_DrivingFuncInfo_1_VLAN62_ADCC], data-element=AM_CompositionPrototype67.ADCC_DrivingFuncInfo_Provider.AM_CompositionType1.ADCC_DrivingFuncInfo_NtfMNPAllRoutesInfo_Drvg_SndP.DataElement_NtfMNPAllRoutesInfo_Drvg, system-signal=SysSIG_Event_NtfMNPAllRoutesInfo_Drvg_ADCC_DrivingFuncInfo_1}
        sender-receiver-to-signal-mapping={service-instance=[AEP_VLAN62_ICC_8155_QNX_UDP_30501/CSI_ADCC_DrivingFuncInfo_VLAN62_ICC_8155_QNX, AEP_VLAN62_ICC_8155_QNX_TCP_30501/CSI_ADCC_DrivingFuncInfo_VLAN62_ICC_8155_QNX], data-element=AM_CompositionPrototype67.ADCC_DrivingFuncInfoConsumer_ICC_8155_QNX.AM_CompositionType1.ADCC_DrivingFuncInfo_NtfMNPAllRoutesInfo_Drvg_RcvP.DataElement_NtfMNPAllRoutesInfo_Drvg, system-signal=SysSIG_Event_NtfMNPAllRoutesInfo_Drvg_ADCC_DrivingFuncInfo_1}
        sender-receiver-to-signal-mapping={service-instance=[AEP_VLAN62_ADCC_UDP_30500/PSI_ADCC_DrivingFuncInfo_1_VLAN62_ADCC, AEP_VLAN62_ADCC_TCP_30500/PSI_ADCC_DrivingFuncInfo_1_VLAN62_ADCC], data-element=AM_CompositionPrototype67.ADCC_DrivingFuncInfo_Provider.AM_CompositionType1.ADCC_DrivingFuncInfo_NtfMNPMemRouteInfo_Drvg_SndP.DataElement_NtfMNPMemRouteInfo_Drvg, system-signal=SysSIG_Event_NtfMNPMemRouteInfo_Drvg_ADCC_DrivingFuncInfo_1}
        sender-receiver-to-signal-mapping={service-instance=[AEP_VLAN62_ICC_8155_QNX_UDP_30501/CSI_ADCC_DrivingFuncInfo_VLAN62_ICC_8155_QNX, AEP_VLAN62_ICC_8155_QNX_TCP_30501/CSI_ADCC_DrivingFuncInfo_VLAN62_ICC_8155_QNX], data-element=AM_CompositionPrototype67.ADCC_DrivingFuncInfoConsumer_ICC_8155_QNX.AM_CompositionType1.ADCC_DrivingFuncInfo_NtfMNPMemRouteInfo_Drvg_RcvP.DataElement_NtfMNPMemRouteInfo_Drvg, system-signal=SysSIG_Event_NtfMNPMemRouteInfo_Drvg_ADCC_DrivingFuncInfo_1}
        sender-receiver-to-signal-mapping={service-instance=[AEP_VLAN62_ADCC_UDP_30500/PSI_ADCC_DrivingFuncInfo_1_VLAN62_ADCC, AEP_VLAN62_ADCC_TCP_30500/PSI_ADCC_DrivingFuncInfo_1_VLAN62_ADCC], data-element=AM_CompositionPrototype67.ADCC_DrivingFuncInfo_Provider.AM_CompositionType1.ADCC_DrivingFuncInfo_NtfTLRInfo_Drvg_SndP.DataElement_NtfTLRInfo_Drvg, system-signal=SysSIG_Event_NtfTLRInfo_Drvg_ADCC_DrivingFuncInfo_1}
        sender-receiver-to-signal-mapping={service-instance=[AEP_VLAN62_ICC_8155_QNX_UDP_30501/CSI_ADCC_DrivingFuncInfo_VLAN62_ICC_8155_QNX, AEP_VLAN62_ICC_8155_QNX_TCP_30501/CSI_ADCC_DrivingFuncInfo_VLAN62_ICC_8155_QNX], data-element=AM_CompositionPrototype67.ADCC_DrivingFuncInfoConsumer_ICC_8155_QNX.AM_CompositionType1.ADCC_DrivingFuncInfo_NtfTLRInfo_Drvg_RcvP.DataElement_NtfTLRInfo_Drvg, system-signal=SysSIG_Event_NtfTLRInfo_Drvg_ADCC_DrivingFuncInfo_1}
        sender-receiver-to-signal-mapping={service-instance=[AEP_VLAN62_ADCC_UDP_30500/PSI_ADCC_DrivingFuncInfo_1_VLAN62_ADCC, AEP_VLAN62_ADCC_TCP_30500/PSI_ADCC_DrivingFuncInfo_1_VLAN62_ADCC], data-element=AM_CompositionPrototype67.ADCC_DrivingFuncInfo_Provider.AM_CompositionType1.ADCC_DrivingFuncInfo_NtfTLAInfo_Drvg_SndP.DataElement_NtfTLAInfo_Drvg, system-signal=SysSIG_Event_NtfTLAInfo_Drvg_ADCC_DrivingFuncInfo_1}
        sender-receiver-to-signal-mapping={service-instance=[AEP_VLAN62_ICC_8155_QNX_UDP_30501/CSI_ADCC_DrivingFuncInfo_VLAN62_ICC_8155_QNX, AEP_VLAN62_ICC_8155_QNX_TCP_30501/CSI_ADCC_DrivingFuncInfo_VLAN62_ICC_8155_QNX], data-element=AM_CompositionPrototype67.ADCC_DrivingFuncInfoConsumer_ICC_8155_QNX.AM_CompositionType1.ADCC_DrivingFuncInfo_NtfTLAInfo_Drvg_RcvP.DataElement_NtfTLAInfo_Drvg, system-signal=SysSIG_Event_NtfTLAInfo_Drvg_ADCC_DrivingFuncInfo_1}
        sender-receiver-to-signal-mapping={service-instance=[AEP_VLAN62_ADCC_UDP_30500/PSI_ADCC_DrivingFuncInfo_1_VLAN62_ADCC, AEP_VLAN62_ADCC_TCP_30500/PSI_ADCC_DrivingFuncInfo_1_VLAN62_ADCC], data-element=AM_CompositionPrototype67.ADCC_DrivingFuncInfo_Provider.AM_CompositionType1.ADCC_DrivingFuncInfo_NtfMNPInfo_Drvg_2_SndP.DataElement_NtfMNPInfo_Drvg_2, system-signal=SysSIG_Event_NtfMNPInfo_Drvg_2_ADCC_DrivingFuncInfo_1}
        sender-receiver-to-signal-mapping={service-instance=[AEP_VLAN62_ICC_8155_QNX_UDP_30501/CSI_ADCC_DrivingFuncInfo_VLAN62_ICC_8155_QNX, AEP_VLAN62_ICC_8155_QNX_TCP_30501/CSI_ADCC_DrivingFuncInfo_VLAN62_ICC_8155_QNX], data-element=AM_CompositionPrototype67.ADCC_DrivingFuncInfoConsumer_ICC_8155_QNX.AM_CompositionType1.ADCC_DrivingFuncInfo_NtfMNPInfo_Drvg_2_RcvP.DataElement_NtfMNPInfo_Drvg_2, system-signal=SysSIG_Event_NtfMNPInfo_Drvg_2_ADCC_DrivingFuncInfo_1}
        sender-receiver-to-signal-mapping={service-instance=[AEP_VLAN62_ADCC_UDP_30500/PSI_ADCC_DrivingFuncInfo_1_VLAN62_ADCC, AEP_VLAN62_ADCC_TCP_30500/PSI_ADCC_DrivingFuncInfo_1_VLAN62_ADCC], data-element=AM_CompositionPrototype67.ADCC_DrivingFuncInfo_Provider.AM_CompositionType1.ADCC_DrivingFuncInfo_NtfTrafficSign_Drvg_2_SndP.DataElement_NtfTrafficSign_Drvg_2, system-signal=SysSIG_Event_NtfTrafficSign_Drvg_2_ADCC_DrivingFuncInfo_1}
        sender-receiver-to-signal-mapping={service-instance=[AEP_VLAN62_ICC_8155_QNX_UDP_30501/CSI_ADCC_DrivingFuncInfo_VLAN62_ICC_8155_QNX, AEP_VLAN62_ICC_8155_QNX_TCP_30501/CSI_ADCC_DrivingFuncInfo_VLAN62_ICC_8155_QNX], data-element=AM_CompositionPrototype67.ADCC_DrivingFuncInfoConsumer_ICC_8155_QNX.AM_CompositionType1.ADCC_DrivingFuncInfo_NtfTrafficSign_Drvg_2_RcvP.DataElement_NtfTrafficSign_Drvg_2, system-signal=SysSIG_Event_NtfTrafficSign_Drvg_2_ADCC_DrivingFuncInfo_1}
        sender-receiver-to-signal-mapping={service-instance=[AEP_VLAN62_ADCC_UDP_30500/PSI_ADCC_DrivingFuncInfo_1_VLAN62_ADCC, AEP_VLAN62_ADCC_TCP_30500/PSI_ADCC_DrivingFuncInfo_1_VLAN62_ADCC], data-element=AM_CompositionPrototype67.ADCC_DrivingFuncInfo_Provider.AM_CompositionType1.ADCC_DrivingFuncInfo_TolNtfADDrivingCardinfo_SndP.DataElement_TolNtfADDrivingCardinfo, system-signal=SysSIG_Event_TolNtfADDrivingCardinfo_ADCC_DrivingFuncInfo_1}
        sender-receiver-to-signal-mapping={service-instance=[AEP_VLAN62_ICC_8155_QNX_UDP_30501/CSI_ADCC_DrivingFuncInfo_VLAN62_ICC_8155_QNX, AEP_VLAN62_ICC_8155_QNX_TCP_30501/CSI_ADCC_DrivingFuncInfo_VLAN62_ICC_8155_QNX], data-element=AM_CompositionPrototype67.ADCC_DrivingFuncInfoConsumer_ICC_8155_QNX.AM_CompositionType1.ADCC_DrivingFuncInfo_TolNtfADDrivingCardinfo_RcvP.DataElement_TolNtfADDrivingCardinfo, system-signal=SysSIG_Event_TolNtfADDrivingCardinfo_ADCC_DrivingFuncInfo_1}
        sender-receiver-to-signal-mapping={service-instance=[AEP_VLAN62_ADCC_UDP_30500/PSI_ADCC_DrivingFuncInfo_1_VLAN62_ADCC, AEP_VLAN62_ADCC_TCP_30500/PSI_ADCC_DrivingFuncInfo_1_VLAN62_ADCC], data-element=AM_CompositionPrototype67.ADCC_DrivingFuncInfo_Provider.AM_CompositionType1.ADCC_DrivingFuncInfo_SglNtfADDrivingCardinfo_SndP.DataElement_SglNtfADDrivingCardinfo, system-signal=SysSIG_Event_SglNtfADDrivingCardinfo_ADCC_DrivingFuncInfo_1}
        sender-receiver-to-signal-mapping={service-instance=[AEP_VLAN62_ICC_8155_QNX_UDP_30501/CSI_ADCC_DrivingFuncInfo_VLAN62_ICC_8155_QNX, AEP_VLAN62_ICC_8155_QNX_TCP_30501/CSI_ADCC_DrivingFuncInfo_VLAN62_ICC_8155_QNX], data-element=AM_CompositionPrototype67.ADCC_DrivingFuncInfoConsumer_ICC_8155_QNX.AM_CompositionType1.ADCC_DrivingFuncInfo_SglNtfADDrivingCardinfo_RcvP.DataElement_SglNtfADDrivingCardinfo, system-signal=SysSIG_Event_SglNtfADDrivingCardinfo_ADCC_DrivingFuncInfo_1}
        sender-receiver-to-signal-mapping={service-instance=[AEP_VLAN62_ADCC_UDP_30500/PSI_ADCC_ParkingFuncInfo_1_VLAN62_ADCC, AEP_VLAN62_ADCC_TCP_30500/PSI_ADCC_ParkingFuncInfo_1_VLAN62_ADCC], data-element=AM_CompositionPrototype67.ADCC_ParkingFuncInfo_Provider.AM_CompositionType1.ADCC_ParkingFuncInfo_NtfParkingGenaralInfo_SndP.DataElement_NtfParkingGenaralInfo, system-signal=SysSIG_Event_NtfParkingGenaralInfo_ADCC_ParkingFuncInfo}
        sender-receiver-to-signal-mapping={service-instance=[AEP_VLAN62_ICC_8155_Android_UDP_30501/CSI_ADCC_ParkingFuncInfo_VLAN62_ICC_8155_Android, AEP_VLAN62_ICC_8155_Android_TCP_30501/CSI_ADCC_ParkingFuncInfo_VLAN62_ICC_8155_Android], data-element=AM_CompositionPrototype67.ADCC_ParkingFuncInfoConsumer_ICC_8155_Android.AM_CompositionType1.ADCC_ParkingFuncInfo_NtfParkingGenaralInfo_RcvP.DataElement_NtfParkingGenaralInfo, system-signal=SysSIG_Event_NtfParkingGenaralInfo_ADCC_ParkingFuncInfo}
        sender-receiver-to-signal-mapping={service-instance=[AEP_VLAN62_ADCC_UDP_30500/PSI_ADCC_ParkingFuncInfo_1_VLAN62_ADCC, AEP_VLAN62_ADCC_TCP_30500/PSI_ADCC_ParkingFuncInfo_1_VLAN62_ADCC], data-element=AM_CompositionPrototype67.ADCC_ParkingFuncInfo_Provider.AM_CompositionType1.ADCC_ParkingFuncInfo_NtfAPARPAInfo_SndP.DataElement_NtfAPARPAInfo, system-signal=SysSIG_Event_NtfAPARPAInfo_ADCC_ParkingFuncInfo}
        sender-receiver-to-signal-mapping={service-instance=[AEP_VLAN62_ICC_8155_Android_UDP_30501/CSI_ADCC_ParkingFuncInfo_VLAN62_ICC_8155_Android, AEP_VLAN62_ICC_8155_Android_TCP_30501/CSI_ADCC_ParkingFuncInfo_VLAN62_ICC_8155_Android], data-element=AM_CompositionPrototype67.ADCC_ParkingFuncInfoConsumer_ICC_8155_Android.AM_CompositionType1.ADCC_ParkingFuncInfo_NtfAPARPAInfo_RcvP.DataElement_NtfAPARPAInfo, system-signal=SysSIG_Event_NtfAPARPAInfo_ADCC_ParkingFuncInfo}
        sender-receiver-to-signal-mapping={service-instance=[AEP_VLAN62_ADCC_UDP_30500/PSI_ADCC_ParkingFuncInfo_1_VLAN62_ADCC, AEP_VLAN62_ADCC_TCP_30500/PSI_ADCC_ParkingFuncInfo_1_VLAN62_ADCC], data-element=AM_CompositionPrototype67.ADCC_ParkingFuncInfo_Provider.AM_CompositionType1.ADCC_ParkingFuncInfo_NtfAdvanceParkingInfo_SndP.DataElement_NtfAdvanceParkingInfo, system-signal=SysSIG_Event_NtfAdvanceParkingInfo_ADCC_ParkingFuncInfo}
        sender-receiver-to-signal-mapping={service-instance=[AEP_VLAN62_ICC_8155_Android_UDP_30501/CSI_ADCC_ParkingFuncInfo_VLAN62_ICC_8155_Android, AEP_VLAN62_ICC_8155_Android_TCP_30501/CSI_ADCC_ParkingFuncInfo_VLAN62_ICC_8155_Android], data-element=AM_CompositionPrototype67.ADCC_ParkingFuncInfoConsumer_ICC_8155_Android.AM_CompositionType1.ADCC_ParkingFuncInfo_NtfAdvanceParkingInfo_RcvP.DataElement_NtfAdvanceParkingInfo, system-signal=SysSIG_Event_NtfAdvanceParkingInfo_ADCC_ParkingFuncInfo}
        sender-receiver-to-signal-mapping={service-instance=[AEP_VLAN62_ADCC_UDP_30500/PSI_ADCC_ParkingFuncInfo_1_VLAN62_ADCC, AEP_VLAN62_ADCC_TCP_30500/PSI_ADCC_ParkingFuncInfo_1_VLAN62_ADCC], data-element=AM_CompositionPrototype67.ADCC_ParkingFuncInfo_Provider.AM_CompositionType1.ADCC_ParkingFuncInfo_NtfHPAPathDetail_SndP.DataElement_NtfHPAPathDetail, system-signal=SysSIG_Event_NtfHPAPathDetail_ADCC_ParkingFuncInfo}
        sender-receiver-to-signal-mapping={service-instance=[AEP_VLAN62_ICC_8155_Android_UDP_30501/CSI_ADCC_ParkingFuncInfo_VLAN62_ICC_8155_Android, AEP_VLAN62_ICC_8155_Android_TCP_30501/CSI_ADCC_ParkingFuncInfo_VLAN62_ICC_8155_Android], data-element=AM_CompositionPrototype67.ADCC_ParkingFuncInfoConsumer_ICC_8155_Android.AM_CompositionType1.ADCC_ParkingFuncInfo_NtfHPAPathDetail_RcvP.DataElement_NtfHPAPathDetail, system-signal=SysSIG_Event_NtfHPAPathDetail_ADCC_ParkingFuncInfo}
        sender-receiver-to-signal-mapping={service-instance=[AEP_VLAN62_ADCC_UDP_30500/PSI_ADCC_ParkingFuncInfo_1_VLAN62_ADCC, AEP_VLAN62_ADCC_TCP_30500/PSI_ADCC_ParkingFuncInfo_1_VLAN62_ADCC], data-element=AM_CompositionPrototype67.ADCC_ParkingFuncInfo_Provider.AM_CompositionType1.ADCC_ParkingFuncInfo_NtfHPATrainigPathInfo_SndP.DataElement_NtfHPATrainigPathInfo, system-signal=SysSIG_Event_NtfHPATrainigPathInfo_ADCC_ParkingFuncInfo}
        sender-receiver-to-signal-mapping={service-instance=[AEP_VLAN62_ICC_8155_Android_UDP_30501/CSI_ADCC_ParkingFuncInfo_VLAN62_ICC_8155_Android, AEP_VLAN62_ICC_8155_Android_TCP_30501/CSI_ADCC_ParkingFuncInfo_VLAN62_ICC_8155_Android], data-element=AM_CompositionPrototype67.ADCC_ParkingFuncInfoConsumer_ICC_8155_Android.AM_CompositionType1.ADCC_ParkingFuncInfo_NtfHPATrainigPathInfo_RcvP.DataElement_NtfHPATrainigPathInfo, system-signal=SysSIG_Event_NtfHPATrainigPathInfo_ADCC_ParkingFuncInfo}
        sender-receiver-to-signal-mapping={service-instance=[AEP_VLAN62_ADCC_UDP_30500/PSI_ADCC_ParkingFuncInfo_1_VLAN62_ADCC, AEP_VLAN62_ADCC_TCP_30500/PSI_ADCC_ParkingFuncInfo_1_VLAN62_ADCC], data-element=AM_CompositionPrototype67.ADCC_ParkingFuncInfo_Provider.AM_CompositionType1.ADCC_ParkingFuncInfo_NtfVPASelfBuildMapDate_SndP.DataElement_NtfVPASelfBuildMapDate, system-signal=SysSIG_Event_NtfVPASelfBuildMapDate_ADCC_ParkingFuncInfo}
        sender-receiver-to-signal-mapping={service-instance=[AEP_VLAN62_ICC_8155_Android_UDP_30501/CSI_ADCC_ParkingFuncInfo_VLAN62_ICC_8155_Android, AEP_VLAN62_ICC_8155_Android_TCP_30501/CSI_ADCC_ParkingFuncInfo_VLAN62_ICC_8155_Android], data-element=AM_CompositionPrototype67.ADCC_ParkingFuncInfoConsumer_ICC_8155_Android.AM_CompositionType1.ADCC_ParkingFuncInfo_NtfVPASelfBuildMapDate_RcvP.DataElement_NtfVPASelfBuildMapDate, system-signal=SysSIG_Event_NtfVPASelfBuildMapDate_ADCC_ParkingFuncInfo}
        sender-receiver-to-signal-mapping={service-instance=[AEP_VLAN62_ADCC_UDP_30500/PSI_ADCC_ParkingFuncInfo_1_VLAN62_ADCC, AEP_VLAN62_ADCC_TCP_30500/PSI_ADCC_ParkingFuncInfo_1_VLAN62_ADCC], data-element=AM_CompositionPrototype67.ADCC_ParkingFuncInfo_Provider.AM_CompositionType1.ADCC_ParkingFuncInfo_NtfMRAInfo_SndP.DataElement_NtfMRAInfo, system-signal=SysSIG_Event_NtfMRAInfo_ADCC_ParkingFuncInfo}
        sender-receiver-to-signal-mapping={service-instance=[AEP_VLAN62_ICC_8155_Android_UDP_30501/CSI_ADCC_ParkingFuncInfo_VLAN62_ICC_8155_Android, AEP_VLAN62_ICC_8155_Android_TCP_30501/CSI_ADCC_ParkingFuncInfo_VLAN62_ICC_8155_Android], data-element=AM_CompositionPrototype67.ADCC_ParkingFuncInfoConsumer_ICC_8155_Android.AM_CompositionType1.ADCC_ParkingFuncInfo_NtfMRAInfo_RcvP.DataElement_NtfMRAInfo, system-signal=SysSIG_Event_NtfMRAInfo_ADCC_ParkingFuncInfo}
        sender-receiver-to-signal-mapping={service-instance=[AEP_VLAN62_ADCC_UDP_30500/PSI_ADCC_ParkingFuncInfo_1_VLAN62_ADCC, AEP_VLAN62_ADCC_TCP_30500/PSI_ADCC_ParkingFuncInfo_1_VLAN62_ADCC], data-element=AM_CompositionPrototype67.ADCC_ParkingFuncInfo_Provider.AM_CompositionType1.ADCC_ParkingFuncInfo_NtfMEBInfo_SndP.DataElement_NtfMEBInfo, system-signal=SysSIG_Event_NtfMEBInfo_ADCC_ParkingFuncInfo}
        sender-receiver-to-signal-mapping={service-instance=[AEP_VLAN62_ICC_8155_Android_UDP_30501/CSI_ADCC_ParkingFuncInfo_VLAN62_ICC_8155_Android, AEP_VLAN62_ICC_8155_Android_TCP_30501/CSI_ADCC_ParkingFuncInfo_VLAN62_ICC_8155_Android], data-element=AM_CompositionPrototype67.ADCC_ParkingFuncInfoConsumer_ICC_8155_Android.AM_CompositionType1.ADCC_ParkingFuncInfo_NtfMEBInfo_RcvP.DataElement_NtfMEBInfo, system-signal=SysSIG_Event_NtfMEBInfo_ADCC_ParkingFuncInfo}
        sender-receiver-to-signal-mapping={service-instance=[AEP_VLAN62_ADCC_UDP_30500/PSI_ADCC_ParkingFuncInfo_1_VLAN62_ADCC, AEP_VLAN62_ADCC_TCP_30500/PSI_ADCC_ParkingFuncInfo_1_VLAN62_ADCC], data-element=AM_CompositionPrototype67.ADCC_ParkingFuncInfo_Provider.AM_CompositionType1.ADCC_ParkingFuncInfo_NtfMAAInfo_SndP.DataElement_NtfMAAInfo, system-signal=SysSIG_Event_NtfMAAInfo_ADCC_ParkingFuncInfo}
        sender-receiver-to-signal-mapping={service-instance=[AEP_VLAN62_ICC_8155_Android_UDP_30501/CSI_ADCC_ParkingFuncInfo_VLAN62_ICC_8155_Android, AEP_VLAN62_ICC_8155_Android_TCP_30501/CSI_ADCC_ParkingFuncInfo_VLAN62_ICC_8155_Android], data-element=AM_CompositionPrototype67.ADCC_ParkingFuncInfoConsumer_ICC_8155_Android.AM_CompositionType1.ADCC_ParkingFuncInfo_NtfMAAInfo_RcvP.DataElement_NtfMAAInfo, system-signal=SysSIG_Event_NtfMAAInfo_ADCC_ParkingFuncInfo}
        sender-receiver-to-signal-mapping={service-instance=[AEP_VLAN62_ADCC_UDP_30500/PSI_ADCC_ParkingFuncInfo_1_VLAN62_ADCC, AEP_VLAN62_ADCC_TCP_30500/PSI_ADCC_ParkingFuncInfo_1_VLAN62_ADCC], data-element=AM_CompositionPrototype67.ADCC_ParkingFuncInfo_Provider.AM_CompositionType1.ADCC_ParkingFuncInfo_NtfHPARepalyPathInfo_SndP.DataElement_NtfHPARepalyPathInfo, system-signal=SysSIG_Event_NtfHPARepalyPathInfo_ADCC_ParkingFuncInfo}
        sender-receiver-to-signal-mapping={service-instance=[AEP_VLAN62_ICC_8155_Android_UDP_30501/CSI_ADCC_ParkingFuncInfo_VLAN62_ICC_8155_Android, AEP_VLAN62_ICC_8155_Android_TCP_30501/CSI_ADCC_ParkingFuncInfo_VLAN62_ICC_8155_Android], data-element=AM_CompositionPrototype67.ADCC_ParkingFuncInfoConsumer_ICC_8155_Android.AM_CompositionType1.ADCC_ParkingFuncInfo_NtfHPARepalyPathInfo_RcvP.DataElement_NtfHPARepalyPathInfo, system-signal=SysSIG_Event_NtfHPARepalyPathInfo_ADCC_ParkingFuncInfo}
        sender-receiver-to-signal-mapping={service-instance=[AEP_VLAN62_ADCC_UDP_30500/PSI_ADCC_ParkingFuncInfo_1_VLAN62_ADCC, AEP_VLAN62_ADCC_TCP_30500/PSI_ADCC_ParkingFuncInfo_1_VLAN62_ADCC], data-element=AM_CompositionPrototype67.ADCC_ParkingFuncInfo_Provider.AM_CompositionType1.ADCC_ParkingFuncInfo_NtfParkingGenaralInfo_2_SndP.DataElement_NtfParkingGenaralInfo_2, system-signal=SysSIG_Event_NtfParkingGenaralInfo_2_ADCC_ParkingFuncInfo}
        sender-receiver-to-signal-mapping={service-instance=[AEP_VLAN62_ICC_8155_Android_UDP_30501/CSI_ADCC_ParkingFuncInfo_VLAN62_ICC_8155_Android, AEP_VLAN62_ICC_8155_Android_TCP_30501/CSI_ADCC_ParkingFuncInfo_VLAN62_ICC_8155_Android], data-element=AM_CompositionPrototype67.ADCC_ParkingFuncInfoConsumer_ICC_8155_Android.AM_CompositionType1.ADCC_ParkingFuncInfo_NtfParkingGenaralInfo_2_RcvP.DataElement_NtfParkingGenaralInfo_2, system-signal=SysSIG_Event_NtfParkingGenaralInfo_2_ADCC_ParkingFuncInfo}
        sender-receiver-to-signal-mapping={service-instance=[AEP_VLAN62_ADCC_UDP_30500/PSI_ADCC_ParkingFuncInfo_1_VLAN62_ADCC, AEP_VLAN62_ADCC_TCP_30500/PSI_ADCC_ParkingFuncInfo_1_VLAN62_ADCC], data-element=AM_CompositionPrototype67.ADCC_ParkingFuncInfo_Provider.AM_CompositionType1.ADCC_ParkingFuncInfo_NtfMRAInfo_2_SndP.DataElement_NtfMRAInfo_2, system-signal=SysSIG_Event_NtfMRAInfo_2_ADCC_ParkingFuncInfo}
        sender-receiver-to-signal-mapping={service-instance=[AEP_VLAN62_ICC_8155_Android_UDP_30501/CSI_ADCC_ParkingFuncInfo_VLAN62_ICC_8155_Android, AEP_VLAN62_ICC_8155_Android_TCP_30501/CSI_ADCC_ParkingFuncInfo_VLAN62_ICC_8155_Android], data-element=AM_CompositionPrototype67.ADCC_ParkingFuncInfoConsumer_ICC_8155_Android.AM_CompositionType1.ADCC_ParkingFuncInfo_NtfMRAInfo_2_RcvP.DataElement_NtfMRAInfo_2, system-signal=SysSIG_Event_NtfMRAInfo_2_ADCC_ParkingFuncInfo}
        sender-receiver-to-signal-mapping={service-instance=[AEP_VLAN62_ADCC_UDP_30500/PSI_ADCC_ParkingFuncInfo_1_VLAN62_ADCC, AEP_VLAN62_ADCC_TCP_30500/PSI_ADCC_ParkingFuncInfo_1_VLAN62_ADCC], data-element=AM_CompositionPrototype67.ADCC_ParkingFuncInfo_Provider.AM_CompositionType1.ADCC_ParkingFuncInfo_NtfAPARPAInfo_2_SndP.DataElement_NtfAPARPAInfo_2, system-signal=SysSIG_Event_NtfAPARPAInfo_2_ADCC_ParkingFuncInfo}
        sender-receiver-to-signal-mapping={service-instance=[AEP_VLAN62_ICC_8155_Android_UDP_30501/CSI_ADCC_ParkingFuncInfo_VLAN62_ICC_8155_Android, AEP_VLAN62_ICC_8155_Android_TCP_30501/CSI_ADCC_ParkingFuncInfo_VLAN62_ICC_8155_Android], data-element=AM_CompositionPrototype67.ADCC_ParkingFuncInfoConsumer_ICC_8155_Android.AM_CompositionType1.ADCC_ParkingFuncInfo_NtfAPARPAInfo_2_RcvP.DataElement_NtfAPARPAInfo_2, system-signal=SysSIG_Event_NtfAPARPAInfo_2_ADCC_ParkingFuncInfo}
        sender-receiver-to-signal-mapping={service-instance=[AEP_VLAN62_ADCC_UDP_30500/PSI_ADCC_ParkingFuncInfo_1_VLAN62_ADCC, AEP_VLAN62_ADCC_TCP_30500/PSI_ADCC_ParkingFuncInfo_1_VLAN62_ADCC], data-element=AM_CompositionPrototype67.ADCC_ParkingFuncInfo_Provider.AM_CompositionType1.ADCC_ParkingFuncInfo_NtfAdvanceParkingInfo_2_SndP.DataElement_NtfAdvanceParkingInfo_2, system-signal=SysSIG_Event_NtfAdvanceParkingInfo_2_ADCC_ParkingFuncInfo}
        sender-receiver-to-signal-mapping={service-instance=[AEP_VLAN62_ICC_8155_Android_UDP_30501/CSI_ADCC_ParkingFuncInfo_VLAN62_ICC_8155_Android, AEP_VLAN62_ICC_8155_Android_TCP_30501/CSI_ADCC_ParkingFuncInfo_VLAN62_ICC_8155_Android], data-element=AM_CompositionPrototype67.ADCC_ParkingFuncInfoConsumer_ICC_8155_Android.AM_CompositionType1.ADCC_ParkingFuncInfo_NtfAdvanceParkingInfo_2_RcvP.DataElement_NtfAdvanceParkingInfo_2, system-signal=SysSIG_Event_NtfAdvanceParkingInfo_2_ADCC_ParkingFuncInfo}
        sender-receiver-to-signal-mapping={service-instance=[AEP_VLAN62_ADCC_UDP_30500/PSI_ADCC_ParkingFuncInfo_1_VLAN62_ADCC, AEP_VLAN62_ADCC_TCP_30500/PSI_ADCC_ParkingFuncInfo_1_VLAN62_ADCC], data-element=AM_CompositionPrototype67.ADCC_ParkingFuncInfo_Provider.AM_CompositionType1.ADCC_ParkingFuncInfo_NtfHPAPathDetail_2_SndP.DataElement_NtfHPAPathDetail_2, system-signal=SysSIG_Event_NtfHPAPathDetail_2_ADCC_ParkingFuncInfo}
        sender-receiver-to-signal-mapping={service-instance=[AEP_VLAN62_ICC_8155_Android_UDP_30501/CSI_ADCC_ParkingFuncInfo_VLAN62_ICC_8155_Android, AEP_VLAN62_ICC_8155_Android_TCP_30501/CSI_ADCC_ParkingFuncInfo_VLAN62_ICC_8155_Android], data-element=AM_CompositionPrototype67.ADCC_ParkingFuncInfoConsumer_ICC_8155_Android.AM_CompositionType1.ADCC_ParkingFuncInfo_NtfHPAPathDetail_2_RcvP.DataElement_NtfHPAPathDetail_2, system-signal=SysSIG_Event_NtfHPAPathDetail_2_ADCC_ParkingFuncInfo}
        sender-receiver-to-signal-mapping={service-instance=[AEP_VLAN62_ADCC_UDP_30500/PSI_ADCC_ParkingFuncInfo_1_VLAN62_ADCC, AEP_VLAN62_ADCC_TCP_30500/PSI_ADCC_ParkingFuncInfo_1_VLAN62_ADCC], data-element=AM_CompositionPrototype67.ADCC_ParkingFuncInfo_Provider.AM_CompositionType1.ADCC_ParkingFuncInfo_NtfHPATrainigPathInfo_2_SndP.DataElement_NtfHPATrainigPathInfo_2, system-signal=SysSIG_Event_NtfHPATrainigPathInfo_2_ADCC_ParkingFuncInfo}
        sender-receiver-to-signal-mapping={service-instance=[AEP_VLAN62_ICC_8155_Android_UDP_30501/CSI_ADCC_ParkingFuncInfo_VLAN62_ICC_8155_Android, AEP_VLAN62_ICC_8155_Android_TCP_30501/CSI_ADCC_ParkingFuncInfo_VLAN62_ICC_8155_Android], data-element=AM_CompositionPrototype67.ADCC_ParkingFuncInfoConsumer_ICC_8155_Android.AM_CompositionType1.ADCC_ParkingFuncInfo_NtfHPATrainigPathInfo_2_RcvP.DataElement_NtfHPATrainigPathInfo_2, system-signal=SysSIG_Event_NtfHPATrainigPathInfo_2_ADCC_ParkingFuncInfo}
        sender-receiver-to-signal-mapping={service-instance=[AEP_VLAN62_ADCC_UDP_30500/PSI_ADCC_ParkingFuncInfo_1_VLAN62_ADCC, AEP_VLAN62_ADCC_TCP_30500/PSI_ADCC_ParkingFuncInfo_1_VLAN62_ADCC], data-element=AM_CompositionPrototype67.ADCC_ParkingFuncInfo_Provider.AM_CompositionType1.ADCC_ParkingFuncInfo_NtfHPARepalyPathInfo_2_SndP.DataElement_NtfHPARepalyPathInfo_2, system-signal=SysSIG_Event_NtfHPARepalyPathInfo_2_ADCC_ParkingFuncInfo}
        sender-receiver-to-signal-mapping={service-instance=[AEP_VLAN62_ICC_8155_Android_UDP_30501/CSI_ADCC_ParkingFuncInfo_VLAN62_ICC_8155_Android, AEP_VLAN62_ICC_8155_Android_TCP_30501/CSI_ADCC_ParkingFuncInfo_VLAN62_ICC_8155_Android], data-element=AM_CompositionPrototype67.ADCC_ParkingFuncInfoConsumer_ICC_8155_Android.AM_CompositionType1.ADCC_ParkingFuncInfo_NtfHPARepalyPathInfo_2_RcvP.DataElement_NtfHPARepalyPathInfo_2, system-signal=SysSIG_Event_NtfHPARepalyPathInfo_2_ADCC_ParkingFuncInfo}
        sender-receiver-to-signal-mapping={service-instance=[AEP_VLAN62_ADCC_UDP_30500/PSI_ADCC_ParkingFuncInfo_1_VLAN62_ADCC, AEP_VLAN62_ADCC_TCP_30500/PSI_ADCC_ParkingFuncInfo_1_VLAN62_ADCC], data-element=AM_CompositionPrototype67.ADCC_ParkingFuncInfo_Provider.AM_CompositionType1.ADCC_ParkingFuncInfo_NtfVPAInfo_SndP.DataElement_NtfVPAInfo, system-signal=SysSIG_Event_NtfVPAInfo_ADCC_ParkingFuncInfo}
        sender-receiver-to-signal-mapping={service-instance=[AEP_VLAN62_ICC_8155_Android_UDP_30501/CSI_ADCC_ParkingFuncInfo_VLAN62_ICC_8155_Android, AEP_VLAN62_ICC_8155_Android_TCP_30501/CSI_ADCC_ParkingFuncInfo_VLAN62_ICC_8155_Android], data-element=AM_CompositionPrototype67.ADCC_ParkingFuncInfoConsumer_ICC_8155_Android.AM_CompositionType1.ADCC_ParkingFuncInfo_NtfVPAInfo_RcvP.DataElement_NtfVPAInfo, system-signal=SysSIG_Event_NtfVPAInfo_ADCC_ParkingFuncInfo}
        sender-receiver-to-signal-mapping={service-instance=[AEP_VLAN62_ADCC_UDP_30500/PSI_ADCC_ParkingFuncInfo_1_VLAN62_ADCC, AEP_VLAN62_ADCC_TCP_30500/PSI_ADCC_ParkingFuncInfo_1_VLAN62_ADCC], data-element=AM_CompositionPrototype67.ADCC_ParkingFuncInfo_Provider.AM_CompositionType1.ADCC_ParkingFuncInfo_NtfParkingHMIInfo_SndP.DataElement_NtfParkingHMIInfo, system-signal=SysSIG_Event_NtfParkingHMIInfo_ADCC_ParkingFuncInfo}
        sender-receiver-to-signal-mapping={service-instance=[AEP_VLAN62_ICC_8155_Android_UDP_30501/CSI_ADCC_ParkingFuncInfo_VLAN62_ICC_8155_Android, AEP_VLAN62_ICC_8155_Android_TCP_30501/CSI_ADCC_ParkingFuncInfo_VLAN62_ICC_8155_Android], data-element=AM_CompositionPrototype67.ADCC_ParkingFuncInfoConsumer_ICC_8155_Android.AM_CompositionType1.ADCC_ParkingFuncInfo_NtfParkingHMIInfo_RcvP.DataElement_NtfParkingHMIInfo, system-signal=SysSIG_Event_NtfParkingHMIInfo_ADCC_ParkingFuncInfo}
        sender-receiver-to-signal-mapping={service-instance=[AEP_VLAN62_ADCC_UDP_30500/PSI_ADCC_ParkingFuncInfo_1_VLAN62_ADCC, AEP_VLAN62_ADCC_TCP_30500/PSI_ADCC_ParkingFuncInfo_1_VLAN62_ADCC], data-element=AM_CompositionPrototype67.ADCC_ParkingFuncInfo_Provider.AM_CompositionType1.ADCC_ParkingFuncInfo_NtfParkingGenaralInfo_SndP.DataElement_NtfParkingGenaralInfo, system-signal=SysSIG_Event_NtfParkingGenaralInfo_ADCC_ParkingFuncInfo_1}
        sender-receiver-to-signal-mapping={service-instance=[AEP_VLAN62_ICC_8155_QNX_UDP_30501/CSI_ADCC_ParkingFuncInfo_VLAN62_ICC_8155_QNX, AEP_VLAN62_ICC_8155_QNX_TCP_30501/CSI_ADCC_ParkingFuncInfo_VLAN62_ICC_8155_QNX], data-element=AM_CompositionPrototype67.ADCC_ParkingFuncInfoConsumer_ICC_8155_QNX.AM_CompositionType1.ADCC_ParkingFuncInfo_NtfParkingGenaralInfo_RcvP.DataElement_NtfParkingGenaralInfo, system-signal=SysSIG_Event_NtfParkingGenaralInfo_ADCC_ParkingFuncInfo_1}
        sender-receiver-to-signal-mapping={service-instance=[AEP_VLAN62_ADCC_UDP_30500/PSI_ADCC_ParkingFuncInfo_1_VLAN62_ADCC, AEP_VLAN62_ADCC_TCP_30500/PSI_ADCC_ParkingFuncInfo_1_VLAN62_ADCC], data-element=AM_CompositionPrototype67.ADCC_ParkingFuncInfo_Provider.AM_CompositionType1.ADCC_ParkingFuncInfo_NtfAPARPAInfo_SndP.DataElement_NtfAPARPAInfo, system-signal=SysSIG_Event_NtfAPARPAInfo_ADCC_ParkingFuncInfo_1}
        sender-receiver-to-signal-mapping={service-instance=[AEP_VLAN62_ICC_8155_QNX_UDP_30501/CSI_ADCC_ParkingFuncInfo_VLAN62_ICC_8155_QNX, AEP_VLAN62_ICC_8155_QNX_TCP_30501/CSI_ADCC_ParkingFuncInfo_VLAN62_ICC_8155_QNX], data-element=AM_CompositionPrototype67.ADCC_ParkingFuncInfoConsumer_ICC_8155_QNX.AM_CompositionType1.ADCC_ParkingFuncInfo_NtfAPARPAInfo_RcvP.DataElement_NtfAPARPAInfo, system-signal=SysSIG_Event_NtfAPARPAInfo_ADCC_ParkingFuncInfo_1}
        sender-receiver-to-signal-mapping={service-instance=[AEP_VLAN62_ADCC_UDP_30500/PSI_ADCC_ParkingFuncInfo_1_VLAN62_ADCC, AEP_VLAN62_ADCC_TCP_30500/PSI_ADCC_ParkingFuncInfo_1_VLAN62_ADCC], data-element=AM_CompositionPrototype67.ADCC_ParkingFuncInfo_Provider.AM_CompositionType1.ADCC_ParkingFuncInfo_NtfAdvanceParkingInfo_SndP.DataElement_NtfAdvanceParkingInfo, system-signal=SysSIG_Event_NtfAdvanceParkingInfo_ADCC_ParkingFuncInfo_1}
        sender-receiver-to-signal-mapping={service-instance=[AEP_VLAN62_ICC_8155_QNX_UDP_30501/CSI_ADCC_ParkingFuncInfo_VLAN62_ICC_8155_QNX, AEP_VLAN62_ICC_8155_QNX_TCP_30501/CSI_ADCC_ParkingFuncInfo_VLAN62_ICC_8155_QNX], data-element=AM_CompositionPrototype67.ADCC_ParkingFuncInfoConsumer_ICC_8155_QNX.AM_CompositionType1.ADCC_ParkingFuncInfo_NtfAdvanceParkingInfo_RcvP.DataElement_NtfAdvanceParkingInfo, system-signal=SysSIG_Event_NtfAdvanceParkingInfo_ADCC_ParkingFuncInfo_1}
        sender-receiver-to-signal-mapping={service-instance=[AEP_VLAN62_ADCC_UDP_30500/PSI_ADCC_ParkingFuncInfo_1_VLAN62_ADCC, AEP_VLAN62_ADCC_TCP_30500/PSI_ADCC_ParkingFuncInfo_1_VLAN62_ADCC], data-element=AM_CompositionPrototype67.ADCC_ParkingFuncInfo_Provider.AM_CompositionType1.ADCC_ParkingFuncInfo_NtfHPAPathDetail_SndP.DataElement_NtfHPAPathDetail, system-signal=SysSIG_Event_NtfHPAPathDetail_ADCC_ParkingFuncInfo_1}
        sender-receiver-to-signal-mapping={service-instance=[AEP_VLAN62_ICC_8155_QNX_UDP_30501/CSI_ADCC_ParkingFuncInfo_VLAN62_ICC_8155_QNX, AEP_VLAN62_ICC_8155_QNX_TCP_30501/CSI_ADCC_ParkingFuncInfo_VLAN62_ICC_8155_QNX], data-element=AM_CompositionPrototype67.ADCC_ParkingFuncInfoConsumer_ICC_8155_QNX.AM_CompositionType1.ADCC_ParkingFuncInfo_NtfHPAPathDetail_RcvP.DataElement_NtfHPAPathDetail, system-signal=SysSIG_Event_NtfHPAPathDetail_ADCC_ParkingFuncInfo_1}
        sender-receiver-to-signal-mapping={service-instance=[AEP_VLAN62_ADCC_UDP_30500/PSI_ADCC_ParkingFuncInfo_1_VLAN62_ADCC, AEP_VLAN62_ADCC_TCP_30500/PSI_ADCC_ParkingFuncInfo_1_VLAN62_ADCC], data-element=AM_CompositionPrototype67.ADCC_ParkingFuncInfo_Provider.AM_CompositionType1.ADCC_ParkingFuncInfo_NtfHPATrainigPathInfo_SndP.DataElement_NtfHPATrainigPathInfo, system-signal=SysSIG_Event_NtfHPATrainigPathInfo_ADCC_ParkingFuncInfo_1}
        sender-receiver-to-signal-mapping={service-instance=[AEP_VLAN62_ICC_8155_QNX_UDP_30501/CSI_ADCC_ParkingFuncInfo_VLAN62_ICC_8155_QNX, AEP_VLAN62_ICC_8155_QNX_TCP_30501/CSI_ADCC_ParkingFuncInfo_VLAN62_ICC_8155_QNX], data-element=AM_CompositionPrototype67.ADCC_ParkingFuncInfoConsumer_ICC_8155_QNX.AM_CompositionType1.ADCC_ParkingFuncInfo_NtfHPATrainigPathInfo_RcvP.DataElement_NtfHPATrainigPathInfo, system-signal=SysSIG_Event_NtfHPATrainigPathInfo_ADCC_ParkingFuncInfo_1}
        sender-receiver-to-signal-mapping={service-instance=[AEP_VLAN62_ADCC_UDP_30500/PSI_ADCC_ParkingFuncInfo_1_VLAN62_ADCC, AEP_VLAN62_ADCC_TCP_30500/PSI_ADCC_ParkingFuncInfo_1_VLAN62_ADCC], data-element=AM_CompositionPrototype67.ADCC_ParkingFuncInfo_Provider.AM_CompositionType1.ADCC_ParkingFuncInfo_NtfVPASelfBuildMapDate_SndP.DataElement_NtfVPASelfBuildMapDate, system-signal=SysSIG_Event_NtfVPASelfBuildMapDate_ADCC_ParkingFuncInfo_1}
        sender-receiver-to-signal-mapping={service-instance=[AEP_VLAN62_ICC_8155_QNX_UDP_30501/CSI_ADCC_ParkingFuncInfo_VLAN62_ICC_8155_QNX, AEP_VLAN62_ICC_8155_QNX_TCP_30501/CSI_ADCC_ParkingFuncInfo_VLAN62_ICC_8155_QNX], data-element=AM_CompositionPrototype67.ADCC_ParkingFuncInfoConsumer_ICC_8155_QNX.AM_CompositionType1.ADCC_ParkingFuncInfo_NtfVPASelfBuildMapDate_RcvP.DataElement_NtfVPASelfBuildMapDate, system-signal=SysSIG_Event_NtfVPASelfBuildMapDate_ADCC_ParkingFuncInfo_1}
        sender-receiver-to-signal-mapping={service-instance=[AEP_VLAN62_ADCC_UDP_30500/PSI_ADCC_ParkingFuncInfo_1_VLAN62_ADCC, AEP_VLAN62_ADCC_TCP_30500/PSI_ADCC_ParkingFuncInfo_1_VLAN62_ADCC], data-element=AM_CompositionPrototype67.ADCC_ParkingFuncInfo_Provider.AM_CompositionType1.ADCC_ParkingFuncInfo_NtfMRAInfo_SndP.DataElement_NtfMRAInfo, system-signal=SysSIG_Event_NtfMRAInfo_ADCC_ParkingFuncInfo_1}
        sender-receiver-to-signal-mapping={service-instance=[AEP_VLAN62_ICC_8155_QNX_UDP_30501/CSI_ADCC_ParkingFuncInfo_VLAN62_ICC_8155_QNX, AEP_VLAN62_ICC_8155_QNX_TCP_30501/CSI_ADCC_ParkingFuncInfo_VLAN62_ICC_8155_QNX], data-element=AM_CompositionPrototype67.ADCC_ParkingFuncInfoConsumer_ICC_8155_QNX.AM_CompositionType1.ADCC_ParkingFuncInfo_NtfMRAInfo_RcvP.DataElement_NtfMRAInfo, system-signal=SysSIG_Event_NtfMRAInfo_ADCC_ParkingFuncInfo_1}
        sender-receiver-to-signal-mapping={service-instance=[AEP_VLAN62_ADCC_UDP_30500/PSI_ADCC_ParkingFuncInfo_1_VLAN62_ADCC, AEP_VLAN62_ADCC_TCP_30500/PSI_ADCC_ParkingFuncInfo_1_VLAN62_ADCC], data-element=AM_CompositionPrototype67.ADCC_ParkingFuncInfo_Provider.AM_CompositionType1.ADCC_ParkingFuncInfo_NtfMEBInfo_SndP.DataElement_NtfMEBInfo, system-signal=SysSIG_Event_NtfMEBInfo_ADCC_ParkingFuncInfo_1}
        sender-receiver-to-signal-mapping={service-instance=[AEP_VLAN62_ICC_8155_QNX_UDP_30501/CSI_ADCC_ParkingFuncInfo_VLAN62_ICC_8155_QNX, AEP_VLAN62_ICC_8155_QNX_TCP_30501/CSI_ADCC_ParkingFuncInfo_VLAN62_ICC_8155_QNX], data-element=AM_CompositionPrototype67.ADCC_ParkingFuncInfoConsumer_ICC_8155_QNX.AM_CompositionType1.ADCC_ParkingFuncInfo_NtfMEBInfo_RcvP.DataElement_NtfMEBInfo, system-signal=SysSIG_Event_NtfMEBInfo_ADCC_ParkingFuncInfo_1}
        sender-receiver-to-signal-mapping={service-instance=[AEP_VLAN62_ADCC_UDP_30500/PSI_ADCC_ParkingFuncInfo_1_VLAN62_ADCC, AEP_VLAN62_ADCC_TCP_30500/PSI_ADCC_ParkingFuncInfo_1_VLAN62_ADCC], data-element=AM_CompositionPrototype67.ADCC_ParkingFuncInfo_Provider.AM_CompositionType1.ADCC_ParkingFuncInfo_NtfMAAInfo_SndP.DataElement_NtfMAAInfo, system-signal=SysSIG_Event_NtfMAAInfo_ADCC_ParkingFuncInfo_1}
        sender-receiver-to-signal-mapping={service-instance=[AEP_VLAN62_ICC_8155_QNX_UDP_30501/CSI_ADCC_ParkingFuncInfo_VLAN62_ICC_8155_QNX, AEP_VLAN62_ICC_8155_QNX_TCP_30501/CSI_ADCC_ParkingFuncInfo_VLAN62_ICC_8155_QNX], data-element=AM_CompositionPrototype67.ADCC_ParkingFuncInfoConsumer_ICC_8155_QNX.AM_CompositionType1.ADCC_ParkingFuncInfo_NtfMAAInfo_RcvP.DataElement_NtfMAAInfo, system-signal=SysSIG_Event_NtfMAAInfo_ADCC_ParkingFuncInfo_1}
        sender-receiver-to-signal-mapping={service-instance=[AEP_VLAN62_ADCC_UDP_30500/PSI_ADCC_ParkingFuncInfo_1_VLAN62_ADCC, AEP_VLAN62_ADCC_TCP_30500/PSI_ADCC_ParkingFuncInfo_1_VLAN62_ADCC], data-element=AM_CompositionPrototype67.ADCC_ParkingFuncInfo_Provider.AM_CompositionType1.ADCC_ParkingFuncInfo_NtfHPARepalyPathInfo_SndP.DataElement_NtfHPARepalyPathInfo, system-signal=SysSIG_Event_NtfHPARepalyPathInfo_ADCC_ParkingFuncInfo_1}
        sender-receiver-to-signal-mapping={service-instance=[AEP_VLAN62_ICC_8155_QNX_UDP_30501/CSI_ADCC_ParkingFuncInfo_VLAN62_ICC_8155_QNX, AEP_VLAN62_ICC_8155_QNX_TCP_30501/CSI_ADCC_ParkingFuncInfo_VLAN62_ICC_8155_QNX], data-element=AM_CompositionPrototype67.ADCC_ParkingFuncInfoConsumer_ICC_8155_QNX.AM_CompositionType1.ADCC_ParkingFuncInfo_NtfHPARepalyPathInfo_RcvP.DataElement_NtfHPARepalyPathInfo, system-signal=SysSIG_Event_NtfHPARepalyPathInfo_ADCC_ParkingFuncInfo_1}
        sender-receiver-to-signal-mapping={service-instance=[AEP_VLAN62_ADCC_UDP_30500/PSI_ADCC_ParkingFuncInfo_1_VLAN62_ADCC, AEP_VLAN62_ADCC_TCP_30500/PSI_ADCC_ParkingFuncInfo_1_VLAN62_ADCC], data-element=AM_CompositionPrototype67.ADCC_ParkingFuncInfo_Provider.AM_CompositionType1.ADCC_ParkingFuncInfo_NtfParkingGenaralInfo_2_SndP.DataElement_NtfParkingGenaralInfo_2, system-signal=SysSIG_Event_NtfParkingGenaralInfo_2_ADCC_ParkingFuncInfo_1}
        sender-receiver-to-signal-mapping={service-instance=[AEP_VLAN62_ICC_8155_QNX_UDP_30501/CSI_ADCC_ParkingFuncInfo_VLAN62_ICC_8155_QNX, AEP_VLAN62_ICC_8155_QNX_TCP_30501/CSI_ADCC_ParkingFuncInfo_VLAN62_ICC_8155_QNX], data-element=AM_CompositionPrototype67.ADCC_ParkingFuncInfoConsumer_ICC_8155_QNX.AM_CompositionType1.ADCC_ParkingFuncInfo_NtfParkingGenaralInfo_2_RcvP.DataElement_NtfParkingGenaralInfo_2, system-signal=SysSIG_Event_NtfParkingGenaralInfo_2_ADCC_ParkingFuncInfo_1}
        sender-receiver-to-signal-mapping={service-instance=[AEP_VLAN62_ADCC_UDP_30500/PSI_ADCC_ParkingFuncInfo_1_VLAN62_ADCC, AEP_VLAN62_ADCC_TCP_30500/PSI_ADCC_ParkingFuncInfo_1_VLAN62_ADCC], data-element=AM_CompositionPrototype67.ADCC_ParkingFuncInfo_Provider.AM_CompositionType1.ADCC_ParkingFuncInfo_NtfMRAInfo_2_SndP.DataElement_NtfMRAInfo_2, system-signal=SysSIG_Event_NtfMRAInfo_2_ADCC_ParkingFuncInfo_1}
        sender-receiver-to-signal-mapping={service-instance=[AEP_VLAN62_ICC_8155_QNX_UDP_30501/CSI_ADCC_ParkingFuncInfo_VLAN62_ICC_8155_QNX, AEP_VLAN62_ICC_8155_QNX_TCP_30501/CSI_ADCC_ParkingFuncInfo_VLAN62_ICC_8155_QNX], data-element=AM_CompositionPrototype67.ADCC_ParkingFuncInfoConsumer_ICC_8155_QNX.AM_CompositionType1.ADCC_ParkingFuncInfo_NtfMRAInfo_2_RcvP.DataElement_NtfMRAInfo_2, system-signal=SysSIG_Event_NtfMRAInfo_2_ADCC_ParkingFuncInfo_1}
        sender-receiver-to-signal-mapping={service-instance=[AEP_VLAN62_ADCC_UDP_30500/PSI_ADCC_ParkingFuncInfo_1_VLAN62_ADCC, AEP_VLAN62_ADCC_TCP_30500/PSI_ADCC_ParkingFuncInfo_1_VLAN62_ADCC], data-element=AM_CompositionPrototype67.ADCC_ParkingFuncInfo_Provider.AM_CompositionType1.ADCC_ParkingFuncInfo_NtfAPARPAInfo_2_SndP.DataElement_NtfAPARPAInfo_2, system-signal=SysSIG_Event_NtfAPARPAInfo_2_ADCC_ParkingFuncInfo_1}
        sender-receiver-to-signal-mapping={service-instance=[AEP_VLAN62_ICC_8155_QNX_UDP_30501/CSI_ADCC_ParkingFuncInfo_VLAN62_ICC_8155_QNX, AEP_VLAN62_ICC_8155_QNX_TCP_30501/CSI_ADCC_ParkingFuncInfo_VLAN62_ICC_8155_QNX], data-element=AM_CompositionPrototype67.ADCC_ParkingFuncInfoConsumer_ICC_8155_QNX.AM_CompositionType1.ADCC_ParkingFuncInfo_NtfAPARPAInfo_2_RcvP.DataElement_NtfAPARPAInfo_2, system-signal=SysSIG_Event_NtfAPARPAInfo_2_ADCC_ParkingFuncInfo_1}
        sender-receiver-to-signal-mapping={service-instance=[AEP_VLAN62_ADCC_UDP_30500/PSI_ADCC_ParkingFuncInfo_1_VLAN62_ADCC, AEP_VLAN62_ADCC_TCP_30500/PSI_ADCC_ParkingFuncInfo_1_VLAN62_ADCC], data-element=AM_CompositionPrototype67.ADCC_ParkingFuncInfo_Provider.AM_CompositionType1.ADCC_ParkingFuncInfo_NtfAdvanceParkingInfo_2_SndP.DataElement_NtfAdvanceParkingInfo_2, system-signal=SysSIG_Event_NtfAdvanceParkingInfo_2_ADCC_ParkingFuncInfo_1}
        sender-receiver-to-signal-mapping={service-instance=[AEP_VLAN62_ICC_8155_QNX_UDP_30501/CSI_ADCC_ParkingFuncInfo_VLAN62_ICC_8155_QNX, AEP_VLAN62_ICC_8155_QNX_TCP_30501/CSI_ADCC_ParkingFuncInfo_VLAN62_ICC_8155_QNX], data-element=AM_CompositionPrototype67.ADCC_ParkingFuncInfoConsumer_ICC_8155_QNX.AM_CompositionType1.ADCC_ParkingFuncInfo_NtfAdvanceParkingInfo_2_RcvP.DataElement_NtfAdvanceParkingInfo_2, system-signal=SysSIG_Event_NtfAdvanceParkingInfo_2_ADCC_ParkingFuncInfo_1}
        sender-receiver-to-signal-mapping={service-instance=[AEP_VLAN62_ADCC_UDP_30500/PSI_ADCC_ParkingFuncInfo_1_VLAN62_ADCC, AEP_VLAN62_ADCC_TCP_30500/PSI_ADCC_ParkingFuncInfo_1_VLAN62_ADCC], data-element=AM_CompositionPrototype67.ADCC_ParkingFuncInfo_Provider.AM_CompositionType1.ADCC_ParkingFuncInfo_NtfHPAPathDetail_2_SndP.DataElement_NtfHPAPathDetail_2, system-signal=SysSIG_Event_NtfHPAPathDetail_2_ADCC_ParkingFuncInfo_1}
        sender-receiver-to-signal-mapping={service-instance=[AEP_VLAN62_ICC_8155_QNX_UDP_30501/CSI_ADCC_ParkingFuncInfo_VLAN62_ICC_8155_QNX, AEP_VLAN62_ICC_8155_QNX_TCP_30501/CSI_ADCC_ParkingFuncInfo_VLAN62_ICC_8155_QNX], data-element=AM_CompositionPrototype67.ADCC_ParkingFuncInfoConsumer_ICC_8155_QNX.AM_CompositionType1.ADCC_ParkingFuncInfo_NtfHPAPathDetail_2_RcvP.DataElement_NtfHPAPathDetail_2, system-signal=SysSIG_Event_NtfHPAPathDetail_2_ADCC_ParkingFuncInfo_1}
        sender-receiver-to-signal-mapping={service-instance=[AEP_VLAN62_ADCC_UDP_30500/PSI_ADCC_ParkingFuncInfo_1_VLAN62_ADCC, AEP_VLAN62_ADCC_TCP_30500/PSI_ADCC_ParkingFuncInfo_1_VLAN62_ADCC], data-element=AM_CompositionPrototype67.ADCC_ParkingFuncInfo_Provider.AM_CompositionType1.ADCC_ParkingFuncInfo_NtfHPATrainigPathInfo_2_SndP.DataElement_NtfHPATrainigPathInfo_2, system-signal=SysSIG_Event_NtfHPATrainigPathInfo_2_ADCC_ParkingFuncInfo_1}
        sender-receiver-to-signal-mapping={service-instance=[AEP_VLAN62_ICC_8155_QNX_UDP_30501/CSI_ADCC_ParkingFuncInfo_VLAN62_ICC_8155_QNX, AEP_VLAN62_ICC_8155_QNX_TCP_30501/CSI_ADCC_ParkingFuncInfo_VLAN62_ICC_8155_QNX], data-element=AM_CompositionPrototype67.ADCC_ParkingFuncInfoConsumer_ICC_8155_QNX.AM_CompositionType1.ADCC_ParkingFuncInfo_NtfHPATrainigPathInfo_2_RcvP.DataElement_NtfHPATrainigPathInfo_2, system-signal=SysSIG_Event_NtfHPATrainigPathInfo_2_ADCC_ParkingFuncInfo_1}
        sender-receiver-to-signal-mapping={service-instance=[AEP_VLAN62_ADCC_UDP_30500/PSI_ADCC_ParkingFuncInfo_1_VLAN62_ADCC, AEP_VLAN62_ADCC_TCP_30500/PSI_ADCC_ParkingFuncInfo_1_VLAN62_ADCC], data-element=AM_CompositionPrototype67.ADCC_ParkingFuncInfo_Provider.AM_CompositionType1.ADCC_ParkingFuncInfo_NtfHPARepalyPathInfo_2_SndP.DataElement_NtfHPARepalyPathInfo_2, system-signal=SysSIG_Event_NtfHPARepalyPathInfo_2_ADCC_ParkingFuncInfo_1}
        sender-receiver-to-signal-mapping={service-instance=[AEP_VLAN62_ICC_8155_QNX_UDP_30501/CSI_ADCC_ParkingFuncInfo_VLAN62_ICC_8155_QNX, AEP_VLAN62_ICC_8155_QNX_TCP_30501/CSI_ADCC_ParkingFuncInfo_VLAN62_ICC_8155_QNX], data-element=AM_CompositionPrototype67.ADCC_ParkingFuncInfoConsumer_ICC_8155_QNX.AM_CompositionType1.ADCC_ParkingFuncInfo_NtfHPARepalyPathInfo_2_RcvP.DataElement_NtfHPARepalyPathInfo_2, system-signal=SysSIG_Event_NtfHPARepalyPathInfo_2_ADCC_ParkingFuncInfo_1}
        sender-receiver-to-signal-mapping={service-instance=[AEP_VLAN62_ADCC_UDP_30500/PSI_ADCC_ParkingFuncInfo_1_VLAN62_ADCC, AEP_VLAN62_ADCC_TCP_30500/PSI_ADCC_ParkingFuncInfo_1_VLAN62_ADCC], data-element=AM_CompositionPrototype67.ADCC_ParkingFuncInfo_Provider.AM_CompositionType1.ADCC_ParkingFuncInfo_NtfVPAInfo_SndP.DataElement_NtfVPAInfo, system-signal=SysSIG_Event_NtfVPAInfo_ADCC_ParkingFuncInfo_1}
        sender-receiver-to-signal-mapping={service-instance=[AEP_VLAN62_ICC_8155_QNX_UDP_30501/CSI_ADCC_ParkingFuncInfo_VLAN62_ICC_8155_QNX, AEP_VLAN62_ICC_8155_QNX_TCP_30501/CSI_ADCC_ParkingFuncInfo_VLAN62_ICC_8155_QNX], data-element=AM_CompositionPrototype67.ADCC_ParkingFuncInfoConsumer_ICC_8155_QNX.AM_CompositionType1.ADCC_ParkingFuncInfo_NtfVPAInfo_RcvP.DataElement_NtfVPAInfo, system-signal=SysSIG_Event_NtfVPAInfo_ADCC_ParkingFuncInfo_1}
        sender-receiver-to-signal-mapping={service-instance=[AEP_VLAN62_ADCC_UDP_30500/PSI_ADCC_ParkingFuncInfo_1_VLAN62_ADCC, AEP_VLAN62_ADCC_TCP_30500/PSI_ADCC_ParkingFuncInfo_1_VLAN62_ADCC], data-element=AM_CompositionPrototype67.ADCC_ParkingFuncInfo_Provider.AM_CompositionType1.ADCC_ParkingFuncInfo_NtfParkingHMIInfo_SndP.DataElement_NtfParkingHMIInfo, system-signal=SysSIG_Event_NtfParkingHMIInfo_ADCC_ParkingFuncInfo_1}
        sender-receiver-to-signal-mapping={service-instance=[AEP_VLAN62_ICC_8155_QNX_UDP_30501/CSI_ADCC_ParkingFuncInfo_VLAN62_ICC_8155_QNX, AEP_VLAN62_ICC_8155_QNX_TCP_30501/CSI_ADCC_ParkingFuncInfo_VLAN62_ICC_8155_QNX], data-element=AM_CompositionPrototype67.ADCC_ParkingFuncInfoConsumer_ICC_8155_QNX.AM_CompositionType1.ADCC_ParkingFuncInfo_NtfParkingHMIInfo_RcvP.DataElement_NtfParkingHMIInfo, system-signal=SysSIG_Event_NtfParkingHMIInfo_ADCC_ParkingFuncInfo_1}
        sender-receiver-to-signal-mapping={service-instance=[AEP_VLAN62_ADCC_UDP_30500/PSI_ADCC_ParkingHmiEnv_1_VLAN62_ADCC, AEP_VLAN62_ADCC_TCP_30500/PSI_ADCC_ParkingHmiEnv_1_VLAN62_ADCC], data-element=AM_CompositionPrototype67.ADCC_ParkingHmiEnv_Provider.AM_CompositionType1.ADCC_ParkingHmiEnv_NtfDynamicObjectList_Prkg_SndP.DataElement_NtfDynamicObjectList_Prkg, system-signal=SysSIG_Event_NtfDynamicObjectList_Prkg_ADCC_ParkingHmiEnv}
        sender-receiver-to-signal-mapping={service-instance=[AEP_VLAN62_ICC_8155_Android_UDP_30501/CSI_ADCC_ParkingHmiEnv_VLAN62_ICC_8155_Android, AEP_VLAN62_ICC_8155_Android_TCP_30501/CSI_ADCC_ParkingHmiEnv_VLAN62_ICC_8155_Android], data-element=AM_CompositionPrototype67.ADCC_ParkingHmiEnvConsumer_ICC_8155_Android.AM_CompositionType1.ADCC_ParkingHmiEnv_NtfDynamicObjectList_Prkg_RcvP.DataElement_NtfDynamicObjectList_Prkg, system-signal=SysSIG_Event_NtfDynamicObjectList_Prkg_ADCC_ParkingHmiEnv}
        sender-receiver-to-signal-mapping={service-instance=[AEP_VLAN62_ADCC_UDP_30500/PSI_ADCC_ParkingHmiEnv_1_VLAN62_ADCC, AEP_VLAN62_ADCC_TCP_30500/PSI_ADCC_ParkingHmiEnv_1_VLAN62_ADCC], data-element=AM_CompositionPrototype67.ADCC_ParkingHmiEnv_Provider.AM_CompositionType1.ADCC_ParkingHmiEnv_NtfStaticObjectList_Prkg_SndP.DataElement_NtfStaticObjectList_Prkg, system-signal=SysSIG_Event_NtfStaticObjectList_Prkg_ADCC_ParkingHmiEnv}
        sender-receiver-to-signal-mapping={service-instance=[AEP_VLAN62_ICC_8155_Android_UDP_30501/CSI_ADCC_ParkingHmiEnv_VLAN62_ICC_8155_Android, AEP_VLAN62_ICC_8155_Android_TCP_30501/CSI_ADCC_ParkingHmiEnv_VLAN62_ICC_8155_Android], data-element=AM_CompositionPrototype67.ADCC_ParkingHmiEnvConsumer_ICC_8155_Android.AM_CompositionType1.ADCC_ParkingHmiEnv_NtfStaticObjectList_Prkg_RcvP.DataElement_NtfStaticObjectList_Prkg, system-signal=SysSIG_Event_NtfStaticObjectList_Prkg_ADCC_ParkingHmiEnv}
        sender-receiver-to-signal-mapping={service-instance=[AEP_VLAN62_ADCC_UDP_30500/PSI_ADCC_ParkingHmiEnv_1_VLAN62_ADCC, AEP_VLAN62_ADCC_TCP_30500/PSI_ADCC_ParkingHmiEnv_1_VLAN62_ADCC], data-element=AM_CompositionPrototype67.ADCC_ParkingHmiEnv_Provider.AM_CompositionType1.ADCC_ParkingHmiEnv_NtfParkingSlot_Prkg_SndP.DataElement_NtfParkingSlot_Prkg, system-signal=SysSIG_Event_NtfParkingSlot_Prkg_ADCC_ParkingHmiEnv}
        sender-receiver-to-signal-mapping={service-instance=[AEP_VLAN62_ICC_8155_Android_UDP_30501/CSI_ADCC_ParkingHmiEnv_VLAN62_ICC_8155_Android, AEP_VLAN62_ICC_8155_Android_TCP_30501/CSI_ADCC_ParkingHmiEnv_VLAN62_ICC_8155_Android], data-element=AM_CompositionPrototype67.ADCC_ParkingHmiEnvConsumer_ICC_8155_Android.AM_CompositionType1.ADCC_ParkingHmiEnv_NtfParkingSlot_Prkg_RcvP.DataElement_NtfParkingSlot_Prkg, system-signal=SysSIG_Event_NtfParkingSlot_Prkg_ADCC_ParkingHmiEnv}
        sender-receiver-to-signal-mapping={service-instance=[AEP_VLAN62_ADCC_UDP_30500/PSI_ADCC_ParkingHmiEnv_1_VLAN62_ADCC, AEP_VLAN62_ADCC_TCP_30500/PSI_ADCC_ParkingHmiEnv_1_VLAN62_ADCC], data-element=AM_CompositionPrototype67.ADCC_ParkingHmiEnv_Provider.AM_CompositionType1.ADCC_ParkingHmiEnv_NtfHPAStaticObjectList_Prkg_SndP.DataElement_NtfHPAStaticObjectList_Prkg, system-signal=SysSIG_Event_NtfHPAStaticObjectList_Prkg_ADCC_ParkingHmiEnv}
        sender-receiver-to-signal-mapping={service-instance=[AEP_VLAN62_ICC_8155_Android_UDP_30501/CSI_ADCC_ParkingHmiEnv_VLAN62_ICC_8155_Android, AEP_VLAN62_ICC_8155_Android_TCP_30501/CSI_ADCC_ParkingHmiEnv_VLAN62_ICC_8155_Android], data-element=AM_CompositionPrototype67.ADCC_ParkingHmiEnvConsumer_ICC_8155_Android.AM_CompositionType1.ADCC_ParkingHmiEnv_NtfHPAStaticObjectList_Prkg_RcvP.DataElement_NtfHPAStaticObjectList_Prkg, system-signal=SysSIG_Event_NtfHPAStaticObjectList_Prkg_ADCC_ParkingHmiEnv}
        sender-receiver-to-signal-mapping={service-instance=[AEP_VLAN62_ADCC_UDP_30500/PSI_ADCC_ParkingHmiEnv_1_VLAN62_ADCC, AEP_VLAN62_ADCC_TCP_30500/PSI_ADCC_ParkingHmiEnv_1_VLAN62_ADCC], data-element=AM_CompositionPrototype67.ADCC_ParkingHmiEnv_Provider.AM_CompositionType1.ADCC_ParkingHmiEnv_NtfHPAParkingSlot_Prkg_SndP.DataElement_NtfHPAParkingSlot_Prkg, system-signal=SysSIG_Event_NtfHPAParkingSlot_Prkg_ADCC_ParkingHmiEnv}
        sender-receiver-to-signal-mapping={service-instance=[AEP_VLAN62_ICC_8155_Android_UDP_30501/CSI_ADCC_ParkingHmiEnv_VLAN62_ICC_8155_Android, AEP_VLAN62_ICC_8155_Android_TCP_30501/CSI_ADCC_ParkingHmiEnv_VLAN62_ICC_8155_Android], data-element=AM_CompositionPrototype67.ADCC_ParkingHmiEnvConsumer_ICC_8155_Android.AM_CompositionType1.ADCC_ParkingHmiEnv_NtfHPAParkingSlot_Prkg_RcvP.DataElement_NtfHPAParkingSlot_Prkg, system-signal=SysSIG_Event_NtfHPAParkingSlot_Prkg_ADCC_ParkingHmiEnv}
        sender-receiver-to-signal-mapping={service-instance=[AEP_VLAN62_ADCC_UDP_30500/PSI_ADCC_ParkingHmiEnv_1_VLAN62_ADCC, AEP_VLAN62_ADCC_TCP_30500/PSI_ADCC_ParkingHmiEnv_1_VLAN62_ADCC], data-element=AM_CompositionPrototype67.ADCC_ParkingHmiEnv_Provider.AM_CompositionType1.ADCC_ParkingHmiEnv_NtfVPASelfBuildMapInfo_SndP.DataElement_NtfVPASelfBuildMapInfo, system-signal=SysSIG_Event_NtfVPASelfBuildMapInfo_ADCC_ParkingHmiEnv}
        sender-receiver-to-signal-mapping={service-instance=[AEP_VLAN62_ICC_8155_Android_UDP_30501/CSI_ADCC_ParkingHmiEnv_VLAN62_ICC_8155_Android, AEP_VLAN62_ICC_8155_Android_TCP_30501/CSI_ADCC_ParkingHmiEnv_VLAN62_ICC_8155_Android], data-element=AM_CompositionPrototype67.ADCC_ParkingHmiEnvConsumer_ICC_8155_Android.AM_CompositionType1.ADCC_ParkingHmiEnv_NtfVPASelfBuildMapInfo_RcvP.DataElement_NtfVPASelfBuildMapInfo, system-signal=SysSIG_Event_NtfVPASelfBuildMapInfo_ADCC_ParkingHmiEnv}
        sender-receiver-to-signal-mapping={service-instance=[AEP_VLAN62_ADCC_UDP_30500/PSI_ADCC_ParkingHmiEnv_1_VLAN62_ADCC, AEP_VLAN62_ADCC_TCP_30500/PSI_ADCC_ParkingHmiEnv_1_VLAN62_ADCC], data-element=AM_CompositionPrototype67.ADCC_ParkingHmiEnv_Provider.AM_CompositionType1.ADCC_ParkingHmiEnv_NtfVPAParkingLotInfo_SndP.DataElement_NtfVPAParkingLotInfo, system-signal=SysSIG_Event_NtfVPAParkingLotInfo_ADCC_ParkingHmiEnv}
        sender-receiver-to-signal-mapping={service-instance=[AEP_VLAN62_ICC_8155_Android_UDP_30501/CSI_ADCC_ParkingHmiEnv_VLAN62_ICC_8155_Android, AEP_VLAN62_ICC_8155_Android_TCP_30501/CSI_ADCC_ParkingHmiEnv_VLAN62_ICC_8155_Android], data-element=AM_CompositionPrototype67.ADCC_ParkingHmiEnvConsumer_ICC_8155_Android.AM_CompositionType1.ADCC_ParkingHmiEnv_NtfVPAParkingLotInfo_RcvP.DataElement_NtfVPAParkingLotInfo, system-signal=SysSIG_Event_NtfVPAParkingLotInfo_ADCC_ParkingHmiEnv}
        sender-receiver-to-signal-mapping={service-instance=[AEP_VLAN62_ADCC_UDP_30500/PSI_ADCC_ParkingHmiEnv_1_VLAN62_ADCC, AEP_VLAN62_ADCC_TCP_30500/PSI_ADCC_ParkingHmiEnv_1_VLAN62_ADCC], data-element=AM_CompositionPrototype67.ADCC_ParkingHmiEnv_Provider.AM_CompositionType1.ADCC_ParkingHmiEnv_NtfDynamicObjectList_Prkg_2_SndP.DataElement_NtfDynamicObjectList_Prkg_2, system-signal=SysSIG_Event_NtfDynamicObjectList_Prkg_2_ADCC_ParkingHmiEnv}
        sender-receiver-to-signal-mapping={service-instance=[AEP_VLAN62_ICC_8155_Android_UDP_30501/CSI_ADCC_ParkingHmiEnv_VLAN62_ICC_8155_Android, AEP_VLAN62_ICC_8155_Android_TCP_30501/CSI_ADCC_ParkingHmiEnv_VLAN62_ICC_8155_Android], data-element=AM_CompositionPrototype67.ADCC_ParkingHmiEnvConsumer_ICC_8155_Android.AM_CompositionType1.ADCC_ParkingHmiEnv_NtfDynamicObjectList_Prkg_2_RcvP.DataElement_NtfDynamicObjectList_Prkg_2, system-signal=SysSIG_Event_NtfDynamicObjectList_Prkg_2_ADCC_ParkingHmiEnv}
        sender-receiver-to-signal-mapping={service-instance=[AEP_VLAN62_ADCC_UDP_30500/PSI_ADCC_ParkingHmiEnv_1_VLAN62_ADCC, AEP_VLAN62_ADCC_TCP_30500/PSI_ADCC_ParkingHmiEnv_1_VLAN62_ADCC], data-element=AM_CompositionPrototype67.ADCC_ParkingHmiEnv_Provider.AM_CompositionType1.ADCC_ParkingHmiEnv_NtfStaticObjectList_Prkg_2_SndP.DataElement_NtfStaticObjectList_Prkg_2, system-signal=SysSIG_Event_NtfStaticObjectList_Prkg_2_ADCC_ParkingHmiEnv}
        sender-receiver-to-signal-mapping={service-instance=[AEP_VLAN62_ICC_8155_Android_UDP_30501/CSI_ADCC_ParkingHmiEnv_VLAN62_ICC_8155_Android, AEP_VLAN62_ICC_8155_Android_TCP_30501/CSI_ADCC_ParkingHmiEnv_VLAN62_ICC_8155_Android], data-element=AM_CompositionPrototype67.ADCC_ParkingHmiEnvConsumer_ICC_8155_Android.AM_CompositionType1.ADCC_ParkingHmiEnv_NtfStaticObjectList_Prkg_2_RcvP.DataElement_NtfStaticObjectList_Prkg_2, system-signal=SysSIG_Event_NtfStaticObjectList_Prkg_2_ADCC_ParkingHmiEnv}
        sender-receiver-to-signal-mapping={service-instance=[AEP_VLAN62_ADCC_UDP_30500/PSI_ADCC_ParkingHmiEnv_1_VLAN62_ADCC, AEP_VLAN62_ADCC_TCP_30500/PSI_ADCC_ParkingHmiEnv_1_VLAN62_ADCC], data-element=AM_CompositionPrototype67.ADCC_ParkingHmiEnv_Provider.AM_CompositionType1.ADCC_ParkingHmiEnv_NtfDynamicObjectList_Prkg_SndP.DataElement_NtfDynamicObjectList_Prkg, system-signal=SysSIG_Event_NtfDynamicObjectList_Prkg_ADCC_ParkingHmiEnv_1}
        sender-receiver-to-signal-mapping={service-instance=[AEP_VLAN62_ICC_8155_QNX_UDP_30501/CSI_ADCC_ParkingHmiEnv_VLAN62_ICC_8155_QNX, AEP_VLAN62_ICC_8155_QNX_TCP_30501/CSI_ADCC_ParkingHmiEnv_VLAN62_ICC_8155_QNX], data-element=AM_CompositionPrototype67.ADCC_ParkingHmiEnvConsumer_ICC_8155_QNX.AM_CompositionType1.ADCC_ParkingHmiEnv_NtfDynamicObjectList_Prkg_RcvP.DataElement_NtfDynamicObjectList_Prkg, system-signal=SysSIG_Event_NtfDynamicObjectList_Prkg_ADCC_ParkingHmiEnv_1}
        sender-receiver-to-signal-mapping={service-instance=[AEP_VLAN62_ADCC_UDP_30500/PSI_ADCC_ParkingHmiEnv_1_VLAN62_ADCC, AEP_VLAN62_ADCC_TCP_30500/PSI_ADCC_ParkingHmiEnv_1_VLAN62_ADCC], data-element=AM_CompositionPrototype67.ADCC_ParkingHmiEnv_Provider.AM_CompositionType1.ADCC_ParkingHmiEnv_NtfStaticObjectList_Prkg_SndP.DataElement_NtfStaticObjectList_Prkg, system-signal=SysSIG_Event_NtfStaticObjectList_Prkg_ADCC_ParkingHmiEnv_1}
        sender-receiver-to-signal-mapping={service-instance=[AEP_VLAN62_ICC_8155_QNX_UDP_30501/CSI_ADCC_ParkingHmiEnv_VLAN62_ICC_8155_QNX, AEP_VLAN62_ICC_8155_QNX_TCP_30501/CSI_ADCC_ParkingHmiEnv_VLAN62_ICC_8155_QNX], data-element=AM_CompositionPrototype67.ADCC_ParkingHmiEnvConsumer_ICC_8155_QNX.AM_CompositionType1.ADCC_ParkingHmiEnv_NtfStaticObjectList_Prkg_RcvP.DataElement_NtfStaticObjectList_Prkg, system-signal=SysSIG_Event_NtfStaticObjectList_Prkg_ADCC_ParkingHmiEnv_1}
        sender-receiver-to-signal-mapping={service-instance=[AEP_VLAN62_ADCC_UDP_30500/PSI_ADCC_ParkingHmiEnv_1_VLAN62_ADCC, AEP_VLAN62_ADCC_TCP_30500/PSI_ADCC_ParkingHmiEnv_1_VLAN62_ADCC], data-element=AM_CompositionPrototype67.ADCC_ParkingHmiEnv_Provider.AM_CompositionType1.ADCC_ParkingHmiEnv_NtfParkingSlot_Prkg_SndP.DataElement_NtfParkingSlot_Prkg, system-signal=SysSIG_Event_NtfParkingSlot_Prkg_ADCC_ParkingHmiEnv_1}
        sender-receiver-to-signal-mapping={service-instance=[AEP_VLAN62_ICC_8155_QNX_UDP_30501/CSI_ADCC_ParkingHmiEnv_VLAN62_ICC_8155_QNX, AEP_VLAN62_ICC_8155_QNX_TCP_30501/CSI_ADCC_ParkingHmiEnv_VLAN62_ICC_8155_QNX], data-element=AM_CompositionPrototype67.ADCC_ParkingHmiEnvConsumer_ICC_8155_QNX.AM_CompositionType1.ADCC_ParkingHmiEnv_NtfParkingSlot_Prkg_RcvP.DataElement_NtfParkingSlot_Prkg, system-signal=SysSIG_Event_NtfParkingSlot_Prkg_ADCC_ParkingHmiEnv_1}
        sender-receiver-to-signal-mapping={service-instance=[AEP_VLAN62_ADCC_UDP_30500/PSI_ADCC_ParkingHmiEnv_1_VLAN62_ADCC, AEP_VLAN62_ADCC_TCP_30500/PSI_ADCC_ParkingHmiEnv_1_VLAN62_ADCC], data-element=AM_CompositionPrototype67.ADCC_ParkingHmiEnv_Provider.AM_CompositionType1.ADCC_ParkingHmiEnv_NtfHPAStaticObjectList_Prkg_SndP.DataElement_NtfHPAStaticObjectList_Prkg, system-signal=SysSIG_Event_NtfHPAStaticObjectList_Prkg_ADCC_ParkingHmiEnv_1}
        sender-receiver-to-signal-mapping={service-instance=[AEP_VLAN62_ICC_8155_QNX_UDP_30501/CSI_ADCC_ParkingHmiEnv_VLAN62_ICC_8155_QNX, AEP_VLAN62_ICC_8155_QNX_TCP_30501/CSI_ADCC_ParkingHmiEnv_VLAN62_ICC_8155_QNX], data-element=AM_CompositionPrototype67.ADCC_ParkingHmiEnvConsumer_ICC_8155_QNX.AM_CompositionType1.ADCC_ParkingHmiEnv_NtfHPAStaticObjectList_Prkg_RcvP.DataElement_NtfHPAStaticObjectList_Prkg, system-signal=SysSIG_Event_NtfHPAStaticObjectList_Prkg_ADCC_ParkingHmiEnv_1}
        sender-receiver-to-signal-mapping={service-instance=[AEP_VLAN62_ADCC_UDP_30500/PSI_ADCC_ParkingHmiEnv_1_VLAN62_ADCC, AEP_VLAN62_ADCC_TCP_30500/PSI_ADCC_ParkingHmiEnv_1_VLAN62_ADCC], data-element=AM_CompositionPrototype67.ADCC_ParkingHmiEnv_Provider.AM_CompositionType1.ADCC_ParkingHmiEnv_NtfHPAParkingSlot_Prkg_SndP.DataElement_NtfHPAParkingSlot_Prkg, system-signal=SysSIG_Event_NtfHPAParkingSlot_Prkg_ADCC_ParkingHmiEnv_1}
        sender-receiver-to-signal-mapping={service-instance=[AEP_VLAN62_ICC_8155_QNX_UDP_30501/CSI_ADCC_ParkingHmiEnv_VLAN62_ICC_8155_QNX, AEP_VLAN62_ICC_8155_QNX_TCP_30501/CSI_ADCC_ParkingHmiEnv_VLAN62_ICC_8155_QNX], data-element=AM_CompositionPrototype67.ADCC_ParkingHmiEnvConsumer_ICC_8155_QNX.AM_CompositionType1.ADCC_ParkingHmiEnv_NtfHPAParkingSlot_Prkg_RcvP.DataElement_NtfHPAParkingSlot_Prkg, system-signal=SysSIG_Event_NtfHPAParkingSlot_Prkg_ADCC_ParkingHmiEnv_1}
        sender-receiver-to-signal-mapping={service-instance=[AEP_VLAN62_ADCC_UDP_30500/PSI_ADCC_ParkingHmiEnv_1_VLAN62_ADCC, AEP_VLAN62_ADCC_TCP_30500/PSI_ADCC_ParkingHmiEnv_1_VLAN62_ADCC], data-element=AM_CompositionPrototype67.ADCC_ParkingHmiEnv_Provider.AM_CompositionType1.ADCC_ParkingHmiEnv_NtfVPASelfBuildMapInfo_SndP.DataElement_NtfVPASelfBuildMapInfo, system-signal=SysSIG_Event_NtfVPASelfBuildMapInfo_ADCC_ParkingHmiEnv_1}
        sender-receiver-to-signal-mapping={service-instance=[AEP_VLAN62_ICC_8155_QNX_UDP_30501/CSI_ADCC_ParkingHmiEnv_VLAN62_ICC_8155_QNX, AEP_VLAN62_ICC_8155_QNX_TCP_30501/CSI_ADCC_ParkingHmiEnv_VLAN62_ICC_8155_QNX], data-element=AM_CompositionPrototype67.ADCC_ParkingHmiEnvConsumer_ICC_8155_QNX.AM_CompositionType1.ADCC_ParkingHmiEnv_NtfVPASelfBuildMapInfo_RcvP.DataElement_NtfVPASelfBuildMapInfo, system-signal=SysSIG_Event_NtfVPASelfBuildMapInfo_ADCC_ParkingHmiEnv_1}
        sender-receiver-to-signal-mapping={service-instance=[AEP_VLAN62_ADCC_UDP_30500/PSI_ADCC_ParkingHmiEnv_1_VLAN62_ADCC, AEP_VLAN62_ADCC_TCP_30500/PSI_ADCC_ParkingHmiEnv_1_VLAN62_ADCC], data-element=AM_CompositionPrototype67.ADCC_ParkingHmiEnv_Provider.AM_CompositionType1.ADCC_ParkingHmiEnv_NtfVPAParkingLotInfo_SndP.DataElement_NtfVPAParkingLotInfo, system-signal=SysSIG_Event_NtfVPAParkingLotInfo_ADCC_ParkingHmiEnv_1}
        sender-receiver-to-signal-mapping={service-instance=[AEP_VLAN62_ICC_8155_QNX_UDP_30501/CSI_ADCC_ParkingHmiEnv_VLAN62_ICC_8155_QNX, AEP_VLAN62_ICC_8155_QNX_TCP_30501/CSI_ADCC_ParkingHmiEnv_VLAN62_ICC_8155_QNX], data-element=AM_CompositionPrototype67.ADCC_ParkingHmiEnvConsumer_ICC_8155_QNX.AM_CompositionType1.ADCC_ParkingHmiEnv_NtfVPAParkingLotInfo_RcvP.DataElement_NtfVPAParkingLotInfo, system-signal=SysSIG_Event_NtfVPAParkingLotInfo_ADCC_ParkingHmiEnv_1}
        sender-receiver-to-signal-mapping={service-instance=[AEP_VLAN62_ADCC_UDP_30500/PSI_ADCC_ParkingHmiEnv_1_VLAN62_ADCC, AEP_VLAN62_ADCC_TCP_30500/PSI_ADCC_ParkingHmiEnv_1_VLAN62_ADCC], data-element=AM_CompositionPrototype67.ADCC_ParkingHmiEnv_Provider.AM_CompositionType1.ADCC_ParkingHmiEnv_NtfDynamicObjectList_Prkg_2_SndP.DataElement_NtfDynamicObjectList_Prkg_2, system-signal=SysSIG_Event_NtfDynamicObjectList_Prkg_2_ADCC_ParkingHmiEnv_1}
        sender-receiver-to-signal-mapping={service-instance=[AEP_VLAN62_ICC_8155_QNX_UDP_30501/CSI_ADCC_ParkingHmiEnv_VLAN62_ICC_8155_QNX, AEP_VLAN62_ICC_8155_QNX_TCP_30501/CSI_ADCC_ParkingHmiEnv_VLAN62_ICC_8155_QNX], data-element=AM_CompositionPrototype67.ADCC_ParkingHmiEnvConsumer_ICC_8155_QNX.AM_CompositionType1.ADCC_ParkingHmiEnv_NtfDynamicObjectList_Prkg_2_RcvP.DataElement_NtfDynamicObjectList_Prkg_2, system-signal=SysSIG_Event_NtfDynamicObjectList_Prkg_2_ADCC_ParkingHmiEnv_1}
        sender-receiver-to-signal-mapping={service-instance=[AEP_VLAN62_ADCC_UDP_30500/PSI_ADCC_ParkingHmiEnv_1_VLAN62_ADCC, AEP_VLAN62_ADCC_TCP_30500/PSI_ADCC_ParkingHmiEnv_1_VLAN62_ADCC], data-element=AM_CompositionPrototype67.ADCC_ParkingHmiEnv_Provider.AM_CompositionType1.ADCC_ParkingHmiEnv_NtfStaticObjectList_Prkg_2_SndP.DataElement_NtfStaticObjectList_Prkg_2, system-signal=SysSIG_Event_NtfStaticObjectList_Prkg_2_ADCC_ParkingHmiEnv_1}
        sender-receiver-to-signal-mapping={service-instance=[AEP_VLAN62_ICC_8155_QNX_UDP_30501/CSI_ADCC_ParkingHmiEnv_VLAN62_ICC_8155_QNX, AEP_VLAN62_ICC_8155_QNX_TCP_30501/CSI_ADCC_ParkingHmiEnv_VLAN62_ICC_8155_QNX], data-element=AM_CompositionPrototype67.ADCC_ParkingHmiEnvConsumer_ICC_8155_QNX.AM_CompositionType1.ADCC_ParkingHmiEnv_NtfStaticObjectList_Prkg_2_RcvP.DataElement_NtfStaticObjectList_Prkg_2, system-signal=SysSIG_Event_NtfStaticObjectList_Prkg_2_ADCC_ParkingHmiEnv_1}
        sender-receiver-to-signal-mapping={service-instance=PSI_ADCC_AomMMSt_1_VLAN62_ADCC, data-element=AM_CompositionPrototype67.ADCC_AomMMSt_Provider.AM_CompositionType1.ADCC_AomMMSt_notifyExtMMResWLnk_SndP.DataElement_notifyExtMMResWLnk, system-signal=SysSIG_Event_notifyExtMMResWLnk_ADCC_AomMMSt}
        sender-receiver-to-signal-mapping={service-instance=CSI_ADCC_AomMMSt_VLAN62_ICC_8155_Android, data-element=AM_CompositionPrototype67.ADCC_AomMMStConsumer_ICC_8155_Android.AM_CompositionType1.ADCC_AomMMSt_notifyExtMMResWLnk_RcvP.DataElement_notifyExtMMResWLnk, system-signal=SysSIG_Event_notifyExtMMResWLnk_ADCC_AomMMSt}
        sender-receiver-to-signal-mapping={service-instance=PSI_ADCC_AomMMSt_1_VLAN62_ADCC, data-element=AM_CompositionPrototype67.ADCC_AomMMSt_Provider.AM_CompositionType1.ADCC_AomMMSt_HDMapInfo_SndP.DataElement_HDMapInfo, system-signal=SysSIG_Event_HDMapInfo_ADCC_AomMMSt}
        sender-receiver-to-signal-mapping={service-instance=CSI_ADCC_AomMMSt_VLAN62_ICC_8155_Android, data-element=AM_CompositionPrototype67.ADCC_AomMMStConsumer_ICC_8155_Android.AM_CompositionType1.ADCC_AomMMSt_HDMapInfo_RcvP.DataElement_HDMapInfo, system-signal=SysSIG_Event_HDMapInfo_ADCC_AomMMSt}
        sender-receiver-to-signal-mapping={service-instance=PSI_ADCC_AomMMSt_1_VLAN62_ADCC, data-element=AM_CompositionPrototype67.ADCC_AomMMSt_Provider.AM_CompositionType1.ADCC_AomMMSt_notifyExtMMResWLnk_SndP.DataElement_notifyExtMMResWLnk, system-signal=SysSIG_Event_notifyExtMMResWLnk_ADCC_AomMMSt_1}
        sender-receiver-to-signal-mapping={service-instance=CSI_ADCC_AomMMSt_VLAN62_ICC_8155_QNX, data-element=AM_CompositionPrototype67.ADCC_AomMMStConsumer_ICC_8155_QNX.AM_CompositionType1.ADCC_AomMMSt_notifyExtMMResWLnk_RcvP.DataElement_notifyExtMMResWLnk, system-signal=SysSIG_Event_notifyExtMMResWLnk_ADCC_AomMMSt_1}
        sender-receiver-to-signal-mapping={service-instance=PSI_ADCC_AomMMSt_1_VLAN62_ADCC, data-element=AM_CompositionPrototype67.ADCC_AomMMSt_Provider.AM_CompositionType1.ADCC_AomMMSt_HDMapInfo_SndP.DataElement_HDMapInfo, system-signal=SysSIG_Event_HDMapInfo_ADCC_AomMMSt_1}
        sender-receiver-to-signal-mapping={service-instance=CSI_ADCC_AomMMSt_VLAN62_ICC_8155_QNX, data-element=AM_CompositionPrototype67.ADCC_AomMMStConsumer_ICC_8155_QNX.AM_CompositionType1.ADCC_AomMMSt_HDMapInfo_RcvP.DataElement_HDMapInfo, system-signal=SysSIG_Event_HDMapInfo_ADCC_AomMMSt_1}
        client-server-to-signal-mapping={service-instance=PSI_ADCC_AomDB_1_VLAN62_ADCC, call-signal=SysSIG_RR_GetPackageData_call_Cis_ICC_8155_Android_ADCC_AomDB, client-server-operation=AM_CompositionType1.AM_CompositionPrototype67.ADCC_AomDB_Provider.ServerPort_ADCC_AomDB.RROper_GetPackageData, return-signal=SysSIG_RR_GetPackageData_return_Cis_ICC_8155_Android_ADCC_AomDB}
        client-server-to-signal-mapping={service-instance=CSI_ADCC_AomDB_VLAN62_ICC_8155_Android, call-signal=SysSIG_RR_GetPackageData_call_Cis_ICC_8155_Android_ADCC_AomDB, client-server-operation=AM_CompositionType1.AM_CompositionPrototype67.ADCC_AomDBConsumer_ICC_8155_Android.ClientPort_ADCC_AomDB.RROper_GetPackageData, return-signal=SysSIG_RR_GetPackageData_return_Cis_ICC_8155_Android_ADCC_AomDB}
        client-server-to-signal-mapping={service-instance=PSI_ADCC_AomDB_1_VLAN62_ADCC, call-signal=SysSIG_RR_GetPackageData_call_Cis_ICC_8155_QNX_ADCC_AomDB, client-server-operation=AM_CompositionType1.AM_CompositionPrototype67.ADCC_AomDB_Provider.ServerPort_ADCC_AomDB.RROper_GetPackageData, return-signal=SysSIG_RR_GetPackageData_return_Cis_ICC_8155_QNX_ADCC_AomDB}
        client-server-to-signal-mapping={service-instance=CSI_ADCC_AomDB_VLAN62_ICC_8155_QNX, call-signal=SysSIG_RR_GetPackageData_call_Cis_ICC_8155_QNX_ADCC_AomDB, client-server-operation=AM_CompositionType1.AM_CompositionPrototype67.ADCC_AomDBConsumer_ICC_8155_QNX.ClientPort_ADCC_AomDB.RROper_GetPackageData, return-signal=SysSIG_RR_GetPackageData_return_Cis_ICC_8155_QNX_ADCC_AomDB}
        sender-receiver-to-signal-mapping={service-instance=PSI_ADCC_RtMM_1_VLAN62_ADCC, data-element=AM_CompositionPrototype67.ADCC_RtMM_Provider.AM_CompositionType1.ADCC_RtMM_notifyRtMatchRes_SndP.DataElement_notifyRtMatchRes, system-signal=SysSIG_Event_notifyRtMatchRes_ADCC_RtMM}
        sender-receiver-to-signal-mapping={service-instance=CSI_ADCC_RtMM_VLAN62_ICC_8155_Android, data-element=AM_CompositionPrototype67.ADCC_RtMMConsumer_ICC_8155_Android.AM_CompositionType1.ADCC_RtMM_notifyRtMatchRes_RcvP.DataElement_notifyRtMatchRes, system-signal=SysSIG_Event_notifyRtMatchRes_ADCC_RtMM}
        sender-receiver-to-signal-mapping={service-instance=PSI_ADCC_RtMM_1_VLAN62_ADCC, data-element=AM_CompositionPrototype67.ADCC_RtMM_Provider.AM_CompositionType1.ADCC_RtMM_notifyRtMatchRes_SndP.DataElement_notifyRtMatchRes, system-signal=SysSIG_Event_notifyRtMatchRes_ADCC_RtMM_1}
        sender-receiver-to-signal-mapping={service-instance=CSI_ADCC_RtMM_VLAN62_ICC_8155_QNX, data-element=AM_CompositionPrototype67.ADCC_RtMMConsumer_ICC_8155_QNX.AM_CompositionType1.ADCC_RtMM_notifyRtMatchRes_RcvP.DataElement_notifyRtMatchRes, system-signal=SysSIG_Event_notifyRtMatchRes_ADCC_RtMM_1}
        sender-receiver-to-signal-mapping={service-instance=[AEP_VLAN62_FCM_UDP_30500/PSI_FCM_DrivingHmiEnv_1_VLAN62_FCM, AEP_VLAN62_FCM_TCP_30500/PSI_FCM_DrivingHmiEnv_1_VLAN62_FCM], data-element=AM_CompositionPrototype67.FCM_DrivingHmiEnv_Provider.AM_CompositionType1.FCM_DrivingHmiEnv_NtfDynamicObjectList_SndP.DataElement_NtfDynamicObjectList, system-signal=SysSIG_Event_NtfDynamicObjectList_FCM_DrivingHmiEnv}
        sender-receiver-to-signal-mapping={service-instance=[AEP_VLAN62_ICC_8155_QNX_UDP_30501/CSI_FCM_DrivingHmiEnv_VLAN62_ICC_8155_QNX, AEP_VLAN62_ICC_8155_QNX_TCP_30501/CSI_FCM_DrivingHmiEnv_VLAN62_ICC_8155_QNX], data-element=AM_CompositionPrototype67.FCM_DrivingHmiEnvConsumer_ICC_8155_QNX.AM_CompositionType1.FCM_DrivingHmiEnv_NtfDynamicObjectList_RcvP.DataElement_NtfDynamicObjectList, system-signal=SysSIG_Event_NtfDynamicObjectList_FCM_DrivingHmiEnv}
        sender-receiver-to-signal-mapping={service-instance=[AEP_VLAN62_FCM_UDP_30500/PSI_FCM_DrivingHmiEnv_1_VLAN62_FCM, AEP_VLAN62_FCM_TCP_30500/PSI_FCM_DrivingHmiEnv_1_VLAN62_FCM], data-element=AM_CompositionPrototype67.FCM_DrivingHmiEnv_Provider.AM_CompositionType1.FCM_DrivingHmiEnv_NtfStaticObjectList_SndP.DataElement_NtfStaticObjectList, system-signal=SysSIG_Event_NtfStaticObjectList_FCM_DrivingHmiEnv}
        sender-receiver-to-signal-mapping={service-instance=[AEP_VLAN62_ICC_8155_QNX_UDP_30501/CSI_FCM_DrivingHmiEnv_VLAN62_ICC_8155_QNX, AEP_VLAN62_ICC_8155_QNX_TCP_30501/CSI_FCM_DrivingHmiEnv_VLAN62_ICC_8155_QNX], data-element=AM_CompositionPrototype67.FCM_DrivingHmiEnvConsumer_ICC_8155_QNX.AM_CompositionType1.FCM_DrivingHmiEnv_NtfStaticObjectList_RcvP.DataElement_NtfStaticObjectList, system-signal=SysSIG_Event_NtfStaticObjectList_FCM_DrivingHmiEnv}
        sender-receiver-to-signal-mapping={service-instance=[AEP_VLAN62_FCM_UDP_30500/PSI_FCM_DrivingHmiEnv_1_VLAN62_FCM, AEP_VLAN62_FCM_TCP_30500/PSI_FCM_DrivingHmiEnv_1_VLAN62_FCM], data-element=AM_CompositionPrototype67.FCM_DrivingHmiEnv_Provider.AM_CompositionType1.FCM_DrivingHmiEnv_NtfLaneLineList_SndP.DataElement_NtfLaneLineList, system-signal=SysSIG_Event_NtfLaneLineList_FCM_DrivingHmiEnv}
        sender-receiver-to-signal-mapping={service-instance=[AEP_VLAN62_ICC_8155_QNX_UDP_30501/CSI_FCM_DrivingHmiEnv_VLAN62_ICC_8155_QNX, AEP_VLAN62_ICC_8155_QNX_TCP_30501/CSI_FCM_DrivingHmiEnv_VLAN62_ICC_8155_QNX], data-element=AM_CompositionPrototype67.FCM_DrivingHmiEnvConsumer_ICC_8155_QNX.AM_CompositionType1.FCM_DrivingHmiEnv_NtfLaneLineList_RcvP.DataElement_NtfLaneLineList, system-signal=SysSIG_Event_NtfLaneLineList_FCM_DrivingHmiEnv}
        sender-receiver-to-signal-mapping={service-instance=[AEP_VLAN62_FCM_UDP_30500/PSI_FCM_DrivingHmiEnv_1_VLAN62_FCM, AEP_VLAN62_FCM_TCP_30500/PSI_FCM_DrivingHmiEnv_1_VLAN62_FCM], data-element=AM_CompositionPrototype67.FCM_DrivingHmiEnv_Provider.AM_CompositionType1.FCM_DrivingHmiEnv_NtfLaneLineList_2_SndP.DataElement_NtfLaneLineList_2, system-signal=SysSIG_Event_NtfLaneLineList_2_FCM_DrivingHmiEnv}
        sender-receiver-to-signal-mapping={service-instance=[AEP_VLAN62_ICC_8155_QNX_UDP_30501/CSI_FCM_DrivingHmiEnv_VLAN62_ICC_8155_QNX, AEP_VLAN62_ICC_8155_QNX_TCP_30501/CSI_FCM_DrivingHmiEnv_VLAN62_ICC_8155_QNX], data-element=AM_CompositionPrototype67.FCM_DrivingHmiEnvConsumer_ICC_8155_QNX.AM_CompositionType1.FCM_DrivingHmiEnv_NtfLaneLineList_2_RcvP.DataElement_NtfLaneLineList_2, system-signal=SysSIG_Event_NtfLaneLineList_2_FCM_DrivingHmiEnv}
        sender-receiver-to-signal-mapping={service-instance=[AEP_VLAN62_FCM_UDP_30500/PSI_FCM_DrivingHmiEnv_1_VLAN62_FCM, AEP_VLAN62_FCM_TCP_30500/PSI_FCM_DrivingHmiEnv_1_VLAN62_FCM], data-element=AM_CompositionPrototype67.FCM_DrivingHmiEnv_Provider.AM_CompositionType1.FCM_DrivingHmiEnv_NtfEgoFusionPose_SndP.DataElement_NtfEgoFusionPose, system-signal=SysSIG_Event_NtfEgoFusionPose_FCM_DrivingHmiEnv}
        sender-receiver-to-signal-mapping={service-instance=[AEP_VLAN62_ICC_8155_QNX_UDP_30501/CSI_FCM_DrivingHmiEnv_VLAN62_ICC_8155_QNX, AEP_VLAN62_ICC_8155_QNX_TCP_30501/CSI_FCM_DrivingHmiEnv_VLAN62_ICC_8155_QNX], data-element=AM_CompositionPrototype67.FCM_DrivingHmiEnvConsumer_ICC_8155_QNX.AM_CompositionType1.FCM_DrivingHmiEnv_NtfEgoFusionPose_RcvP.DataElement_NtfEgoFusionPose, system-signal=SysSIG_Event_NtfEgoFusionPose_FCM_DrivingHmiEnv}
        sender-receiver-to-signal-mapping={service-instance=[AEP_VLAN62_FCM_UDP_30500/PSI_FCM_DrivingHmiEnv_1_VLAN62_FCM, AEP_VLAN62_FCM_TCP_30500/PSI_FCM_DrivingHmiEnv_1_VLAN62_FCM], data-element=AM_CompositionPrototype67.FCM_DrivingHmiEnv_Provider.AM_CompositionType1.FCM_DrivingHmiEnv_NtfDynamicObjectList_2_SndP.DataElement_NtfDynamicObjectList_2, system-signal=SysSIG_Event_NtfDynamicObjectList_2_FCM_DrivingHmiEnv}
        sender-receiver-to-signal-mapping={service-instance=[AEP_VLAN62_ICC_8155_QNX_UDP_30501/CSI_FCM_DrivingHmiEnv_VLAN62_ICC_8155_QNX, AEP_VLAN62_ICC_8155_QNX_TCP_30501/CSI_FCM_DrivingHmiEnv_VLAN62_ICC_8155_QNX], data-element=AM_CompositionPrototype67.FCM_DrivingHmiEnvConsumer_ICC_8155_QNX.AM_CompositionType1.FCM_DrivingHmiEnv_NtfDynamicObjectList_2_RcvP.DataElement_NtfDynamicObjectList_2, system-signal=SysSIG_Event_NtfDynamicObjectList_2_FCM_DrivingHmiEnv}
        sender-receiver-to-signal-mapping={service-instance=[AEP_VLAN62_FCM_UDP_30500/PSI_FCM_DrivingHmiEnv_1_VLAN62_FCM, AEP_VLAN62_FCM_TCP_30500/PSI_FCM_DrivingHmiEnv_1_VLAN62_FCM], data-element=AM_CompositionPrototype67.FCM_DrivingHmiEnv_Provider.AM_CompositionType1.FCM_DrivingHmiEnv_NtfStaticObjectList_2_SndP.DataElement_NtfStaticObjectList_2, system-signal=SysSIG_Event_NtfStaticObjectList_2_FCM_DrivingHmiEnv}
        sender-receiver-to-signal-mapping={service-instance=[AEP_VLAN62_ICC_8155_QNX_UDP_30501/CSI_FCM_DrivingHmiEnv_VLAN62_ICC_8155_QNX, AEP_VLAN62_ICC_8155_QNX_TCP_30501/CSI_FCM_DrivingHmiEnv_VLAN62_ICC_8155_QNX], data-element=AM_CompositionPrototype67.FCM_DrivingHmiEnvConsumer_ICC_8155_QNX.AM_CompositionType1.FCM_DrivingHmiEnv_NtfStaticObjectList_2_RcvP.DataElement_NtfStaticObjectList_2, system-signal=SysSIG_Event_NtfStaticObjectList_2_FCM_DrivingHmiEnv}
        sender-receiver-to-signal-mapping={service-instance=[AEP_VLAN62_FCM_UDP_30500/PSI_FCM_DrivingHmiEnv_1_VLAN62_FCM, AEP_VLAN62_FCM_TCP_30500/PSI_FCM_DrivingHmiEnv_1_VLAN62_FCM], data-element=AM_CompositionPrototype67.FCM_DrivingHmiEnv_Provider.AM_CompositionType1.FCM_DrivingHmiEnv_NtfDynamicObjectList_SndP.DataElement_NtfDynamicObjectList, system-signal=SysSIG_Event_NtfDynamicObjectList_FCM_DrivingHmiEnv_1}
        sender-receiver-to-signal-mapping={service-instance=[AEP_VLAN62_ICC_8155_Android_UDP_30501/CSI_FCM_DrivingHmiEnv_VLAN62_ICC_8155_Android, AEP_VLAN62_ICC_8155_Android_TCP_30501/CSI_FCM_DrivingHmiEnv_VLAN62_ICC_8155_Android], data-element=AM_CompositionPrototype67.FCM_DrivingHmiEnvConsumer_ICC_8155_Android.AM_CompositionType1.FCM_DrivingHmiEnv_NtfDynamicObjectList_RcvP.DataElement_NtfDynamicObjectList, system-signal=SysSIG_Event_NtfDynamicObjectList_FCM_DrivingHmiEnv_1}
        sender-receiver-to-signal-mapping={service-instance=[AEP_VLAN62_FCM_UDP_30500/PSI_FCM_DrivingHmiEnv_1_VLAN62_FCM, AEP_VLAN62_FCM_TCP_30500/PSI_FCM_DrivingHmiEnv_1_VLAN62_FCM], data-element=AM_CompositionPrototype67.FCM_DrivingHmiEnv_Provider.AM_CompositionType1.FCM_DrivingHmiEnv_NtfStaticObjectList_SndP.DataElement_NtfStaticObjectList, system-signal=SysSIG_Event_NtfStaticObjectList_FCM_DrivingHmiEnv_1}
        sender-receiver-to-signal-mapping={service-instance=[AEP_VLAN62_ICC_8155_Android_UDP_30501/CSI_FCM_DrivingHmiEnv_VLAN62_ICC_8155_Android, AEP_VLAN62_ICC_8155_Android_TCP_30501/CSI_FCM_DrivingHmiEnv_VLAN62_ICC_8155_Android], data-element=AM_CompositionPrototype67.FCM_DrivingHmiEnvConsumer_ICC_8155_Android.AM_CompositionType1.FCM_DrivingHmiEnv_NtfStaticObjectList_RcvP.DataElement_NtfStaticObjectList, system-signal=SysSIG_Event_NtfStaticObjectList_FCM_DrivingHmiEnv_1}
        sender-receiver-to-signal-mapping={service-instance=[AEP_VLAN62_FCM_UDP_30500/PSI_FCM_DrivingHmiEnv_1_VLAN62_FCM, AEP_VLAN62_FCM_TCP_30500/PSI_FCM_DrivingHmiEnv_1_VLAN62_FCM], data-element=AM_CompositionPrototype67.FCM_DrivingHmiEnv_Provider.AM_CompositionType1.FCM_DrivingHmiEnv_NtfLaneLineList_SndP.DataElement_NtfLaneLineList, system-signal=SysSIG_Event_NtfLaneLineList_FCM_DrivingHmiEnv_1}
        sender-receiver-to-signal-mapping={service-instance=[AEP_VLAN62_ICC_8155_Android_UDP_30501/CSI_FCM_DrivingHmiEnv_VLAN62_ICC_8155_Android, AEP_VLAN62_ICC_8155_Android_TCP_30501/CSI_FCM_DrivingHmiEnv_VLAN62_ICC_8155_Android], data-element=AM_CompositionPrototype67.FCM_DrivingHmiEnvConsumer_ICC_8155_Android.AM_CompositionType1.FCM_DrivingHmiEnv_NtfLaneLineList_RcvP.DataElement_NtfLaneLineList, system-signal=SysSIG_Event_NtfLaneLineList_FCM_DrivingHmiEnv_1}
        sender-receiver-to-signal-mapping={service-instance=[AEP_VLAN62_FCM_UDP_30500/PSI_FCM_DrivingHmiEnv_1_VLAN62_FCM, AEP_VLAN62_FCM_TCP_30500/PSI_FCM_DrivingHmiEnv_1_VLAN62_FCM], data-element=AM_CompositionPrototype67.FCM_DrivingHmiEnv_Provider.AM_CompositionType1.FCM_DrivingHmiEnv_NtfLaneLineList_2_SndP.DataElement_NtfLaneLineList_2, system-signal=SysSIG_Event_NtfLaneLineList_2_FCM_DrivingHmiEnv_1}
        sender-receiver-to-signal-mapping={service-instance=[AEP_VLAN62_ICC_8155_Android_UDP_30501/CSI_FCM_DrivingHmiEnv_VLAN62_ICC_8155_Android, AEP_VLAN62_ICC_8155_Android_TCP_30501/CSI_FCM_DrivingHmiEnv_VLAN62_ICC_8155_Android], data-element=AM_CompositionPrototype67.FCM_DrivingHmiEnvConsumer_ICC_8155_Android.AM_CompositionType1.FCM_DrivingHmiEnv_NtfLaneLineList_2_RcvP.DataElement_NtfLaneLineList_2, system-signal=SysSIG_Event_NtfLaneLineList_2_FCM_DrivingHmiEnv_1}
        sender-receiver-to-signal-mapping={service-instance=[AEP_VLAN62_FCM_UDP_30500/PSI_FCM_DrivingHmiEnv_1_VLAN62_FCM, AEP_VLAN62_FCM_TCP_30500/PSI_FCM_DrivingHmiEnv_1_VLAN62_FCM], data-element=AM_CompositionPrototype67.FCM_DrivingHmiEnv_Provider.AM_CompositionType1.FCM_DrivingHmiEnv_NtfEgoFusionPose_SndP.DataElement_NtfEgoFusionPose, system-signal=SysSIG_Event_NtfEgoFusionPose_FCM_DrivingHmiEnv_1}
        sender-receiver-to-signal-mapping={service-instance=[AEP_VLAN62_ICC_8155_Android_UDP_30501/CSI_FCM_DrivingHmiEnv_VLAN62_ICC_8155_Android, AEP_VLAN62_ICC_8155_Android_TCP_30501/CSI_FCM_DrivingHmiEnv_VLAN62_ICC_8155_Android], data-element=AM_CompositionPrototype67.FCM_DrivingHmiEnvConsumer_ICC_8155_Android.AM_CompositionType1.FCM_DrivingHmiEnv_NtfEgoFusionPose_RcvP.DataElement_NtfEgoFusionPose, system-signal=SysSIG_Event_NtfEgoFusionPose_FCM_DrivingHmiEnv_1}
        sender-receiver-to-signal-mapping={service-instance=[AEP_VLAN62_FCM_UDP_30500/PSI_FCM_DrivingHmiEnv_1_VLAN62_FCM, AEP_VLAN62_FCM_TCP_30500/PSI_FCM_DrivingHmiEnv_1_VLAN62_FCM], data-element=AM_CompositionPrototype67.FCM_DrivingHmiEnv_Provider.AM_CompositionType1.FCM_DrivingHmiEnv_NtfDynamicObjectList_2_SndP.DataElement_NtfDynamicObjectList_2, system-signal=SysSIG_Event_NtfDynamicObjectList_2_FCM_DrivingHmiEnv_1}
        sender-receiver-to-signal-mapping={service-instance=[AEP_VLAN62_ICC_8155_Android_UDP_30501/CSI_FCM_DrivingHmiEnv_VLAN62_ICC_8155_Android, AEP_VLAN62_ICC_8155_Android_TCP_30501/CSI_FCM_DrivingHmiEnv_VLAN62_ICC_8155_Android], data-element=AM_CompositionPrototype67.FCM_DrivingHmiEnvConsumer_ICC_8155_Android.AM_CompositionType1.FCM_DrivingHmiEnv_NtfDynamicObjectList_2_RcvP.DataElement_NtfDynamicObjectList_2, system-signal=SysSIG_Event_NtfDynamicObjectList_2_FCM_DrivingHmiEnv_1}
        sender-receiver-to-signal-mapping={service-instance=[AEP_VLAN62_FCM_UDP_30500/PSI_FCM_DrivingHmiEnv_1_VLAN62_FCM, AEP_VLAN62_FCM_TCP_30500/PSI_FCM_DrivingHmiEnv_1_VLAN62_FCM], data-element=AM_CompositionPrototype67.FCM_DrivingHmiEnv_Provider.AM_CompositionType1.FCM_DrivingHmiEnv_NtfStaticObjectList_2_SndP.DataElement_NtfStaticObjectList_2, system-signal=SysSIG_Event_NtfStaticObjectList_2_FCM_DrivingHmiEnv_1}
        sender-receiver-to-signal-mapping={service-instance=[AEP_VLAN62_ICC_8155_Android_UDP_30501/CSI_FCM_DrivingHmiEnv_VLAN62_ICC_8155_Android, AEP_VLAN62_ICC_8155_Android_TCP_30501/CSI_FCM_DrivingHmiEnv_VLAN62_ICC_8155_Android], data-element=AM_CompositionPrototype67.FCM_DrivingHmiEnvConsumer_ICC_8155_Android.AM_CompositionType1.FCM_DrivingHmiEnv_NtfStaticObjectList_2_RcvP.DataElement_NtfStaticObjectList_2, system-signal=SysSIG_Event_NtfStaticObjectList_2_FCM_DrivingHmiEnv_1}
        sender-receiver-to-signal-mapping={service-instance=PSI_FCM_ActiveSafetyInfo_1_VLAN62_FCM, data-element=AM_CompositionPrototype67.FCM_ActiveSafetyInfo_Provider.AM_CompositionType1.FCM_ActiveSafetyInfo_NtfActiveSafetyFcnInfo_SndP.DataElement_NtfActiveSafetyFcnInfo, system-signal=SysSIG_Event_NtfActiveSafetyFcnInfo_FCM_ActiveSafetyInfo}
        sender-receiver-to-signal-mapping={service-instance=CSI_FCM_ActiveSafetyInfo_VLAN62_ICC_8155_Android, data-element=AM_CompositionPrototype67.FCM_ActiveSafetyInfoConsumer_ICC_8155_Android.AM_CompositionType1.FCM_ActiveSafetyInfo_NtfActiveSafetyFcnInfo_RcvP.DataElement_NtfActiveSafetyFcnInfo, system-signal=SysSIG_Event_NtfActiveSafetyFcnInfo_FCM_ActiveSafetyInfo}
        sender-receiver-to-signal-mapping={service-instance=PSI_FCM_ActiveSafetyInfo_1_VLAN62_FCM, data-element=AM_CompositionPrototype67.FCM_ActiveSafetyInfo_Provider.AM_CompositionType1.FCM_ActiveSafetyInfo_NtfAEBTargetObjInfo_SndP.DataElement_NtfAEBTargetObjInfo, system-signal=SysSIG_Event_NtfAEBTargetObjInfo_FCM_ActiveSafetyInfo}
        sender-receiver-to-signal-mapping={service-instance=CSI_FCM_ActiveSafetyInfo_VLAN62_ICC_8155_Android, data-element=AM_CompositionPrototype67.FCM_ActiveSafetyInfoConsumer_ICC_8155_Android.AM_CompositionType1.FCM_ActiveSafetyInfo_NtfAEBTargetObjInfo_RcvP.DataElement_NtfAEBTargetObjInfo, system-signal=SysSIG_Event_NtfAEBTargetObjInfo_FCM_ActiveSafetyInfo}
        sender-receiver-to-signal-mapping={service-instance=PSI_FCM_ActiveSafetyInfo_1_VLAN62_FCM, data-element=AM_CompositionPrototype67.FCM_ActiveSafetyInfo_Provider.AM_CompositionType1.FCM_ActiveSafetyInfo_NtfActiveSafetyFcnInfo_2_SndP.DataElement_NtfActiveSafetyFcnInfo_2, system-signal=SysSIG_Event_NtfActiveSafetyFcnInfo_2_FCM_ActiveSafetyInfo}
        sender-receiver-to-signal-mapping={service-instance=CSI_FCM_ActiveSafetyInfo_VLAN62_ICC_8155_Android, data-element=AM_CompositionPrototype67.FCM_ActiveSafetyInfoConsumer_ICC_8155_Android.AM_CompositionType1.FCM_ActiveSafetyInfo_NtfActiveSafetyFcnInfo_2_RcvP.DataElement_NtfActiveSafetyFcnInfo_2, system-signal=SysSIG_Event_NtfActiveSafetyFcnInfo_2_FCM_ActiveSafetyInfo}
        sender-receiver-to-signal-mapping={service-instance=PSI_FCM_ActiveSafetyInfo_1_VLAN62_FCM, data-element=AM_CompositionPrototype67.FCM_ActiveSafetyInfo_Provider.AM_CompositionType1.FCM_ActiveSafetyInfo_NtfAEBTargetObjInfo_2_SndP.DataElement_NtfAEBTargetObjInfo_2, system-signal=SysSIG_Event_NtfAEBTargetObjInfo_2_FCM_ActiveSafetyInfo}
        sender-receiver-to-signal-mapping={service-instance=CSI_FCM_ActiveSafetyInfo_VLAN62_ICC_8155_Android, data-element=AM_CompositionPrototype67.FCM_ActiveSafetyInfoConsumer_ICC_8155_Android.AM_CompositionType1.FCM_ActiveSafetyInfo_NtfAEBTargetObjInfo_2_RcvP.DataElement_NtfAEBTargetObjInfo_2, system-signal=SysSIG_Event_NtfAEBTargetObjInfo_2_FCM_ActiveSafetyInfo}
        sender-receiver-to-signal-mapping={service-instance=PSI_FCM_ActiveSafetyInfo_1_VLAN62_FCM, data-element=AM_CompositionPrototype67.FCM_ActiveSafetyInfo_Provider.AM_CompositionType1.FCM_ActiveSafetyInfo_NtfActiveSafetyFcnInfo_SndP.DataElement_NtfActiveSafetyFcnInfo, system-signal=SysSIG_Event_NtfActiveSafetyFcnInfo_FCM_ActiveSafetyInfo_1}
        sender-receiver-to-signal-mapping={service-instance=CSI_FCM_ActiveSafetyInfo_VLAN62_ICC_8155_QNX, data-element=AM_CompositionPrototype67.FCM_ActiveSafetyInfoConsumer_ICC_8155_QNX.AM_CompositionType1.FCM_ActiveSafetyInfo_NtfActiveSafetyFcnInfo_RcvP.DataElement_NtfActiveSafetyFcnInfo, system-signal=SysSIG_Event_NtfActiveSafetyFcnInfo_FCM_ActiveSafetyInfo_1}
        sender-receiver-to-signal-mapping={service-instance=PSI_FCM_ActiveSafetyInfo_1_VLAN62_FCM, data-element=AM_CompositionPrototype67.FCM_ActiveSafetyInfo_Provider.AM_CompositionType1.FCM_ActiveSafetyInfo_NtfAEBTargetObjInfo_SndP.DataElement_NtfAEBTargetObjInfo, system-signal=SysSIG_Event_NtfAEBTargetObjInfo_FCM_ActiveSafetyInfo_1}
        sender-receiver-to-signal-mapping={service-instance=CSI_FCM_ActiveSafetyInfo_VLAN62_ICC_8155_QNX, data-element=AM_CompositionPrototype67.FCM_ActiveSafetyInfoConsumer_ICC_8155_QNX.AM_CompositionType1.FCM_ActiveSafetyInfo_NtfAEBTargetObjInfo_RcvP.DataElement_NtfAEBTargetObjInfo, system-signal=SysSIG_Event_NtfAEBTargetObjInfo_FCM_ActiveSafetyInfo_1}
        sender-receiver-to-signal-mapping={service-instance=PSI_FCM_ActiveSafetyInfo_1_VLAN62_FCM, data-element=AM_CompositionPrototype67.FCM_ActiveSafetyInfo_Provider.AM_CompositionType1.FCM_ActiveSafetyInfo_NtfActiveSafetyFcnInfo_2_SndP.DataElement_NtfActiveSafetyFcnInfo_2, system-signal=SysSIG_Event_NtfActiveSafetyFcnInfo_2_FCM_ActiveSafetyInfo_1}
        sender-receiver-to-signal-mapping={service-instance=CSI_FCM_ActiveSafetyInfo_VLAN62_ICC_8155_QNX, data-element=AM_CompositionPrototype67.FCM_ActiveSafetyInfoConsumer_ICC_8155_QNX.AM_CompositionType1.FCM_ActiveSafetyInfo_NtfActiveSafetyFcnInfo_2_RcvP.DataElement_NtfActiveSafetyFcnInfo_2, system-signal=SysSIG_Event_NtfActiveSafetyFcnInfo_2_FCM_ActiveSafetyInfo_1}
        sender-receiver-to-signal-mapping={service-instance=PSI_FCM_ActiveSafetyInfo_1_VLAN62_FCM, data-element=AM_CompositionPrototype67.FCM_ActiveSafetyInfo_Provider.AM_CompositionType1.FCM_ActiveSafetyInfo_NtfAEBTargetObjInfo_2_SndP.DataElement_NtfAEBTargetObjInfo_2, system-signal=SysSIG_Event_NtfAEBTargetObjInfo_2_FCM_ActiveSafetyInfo_1}
        sender-receiver-to-signal-mapping={service-instance=CSI_FCM_ActiveSafetyInfo_VLAN62_ICC_8155_QNX, data-element=AM_CompositionPrototype67.FCM_ActiveSafetyInfoConsumer_ICC_8155_QNX.AM_CompositionType1.FCM_ActiveSafetyInfo_NtfAEBTargetObjInfo_2_RcvP.DataElement_NtfAEBTargetObjInfo_2, system-signal=SysSIG_Event_NtfAEBTargetObjInfo_2_FCM_ActiveSafetyInfo_1}
        sender-receiver-to-signal-mapping={service-instance=PSI_FCM_DrivingFuncInfo_1_VLAN62_FCM, data-element=AM_CompositionPrototype67.FCM_DrivingFuncInfo_Provider.AM_CompositionType1.FCM_DrivingFuncInfo_NtfTrafficSign_SndP.DataElement_NtfTrafficSign, system-signal=SysSIG_Event_NtfTrafficSign_FCM_DrivingFuncInfo}
        sender-receiver-to-signal-mapping={service-instance=CSI_FCM_DrivingFuncInfo_VLAN62_ICC_8155_Android, data-element=AM_CompositionPrototype67.FCM_DrivingFuncInfoConsumer_ICC_8155_Android.AM_CompositionType1.FCM_DrivingFuncInfo_NtfTrafficSign_RcvP.DataElement_NtfTrafficSign, system-signal=SysSIG_Event_NtfTrafficSign_FCM_DrivingFuncInfo}
        sender-receiver-to-signal-mapping={service-instance=PSI_FCM_DrivingFuncInfo_1_VLAN62_FCM, data-element=AM_CompositionPrototype67.FCM_DrivingFuncInfo_Provider.AM_CompositionType1.FCM_DrivingFuncInfo_NtfISLIinfo_SndP.DataElement_NtfISLIinfo, system-signal=SysSIG_Event_NtfISLIinfo_FCM_DrivingFuncInfo}
        sender-receiver-to-signal-mapping={service-instance=CSI_FCM_DrivingFuncInfo_VLAN62_ICC_8155_Android, data-element=AM_CompositionPrototype67.FCM_DrivingFuncInfoConsumer_ICC_8155_Android.AM_CompositionType1.FCM_DrivingFuncInfo_NtfISLIinfo_RcvP.DataElement_NtfISLIinfo, system-signal=SysSIG_Event_NtfISLIinfo_FCM_DrivingFuncInfo}
        sender-receiver-to-signal-mapping={service-instance=PSI_FCM_DrivingFuncInfo_1_VLAN62_FCM, data-element=AM_CompositionPrototype67.FCM_DrivingFuncInfo_Provider.AM_CompositionType1.FCM_DrivingFuncInfo_NtfACCinfo_SndP.DataElement_NtfACCinfo, system-signal=SysSIG_Event_NtfACCinfo_FCM_DrivingFuncInfo}
        sender-receiver-to-signal-mapping={service-instance=CSI_FCM_DrivingFuncInfo_VLAN62_ICC_8155_Android, data-element=AM_CompositionPrototype67.FCM_DrivingFuncInfoConsumer_ICC_8155_Android.AM_CompositionType1.FCM_DrivingFuncInfo_NtfACCinfo_RcvP.DataElement_NtfACCinfo, system-signal=SysSIG_Event_NtfACCinfo_FCM_DrivingFuncInfo}
        sender-receiver-to-signal-mapping={service-instance=PSI_FCM_DrivingFuncInfo_1_VLAN62_FCM, data-element=AM_CompositionPrototype67.FCM_DrivingFuncInfo_Provider.AM_CompositionType1.FCM_DrivingFuncInfo_NtfICAInfo_SndP.DataElement_NtfICAInfo, system-signal=SysSIG_Event_NtfICAInfo_FCM_DrivingFuncInfo}
        sender-receiver-to-signal-mapping={service-instance=CSI_FCM_DrivingFuncInfo_VLAN62_ICC_8155_Android, data-element=AM_CompositionPrototype67.FCM_DrivingFuncInfoConsumer_ICC_8155_Android.AM_CompositionType1.FCM_DrivingFuncInfo_NtfICAInfo_RcvP.DataElement_NtfICAInfo, system-signal=SysSIG_Event_NtfICAInfo_FCM_DrivingFuncInfo}
        sender-receiver-to-signal-mapping={service-instance=PSI_FCM_DrivingFuncInfo_1_VLAN62_FCM, data-element=AM_CompositionPrototype67.FCM_DrivingFuncInfo_Provider.AM_CompositionType1.FCM_DrivingFuncInfo_NtfIntelligentEvasionInfo_SndP.DataElement_NtfIntelligentEvasionInfo, system-signal=SysSIG_Event_NtfIntelligentEvasionInfo_FCM_DrivingFuncInfo}
        sender-receiver-to-signal-mapping={service-instance=CSI_FCM_DrivingFuncInfo_VLAN62_ICC_8155_Android, data-element=AM_CompositionPrototype67.FCM_DrivingFuncInfoConsumer_ICC_8155_Android.AM_CompositionType1.FCM_DrivingFuncInfo_NtfIntelligentEvasionInfo_RcvP.DataElement_NtfIntelligentEvasionInfo, system-signal=SysSIG_Event_NtfIntelligentEvasionInfo_FCM_DrivingFuncInfo}
        sender-receiver-to-signal-mapping={service-instance=PSI_FCM_DrivingFuncInfo_1_VLAN62_FCM, data-element=AM_CompositionPrototype67.FCM_DrivingFuncInfo_Provider.AM_CompositionType1.FCM_DrivingFuncInfo_NtfHodDmsInfo_SndP.DataElement_NtfHodDmsInfo, system-signal=SysSIG_Event_NtfHodDmsInfo_FCM_DrivingFuncInfo}
        sender-receiver-to-signal-mapping={service-instance=CSI_FCM_DrivingFuncInfo_VLAN62_ICC_8155_Android, data-element=AM_CompositionPrototype67.FCM_DrivingFuncInfoConsumer_ICC_8155_Android.AM_CompositionType1.FCM_DrivingFuncInfo_NtfHodDmsInfo_RcvP.DataElement_NtfHodDmsInfo, system-signal=SysSIG_Event_NtfHodDmsInfo_FCM_DrivingFuncInfo}
        sender-receiver-to-signal-mapping={service-instance=PSI_FCM_DrivingFuncInfo_1_VLAN62_FCM, data-element=AM_CompositionPrototype67.FCM_DrivingFuncInfo_Provider.AM_CompositionType1.FCM_DrivingFuncInfo_NtfLSSInfo_SndP.DataElement_NtfLSSInfo, system-signal=SysSIG_Event_NtfLSSInfo_FCM_DrivingFuncInfo}
        sender-receiver-to-signal-mapping={service-instance=CSI_FCM_DrivingFuncInfo_VLAN62_ICC_8155_Android, data-element=AM_CompositionPrototype67.FCM_DrivingFuncInfoConsumer_ICC_8155_Android.AM_CompositionType1.FCM_DrivingFuncInfo_NtfLSSInfo_RcvP.DataElement_NtfLSSInfo, system-signal=SysSIG_Event_NtfLSSInfo_FCM_DrivingFuncInfo}
        sender-receiver-to-signal-mapping={service-instance=PSI_FCM_DrivingFuncInfo_1_VLAN62_FCM, data-element=AM_CompositionPrototype67.FCM_DrivingFuncInfo_Provider.AM_CompositionType1.FCM_DrivingFuncInfo_NtfESSInfo_SndP.DataElement_NtfESSInfo, system-signal=SysSIG_Event_NtfESSInfo_FCM_DrivingFuncInfo}
        sender-receiver-to-signal-mapping={service-instance=CSI_FCM_DrivingFuncInfo_VLAN62_ICC_8155_Android, data-element=AM_CompositionPrototype67.FCM_DrivingFuncInfoConsumer_ICC_8155_Android.AM_CompositionType1.FCM_DrivingFuncInfo_NtfESSInfo_RcvP.DataElement_NtfESSInfo, system-signal=SysSIG_Event_NtfESSInfo_FCM_DrivingFuncInfo}
        sender-receiver-to-signal-mapping={service-instance=PSI_FCM_DrivingFuncInfo_1_VLAN62_FCM, data-element=AM_CompositionPrototype67.FCM_DrivingFuncInfo_Provider.AM_CompositionType1.FCM_DrivingFuncInfo_NtfDAIInfo_SndP.DataElement_NtfDAIInfo, system-signal=SysSIG_Event_NtfDAIInfo_FCM_DrivingFuncInfo}
        sender-receiver-to-signal-mapping={service-instance=CSI_FCM_DrivingFuncInfo_VLAN62_ICC_8155_Android, data-element=AM_CompositionPrototype67.FCM_DrivingFuncInfoConsumer_ICC_8155_Android.AM_CompositionType1.FCM_DrivingFuncInfo_NtfDAIInfo_RcvP.DataElement_NtfDAIInfo, system-signal=SysSIG_Event_NtfDAIInfo_FCM_DrivingFuncInfo}
        sender-receiver-to-signal-mapping={service-instance=PSI_FCM_DrivingFuncInfo_1_VLAN62_FCM, data-element=AM_CompositionPrototype67.FCM_DrivingFuncInfo_Provider.AM_CompositionType1.FCM_DrivingFuncInfo_NtfISLIinfo_2_SndP.DataElement_NtfISLIinfo_2, system-signal=SysSIG_Event_NtfISLIinfo_2_FCM_DrivingFuncInfo}
        sender-receiver-to-signal-mapping={service-instance=CSI_FCM_DrivingFuncInfo_VLAN62_ICC_8155_Android, data-element=AM_CompositionPrototype67.FCM_DrivingFuncInfoConsumer_ICC_8155_Android.AM_CompositionType1.FCM_DrivingFuncInfo_NtfISLIinfo_2_RcvP.DataElement_NtfISLIinfo_2, system-signal=SysSIG_Event_NtfISLIinfo_2_FCM_DrivingFuncInfo}
        sender-receiver-to-signal-mapping={service-instance=PSI_FCM_DrivingFuncInfo_1_VLAN62_FCM, data-element=AM_CompositionPrototype67.FCM_DrivingFuncInfo_Provider.AM_CompositionType1.FCM_DrivingFuncInfo_NtfLSSInfo_2_SndP.DataElement_NtfLSSInfo_2, system-signal=SysSIG_Event_NtfLSSInfo_2_FCM_DrivingFuncInfo}
        sender-receiver-to-signal-mapping={service-instance=CSI_FCM_DrivingFuncInfo_VLAN62_ICC_8155_Android, data-element=AM_CompositionPrototype67.FCM_DrivingFuncInfoConsumer_ICC_8155_Android.AM_CompositionType1.FCM_DrivingFuncInfo_NtfLSSInfo_2_RcvP.DataElement_NtfLSSInfo_2, system-signal=SysSIG_Event_NtfLSSInfo_2_FCM_DrivingFuncInfo}
        sender-receiver-to-signal-mapping={service-instance=PSI_FCM_DrivingFuncInfo_1_VLAN62_FCM, data-element=AM_CompositionPrototype67.FCM_DrivingFuncInfo_Provider.AM_CompositionType1.FCM_DrivingFuncInfo_NtfDrivingSoundInfo_SndP.DataElement_NtfDrivingSoundInfo, system-signal=SysSIG_Event_NtfDrivingSoundInfo_FCM_DrivingFuncInfo}
        sender-receiver-to-signal-mapping={service-instance=CSI_FCM_DrivingFuncInfo_VLAN62_ICC_8155_Android, data-element=AM_CompositionPrototype67.FCM_DrivingFuncInfoConsumer_ICC_8155_Android.AM_CompositionType1.FCM_DrivingFuncInfo_NtfDrivingSoundInfo_RcvP.DataElement_NtfDrivingSoundInfo, system-signal=SysSIG_Event_NtfDrivingSoundInfo_FCM_DrivingFuncInfo}
        sender-receiver-to-signal-mapping={service-instance=PSI_FCM_DrivingFuncInfo_1_VLAN62_FCM, data-element=AM_CompositionPrototype67.FCM_DrivingFuncInfo_Provider.AM_CompositionType1.FCM_DrivingFuncInfo_NtfIHCInfo_SndP.DataElement_NtfIHCInfo, system-signal=SysSIG_Event_NtfIHCInfo_FCM_DrivingFuncInfo}
        sender-receiver-to-signal-mapping={service-instance=CSI_FCM_DrivingFuncInfo_VLAN62_ICC_8155_Android, data-element=AM_CompositionPrototype67.FCM_DrivingFuncInfoConsumer_ICC_8155_Android.AM_CompositionType1.FCM_DrivingFuncInfo_NtfIHCInfo_RcvP.DataElement_NtfIHCInfo, system-signal=SysSIG_Event_NtfIHCInfo_FCM_DrivingFuncInfo}
        sender-receiver-to-signal-mapping={service-instance=PSI_FCM_DrivingFuncInfo_1_VLAN62_FCM, data-element=AM_CompositionPrototype67.FCM_DrivingFuncInfo_Provider.AM_CompositionType1.FCM_DrivingFuncInfo_NtfHNOPfunctionInfo_SndP.DataElement_NtfHNOPfunctionInfo, system-signal=SysSIG_Event_NtfHNOPfunctionInfo_FCM_DrivingFuncInfo}
        sender-receiver-to-signal-mapping={service-instance=CSI_FCM_DrivingFuncInfo_VLAN62_ICC_8155_Android, data-element=AM_CompositionPrototype67.FCM_DrivingFuncInfoConsumer_ICC_8155_Android.AM_CompositionType1.FCM_DrivingFuncInfo_NtfHNOPfunctionInfo_RcvP.DataElement_NtfHNOPfunctionInfo, system-signal=SysSIG_Event_NtfHNOPfunctionInfo_FCM_DrivingFuncInfo}
        sender-receiver-to-signal-mapping={service-instance=PSI_FCM_DrivingFuncInfo_1_VLAN62_FCM, data-element=AM_CompositionPrototype67.FCM_DrivingFuncInfo_Provider.AM_CompositionType1.FCM_DrivingFuncInfo_NtfTrafficSign_SndP.DataElement_NtfTrafficSign, system-signal=SysSIG_Event_NtfTrafficSign_FCM_DrivingFuncInfo_1}
        sender-receiver-to-signal-mapping={service-instance=CSI_FCM_DrivingFuncInfo_VLAN62_ICC_8155_QNX, data-element=AM_CompositionPrototype67.FCM_DrivingFuncInfoConsumer_ICC_8155_QNX.AM_CompositionType1.FCM_DrivingFuncInfo_NtfTrafficSign_RcvP.DataElement_NtfTrafficSign, system-signal=SysSIG_Event_NtfTrafficSign_FCM_DrivingFuncInfo_1}
        sender-receiver-to-signal-mapping={service-instance=PSI_FCM_DrivingFuncInfo_1_VLAN62_FCM, data-element=AM_CompositionPrototype67.FCM_DrivingFuncInfo_Provider.AM_CompositionType1.FCM_DrivingFuncInfo_NtfISLIinfo_SndP.DataElement_NtfISLIinfo, system-signal=SysSIG_Event_NtfISLIinfo_FCM_DrivingFuncInfo_1}
        sender-receiver-to-signal-mapping={service-instance=CSI_FCM_DrivingFuncInfo_VLAN62_ICC_8155_QNX, data-element=AM_CompositionPrototype67.FCM_DrivingFuncInfoConsumer_ICC_8155_QNX.AM_CompositionType1.FCM_DrivingFuncInfo_NtfISLIinfo_RcvP.DataElement_NtfISLIinfo, system-signal=SysSIG_Event_NtfISLIinfo_FCM_DrivingFuncInfo_1}
        sender-receiver-to-signal-mapping={service-instance=PSI_FCM_DrivingFuncInfo_1_VLAN62_FCM, data-element=AM_CompositionPrototype67.FCM_DrivingFuncInfo_Provider.AM_CompositionType1.FCM_DrivingFuncInfo_NtfACCinfo_SndP.DataElement_NtfACCinfo, system-signal=SysSIG_Event_NtfACCinfo_FCM_DrivingFuncInfo_1}
        sender-receiver-to-signal-mapping={service-instance=CSI_FCM_DrivingFuncInfo_VLAN62_ICC_8155_QNX, data-element=AM_CompositionPrototype67.FCM_DrivingFuncInfoConsumer_ICC_8155_QNX.AM_CompositionType1.FCM_DrivingFuncInfo_NtfACCinfo_RcvP.DataElement_NtfACCinfo, system-signal=SysSIG_Event_NtfACCinfo_FCM_DrivingFuncInfo_1}
        sender-receiver-to-signal-mapping={service-instance=PSI_FCM_DrivingFuncInfo_1_VLAN62_FCM, data-element=AM_CompositionPrototype67.FCM_DrivingFuncInfo_Provider.AM_CompositionType1.FCM_DrivingFuncInfo_NtfICAInfo_SndP.DataElement_NtfICAInfo, system-signal=SysSIG_Event_NtfICAInfo_FCM_DrivingFuncInfo_1}
        sender-receiver-to-signal-mapping={service-instance=CSI_FCM_DrivingFuncInfo_VLAN62_ICC_8155_QNX, data-element=AM_CompositionPrototype67.FCM_DrivingFuncInfoConsumer_ICC_8155_QNX.AM_CompositionType1.FCM_DrivingFuncInfo_NtfICAInfo_RcvP.DataElement_NtfICAInfo, system-signal=SysSIG_Event_NtfICAInfo_FCM_DrivingFuncInfo_1}
        sender-receiver-to-signal-mapping={service-instance=PSI_FCM_DrivingFuncInfo_1_VLAN62_FCM, data-element=AM_CompositionPrototype67.FCM_DrivingFuncInfo_Provider.AM_CompositionType1.FCM_DrivingFuncInfo_NtfIntelligentEvasionInfo_SndP.DataElement_NtfIntelligentEvasionInfo, system-signal=SysSIG_Event_NtfIntelligentEvasionInfo_FCM_DrivingFuncInfo_1}
        sender-receiver-to-signal-mapping={service-instance=CSI_FCM_DrivingFuncInfo_VLAN62_ICC_8155_QNX, data-element=AM_CompositionPrototype67.FCM_DrivingFuncInfoConsumer_ICC_8155_QNX.AM_CompositionType1.FCM_DrivingFuncInfo_NtfIntelligentEvasionInfo_RcvP.DataElement_NtfIntelligentEvasionInfo, system-signal=SysSIG_Event_NtfIntelligentEvasionInfo_FCM_DrivingFuncInfo_1}
        sender-receiver-to-signal-mapping={service-instance=PSI_FCM_DrivingFuncInfo_1_VLAN62_FCM, data-element=AM_CompositionPrototype67.FCM_DrivingFuncInfo_Provider.AM_CompositionType1.FCM_DrivingFuncInfo_NtfHodDmsInfo_SndP.DataElement_NtfHodDmsInfo, system-signal=SysSIG_Event_NtfHodDmsInfo_FCM_DrivingFuncInfo_1}
        sender-receiver-to-signal-mapping={service-instance=CSI_FCM_DrivingFuncInfo_VLAN62_ICC_8155_QNX, data-element=AM_CompositionPrototype67.FCM_DrivingFuncInfoConsumer_ICC_8155_QNX.AM_CompositionType1.FCM_DrivingFuncInfo_NtfHodDmsInfo_RcvP.DataElement_NtfHodDmsInfo, system-signal=SysSIG_Event_NtfHodDmsInfo_FCM_DrivingFuncInfo_1}
        sender-receiver-to-signal-mapping={service-instance=PSI_FCM_DrivingFuncInfo_1_VLAN62_FCM, data-element=AM_CompositionPrototype67.FCM_DrivingFuncInfo_Provider.AM_CompositionType1.FCM_DrivingFuncInfo_NtfLSSInfo_SndP.DataElement_NtfLSSInfo, system-signal=SysSIG_Event_NtfLSSInfo_FCM_DrivingFuncInfo_1}
        sender-receiver-to-signal-mapping={service-instance=CSI_FCM_DrivingFuncInfo_VLAN62_ICC_8155_QNX, data-element=AM_CompositionPrototype67.FCM_DrivingFuncInfoConsumer_ICC_8155_QNX.AM_CompositionType1.FCM_DrivingFuncInfo_NtfLSSInfo_RcvP.DataElement_NtfLSSInfo, system-signal=SysSIG_Event_NtfLSSInfo_FCM_DrivingFuncInfo_1}
        sender-receiver-to-signal-mapping={service-instance=PSI_FCM_DrivingFuncInfo_1_VLAN62_FCM, data-element=AM_CompositionPrototype67.FCM_DrivingFuncInfo_Provider.AM_CompositionType1.FCM_DrivingFuncInfo_NtfESSInfo_SndP.DataElement_NtfESSInfo, system-signal=SysSIG_Event_NtfESSInfo_FCM_DrivingFuncInfo_1}
        sender-receiver-to-signal-mapping={service-instance=CSI_FCM_DrivingFuncInfo_VLAN62_ICC_8155_QNX, data-element=AM_CompositionPrototype67.FCM_DrivingFuncInfoConsumer_ICC_8155_QNX.AM_CompositionType1.FCM_DrivingFuncInfo_NtfESSInfo_RcvP.DataElement_NtfESSInfo, system-signal=SysSIG_Event_NtfESSInfo_FCM_DrivingFuncInfo_1}
        sender-receiver-to-signal-mapping={service-instance=PSI_FCM_DrivingFuncInfo_1_VLAN62_FCM, data-element=AM_CompositionPrototype67.FCM_DrivingFuncInfo_Provider.AM_CompositionType1.FCM_DrivingFuncInfo_NtfDAIInfo_SndP.DataElement_NtfDAIInfo, system-signal=SysSIG_Event_NtfDAIInfo_FCM_DrivingFuncInfo_1}
        sender-receiver-to-signal-mapping={service-instance=CSI_FCM_DrivingFuncInfo_VLAN62_ICC_8155_QNX, data-element=AM_CompositionPrototype67.FCM_DrivingFuncInfoConsumer_ICC_8155_QNX.AM_CompositionType1.FCM_DrivingFuncInfo_NtfDAIInfo_RcvP.DataElement_NtfDAIInfo, system-signal=SysSIG_Event_NtfDAIInfo_FCM_DrivingFuncInfo_1}
        sender-receiver-to-signal-mapping={service-instance=PSI_FCM_DrivingFuncInfo_1_VLAN62_FCM, data-element=AM_CompositionPrototype67.FCM_DrivingFuncInfo_Provider.AM_CompositionType1.FCM_DrivingFuncInfo_NtfISLIinfo_2_SndP.DataElement_NtfISLIinfo_2, system-signal=SysSIG_Event_NtfISLIinfo_2_FCM_DrivingFuncInfo_1}
        sender-receiver-to-signal-mapping={service-instance=CSI_FCM_DrivingFuncInfo_VLAN62_ICC_8155_QNX, data-element=AM_CompositionPrototype67.FCM_DrivingFuncInfoConsumer_ICC_8155_QNX.AM_CompositionType1.FCM_DrivingFuncInfo_NtfISLIinfo_2_RcvP.DataElement_NtfISLIinfo_2, system-signal=SysSIG_Event_NtfISLIinfo_2_FCM_DrivingFuncInfo_1}
        sender-receiver-to-signal-mapping={service-instance=PSI_FCM_DrivingFuncInfo_1_VLAN62_FCM, data-element=AM_CompositionPrototype67.FCM_DrivingFuncInfo_Provider.AM_CompositionType1.FCM_DrivingFuncInfo_NtfLSSInfo_2_SndP.DataElement_NtfLSSInfo_2, system-signal=SysSIG_Event_NtfLSSInfo_2_FCM_DrivingFuncInfo_1}
        sender-receiver-to-signal-mapping={service-instance=CSI_FCM_DrivingFuncInfo_VLAN62_ICC_8155_QNX, data-element=AM_CompositionPrototype67.FCM_DrivingFuncInfoConsumer_ICC_8155_QNX.AM_CompositionType1.FCM_DrivingFuncInfo_NtfLSSInfo_2_RcvP.DataElement_NtfLSSInfo_2, system-signal=SysSIG_Event_NtfLSSInfo_2_FCM_DrivingFuncInfo_1}
        sender-receiver-to-signal-mapping={service-instance=PSI_FCM_DrivingFuncInfo_1_VLAN62_FCM, data-element=AM_CompositionPrototype67.FCM_DrivingFuncInfo_Provider.AM_CompositionType1.FCM_DrivingFuncInfo_NtfDrivingSoundInfo_SndP.DataElement_NtfDrivingSoundInfo, system-signal=SysSIG_Event_NtfDrivingSoundInfo_FCM_DrivingFuncInfo_1}
        sender-receiver-to-signal-mapping={service-instance=CSI_FCM_DrivingFuncInfo_VLAN62_ICC_8155_QNX, data-element=AM_CompositionPrototype67.FCM_DrivingFuncInfoConsumer_ICC_8155_QNX.AM_CompositionType1.FCM_DrivingFuncInfo_NtfDrivingSoundInfo_RcvP.DataElement_NtfDrivingSoundInfo, system-signal=SysSIG_Event_NtfDrivingSoundInfo_FCM_DrivingFuncInfo_1}
        sender-receiver-to-signal-mapping={service-instance=PSI_FCM_DrivingFuncInfo_1_VLAN62_FCM, data-element=AM_CompositionPrototype67.FCM_DrivingFuncInfo_Provider.AM_CompositionType1.FCM_DrivingFuncInfo_NtfIHCInfo_SndP.DataElement_NtfIHCInfo, system-signal=SysSIG_Event_NtfIHCInfo_FCM_DrivingFuncInfo_1}
        sender-receiver-to-signal-mapping={service-instance=CSI_FCM_DrivingFuncInfo_VLAN62_ICC_8155_QNX, data-element=AM_CompositionPrototype67.FCM_DrivingFuncInfoConsumer_ICC_8155_QNX.AM_CompositionType1.FCM_DrivingFuncInfo_NtfIHCInfo_RcvP.DataElement_NtfIHCInfo, system-signal=SysSIG_Event_NtfIHCInfo_FCM_DrivingFuncInfo_1}
        sender-receiver-to-signal-mapping={service-instance=PSI_FCM_DrivingFuncInfo_1_VLAN62_FCM, data-element=AM_CompositionPrototype67.FCM_DrivingFuncInfo_Provider.AM_CompositionType1.FCM_DrivingFuncInfo_NtfHNOPfunctionInfo_SndP.DataElement_NtfHNOPfunctionInfo, system-signal=SysSIG_Event_NtfHNOPfunctionInfo_FCM_DrivingFuncInfo_1}
        sender-receiver-to-signal-mapping={service-instance=CSI_FCM_DrivingFuncInfo_VLAN62_ICC_8155_QNX, data-element=AM_CompositionPrototype67.FCM_DrivingFuncInfoConsumer_ICC_8155_QNX.AM_CompositionType1.FCM_DrivingFuncInfo_NtfHNOPfunctionInfo_RcvP.DataElement_NtfHNOPfunctionInfo, system-signal=SysSIG_Event_NtfHNOPfunctionInfo_FCM_DrivingFuncInfo_1}
        sender-receiver-to-signal-mapping={service-instance=PSI_FCM_DVRSts_1_VLAN62_FCM, data-element=AM_CompositionPrototype67.FCM_DVRSts_Provider.AM_CompositionType1.FCM_DVRSts_notifyDVRSts_SndP.DataElement_notifyDVRSts, system-signal=SysSIG_Event_notifyDVRSts_FCM_DVRSts}
        sender-receiver-to-signal-mapping={service-instance=CSI_FCM_DVRSts_VLAN62_ICC_8155_Android, data-element=AM_CompositionPrototype67.FCM_DVRStsConsumer_ICC_8155_Android.AM_CompositionType1.FCM_DVRSts_notifyDVRSts_RcvP.DataElement_notifyDVRSts, system-signal=SysSIG_Event_notifyDVRSts_FCM_DVRSts}
        sender-receiver-to-signal-mapping={service-instance=PSI_FCM_DVRSts_1_VLAN62_FCM, data-element=AM_CompositionPrototype67.FCM_DVRSts_Provider.AM_CompositionType1.FCM_DVRSts_notifyDVRcameraSts_SndP.DataElement_notifyDVRcameraSts, system-signal=SysSIG_Event_notifyDVRcameraSts_FCM_DVRSts}
        sender-receiver-to-signal-mapping={service-instance=CSI_FCM_DVRSts_VLAN62_ICC_8155_Android, data-element=AM_CompositionPrototype67.FCM_DVRStsConsumer_ICC_8155_Android.AM_CompositionType1.FCM_DVRSts_notifyDVRcameraSts_RcvP.DataElement_notifyDVRcameraSts, system-signal=SysSIG_Event_notifyDVRcameraSts_FCM_DVRSts}
        sender-receiver-to-signal-mapping={service-instance=PSI_FCM_DVRSts_1_VLAN62_FCM, data-element=AM_CompositionPrototype67.FCM_DVRSts_Provider.AM_CompositionType1.FCM_DVRSts_notifyCameraInterParm_SndP.DataElement_notifyCameraInterParm, system-signal=SysSIG_Event_notifyCameraInterParm_FCM_DVRSts}
        sender-receiver-to-signal-mapping={service-instance=CSI_FCM_DVRSts_VLAN62_ICC_8155_Android, data-element=AM_CompositionPrototype67.FCM_DVRStsConsumer_ICC_8155_Android.AM_CompositionType1.FCM_DVRSts_notifyCameraInterParm_RcvP.DataElement_notifyCameraInterParm, system-signal=SysSIG_Event_notifyCameraInterParm_FCM_DVRSts}
        client-server-to-signal-mapping={service-instance=PSI_FCM_DVRSts_1_VLAN62_FCM, call-signal=SysSIG_RR_getCameraInterParm_call_Cis_ICC_8155_Android_FCM_DVRSts, client-server-operation=AM_CompositionType1.AM_CompositionPrototype67.FCM_DVRSts_Provider.ServerPort_FCM_DVRSts.RROper_getCameraInterParm, return-signal=SysSIG_RR_getCameraInterParm_return_Cis_ICC_8155_Android_FCM_DVRSts}
        client-server-to-signal-mapping={service-instance=CSI_FCM_DVRSts_VLAN62_ICC_8155_Android, call-signal=SysSIG_RR_getCameraInterParm_call_Cis_ICC_8155_Android_FCM_DVRSts, client-server-operation=AM_CompositionType1.AM_CompositionPrototype67.FCM_DVRStsConsumer_ICC_8155_Android.ClientPort_FCM_DVRSts.RROper_getCameraInterParm, return-signal=SysSIG_RR_getCameraInterParm_return_Cis_ICC_8155_Android_FCM_DVRSts}
        sender-receiver-to-signal-mapping={service-instance=PSI_FCM_DVRSts_1_VLAN62_FCM, data-element=AM_CompositionPrototype67.FCM_DVRSts_Provider.AM_CompositionType1.FCM_DVRSts_notifyDVRSts_SndP.DataElement_notifyDVRSts, system-signal=SysSIG_Event_notifyDVRSts_FCM_DVRSts_1}
        sender-receiver-to-signal-mapping={service-instance=CSI_FCM_DVRSts_VLAN62_ICC_8155_QNX, data-element=AM_CompositionPrototype67.FCM_DVRStsConsumer_ICC_8155_QNX.AM_CompositionType1.FCM_DVRSts_notifyDVRSts_RcvP.DataElement_notifyDVRSts, system-signal=SysSIG_Event_notifyDVRSts_FCM_DVRSts_1}
        sender-receiver-to-signal-mapping={service-instance=PSI_FCM_DVRSts_1_VLAN62_FCM, data-element=AM_CompositionPrototype67.FCM_DVRSts_Provider.AM_CompositionType1.FCM_DVRSts_notifyDVRcameraSts_SndP.DataElement_notifyDVRcameraSts, system-signal=SysSIG_Event_notifyDVRcameraSts_FCM_DVRSts_1}
        sender-receiver-to-signal-mapping={service-instance=CSI_FCM_DVRSts_VLAN62_ICC_8155_QNX, data-element=AM_CompositionPrototype67.FCM_DVRStsConsumer_ICC_8155_QNX.AM_CompositionType1.FCM_DVRSts_notifyDVRcameraSts_RcvP.DataElement_notifyDVRcameraSts, system-signal=SysSIG_Event_notifyDVRcameraSts_FCM_DVRSts_1}
        sender-receiver-to-signal-mapping={service-instance=PSI_FCM_DVRSts_1_VLAN62_FCM, data-element=AM_CompositionPrototype67.FCM_DVRSts_Provider.AM_CompositionType1.FCM_DVRSts_notifyCameraInterParm_SndP.DataElement_notifyCameraInterParm, system-signal=SysSIG_Event_notifyCameraInterParm_FCM_DVRSts_1}
        sender-receiver-to-signal-mapping={service-instance=CSI_FCM_DVRSts_VLAN62_ICC_8155_QNX, data-element=AM_CompositionPrototype67.FCM_DVRStsConsumer_ICC_8155_QNX.AM_CompositionType1.FCM_DVRSts_notifyCameraInterParm_RcvP.DataElement_notifyCameraInterParm, system-signal=SysSIG_Event_notifyCameraInterParm_FCM_DVRSts_1}
        client-server-to-signal-mapping={service-instance=PSI_FCM_DVRSts_1_VLAN62_FCM, call-signal=SysSIG_RR_getCameraInterParm_call_Cis_ICC_8155_QNX_FCM_DVRSts, client-server-operation=AM_CompositionType1.AM_CompositionPrototype67.FCM_DVRSts_Provider.ServerPort_FCM_DVRSts.RROper_getCameraInterParm, return-signal=SysSIG_RR_getCameraInterParm_return_Cis_ICC_8155_QNX_FCM_DVRSts}
        client-server-to-signal-mapping={service-instance=CSI_FCM_DVRSts_VLAN62_ICC_8155_QNX, call-signal=SysSIG_RR_getCameraInterParm_call_Cis_ICC_8155_QNX_FCM_DVRSts, client-server-operation=AM_CompositionType1.AM_CompositionPrototype67.FCM_DVRStsConsumer_ICC_8155_QNX.ClientPort_FCM_DVRSts.RROper_getCameraInterParm, return-signal=SysSIG_RR_getCameraInterParm_return_Cis_ICC_8155_QNX_FCM_DVRSts}
        client-server-to-signal-mapping={service-instance=PSI_FCM_UUID_1_VLAN62_FCM, call-signal=SysSIG_RR_GetUUIDCodeResponse_call_Cis_TBOX_FCM_UUID, client-server-operation=AM_CompositionType1.AM_CompositionPrototype67.FCM_UUID_Provider.ServerPort_FCM_UUID.RROper_GetUUIDCodeResponse, return-signal=SysSIG_RR_GetUUIDCodeResponse_return_Cis_TBOX_FCM_UUID}
        client-server-to-signal-mapping={service-instance=CSI_FCM_UUID_VLAN62_TBOX, call-signal=SysSIG_RR_GetUUIDCodeResponse_call_Cis_TBOX_FCM_UUID, client-server-operation=AM_CompositionType1.AM_CompositionPrototype67.FCM_UUIDConsumer_TBOX.ClientPort_FCM_UUID.RROper_GetUUIDCodeResponse, return-signal=SysSIG_RR_GetUUIDCodeResponse_return_Cis_TBOX_FCM_UUID}
        client-server-to-signal-mapping={service-instance=PSI_FCM_UUID_1_VLAN62_FCM, call-signal=SysSIG_RR_GetUUIDCodeResponse_call_Cis_ADCC_FCM_UUID, client-server-operation=AM_CompositionType1.AM_CompositionPrototype67.FCM_UUID_Provider.ServerPort_FCM_UUID.RROper_GetUUIDCodeResponse, return-signal=SysSIG_RR_GetUUIDCodeResponse_return_Cis_ADCC_FCM_UUID}
        client-server-to-signal-mapping={service-instance=CSI_FCM_UUID_VLAN62_ADCC, call-signal=SysSIG_RR_GetUUIDCodeResponse_call_Cis_ADCC_FCM_UUID, client-server-operation=AM_CompositionType1.AM_CompositionPrototype67.FCM_UUIDConsumer_ADCC.ClientPort_FCM_UUID.RROper_GetUUIDCodeResponse, return-signal=SysSIG_RR_GetUUIDCodeResponse_return_Cis_ADCC_FCM_UUID}
        client-server-to-signal-mapping={service-instance=PSI_FCM_UUID_1_VLAN62_FCM, call-signal=SysSIG_RR_GetUUIDCodeResponse_call_Cis_LCM_FCM_UUID, client-server-operation=AM_CompositionType1.AM_CompositionPrototype67.FCM_UUID_Provider.ServerPort_FCM_UUID.RROper_GetUUIDCodeResponse, return-signal=SysSIG_RR_GetUUIDCodeResponse_return_Cis_LCM_FCM_UUID}
        client-server-to-signal-mapping={service-instance=CSI_FCM_UUID_VLAN62_LCM, call-signal=SysSIG_RR_GetUUIDCodeResponse_call_Cis_LCM_FCM_UUID, client-server-operation=AM_CompositionType1.AM_CompositionPrototype67.FCM_UUIDConsumer_LCM.ClientPort_FCM_UUID.RROper_GetUUIDCodeResponse, return-signal=SysSIG_RR_GetUUIDCodeResponse_return_Cis_LCM_FCM_UUID}
        client-server-to-signal-mapping={service-instance=PSI_FCM_UUID_1_VLAN62_FCM, call-signal=SysSIG_RR_GetUUIDCodeResponse_call_Cis_ICC_8155_Android_FCM_UUID, client-server-operation=AM_CompositionType1.AM_CompositionPrototype67.FCM_UUID_Provider.ServerPort_FCM_UUID.RROper_GetUUIDCodeResponse, return-signal=SysSIG_RR_GetUUIDCodeResponse_return_Cis_ICC_8155_Android_FCM_UUID}
        client-server-to-signal-mapping={service-instance=CSI_FCM_UUID_VLAN62_ICC_8155_Android, call-signal=SysSIG_RR_GetUUIDCodeResponse_call_Cis_ICC_8155_Android_FCM_UUID, client-server-operation=AM_CompositionType1.AM_CompositionPrototype67.FCM_UUIDConsumer_ICC_8155_Android.ClientPort_FCM_UUID.RROper_GetUUIDCodeResponse, return-signal=SysSIG_RR_GetUUIDCodeResponse_return_Cis_ICC_8155_Android_FCM_UUID}
        sender-receiver-to-signal-mapping={service-instance=PSI_LCM_ICC_Data_1_VLAN62_LCM, data-element=AM_CompositionPrototype67.LCM_ICC_Data_Provider.AM_CompositionType1.LCM_ICC_Data_NtfIMUInfo_SndP.DataElement_NtfIMUInfo, system-signal=SysSIG_Event_NtfIMUInfo_LCM_ICC_Data}
        sender-receiver-to-signal-mapping={service-instance=CSI_LCM_ICC_Data_VLAN62_ICC_8155_QNX, data-element=AM_CompositionPrototype67.LCM_ICC_DataConsumer_ICC_8155_QNX.AM_CompositionType1.LCM_ICC_Data_NtfIMUInfo_RcvP.DataElement_NtfIMUInfo, system-signal=SysSIG_Event_NtfIMUInfo_LCM_ICC_Data}
        sender-receiver-to-signal-mapping={service-instance=PSI_LCM_ADCC_RawData_1_VLAN62_LCM, data-element=AM_CompositionPrototype67.LCM_ADCC_RawData_Provider.AM_CompositionType1.LCM_ADCC_RawData_NtfGRawInfo_SndP.DataElement_NtfGRawInfo, system-signal=SysSIG_Event_NtfGRawInfo_LCM_ADCC_RawData}
        sender-receiver-to-signal-mapping={service-instance=CSI_LCM_ADCC_RawData_VLAN62_ADCC, data-element=AM_CompositionPrototype67.LCM_ADCC_RawDataConsumer_ADCC.AM_CompositionType1.LCM_ADCC_RawData_NtfGRawInfo_RcvP.DataElement_NtfGRawInfo, system-signal=SysSIG_Event_NtfGRawInfo_LCM_ADCC_RawData}
        sender-receiver-to-signal-mapping={service-instance=PSI_ADCC_ActiveSafetyInfo_1_VLAN62_ADCC, data-element=AM_CompositionPrototype67.ADCC_ActiveSafetyInfo_Provider.AM_CompositionType1.ADCC_ActiveSafetyInfo_NtfActiveSafetyFcnInfo_Act_SndP.DataElement_NtfActiveSafetyFcnInfo_Act, system-signal=SysSIG_Event_NtfActiveSafetyFcnInfo_Act_ADCC_ActiveSafetyInfo}
        sender-receiver-to-signal-mapping={service-instance=CSI_ADCC_ActiveSafetyInfo_VLAN62_ICC_8155_Android, data-element=AM_CompositionPrototype67.ADCC_ActiveSafetyInfoConsumer_ICC_8155_Android.AM_CompositionType1.ADCC_ActiveSafetyInfo_NtfActiveSafetyFcnInfo_Act_RcvP.DataElement_NtfActiveSafetyFcnInfo_Act, system-signal=SysSIG_Event_NtfActiveSafetyFcnInfo_Act_ADCC_ActiveSafetyInfo}
        sender-receiver-to-signal-mapping={service-instance=PSI_ADCC_ActiveSafetyInfo_1_VLAN62_ADCC, data-element=AM_CompositionPrototype67.ADCC_ActiveSafetyInfo_Provider.AM_CompositionType1.ADCC_ActiveSafetyInfo_NtfAEBTargetObjInfo_Act_SndP.DataElement_NtfAEBTargetObjInfo_Act, system-signal=SysSIG_Event_NtfAEBTargetObjInfo_Act_ADCC_ActiveSafetyInfo}
        sender-receiver-to-signal-mapping={service-instance=CSI_ADCC_ActiveSafetyInfo_VLAN62_ICC_8155_Android, data-element=AM_CompositionPrototype67.ADCC_ActiveSafetyInfoConsumer_ICC_8155_Android.AM_CompositionType1.ADCC_ActiveSafetyInfo_NtfAEBTargetObjInfo_Act_RcvP.DataElement_NtfAEBTargetObjInfo_Act, system-signal=SysSIG_Event_NtfAEBTargetObjInfo_Act_ADCC_ActiveSafetyInfo}
        sender-receiver-to-signal-mapping={service-instance=PSI_ADCC_ActiveSafetyInfo_1_VLAN62_ADCC, data-element=AM_CompositionPrototype67.ADCC_ActiveSafetyInfo_Provider.AM_CompositionType1.ADCC_ActiveSafetyInfo_NtfActiveSafetyFcnInfo_Act_2_SndP.DataElement_NtfActiveSafetyFcnInfo_Act_2, system-signal=SysSIG_Event_NtfActiveSafetyFcnInfo_Act_2_ADCC_ActiveSafetyInfo}
        sender-receiver-to-signal-mapping={service-instance=CSI_ADCC_ActiveSafetyInfo_VLAN62_ICC_8155_Android, data-element=AM_CompositionPrototype67.ADCC_ActiveSafetyInfoConsumer_ICC_8155_Android.AM_CompositionType1.ADCC_ActiveSafetyInfo_NtfActiveSafetyFcnInfo_Act_2_RcvP.DataElement_NtfActiveSafetyFcnInfo_Act_2, system-signal=SysSIG_Event_NtfActiveSafetyFcnInfo_Act_2_ADCC_ActiveSafetyInfo}
        sender-receiver-to-signal-mapping={service-instance=PSI_ADCC_ActiveSafetyInfo_1_VLAN62_ADCC, data-element=AM_CompositionPrototype67.ADCC_ActiveSafetyInfo_Provider.AM_CompositionType1.ADCC_ActiveSafetyInfo_NtfAEBTargetObjInfo_Act_2_SndP.DataElement_NtfAEBTargetObjInfo_Act_2, system-signal=SysSIG_Event_NtfAEBTargetObjInfo_Act_2_ADCC_ActiveSafetyInfo}
        sender-receiver-to-signal-mapping={service-instance=CSI_ADCC_ActiveSafetyInfo_VLAN62_ICC_8155_Android, data-element=AM_CompositionPrototype67.ADCC_ActiveSafetyInfoConsumer_ICC_8155_Android.AM_CompositionType1.ADCC_ActiveSafetyInfo_NtfAEBTargetObjInfo_Act_2_RcvP.DataElement_NtfAEBTargetObjInfo_Act_2, system-signal=SysSIG_Event_NtfAEBTargetObjInfo_Act_2_ADCC_ActiveSafetyInfo}
        sender-receiver-to-signal-mapping={service-instance=PSI_ADCC_ActiveSafetyInfo_1_VLAN62_ADCC, data-element=AM_CompositionPrototype67.ADCC_ActiveSafetyInfo_Provider.AM_CompositionType1.ADCC_ActiveSafetyInfo_NtfAEBTargetObjInfo_Act_3_SndP.DataElement_NtfAEBTargetObjInfo_Act_3, system-signal=SysSIG_Event_NtfAEBTargetObjInfo_Act_3_ADCC_ActiveSafetyInfo}
        sender-receiver-to-signal-mapping={service-instance=CSI_ADCC_ActiveSafetyInfo_VLAN62_ICC_8155_Android, data-element=AM_CompositionPrototype67.ADCC_ActiveSafetyInfoConsumer_ICC_8155_Android.AM_CompositionType1.ADCC_ActiveSafetyInfo_NtfAEBTargetObjInfo_Act_3_RcvP.DataElement_NtfAEBTargetObjInfo_Act_3, system-signal=SysSIG_Event_NtfAEBTargetObjInfo_Act_3_ADCC_ActiveSafetyInfo}
        sender-receiver-to-signal-mapping={service-instance=PSI_ADCC_ActiveSafetyInfo_1_VLAN62_ADCC, data-element=AM_CompositionPrototype67.ADCC_ActiveSafetyInfo_Provider.AM_CompositionType1.ADCC_ActiveSafetyInfo_NtfActiveSafetyFcnInfo_Act_SndP.DataElement_NtfActiveSafetyFcnInfo_Act, system-signal=SysSIG_Event_NtfActiveSafetyFcnInfo_Act_ADCC_ActiveSafetyInfo_1}
