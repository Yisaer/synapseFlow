[part 9 of 11: packages /DataTypes/ApplicationDataTypes to /DataTypes/ImplementationDataTypes]
AUTOSAR XML (schema 00048)
package /DataTypes/ApplicationDataTypes  (continued)
  application record data type ADT_ADAS_strt_ACCInfo: category=STRUCTURE
    18 x application record element, all with category=VALUE:
      DTE_ACCSts: type=ADT_ADAS_enum_ACCSts  # ACC功能状态
      DTE_AutoResumeNotifier: type=ADT_ADAS_enum_AutoResumeNotifier  # 巡航自动恢复提示
      DTE_SetSpeed: type=ADT_ADAS_val_SetSpd  # 巡航车速
      DTE_SetSpeedUnit: type=ADT_ADAS_enum_SetSpdUnit  # 巡航车速单位
      DTE_TimeGapSet: type=ADT_ADAS_enum_TimeGapSet  # 跟车时距
      DTE_LongitudinalTakeOverRequest: type=ADT_ADAS_enum_LongiTakeOverReq  # 接管请求
      DTE_ACCGoNotifier: type=ADT_ADAS_enum_GoNotifier  # 起步提醒
      DTE_ACCTextMessage: type=ADT_ADAS_enum_ACCTextMessage  # ACC提示信息
      DTE_ACCQuitReason: type=ADT_ADAS_enum_ACCQuitReason  # ACC退出原因
      DTE_FSRACruiseSpdModFb: type=ADT_ADAS_enum_FSRACruiseSpdModFb  # 初始巡航车速模式反馈
      DTE_FSRACruiseSpdOffsetModFb: type=ADT_ADAS_enum_FSRACruiseSpdOffsetModFb  # 初始巡航车速偏差模式反馈
      DTE_SetACCSetSpdOffset: type=ADT_ADAS_val_FSRACruiseSpdOffsetSpdFb  # 巡航车速固定值offset值反馈
      DTE_SetACCSetSpdPercOffset: type=ADT_ADAS_val_FSRACruiseSpdOffsetPercentFb  # 巡航车速百分比offcet值反馈
      DTE_ACCholdSts: type=ADT_ADAS_enum_ACCholdSts  # 巡航保压状态
      DTE_FSRASpdSetMod: type=ADT_ADAS_enum_FSRASpdSetMod  # 巡航车速开关调节模式反馈
      DTE_FDMSt: type=ADT_ADAS_enum_FDMSt  # 前车距离检测功能反馈
      DTE_FDMDist: type=ADT_Gen_val_unit8  # 前车距离检测距离值反馈
      DTE_CruiseAccelerateSts: type=ADT_ADAS_enum_CruiseAccelerateSts  # 巡航跟车加减速状态指示
  4 x app type, all with category=VALUE:
    ADT_ICC_enum_SpeedLimitUnit: compu {phys=raw for raw 0..255}, range phys 0..255
    ADT_ADAS_enum_TLAONOFFSts: compu {phys=raw for raw 0..255}, range phys 0..255  # 红绿灯提醒系统开关状态
    ADT_ADAS_Posn_PathIdx: compu {phys=raw for raw 0..63}, range phys 0..63
    ADT_ADAS_val_vehicleSpd: compu {phys=raw for raw -100..80; unit m/s}, range phys -100..80
  application array data type ADT_HPAPath_arr_Reserved: category=ARRAY  # 预留
    element ADT_HPAPath_arr_Reserved: category=VALUE, type=ADT_Reserved_uint8_Type, array-size-semantics=FIXED-SIZE, max-number-of-elements=30
  app type ADT_TimeValidFlag: category=VALUE, compu {0=INI_VALID, 1=INI_INVALID}  # 时间有效性标记
  application record data type ADT_ICC_strt_TrafficLightCountdown: category=STRUCTURE  # 红绿灯倒计时信息
    8 x application record element:
      DTE_SegmentIndex: category=VALUE, type=ADT_ICC_int64_Index  # segment导航段索引
      DTE_LinkIndex: category=VALUE, type=ADT_ICC_int64_Index  # link段索引
      DTE_TrafficLightPostion: category=STRUCTURE, type=ADT_ICC_strt_Coord2DDouble  # 红绿灯位置坐标
      DTE_TrafficLightPathID: category=VALUE, type=ADT_Gen_int64_ID  # 路线ID
      DTE_TrafficLightLinkID: category=VALUE, type=ADT_Gen_int64_ID  # 所在linkID值
      DTE_RoadStatus: category=VALUE, type=ADT_ICC_int32_RoadStatus  # 路况状态
      DTE_TrafficLightInfo: category=STRUCTURE, type=ADT_ICC_strt_TrafficLightInfo  # 实时灯态信息
      DTE_CountdownReserved: category=ARRAY, type=ADT_Countdown_arr_Reserved  # 预留
  app type ADT_CellularCellId: category=VALUE, compu {phys=raw for raw 0..0xFFFFFFFFFFFFFFFF}, range phys 0..0xFFFFFFFFFFFFFFFF  # 小区信息
  application array data type ADT_SubCameraExt_arr_Reserved: category=ARRAY
    element ADT_SubCameraExt_arr_Reserved: category=VALUE, type=ADT_Reserved_int32_Type, array-size-semantics=FIXED-SIZE, max-number-of-elements=20
  application array data type ADT_CameraStreamFaultMessage: category=ARRAY, dynamic-array-size-profile=VSA_LINEAR  # ADS到CDC的视频流故障消息
    element ADT_CameraStreamFaultMessage: category=VALUE, type=ADT_CameraStreamBasicElement, array-size-handling=ALL-INDICES-SAME-ARRAY-SIZE, array-size-semantics=VARIABLE-SIZE, max-number-of-elements=1048576
  application record data type ADT_ADAS_strt_HPAPathDetail_2: category=STRUCTURE
    13 x application record element:
      DTE_HpaPathID: category=VALUE, type=ADT_Gen_val_ID  # 路线ID
      DTE_PathState: category=VALUE, type=ADT_ADAS_enum_PathState  # 路线学习状态
      DTE_PathName: category=STRING, type=ADT_ADAS_string_PathName  # 路线名称
      DTE_PathSaveProgress: category=VALUE, type=ADT_ADAS_val_PathSaveProgress  # 路线保存进度
      DTE_PathLength: category=VALUE, type=ADT_ADAS_val_ParkingDist  # 路线长度
      DTE_LinePoint: category=ARRAY, type=ADT_ADAS_arr_PathPoint_2  # 路线学习点集
      DTE_PathMatchSts: category=VALUE, type=ADT_ADAS_enum_PathMatchSts  # 路线匹配状态
      DTE_PathLabel: category=VALUE, type=ADT_ADAS_enum_PathLabel  # 路线标签
      DTE_HPAPathType: category=VALUE, type=ADT_ADAS_enum_HPAPathType  # 路线模式
      DTE_HPAOnWayLabelReplay: category=ARRAY, type=ADT_ADAS_arr_HPAOnWayLabelReplay  # HPA沿途标签显示
      DTE_HPAPathDetailSlot: category=ARRAY, type=ADT_ADAS_arr_HPAPathslot_2  # 显示路线中车位
      DTE_HPAPathStaticObject: category=ARRAY, type=ADT_ADAS_arr_HPAParkingStaticObjects  # 显示路线中静态障碍物
      DTE_HPAPathReserved: category=ARRAY, type=ADT_HPAPath_arr_Reserved  # 预留
  app type ADT_ADAS_enum_LKSMod: category=VALUE, compu {phys=raw for raw 0..255}, range phys 0..255
  app type ADT_ICC_enum_RCTAWarnType: category=VALUE, compu {phys=raw for raw 0..255}, range phys 0..255  # RCTA报警方式
  app type ADT_ICC_boolean_InnerRoad: category=VALUE, compu {phys=raw for raw 0..2147483647}, range phys 0..2147483647
  application record data type ADT_ADAS_strt_PlannedPath: category=STRUCTURE
    5 x application record element, all with category=ARRAY, type=ADT_ADAS_arr_TrajectoryPoint:
      DTE_Planned_path_0  # 规划轨迹1
      DTE_Planned_path_1  # 规划轨迹2
      DTE_Planned_path_2  # 规划轨迹3
      DTE_Planned_path_3  # 规划轨迹4
      DTE_Planned_path_4  # 规划轨迹5
  app type ADT_ValetParkingLayer: category=VALUE, compu {phys=raw for raw -1024..1024}, range phys -1024..1024  # 楼层
  app type ADT_Enum_SatelTotNrInfo: category=VALUE, compu {phys=raw for raw 0..65535}, range phys 0..65535  # 卫星总个数信息 Total number of satellites information
  application array data type ADT_ICC_arr_BackLanes: category=ARRAY, dynamic-array-size-profile=VSA_LINEAR
    element ADT_ICC_arr_BackLanes: category=STRUCTURE, type=ADT_ICC_strt_LaneAction, array-size-handling=ALL-INDICES-SAME-ARRAY-SIZE, array-size-semantics=VARIABLE-SIZE, max-number-of-elements=32
  app type ADT_VhrCompID: category=STRING, sw-text-props={array-size-semantics=VARIABLE-SIZE, sw-max-text-size=10, base-type=UTF_8}  # 采集部件名称
  app type ADT_ICC_enum_OutsideParkingBtnSt: category=VALUE, compu {phys=raw for raw 0..255}, range phys 0..255  # 离车泊入软开关
  application record data type ADT_ICC_strt_NaviInfo: category=STRUCTURE  # 导航信息
    30 x application record element:
      DTE_NaviPathID: category=VALUE, type=ADT_Gen_int64_ID  # 导航路径ID
      DTE_NaviCityCode: category=VALUE, type=ADT_ICC_int32_CityCode  # 行政区域编码
      DTE_NaviCurrLinkIdx: category=VALUE, type=ADT_ICC_int32_Index  # 当前自车所在Link，从0开始, step内的index
      DTE_NaviCurrSegIdx: category=VALUE, type=ADT_ICC_int32_Index  # 当前导航段Segment index
      DTE_NaviCurrPointIdx: category=VALUE, type=ADT_ICC_int32_Index  # 当前车位在当前导航段上link中点索引
      DTE_NaviType: category=VALUE, type=ADT_ICC_int32_NaviType  # 更新类型
      DTE_NaviChargeStationRemain: category=ARRAY, type=ADT_ICC_arr_TimeAndDist  # 自车到充电站的距离（单位米）和时间（单位秒）
      DTE_NaviLinkRemainDist: category=VALUE, type=ADT_ICC_int32_LinkRemainDist  # 当前自车所在link剩余的距离（单位米）
      DTE_NaviCurrRoadClass: category=VALUE, type=ADT_ICC_int32_RoadClass  # 当前自车所在道路等级
      DTE_NaviFormWay: category=VALUE, type=ADT_ICC_int32_FormWay  # 自车所在道路属性
      DTE_NaviRouteRemain: category=STRUCTURE, type=ADT_ICC_strt_TimeAndDist  # 路径剩余距离（单位米）和时间（单位秒）
      DTE_NaviNextCrossInfo: category=ARRAY, type=ADT_ICC_arr_CrossNaviInfo  # 下一路口信息
      DTE_NaviInfoFlag: category=VALUE, type=ADT_ICC_int32_NaviInfoFlag  # 标记当前标签板应该显示的信息是NaviInfoData的哪一个,有效值(0/1)参考NaviInfoPanel
      DTE_NaviCrossManeuverID: category=VALUE, type=ADT_Gen_int32_ManeuverID  # 路口转向ID
      DTE_RouteRemainLightCount: category=VALUE, type=ADT_Gen_val_int32  # 路径剩余红绿灯数
      DTE_NaviViaRemains: category=ARRAY, type=ADT_ICC_arr_TimeAndDist  # 自车到途经点的距离（单位米）和时间（单位秒）
      DTE_NaviCurrRoadName: category=STRING, type=ADT_ICC_string_RoadName  # 当前道路名称
      DTE_NaviRingOutCnt: category=VALUE, type=ADT_Gen_val_int32  # 环岛出口序号，不是个数
      DTE_RoundaboutOutAngle: category=VALUE, type=ADT_ICC_int32_Angle  # 环岛出口度数[0,360]
      DTE_NaviDriveTime: category=VALUE, type=ADT_ICC_int32_Time  # 实际的行驶用时，包括中途停车时间在内
      DTE_NaviDriveDist: category=VALUE, type=ADT_ICC_int32_Dist  # 实际的行驶里程
      DTE_NaviCurrLinkSpeed: category=VALUE, type=ADT_ICC_int32_Speed  # 当前link的历史行驶速度， 离线暂没有值
      DTE_NaviNotAvoidInfo: category=STRUCTURE, type=ADT_ICC_strt_NotAvoidInfo  # 未避开的设施及禁行
      DTE_NaviInfoData: category=ARRAY, type=ADT_ICC_arr_NaviInfoPanel  # NaviInfo标签板显示内容专用
      DTE_NaviGateName: category=STRING, type=ADT_ICC_string_GateName  # 黑卡需要的小区门的名字
      DTE_NaviAoiName: category=STRING, type=ADT_ICC_string_AoiName  # aoi名字
      DTE_NaviInnerRoad: category=VALUE, type=ADT_ICC_boolean_InnerRoad  # 偏航抑制态
      DTE_MViaPointInfoArrList: category=ARRAY, type=ADT_ICC_arr_ViaPointInfo  # 途经点列表
      DTE_NaviEndPoiInfo: category=STRUCTURE, type=ADT_ICC_strt_EndPoiInfo  # 终点信息
      DTE_NaviInfoReserved: category=ARRAY, type=ADT_NaviInfo_arr_Reserved  # 预留
  app type ADT_ADAS_enum_VPAButtonStatus: category=VALUE, compu {phys=raw for raw 0..255}, range phys 0..255
  app type ADT_ADAS_ProfLong_Offset: category=VALUE, compu {phys=raw for raw 0..8191}, range phys 0..8191
  app type ADT_Enum_CallOperation: category=VALUE, compu {phys=raw for raw 0..4}, range phys 0..4  # 电话操作
  application record data type ADT_Struct_SetCallNumber1: category=STRUCTURE  # 设置TBOX的call呼叫号码
    application record element DTE_SetCallNumber: category=VALUE, type=ADT_Enum_SetCallNumber  # 设置call呼叫号码
    application record element DTE_PhoneNumber: category=STRING, type=ADT_StrVar_PhoneNumber  # 具体的电话号码
  application record data type ADT_Str_CamStreamSwtReq: category=STRUCTURE  # 摄像头视频开关请求 Camera Video Switch Request
    application record element DTE_CamStreamOrntn: category=VALUE, type=ADT_Enum_CamStreamOrntn  # 相机视频流方位 Camera Video Stream Orientation
    application record element DTE_CamStreamSwtReq: category=VALUE, type=ADT_Enum_CamStreamSwt  # 相机视频流开关请求 Camera Video Stream Switch Request
    application record element DTE_CamStreamSwtReqResd: category=ARRAY, type=ADT_Arr_CamStreamSwtReqResd  # 预留 Reserved
  app type ADT_ADAS_enum_IsSlotHasWheelStopper: category=VALUE, compu {phys=raw for raw 0..255}, range phys 0..255  # 车位是否有轮挡
  application record data type ADT_Struct_SetCallNumber2: category=STRUCTURE  # 设置TBOX的call呼叫号码
    application record element DTE_SetCallNumber: category=VALUE, type=ADT_Enum_SetCallNumber  # 设置call呼叫号码
    application record element DTE_PhoneNumber: category=STRING, type=ADT_StrVar_PhoneNumber  # 具体的电话号码
    application record element DTE_Result: category=VALUE, type=ADT_Enum_Result  # 是否设置成功
  application array data type ADT_ADAS_arr_FusionMetaData: category=ARRAY, dynamic-array-size-profile=VSA_LINEAR
    element ADT_ADAS_arr_FusionMetaData: category=VALUE, type=ADT_ADAS_val_FusionMetaData, array-size-handling=ALL-INDICES-SAME-ARRAY-SIZE, array-size-semantics=VARIABLE-SIZE, max-number-of-elements=5000
  application array data type ADT_Arr_TollGateInfoReserved: category=ARRAY  # 预留 Reserved
    element ADT_Arr_TollGateInfoReserved: category=VALUE, type=ADT_Reserved_int32_Type, array-size-semantics=FIXED-SIZE, max-number-of-elements=20
  app type ADT_SentryModeAlarmReason: category=VALUE, compu {1=ABNORMAL_PEOPLE, 2=VIBRATIONS, 3=VEHICLE_MOVE, 4=ANTI_THEFT_ALARM}  # 哨兵模式告警原因
  application record data type ADT_CellularNetworkDetailInfo: category=STRUCTURE  # 蜂窝网详细信息状态上报
    8 x application record element, all with category=VALUE:
      DTE_cellId: type=ADT_CellularCellId  # 小区信息
      DTE_mcc: type=ADT_CellularMcc  # 移动国家码
      DTE_mnc: type=ADT_CellularMnc  # 移动网络码
      DTE_rat: type=ADT_CellularRat  # 网络制式
      DTE_rsrp: type=ADT_CellularRsrp  # 电平（兼容4G/5G制式）
      DTE_sinr: type=ADT_CellularSinr  # 质量（兼容4G/5G制式）
      DTE_frequency: type=ADT_CellularFrequency  # 频点
      DTE_pci: type=ADT_CellularPci  # PCI
  application array data type ADT_ADAS_arr_ParkingStaticObjects_2: category=ARRAY, dynamic-array-size-profile=VSA_LINEAR  # 泊车静态目标数组
    element ADT_ADAS_arr_ParkingStaticObjects_2: category=STRUCTURE, type=ADT_ADAS_strt_StaticObject_2, array-size-handling=ALL-INDICES-SAME-ARRAY-SIZE, array-size-semantics=VARIABLE-SIZE, max-number-of-elements=100
  application record data type ADT_ADAS_strt_TrafficSign: category=STRUCTURE
    6 x application record element, all with category=VALUE:
      DTE_TSRSt: type=ADT_ADAS_enum_TSRSt  # TSR功能状态
      DTE_TrafficSignId: type=ADT_Gen_val_ID  # 交通标志ID
      DTE_TrafficSignType: type=ADT_ADAS_enum_TrafficSignType  # 交通标志类型
      DTE_TrafficSignPosX: type=ADT_Gen_val_Coordinate_X  # 交通标志位置X
      DTE_TrafficSignPosY: type=ADT_Gen_val_Coordinate_Y  # 交通标志位置Y
      DTE_TrafficSignPosZ: type=ADT_Gen_val_Coordinate_Z  # 交通标志位置Z
  app type ADT_ADAS_val_XboundMax: category=VALUE, compu {phys=raw for raw -1000..1000}, range phys -1000..1000
  app type ADT_Str_SoftwareVers: category=STRING, sw-text-props={array-size-semantics=VARIABLE-SIZE, sw-max-text-size=40, base-type=UTF_8}  # ADAS软件版本号 ADAS software version number
  app type ADT_CellularSinr: category=VALUE, compu {phys=raw for raw -255..255}, range phys -255..255  # 质量（兼容4G/5G制式）
  application array data type ADT_CellularCellMapInfoReserved: category=ARRAY  # 小区网络地图信息预留字段
    element ADT_CellularCellMapInfoReserved: category=VALUE, type=ADT_ADS_ReservedUnit8, array-size-semantics=FIXED-SIZE, max-number-of-elements=20
  application array data type ADT_NaviCongestion_arr_Reserved: category=ARRAY
    element ADT_NaviCongestion_arr_Reserved: category=VALUE, type=ADT_Reserved_int32_Type, array-size-semantics=FIXED-SIZE, max-number-of-elements=20
  5 x app type:
    ADT_ADAS_enum_LKSSts: category=VALUE, compu {phys=raw for raw 0..255}, range phys 0..255
    ADT_ADAS_val_XboundMin: category=VALUE, compu {phys=raw for raw -1000..1000}, range phys -1000..1000
    ADT_VhrLogEndTime: category=VALUE, compu {phys=raw for raw 0..9223372036854775807}, range phys 0..9223372036854775807
    ADT_ICC_string_CongestionId: category=STRING, sw-text-props={array-size-semantics=VARIABLE-SIZE, sw-max-text-size=100, base-type=UTF_8}
    ADT_WiFiLinkedInternet: category=VALUE, compu {0=INI_DISCONNECTED, 1=INI_CONNECTED}  # 是否可以上网
  application record data type ADT_ICC_strt_Coord2DDouble: category=STRUCTURE
    application record element DTE_Coord2DDoubleLon: category=VALUE, type=ADT_ICC_val_longitude  # 经度
    application record element DTE_Coord2DDoubleLat: category=VALUE, type=ADT_ICC_val_latitude  # 维度
  app type ADT_ADAS_enum_ICASts: category=VALUE, compu {phys=raw for raw 0..255}, range phys 0..255
  app type ADT_ICC_enum_SubCameraExtType: category=VALUE, compu {phys=raw for raw -1..127}, range phys -1..127
  app type ADT_StrVar_ProductID: category=STRING, sw-text-props={array-size-semantics=VARIABLE-SIZE, sw-max-text-size=16, base-type=UTF_8}  # TBOX产品唯一ID
  application record data type ADT_ADAS_strt_DynamicObject_2: category=STRUCTURE
    11 x application record element, all with category=VALUE:
      DTE_objectId: type=ADT_Gen_uint64_ID  # 目标id
      DTE_objectType: type=ADT_ADAS_enum_DynamicObjectType  # 目标类型
      DTE_lightStatus: type=ADT_ADAS_enum_LightStatus  # 目标灯光状态
      DTE_objectPoseX: type=ADT_Gen_val_Coordinate_X  # 目标位置X坐标
      DTE_objectPoseY: type=ADT_Gen_val_Coordinate_Y  # 目标位置Y坐标
      DTE_objectYaw: type=ADT_Gen_val_Yaw  # 目标位姿
      DTE_objectColor: type=ADT_ADAS_enum_ObjectColor  # 高亮显示
      DTE_objectVelocityX: type=ADT_ADAS_val_vehicleSpd  # 目标X向速度
      DTE_objectVelocityY: type=ADT_ADAS_val_vehicleSpd  # 目标Y向速度
      DTE_timestampnSec: type=ADT_ADAS_val_timestampnSec  # 时间戳-纳秒
      DTE_laneID: type=ADT_ADAS_uint64_laneID  # 目标所属车道ID
  application array data type ADT_ESSInfo_arr_Reserved: category=ARRAY  # 预留
    element ADT_ESSInfo_arr_Reserved: category=VALUE, type=ADT_Reserved_uint8_Type, array-size-semantics=FIXED-SIZE, max-number-of-elements=100
  app type ADT_ADAS_enum_MEBSts: category=VALUE, compu {phys=raw for raw 0..255}, range phys 0..255
  application array data type ADT_ICC_arr_OptimalLane: category=ARRAY, dynamic-array-size-profile=VSA_LINEAR
    element ADT_ICC_arr_OptimalLane: category=STRUCTURE, type=ADT_ICC_strt_LaneAction, array-size-handling=ALL-INDICES-SAME-ARRAY-SIZE, array-size-semantics=VARIABLE-SIZE, max-number-of-elements=32
  application record data type ADT_RoadPointCellInfo: category=STRUCTURE  # 代客泊车单点单小区信息
    4 x application record element, all with category=VALUE:
      DTE_cellularCellId: type=ADT_CellularCellId  # 小区信息
      DTE_rsrp: type=ADT_CellularRsrp  # 电平（兼容4G/5G制式）
      DTE_sinr: type=ADT_CellularSinr  # 质量（兼容4G/5G制式）
      DTE_reserved: type=ADT_ADS_ReservedUnit8  # 预留字段
  application array data type ADT_MNPInfo_arr_Reserved2: category=ARRAY  # 预留
    element ADT_MNPInfo_arr_Reserved2: category=VALUE, type=ADT_Reserved_uint8_Type, array-size-semantics=FIXED-SIZE, max-number-of-elements=50
  app type ADT_ADAS_Stub_PathIdx: category=VALUE, compu {phys=raw for raw 0..63}, range phys 0..63
  app type ADT_ADAS_Stub_NumOfLaneOppDir: category=VALUE, compu {phys=raw for raw 0..3}, range phys 0..3
  application record data type ADT_ICC_strt_ViaPointInfo: category=STRUCTURE
    6 x application record element:
      DTE_ViaPointSegmentIdx: category=VALUE, type=ADT_ICC_int16_Index  # 导航段索引
      DTE_ViaPointDirection: category=VALUE, type=ADT_ICC_val_Direction  # 途经点所在道路方向
      DTE_ViaPointShow: category=STRUCTURE, type=ADT_ICC_strt_Coord2DDouble  # 显示坐标
      DTE_ViaPointProjective: category=STRUCTURE, type=ADT_ICC_strt_Coord3DDouble  # 显示坐标的投影点坐标
      DTE_ViaPointPoiName: category=STRING, type=ADT_ICC_string_PoiName  # POI名称
      DTE_ViaPointReserved: category=ARRAY, type=ADT_ViaPoint_arr_Reserved  # 预留
  application array data type ADT_ICC_arr_WeatherInfo: category=ARRAY, dynamic-array-size-profile=VSA_LINEAR
    element ADT_ICC_arr_WeatherInfo: category=STRUCTURE, type=ADT_ICC_strt_WeatherInfo, array-size-handling=ALL-INDICES-SAME-ARRAY-SIZE, array-size-semantics=VARIABLE-SIZE, max-number-of-elements=5
  5 x app type:
    ADT_StrVar_usid: category=STRING, sw-text-props={array-size-semantics=VARIABLE-SIZE, sw-max-text-size=32, base-type=UTF_8}
    ADT_ICC_enum_MNPUseRouteIDBtnSt: category=VALUE, compu {phys=raw for raw 0..20}, range phys 0..20  # 选中使用的记忆路线ID
    ADT_SentryModeAlarmLevel: category=VALUE, compu {1=WARNING, 2=ALARM}  # 哨兵模式告警等级
    ADT_Enum_CallType: category=VALUE, compu {phys=raw for raw 0..2}, range phys 0..2
    ADT_ValetParkingReferDistanceStep: category=VALUE, compu {phys=raw for raw 0..10; unit m}, range phys 0..10  # 代客泊车路点间隔。即，每2个相邻路点的间隔距离，默认值：1m
  application record data type ADT_ICC_Navi_GpsPoint: category=STRUCTURE  # GPS位置坐标信息
    application record element DTE_Longitude: category=VALUE, type=ADT_ICC_Navi_Longitude  # 经度信息
    application record element DTE_Latitude: category=VALUE, type=ADT_ICC_Navi_Latitude  # 纬度信息
  application record data type ADT_ICC_strt_CongestionExtend: category=STRUCTURE  # 拥堵扩展信息
    7 x application record element:
      DTE_CongestionTrend: category=STRING, type=ADT_ICC_string_Trend  # 趋势
      DTE_CongestionAffect: category=STRING, type=ADT_ICC_string_Affect  # 影响
      DTE_CongestionCause: category=STRING, type=ADT_ICC_string_Cause  # 原因
      DTE_CongestionEventId: category=STRING, type=ADT_ICC_string_EventId  # 拥堵事件 Id
      DTE_HeavyTraffic: category=VALUE, type=ADT_ICC_int64_HeavyTraffic  # 是否为严重拥堵。拥堵长度大于800米且通行时间大于4分钟，透出1。否则为0。
      DTE_CongestionId: category=STRING, type=ADT_ICC_string_CongestionId  # 拥堵段 id
      DTE_CongestionExtendReserved: category=ARRAY, type=ADT_CongestionExtend_arr_Reserved  # 预留
  app type ADT_ADAS_enum_VPAFailureReasonInd: category=VALUE, compu {phys=raw for raw 0..255}, range phys 0..255
  app type ADT_ICC_int32_LinkType: category=VALUE, compu {phys=raw for raw -2147483648..2147483647}, range phys -2147483648..2147483647
  app type ADT_StrVar_CanConfig: category=STRING, sw-text-props={array-size-semantics=VARIABLE-SIZE, sw-max-text-size=255, base-type=UTF_8}  # CAN配置信息
  application record data type ADT_SentryModeAlarm: category=STRUCTURE  # 哨兵模式告警
    application record element DTE_sentryModeAlarmLevel: category=VALUE, type=ADT_SentryModeAlarmLevel  # 哨兵模式告警等级
    application record element DTE_sentryModeAlarmReason: category=VALUE, type=ADT_SentryModeAlarmReason  # 哨兵模式告警原因
  app type ADT_ADAS_enum_MNPSts: category=VALUE, compu {phys=raw for raw 0..255}, range phys 0..255  # MNP工作状态
  app type ADT_ICC_enum_LccPlusEnableBtnSt: category=VALUE, compu {phys=raw for raw 0..255}, range phys 0..255  # 巡航增强功能使能开关
  application array data type ADT_ICC_arr_AheadLaneInfoList: category=ARRAY, dynamic-array-size-profile=VSA_LINEAR  # 前方路口信息列表
    element ADT_ICC_arr_AheadLaneInfoList: category=STRUCTURE, type=ADT_ICC_strt_LaneInfo, array-size-handling=ALL-INDICES-SAME-ARRAY-SIZE, array-size-semantics=VARIABLE-SIZE, max-number-of-elements=6
  app type ADT_ADAS_enum_ParkingOperationResp: category=VALUE, compu {phys=raw for raw 0..255}, range phys 0..255
  app type ADT_ICC_enum_VoiceRemindSettingSt: category=VALUE, compu {phys=raw for raw 0..255}, range phys 0..255  # 语音播报功能设置状态
  app type ADT_ICC_enum_NavigationSts: category=VALUE, compu {phys=raw for raw 0..255}, range phys 0..255
  application array data type ADT_TmcInfo_arr_Reserved: category=ARRAY
    element ADT_TmcInfo_arr_Reserved: category=VALUE, type=ADT_Reserved_int32_Type, array-size-semantics=FIXED-SIZE, max-number-of-elements=20
  5 x app type, all with category=VALUE:
    ADT_ADAS_enum_TSISgnLongStay: compu {phys=raw for raw 0..255}, range phys 0..255  # TSR长时类标识牌
    ADT_ICC_enum_ICAplussetting: compu {phys=raw for raw 0..255}, range phys 0..255  # 直行红绿灯启停设置状态
    ADT_DVRRequest: compu {phys=raw for raw 0..1}, range phys 0..1
    ADT_ICC_int32_RoadStatus: compu {phys=raw for raw 0..2147483647}, range phys 0..2147483647
    ADT_ICC_enum_DOWSettingSt: compu {phys=raw for raw 0..255}, range phys 0..255  # DOW功能设置状态
  application record data type ADT_ADAS_strt_FreeSpaceList: category=STRUCTURE  # FreeSpace信息数组
    application record element DTE_OCCNum: category=VALUE, type=ADT_ADAS_val_OCCNum  # freespace个数
    application record element DTE_OCCInfoList: category=ARRAY, type=ADT_ADAS_arr_OCCInfoList  # freespace数组
  application record data type ADT_ADAS_strt_TrafficSignIdentify: category=STRUCTURE
    5 x application record element:
      DTE_TSISgnGiWay: category=VALUE, type=ADT_ADAS_enum_TSISgnGiWay  # TSR让行类标识牌
      DTE_TSISgnLongStay: category=VALUE, type=ADT_ADAS_enum_TSISgnLongStay  # TSR长时类标识牌
      DTE_TSISgnForb: category=VALUE, type=ADT_ADAS_enum_TSISgnForb  # TSR禁止类标识牌
      DTE_TSINoParkWarn: category=VALUE, type=ADT_ADAS_enum_TSINoParkWarn  # 禁止停车提示
      DTE_TrafficSignIdentifyReserved: category=ARRAY, type=ADT_TrafficSignIdentify_arr_Reserved  # 预留
  application array data type ADT_MNPRoutes_arr_Reserved: category=ARRAY  # 预留
    element ADT_MNPRoutes_arr_Reserved: category=VALUE, type=ADT_Reserved_uint8_Type, array-size-semantics=FIXED-SIZE, max-number-of-elements=30
  application array data type ADT_ADAS_arr_ParkingDynamicObjects_2: category=ARRAY, dynamic-array-size-profile=VSA_LINEAR  # 泊车动态目标数组
    element ADT_ADAS_arr_ParkingDynamicObjects_2: category=STRUCTURE, type=ADT_ADAS_strt_DynamicObject_2, array-size-handling=ALL-INDICES-SAME-ARRAY-SIZE, array-size-semantics=VARIABLE-SIZE, max-number-of-elements=150
  application array data type ADT_ICC_arr_NaviGreenWaveCarSpeed: category=ARRAY, dynamic-array-size-profile=VSA_LINEAR
    element ADT_ICC_arr_NaviGreenWaveCarSpeed: category=STRUCTURE, type=ADT_ICC_strt_NaviGreenWaveCarSpeed, array-size-handling=ALL-INDICES-SAME-ARRAY-SIZE, array-size-semantics=VARIABLE-SIZE, max-number-of-elements=100
  app type ADT_Enum_UpdatePrepare: category=VALUE, compu {phys=raw for raw 0..1}, range phys 0..1  # TBOX升级准备状态
  app type ADT_ADAS_enum_MNPDelRouteSts: category=VALUE, compu {phys=raw for raw 0..255}, range phys 0..255  # 删除路线是否成功
  application record data type ADT_Struct_TBOXOTAAPPTSync: category=STRUCTURE  # TBOX的OTA预约升级任务
    application record element DTE_ScheduleID: category=STRING, type=ADT_StrVar_ScheduleID  # OTA的任务ID
    application record element DTE_OTAAPPTSecs: category=VALUE, type=ADT_OTAAPPTSecs  # 预约升级时间
  7 x app type, all with category=VALUE:
    ADT_ADAS_enum_DrivingSoundWarn: compu {phys=raw for raw 0..255}, range phys 0..255  # chiem音报警
    ADT_ADAS_enum_MNPUseMapTextInfo: compu {phys=raw for raw 0..255}, range phys 0..255  # 记忆行车使用阶段文言提示信息
    ADT_Gen_int64_ID: compu {phys=raw for raw 0..9223372036854775807}, range phys 0..9223372036854775807
    ADT_keeptimelength: compu {phys=raw for raw 0..5400; unit s}, range phys 0..5400  # 保持恢厂状态时长
    ADT_ADAS_Meta_RegionCode: compu {phys=raw for raw 0..32767}, range phys 0..32767
    ADT_ConnStatus: compu {1=INI_DISCONNECTED, 3=INI_CONNECTED}
    ADT_UUIDCodeRequest: compu {phys=raw for raw 0..255}, range phys 0..255  # 请求获取车辆的用户唯一识别码
  application record data type ADT_ICC_strt_ApaRpaFcnOperating: category=STRUCTURE
    5 x application record element:
      DTE_ApaOperationId: category=VALUE, type=ADT_ICC_enum_ApaOperationId  # APA功能操作指令
      DTE_ApaModeReq: category=VALUE, type=ADT_ICC_enum_ApaModeReq  # APA模式选择指令
      DTE_ApaSelectSlotID: category=VALUE, type=ADT_ICC_uint16_SelectSlotID  # APA选择车位ID
      DTE_ApaPocDirection: category=VALUE, type=ADT_ICC_enum_ApaPocDirection  # APA泊出方向指令
      DTE_ApaFreeSlotInfo: category=STRUCTURE, type=ADT_ICC_strt_ApaFreeSlotInfo  # APA自选车位信息
  app type ADT_ADAS_enum_ParkingQuitInd: category=VALUE, compu {phys=raw for raw 0..255}, range phys 0..255
  app type ADT_SimSwitchCheckFailReason: category=VALUE, compu {phys=raw for raw 0..255}, range phys 0..255  # 切卡失败原因
  application array data type ADT_ICC_arr_BackLane: category=ARRAY, dynamic-array-size-profile=VSA_LINEAR  # 背景车道
    element ADT_ICC_arr_BackLane: category=VALUE, type=ADT_ICC_enum_LaneAction, array-size-handling=ALL-INDICES-SAME-ARRAY-SIZE, array-size-semantics=VARIABLE-SIZE, max-number-of-elements=12
  application array data type ADT_RampInfo_arr_Reserved: category=ARRAY  # 预留
    element ADT_RampInfo_arr_Reserved: category=VALUE, type=ADT_Reserved_int32_Type, array-size-semantics=FIXED-SIZE, max-number-of-elements=100
  application record data type ADT_ICC_strt_HPAPathInfo: category=STRUCTURE
    4 x application record element:
      DTE_Coordinate_X: category=VALUE, type=ADT_Gen_val_Coordinate_X  # X坐标
      DTE_Coordinate_Y: category=VALUE, type=ADT_Gen_val_Coordinate_Y  # Y坐标
      DTE_Coordinate_Z: category=VALUE, type=ADT_Gen_val_Coordinate_Z  # Z坐标
      DTE_HPAPathInfoReserved: category=ARRAY, type=ADT_HPAPathInfo_arr_Reserved  # 预留
  4 x app type:
    ADT_UUIDCode: category=STRING, sw-text-props={array-size-semantics=VARIABLE-SIZE, sw-max-text-size=128, base-type=UTF_8}  # 用户唯一识别码
    ADT_ADAS_enum_ISLIWarningMod: category=VALUE, compu {phys=raw for raw 0..255}, range phys 0..255
    ADT_ChargingUtcSecs: category=VALUE, compu {phys=raw for raw 0..4294967295}, range phys 0..4294967295  # 预约充电时间
    ADT_ADAS_enum_SidePassConfirmReq: category=VALUE, compu {phys=raw for raw 0..255}, range phys 0..255
  application array data type ADT_ADAS_arr_AebTargetObjInfo: category=ARRAY, dynamic-array-size-profile=VSA_LINEAR  # FCW AEB目标信息
    element ADT_ADAS_arr_AebTargetObjInfo: category=STRUCTURE, type=ADT_ADAS_strt_AebTargetObjInfo, array-size-handling=ALL-INDICES-SAME-ARRAY-SIZE, array-size-semantics=VARIABLE-SIZE, max-number-of-elements=5
  app type ADT_FCM_val_CamParameter: category=VALUE, compu {phys=raw for raw -340000000000..340000000000}, range phys -340000000000..340000000000
  application record data type ADT_ADAS_strt_MNPMemRoutePointsInfo: category=STRUCTURE  # 路线轨迹点信息
    application record element DTE_MNPMemRoutePointsNum: category=VALUE, type=ADT_ADAS_val_MNPMemRoutePointsNum  # 路线轨迹点数量
    application record element DTE_MNPMemRoutePoints: category=ARRAY, type=ADT_ADAS_arr_MNPMemRoutePosition  # 路线轨迹点数组
  application record data type ADT_ADAS_strt_VPAEntrance: category=STRUCTURE  # VPA的出入口信息
    4 x application record element:
      DTE_VPAEntrancePoint: category=STRUCTURE, type=ADT_ADAS_strt_VPAPointType  # 出入口所在的点的位置
      DTE_VPAEntranceLayer: category=VALUE, type=ADT_ADAS_enum_VPAFloor  # 所属楼层
      DTE_VPAEntranceId: category=VALUE, type=ADT_Gen_val_ID  # 出入口ID
      DTE_VPAEntranceType: category=VALUE, type=ADT_ADAS_enum_VPAEntranceType  # 入口类型
  application record data type ADT_ADAS_strt_TLAInfo: category=STRUCTURE  # TLA功能输出信息
    4 x application record element:
      DTE_TLAONOFFSts: category=VALUE, type=ADT_ADAS_enum_TLAONOFFSts  # 红绿灯提醒系统开关状态
      DTE_TLASts: category=VALUE, type=ADT_ADAS_enum_TLASts  # 红绿灯提醒功能状态
      DTE_TLATextInfo: category=VALUE, type=ADT_ADAS_enum_TLATextInfo  # TLA提示信息
      DTE_TLAInfoReserved: category=ARRAY, type=ADT_TLAInfo_arr_Reserved  # 预留
  application array data type ADT_TrafficLightInfo_arr_Reserved: category=ARRAY
    element ADT_TrafficLightInfo_arr_Reserved: category=VALUE, type=ADT_Reserved_uint8_Type, array-size-semantics=FIXED-SIZE, max-number-of-elements=20
  app type ADT_ADAS_Stub_PartOfCalcRoute: category=VALUE, compu {phys=raw for raw 0..3}, range phys 0..3
  application record data type ADT_ICC_strt_LaneCategoryType: category=STRUCTURE
    application record element DTE_LaneCategoryType: category=VALUE, type=ADT_ICC_int32_LaneCategoryType  # 车道信息
  app type ADT_Gen_val_Pitch: category=VALUE, compu {phys=raw for raw -90..90; unit deg}, range phys -90..90  # 俯仰角
  application record data type ADT_ADAS_strt_LaneCenterPoint: category=STRUCTURE
    application record element DTE_Coordinate_X: category=VALUE, type=ADT_Gen_val_Coordinate_X  # X坐标
    application record element DTE_Coordinate_Y: category=VALUE, type=ADT_Gen_val_Coordinate_Y  # Y坐标
  app type ADT_ADAS_enum_ISLIOverSpeedWarn: category=VALUE, compu {phys=raw for raw 0..255}, range phys 0..255
  application array data type ADT_ICC_arr_BackExtenLane: category=ARRAY, dynamic-array-size-profile=VSA_LINEAR  # 背景拓展车道
    element ADT_ICC_arr_BackExtenLane: category=VALUE, type=ADT_ICC_enum_ExtenLaneAction, array-size-handling=ALL-INDICES-SAME-ARRAY-SIZE, array-size-semantics=VARIABLE-SIZE, max-number-of-elements=12
  5 x app type:
    ADT_ADAS_enum_MNPNewRoute: category=VALUE, compu {phys=raw for raw 0..255}, range phys 0..255  # 可以新建路线提示
    ADT_IncomingTotalTime: category=VALUE, compu {phys=raw for raw 0..4294967295}, range phys 0..4294967295  # 拨入电话时长总计
    ADT_StrVar_MCC: category=STRING, sw-text-props={array-size-semantics=VARIABLE-SIZE, sw-max-text-size=3, base-type=UTF_8}  # 移动国家代码，中国固定460
    ADT_ADAS_enum_ParkingSpeedSet: category=VALUE, compu {phys=raw for raw 0..255}, range phys 0..255
    ADT_SentryModeCmd: category=VALUE, compu {0=OFF, 1=ON}  # 哨兵模式开关设置
  application record data type ADT_ADAS_strt_LaneLine_2: category=STRUCTURE
    15 x application record element:
      DTE_lineIndex: category=VALUE, type=ADT_ADAS_enum_LinePositionIndex  # 车道线索引
      DTE_lineId: category=VALUE, type=ADT_Gen_uint64_ID  # 车道线ID
      DTE_lineColor: category=VALUE, type=ADT_ADAS_enum_LineColor  # 车道线颜色
      DTE_lineType: category=VALUE, type=ADT_ADAS_enum_LineType  # 车道线类型
      DTE_lineEquation_C{0..3}: category=VALUE, type=ADT_ADAS_val_LineEquation_C{0..3}  # 车道线方程C{0..3}
      DTE_laneLineWidth: category=VALUE, type=ADT_Gen_val_float32  # 车道线宽度
      DTE_lineStart_X: category=VALUE, type=ADT_Gen_val_Coordinate_X  # 车道线起点X坐标
      DTE_lineStart_Y: category=VALUE, type=ADT_Gen_val_Coordinate_Y  # 车道线起点Y坐标
      DTE_lineEnd_X: category=VALUE, type=ADT_Gen_val_Coordinate_X  # 车道线终止点X坐标
      DTE_lineEnd_Y: category=VALUE, type=ADT_Gen_val_Coordinate_Y  # 车道线终止点Y坐标
      DTE_LinePointList: category=ARRAY, type=ADT_ADAS_arr_LinePoint  # 车道线形点数组
      DTE_LaneLineReserved: category=ARRAY, type=ADT_LaneLine_arr_Reserved  # 预留
  application record data type ADT_ADAS_strt_SpeedBumpInfo: category=STRUCTURE
    7 x application record element, all with category=VALUE:
      DTE_SpeedBumpId: type=ADT_Gen_val_ID  # 减速带id
      DTE_SpeedBumpPoseX: type=ADT_Gen_val_Coordinate_X  # 减速带X坐标
      DTE_SpeedBumpPoseY: type=ADT_Gen_val_Coordinate_Y  # 减速带Y坐标
      DTE_SpeedBumpPoseZ: type=ADT_Gen_val_Coordinate_Z  # 减速带Z坐标
      DTE_SpeedBumpLength: type=ADT_Gen_val_Length  # 减速带长度
      DTE_SpeedBumpWidth: type=ADT_Gen_val_Width  # 减速带宽度
      DTE_SpeedBumpHeight: type=ADT_Gen_val_Height  # 减速带高度
  9 x app type, all with category=VALUE:
    ADT_ADAS_val_FusionMetaData: compu {phys=raw for raw 0..4398046511103}, range phys 0..4398046511103
    ADT_ICC_enum_ParkingFuncModReq: compu {phys=raw for raw 0..255}, range phys 0..255
    ADT_Enum_RouteMMError: compu {phys=raw for raw 0..255}, range phys 0..255  # HD路线匹配错误
    ADT_Enum_Network: compu {phys=raw for raw 0..3}, range phys 0..3  # 网络
    ADT_ICC_enum_ISLIWarnMod: compu {phys=raw for raw 0..255}, range phys 0..255  # 智能限速提醒方式
    ADT_ADAS_enum_LightType: compu {phys=raw for raw 0..255}, range phys 0..255  # 红绿灯类型
    ADT_ApnCount: compu {phys=raw for raw 0..5}, range phys 0..5
    ADT_ADAS_enum_TargetSlotAvailableParkInType: compu {phys=raw for raw 0..255}, range phys 0..255
    ADT_ADAS_enum_TrafficLightAssistBtnStFb: compu {phys=raw for raw 0..255}, range phys 0..255  # 红绿灯辅助设置反馈
  application record data type ADT_ICC_strt_WeatherInfo: category=STRUCTURE
    application record element DTE_WeatherID: category=VALUE, type=ADT_ICC_enum_WeatherID  # 天气类型
    application record element DTE_WeatherDistance: category=VALUE, type=ADT_ICC_val_Distance  # 自车距离天气区域的距离
  app type ADT_Enum_AntState: category=VALUE, compu {phys=raw for raw 0..255}, range phys 0..255
  application array data type ADT_SimSwitchEventReserved: category=ARRAY  # 切卡事件通知预留
    element ADT_SimSwitchEventReserved: category=VALUE, type=ADT_INI_ReservedUnit8, array-size-semantics=FIXED-SIZE, max-number-of-elements=16
  app type ADT_FactoryResetSartCode: category=VALUE, compu {0=FACTORYRESETSARTCODE_SUCCESS, 1=FACTORYRESETSARTCODE_FAILURE, 2=FACTORYRESETSARTCODE_NOT_USED}  # 恢厂指令接收码
  application record data type ADT_ADAS_strt_TrafficLightPos: category=STRUCTURE  # 交通灯箱位置
    application record element DTE_TrafficLightPosX: category=VALUE, type=ADT_Gen_val_Coordinate_X  # 交通灯箱位置X
    application record element DTE_TrafficLightPosY: category=VALUE, type=ADT_Gen_val_Coordinate_Y  # 交通灯箱位置Y
    application record element DTE_TrafficLightPosZ: category=VALUE, type=ADT_Gen_val_Coordinate_Z  # 交通灯箱位置Z
  app type ADT_ADAS_enum_LightStatus: category=VALUE, compu {phys=raw for raw 0..255}, range phys 0..255
  app type ADT_ICC_enum_BSDSettingSt: category=VALUE, compu {phys=raw for raw 0..255}, range phys 0..255  # BSD/LCW功能设置状态
  app type ADT_Bool_CarrierFrq: category=VALUE, compu {phys=raw for raw 0..255}, range phys 0..255  # 载波频率是否有效信息 Information on whether the carrier frequency is valid
  application record data type ADT_ICC_strt_HPAPathOperation: category=STRUCTURE
    4 x application record element:
      DTE_PathOperationId: category=VALUE, type=ADT_ICC_enum_PathOperationId  # 路线操作指令
      DTE_PathId: category=VALUE, type=ADT_ICC_uint8_PathId  # 路线ID
      DTE_SetPathName: category=STRING, type=ADT_ICC_string_SetPathName  # 路线名称
      DTE_SetPathLabel: category=VALUE, type=ADT_ICC_enum_SetPathLabel  # 路线标签
  app type ADT_Enum_CamStreamOrntn: category=VALUE, compu {phys=raw for raw 0..18446744073709551615}, range phys 0..18446744073709551615  # 相机视频流方位 Camera Video Stream Orientation
  app type ADT_ADAS_enum_SglNOAMileage: category=VALUE, compu {phys=raw for raw 0..100000; unit km}, range phys 0..100000  # NOA行驶里程
  app type ADT_Integer_SignalStrength: category=VALUE, compu {phys=raw for raw 0..31}, range phys 0..31  # 信号强度
  application record data type ADT_ValetParkingStatus: category=STRUCTURE  # 代客泊车状态信息
    application record element DTE_valetParkingActiveStatus: category=VALUE, type=ADT_ValetParkingActiveStatus  # 代客泊车运行激活状态
    application record element DTE_reserved: category=ARRAY, type=ADT_ValetParkingStatusReserved  # 预留字段
  application array data type ADT_LaneLine_arr_Reserved: category=ARRAY  # 预留
    element ADT_LaneLine_arr_Reserved: category=VALUE, type=ADT_Reserved_uint8_Type, array-size-semantics=FIXED-SIZE, max-number-of-elements=30
  app type ADT_ADAS_val_SpdLimitAbsOffset: category=VALUE, compu {phys=raw for raw 40..140}, range phys 40..140
  application record data type ADT_ADAS_strt_ESSInfo: category=STRUCTURE
    4 x application record element, all with category=VALUE:
      DTE_ESSSts: type=ADT_ADAS_enum_ESSSts  # ESS 功能状态
      DTE_ESSDirection: type=ADT_ADAS_enum_ESSDirection  # ESS激活方向
      DTE_AESSts: type=ADT_ADAS_enum_AESSts  # AES 功能状态
      DTE_AESDirection: type=ADT_ADAS_enum_AESDirection  # AES激活方向
  app type ADT_ACCURACY: category=VALUE, compu {phys=raw for raw 0..4294967295}, range phys 0..4294967295  # 精度
  app type ADT_Enum_NavArriveAim: category=VALUE, compu {phys=raw for raw -2147483648..2147483647}, range phys -2147483648..2147483647  # 导航终点信息 Navigation destination information
  app type ADT_ICC_enum_NavSpeedLimitStatus: category=VALUE, compu {phys=raw for raw 0..255}, range phys 0..255  # 导航地图状态
  application record data type ADT_ICC_strt_MixForkInfoList: category=STRUCTURE
    5 x application record element:
      DTE_MixForkDist: category=VALUE, type=ADT_ICC_int32_Dist  # 混淆路口到导航点距离
      DTE_MixForkPos: category=STRUCTURE, type=ADT_ICC_strt_Coord2DDouble  # 混淆路口的经纬度
      DTE_MixForkRoadClass: category=VALUE, type=ADT_ICC_int32_RoadClass  # 混淆道路的roadclass
      DTE_MixForkSegmentIndex: category=VALUE, type=ADT_ICC_int32_Index  # 混淆道路所在segment索引
      DTE_MixForkInfoReserved: category=ARRAY, type=ADT_MixForkInfo_arr_Reserved  # 预留
  application record data type ADT_ADAS_strt_HPAPathDetail: category=STRUCTURE
    8 x application record element:
      DTE_HpaPathID: category=VALUE, type=ADT_Gen_val_ID  # 路线ID
      DTE_PathState: category=VALUE, type=ADT_ADAS_enum_PathState  # 路线学习状态
      DTE_PathName: category=STRING, type=ADT_ADAS_string_PathName  # 路线名称
      DTE_PathSaveProgress: category=VALUE, type=ADT_ADAS_val_PathSaveProgress  # 路线保存进度
      DTE_PathLength: category=VALUE, type=ADT_ADAS_val_ParkingDist  # 路线长度
      DTE_LinePoint: category=ARRAY, type=ADT_ADAS_arr_PathPoint  # 路线学习点集
      DTE_PathMatchSts: category=VALUE, type=ADT_ADAS_enum_PathMatchSts  # 路线匹配状态
      DTE_PathLabel: category=VALUE, type=ADT_ADAS_enum_PathLabel  # 路线标签
  5 x app type:
    ADT_ADAS_enum_ISLISpeedLimitUnit: category=VALUE, compu {phys=raw for raw 0..255}, range phys 0..255
    ADT_StrVar_ARMVersion: category=STRING, sw-text-props={array-size-semantics=VARIABLE-SIZE, sw-max-text-size=16, base-type=UTF_8}  # ARM版本号
    ADT_ICC_enum_CongestionStatus: category=VALUE, compu {phys=raw for raw 0..255}, range phys 0..255  # 拥堵程度:
    ADT_ICC_int32_ForbidType: category=VALUE, compu {phys=raw for raw 0..2147483647}, range phys 0..2147483647
    ADT_EphemerisDataByteElement: category=VALUE, compu {phys=raw for raw 0..255}, range phys 0..255  # 星历数据消息元素
  application record data type ADT_TimeStampOffset: category=STRUCTURE  # 包含秒，纳秒差值及时间有效性
    application record element DTE_timeValidFlag: category=VALUE, type=ADT_TimeValidFlag  # 时间信息有效性
    application record element DTE_secondOffset: category=VALUE, type=ADT_SecondTimeStampOffset  # 秒差值
    application record element DTE_nanoSecondOffset: category=VALUE, type=ADT_NanoSecondTimeStampOffset  # 纳秒差值
  application array data type ADT_CameraStreamResponseMessage: category=ARRAY, dynamic-array-size-profile=VSA_LINEAR  # ADS到CDC的消息响应
    element ADT_CameraStreamResponseMessage: category=VALUE, type=ADT_CameraStreamBasicElement, array-size-handling=ALL-INDICES-SAME-ARRAY-SIZE, array-size-semantics=VARIABLE-SIZE, max-number-of-elements=1048576
  app type ADT_DataUint32: category=VALUE, compu {phys=raw for raw 0..4294967295}, range phys 0..4294967295  # 无符号32位整型
  app type ADT_ADAS_enum_VPAFloor: category=VALUE, compu {phys=raw for raw 0..255}, range phys 0..255
  application record data type ADT_Struct_NOA_SDMapStubInfo: category=STRUCTURE  # 标准地图信息_Stub
    15 x application record element, all with category=VALUE:
      DTE_Stub_MsgType: type=ADT_ADAS_MsgType  # 标识该消息为Stub Message
      DTE_Stub_CycCnt: type=ADT_ADAS_Stub_CycCnt  # STUBMessage 的循环计数器:重构器可以用这个值来检测丢失的消息
      DTE_Stub_PathIdx: type=ADT_ADAS_Stub_PathIdx  # This is Index of new path.父path的索引值，0代表在Horizon中从这个STUB开始了第一条path
      DTE_Stub_Offset: type=ADT_ADAS_Stub_Offset  # stub起点与path起点的距离
      DTE_Stub_Update: type=ADT_ADAS_Stub_Update  # Stub Segment更新
      DTE_Stub_SubPathIdx: type=ADT_ADAS_Stub_SubPathIdx  # stub path索引
      DTE_Stub_TurnAngl: type=ADT_ADAS_Stub_TurnAngl  # stub转向角度信息
      DTE_Stub_RelProbb: type=ADT_ADAS_Stub_RelProbb  # 在路口的新path的相对概率
      DTE_Stub_FuncRoadClass: type=ADT_ADAS_Stub_FuncRoadClass  # stub FRC信息（对应道路类型）
      DTE_Stub_FormOfWay: type=ADT_ADAS_Stub_FormOfWay  # stub道路设施信息（对应匝道信息，支路）
      DTE_Stub_NumOfLaneDrvDir: type=ADT_ADAS_Stub_NumOfLaneDrvDir  # stub当前行车方向车道数信息
      DTE_Stub_NumOfLaneOppDir: type=ADT_ADAS_Stub_NumOfLaneOppDir  # stub当前行车反方向车道数信息
      DTE_Stub_CmplxInsct: type=ADT_ADAS_Stub_CmplxInsct  # stub复杂路口信息
      DTE_Stub_PartOfCalcRoute: type=ADT_ADAS_Stub_PartOfCalcRoute  # stub是否在规划路径上的信息
      DTE_Stub_LastStub: type=ADT_ADAS_Stub_LastStub  # stub消息是给定父path和offset的最后一个
  application record data type ADT_ADAS_strt_ESSInfo_2: category=STRUCTURE
    8 x application record element:
      DTE_ESSSts: category=VALUE, type=ADT_ADAS_enum_ESSSts  # ESS 功能状态
      DTE_ESSDirection: category=VALUE, type=ADT_ADAS_enum_ESSDirection  # ESS激活方向
      DTE_AESSts: category=VALUE, type=ADT_ADAS_enum_AESSts  # AES 功能状态
      DTE_AESDirection: category=VALUE, type=ADT_ADAS_enum_AESDirection  # AES激活方向
      DTE_ESSActiveSt: category=VALUE, type=ADT_ADAS_enum_ESSActiveSt  # ESS激活状态
      DTE_AESActiveSt: category=VALUE, type=ADT_ADAS_enum_AESActiveSt  # AES激活状态
      DTE_AESESSTextInfo: category=VALUE, type=ADT_ADAS_enum_AESESSTextInfo  # AESESS文言提示信息
      DTE_ESSInfoReserved: category=ARRAY, type=ADT_ESSInfo_arr_Reserved  # 预留
  app type ADT_CelluarRegisterStatus: category=VALUE, compu {0=INI_NO_SERVICE, 1=INI_GSM, 2=INI_CDMA_1X, 3=INI_WCDMA, 4=INI_TD_SCDMA, 5=INI_WiMAX, 6=INI_LTE, 7=INI_HRPD, 8=INI_HYBRID, 9=INI_SVLTE_SRLTE, 10=INI_EUTRAN_5GC, 11=INI_NR_5GC, 12=INI_CDMA1X_NR_5GC, 13=INI_NR_NSA_5G}
  application record data type ADT_ResetCommandResponse: category=STRUCTURE  # 恢厂指令响应
    application record element DTE_FactoryResetSartCode: category=VALUE, type=ADT_FactoryResetSartCode  # 恢厂指令接收码
    application record element DTE_FactoryResetTimeLength: category=VALUE, type=ADT_FactoryResetTimeLength  # 恢厂所需时间
  application record data type ADT_ICC_strt_SlotPoint: category=STRUCTURE
    application record element DTE_Point_X: category=VALUE, type=ADT_ICC_float_Point  # x坐标位置信息
    application record element DTE_Point_Y: category=VALUE, type=ADT_ICC_float_Point  # y坐标位置信息
  application record data type ADT_ADAS_strt_TolNtfADDrivingCardinfo: category=STRUCTURE
    14 x application record element:
      DTE_TolDatauploadBtnFb: category=VALUE, type=ADT_ADAS_enum_TolDatauploadBtnFb  # 一键数据回传信息反馈
      DTE_TolRecordUploadBtnFb: category=VALUE, type=ADT_ADAS_enum_TolRecordUploadBtnFb  # 录音上传状态反馈
      DTE_TolNOAMileage: category=VALUE, type=ADT_ADAS_enum_TolNOAMileage  # NOA行驶里程
      DTE_TolLCCMileage: category=VALUE, type=ADT_ADAS_enum_TolLCCMileage  # LCC行驶里程
      DTE_TolAutoRoadCrossingsNum: category=VALUE, type=ADT_ADAS_enum_TolAutoRoadCrossingsNum  # 自动过路口数量
      DTE_TolAutoMergeChangeLane: category=VALUE, type=ADT_ADAS_enum_TolAutoMergeChangeLane  # 自动并道换道
      DTE_TolAccessRemitramp: category=VALUE, type=ADT_ADAS_enum_TolAccessRemitramp  # 汇入汇出匝道
      DTE_TolAutoAvoidObstacle: category=VALUE, type=ADT_ADAS_enum_TolAutoAvoidObstacle  # 自动避障（避障变道和避障bypass）
      DTE_TolRespondCongestion: category=VALUE, type=ADT_ADAS_enum_TolRespondCongestion  # 应对加塞
      DTE_TolU_turnsNum: category=VALUE, type=ADT_ADAS_enum_TolU_turnsNum  # 掉头次数
      DTE_TolAPANum: category=VALUE, type=ADT_ADAS_enum_TolAPANum  # APA次数
      DTE_TolAPAParkingTime: category=VALUE, type=ADT_ADAS_enum_TolAPAParkingTime  # APA泊入时长
      DTE_TolAPAParkedOutTime: category=VALUE, type=ADT_ADAS_enum_TolAPAParkedOutTime  # APA泊出时长
      DTE_TolNtfADDrivingCardinfoReserved: category=ARRAY, type=ADT_TolNtfADDrivingCardinfo_arr_Reserved  # 预留
  app type ADT_ICC_float_SelectZonePos_X: category=VALUE, compu {phys=raw for raw -4294967296..4294967296; unit cm}, range phys -4294967296..4294967296
  application record data type ADT_ICC_strt_LaneInfo: category=STRUCTURE
    13 x application record element:
      DTE_BackLanes: category=ARRAY, type=ADT_ICC_arr_BackLanes  # 背景车道 (巡航、导航都有效)
      DTE_FrontLanes: category=ARRAY, type=ADT_ICC_arr_FrontLanes  # 前景车道 (仅导航有效)
      DTE_OptimalLane: category=ARRAY, type=ADT_ICC_arr_OptimalLane  # 建议车道（仅在线导航有效）
      DTE_BackExtenLanes: category=ARRAY, type=ADT_ICC_arr_BackExtenLanes  # 背景扩展车道信息（巡航、导航都有效）
      DTE_FrontExtenLanes: category=ARRAY, type=ADT_ICC_arr_FrontExtenLanes  # 前景扩展车道信息（无效字段）
      DTE_ExtensionLanes: category=ARRAY, type=ADT_ICC_arr_ExtensionLanes  # 扩展车道信息（仅在线导航有效）
      DTE_FrontLaneTypes: category=ARRAY, type=ADT_ICC_arr_FrontLaneTypes  # 前景分时车道类型（仅在线导航有效）
      DTE_BackLaneTypes: category=ARRAY, type=ADT_ICC_arr_BackLaneTypes  # 背景分时车道类型（仅在线导航有效）
      DTE_LanePoint: category=STRUCTURE, type=ADT_ICC_strt_Coord2DDouble  # 车道坐标点（仅巡航场景有效）
      DTE_LaneSegmentIdx: category=VALUE, type=ADT_ICC_int32_Index  # 所在导航段索引（只有导航有效）
      DTE_LaneLinkIdx: category=VALUE, type=ADT_ICC_int32_Index  # 所在link索引（只有导航有效）
      DTE_Lanetimestamp: category=VALUE, type=ADT_ICC_uint64_Time  # 导航软件获取到车道信息的时间
      DTE_LaneInfoReserved: category=ARRAY, type=ADT_LaneInfo_arr_Reserved  # 预留
  application record data type ADT_ICC_strt_ServiceAreaInfo: category=STRUCTURE  # 服务区信息
    application record element DTE_ServiceAreaExists: category=VALUE, type=ADT_ICC_boolean_exists
    application record element DTE_ServiceAreaDistance: category=VALUE, type=ADT_ICC_int32_Dist
    application record element DTE_ServiceAreaInfoReserved: category=ARRAY, type=ADT_ServiceAreaInfo_arr_Reserved  # 预留
  app type ADT_ICC_float_SelectZonePos_Y: category=VALUE, compu {phys=raw for raw -4294967296..4294967296; unit cm}, range phys -4294967296..4294967296
  app type ADT_ICC_enum_HODWarnSettingSt: category=VALUE, compu {phys=raw for raw 0..255}, range phys 0..255  # HOD脱手模式状态
  application record data type ADT_ADAS_strt_HPARepalyPathInfo_2: category=STRUCTURE
    13 x application record element:
      DTE_HpaReplayPathID: category=VALUE, type=ADT_Gen_val_ID  # 路线ID
      DTE_ReplayPathName: category=STRING, type=ADT_ADAS_string_PathName  # 路线名称
      DTE_ReplayDrivingDist: category=VALUE, type=ADT_ADAS_val_ParkingDist  # 路线行驶距离
      DTE_HPARepayRemainingDist: category=VALUE, type=ADT_ADAS_val_ParkingDist  # 记忆泊车回放剩余距离
      DTE_ReplayLinePoint: category=ARRAY, type=ADT_ADAS_arr_PathPoint_2  # 路线学习点集
      DTE_HPAReplayPathSlotInfo: category=ARRAY, type=ADT_ADAS_arr_HPAPathslot_2  # 路线记忆车位
      DTE_HPASpeedBumpInfo: category=ARRAY, type=ADT_ADAS_arr_HPASpeedBumpInfo  # 路线记忆减速带
      DTE_ReplayPathLabel: category=VALUE, type=ADT_ADAS_enum_PathLabel  # 路线标签
      DTE_HpaEndPos: category=STRUCTURE, type=ADT_ADAS_strt_HpaEndPos  # HPA终点信息
      DTE_HPAStaticObjectReplay: category=ARRAY, type=ADT_ADAS_arr_HPAParkingStaticObjects  # 静态障碍物回放
      DTE_HPARoadMarkerReplay: category=ARRAY, type=ADT_ADAS_arr_RoadMarker  # 记忆泊车地面交通标志
      DTE_HPALaneLineReplay: category=ARRAY, type=ADT_ADAS_arr_LaneLineData_2  # 记忆泊车车道线信息
      DTE_HPARepalyReserved: category=ARRAY, type=ADT_HPARepaly_arr_Reserved  # 预留
  application array data type ADT_HNOPSupplementInfo_arr_Reserved: category=ARRAY
    element ADT_HNOPSupplementInfo_arr_Reserved: category=VALUE, type=ADT_Reserved_uint8_Type, array-size-semantics=FIXED-SIZE, max-number-of-elements=49
  application array data type ADT_FcmCamIntrinsicsData: category=ARRAY  # FCM相机内参数据
    element ADT_FcmCamIntrinsicsData: category=VALUE, type=ADT_FCM_val_CamParameter, array-size-semantics=FIXED-SIZE, max-number-of-elements=12
  application array data type ADT_ADAS_arr_VPAEntrance: category=ARRAY, dynamic-array-size-profile=VSA_LINEAR  # VPA的出入口列表
    element ADT_ADAS_arr_VPAEntrance: category=STRUCTURE, type=ADT_ADAS_strt_VPAEntrance, array-size-handling=ALL-INDICES-SAME-ARRAY-SIZE, array-size-semantics=VARIABLE-SIZE, max-number-of-elements=100
  app type ADT_Altitude: category=VALUE, compu {phys=raw for raw -9999.9..9999.9}, range phys -9999.9..9999.9
  application record data type ADT_Struct_RouteMMSeg: category=STRUCTURE  # HD路线匹配段落
    7 x application record element:
      DTE_startMatchedLinkIdx: category=VALUE, type=ADT_DataUint32  # 段落开始对应SDLink的index
      DTE_startShapePointIdx: category=VALUE, type=ADT_DataUint32  # 段落开始对应SDLink形点的index
      DTE_startMatchedPoint: category=STRUCTURE, type=ADT_Struct_GeoPos2D  # 段落开始点坐标
      DTE_endMatchedLinkIdx: category=VALUE, type=ADT_DataUint32  # 段落结束对应SDLink的index
      DTE_endShapePointIdx: category=VALUE, type=ADT_DataUint32  # 段落结束对应SDLink形点的index
      DTE_endMatchedPoint: category=STRUCTURE, type=ADT_Struct_GeoPos2D  # 段落结束点坐标
      DTE_segLength: category=VALUE, type=ADT_DataUint32  # 段落长度
  8 x app type:
    ADT_ICC_enum_MNPNewBtnSt: category=VALUE, compu {phys=raw for raw 0..255}, range phys 0..255  # 新建路线按钮
    ADT_ADAS_val_Traffic3DSignNum: category=VALUE, compu {phys=raw for raw 0..4294967295}, range phys 0..4294967295  # 交通标识个数
    ADT_ADAS_string_VPAParkingLotName: category=STRING, sw-text-props={array-size-semantics=VARIABLE-SIZE, sw-max-text-size=50, base-type=UTF_8}
    ADT_ADAS_enum_LKSLeftTrackingSt: category=VALUE, compu {phys=raw for raw 0..255}, range phys 0..255
    ADT_WiFiDownloadDataStatus: category=VALUE, compu {0=INI_NO_DATA, 1=INI_HAVE_DATA}
    ADT_ApnIndex: category=VALUE, compu {1..5=INI_APN1..INI_APN5}
    ADT_ADAS_Posn_PosConfdc: category=VALUE, compu {phys=raw for raw 0..7}, range phys 0..7
    ADT_ADAS_val_TrafficLightCountdownNumber: category=VALUE, compu {phys=raw for raw 0..255; unit s}, range phys 0..255
  application array data type ADT_Array_CallNumberList: category=ARRAY, dynamic-array-size-profile=VSA_LINEAR  # 电话号码列表
    element ADT_Array_CallNumberList: category=STRUCTURE, type=ADT_Struct_CallNumberList, array-size-handling=ALL-INDICES-SAME-ARRAY-SIZE, array-size-semantics=VARIABLE-SIZE, max-number-of-elements=3
  app type ADT_ADAS_ProfShort_CycCnt: category=VALUE, compu {phys=raw for raw 0..3}, range phys 0..3
  application array data type ADT_ApnArray: category=ARRAY, dynamic-array-size-profile=VSA_LINEAR
    element ADT_ApnArray: category=STRUCTURE, type=ADT_ApnInfo, array-size-handling=ALL-INDICES-SAME-ARRAY-SIZE, array-size-semantics=VARIABLE-SIZE, max-number-of-elements=5
  5 x app type, all with category=VALUE:
    ADT_ADAS_enum_ParkingDriOperateInd: compu {phys=raw for raw 0..255}, range phys 0..255
    ADT_CelluarRoamingStatus: compu {0=INI_NOT_ROMA, 1=INI_ROMAING}
    ADT_ADAS_MsgType: compu {phys=raw for raw 0..7}, range phys 0..7
    ADT_ICC_val_altitude: compu {phys=raw for raw 0..5000; unit m}, range phys 0..5000  # 高度
    ADT_ICC_enum_ISLICruiseSpdAbdOffset: compu {phys=raw for raw 40..140; unit kph}, range phys 40..140  # 绝对限制值（预留）
  application record data type ADT_Struct_LanePositionInfo: category=STRUCTURE  # 车道线上的位置信息
    7 x application record element, all with category=VALUE:
      DTE_linkId: type=ADT_DataUint64  # Link ID，mode位invalid时，赋默认值0
      DTE_laneGroupId: type=ADT_DataUint64  # LaneGroupId, mode位invalid时，赋默认值0
      DTE_length: type=ADT_LanePositionInfo_length  # length of lane ，单位m，mode位invalid时，赋默认值0
      DTE_offset: type=ADT_LanePositionInfo_offset  # position on lane from start ,单位m,mode为invalid时，赋默认值0
      DTE_offset_Lateral: type=ADT_LanePositionInfo_offset_Lateral  # 相对于车道中心线的横向偏移 ,单位m,mode为invalid时，赋默认值0
      DTE_heading: type=ADT_LanePositionInfo_heading  # heading at current position，unit in degree 0=north clockwise
      DTE_laneNo: type=ADT_DataUint32  # lane编号 从右往左0，.... ，n，没有匹配上车线时赋值0xFFFF
  application array data type ADT_SingleSimDetailInfoReserved: category=ARRAY  # 单sim卡详细信息预留
    element ADT_SingleSimDetailInfoReserved: category=VALUE, type=ADT_INI_ReservedUnit8, array-size-semantics=FIXED-SIZE, max-number-of-elements=16
  app type ADT_ADAS_enum_IHC_Status: category=VALUE, compu {phys=raw for raw 0..255}, range phys 0..255  # IHC功能状态
  application record data type ADT_ADAS_strt_HNOPSupplementInfo: category=STRUCTURE
    26 x application record element:
      DTE_HNOPSts: category=VALUE, type=ADT_ADAS_enum_HNOPSts  # 高速领航辅助状态
      DTE_NOPLaneChangeMod: category=VALUE, type=ADT_ADAS_enum_NOPLaneChangeMod  # 领航辅助变道模式
      DTE_NOPLaneChangeStyle: category=VALUE, type=ADT_ADAS_enum_NOPLaneChangeStyle  # 领航辅助速控模式
      DTE_NOPLaneChangeInfo: category=VALUE, type=ADT_ADAS_enum_NOPLaneChangeInfo  # 领航辅助变道状态信息
      DTE_SafeStopReminder: category=VALUE, type=ADT_ADAS_enum_SafeStopReminder  # 领航辅助执行安全停车提示
      DTE_NOPQuitReason: category=VALUE, type=ADT_ADAS_enum_NOPQuitReason  # 领航辅助退出原因
      DTE_NOPALCReqDriverConf: category=VALUE, type=ADT_ADAS_enum_NOPALCReqDriverConf  # 推荐变道请求确认
      DTE_NOPDegradeReminder: category=VALUE, type=ADT_ADAS_enum_DegradeReminder  # 领航辅助升降级行为提示
      DTE_NOPStReminder: category=VALUE, type=ADT_ADAS_enum_NOPStReminder  # 领航辅助状态提示
      DTE_NOPLaneChangeReason: category=VALUE, type=ADT_ADAS_enum_NOPLaneChangeReason  # 领航辅助变道原因
      DTE_HNOPScenariosReminder: category=VALUE, type=ADT_ADAS_enum_HNOPScenariosReminder  # HNOP场景提示信息
      DTE_Confidencelevel: category=VALUE, type=ADT_ADAS_enum_Confidencelevel  # 场景控制置信度
      DTE_TrajectoryPoint: category=ARRAY, type=ADT_ADAS_arr_TrajectoryPoint  # 决策引导线
      DTE_LeaveFastLaneSts: category=VALUE, type=ADT_ADAS_enum_LeaveFastLaneSts  # 驶离快车道模式设置状态反馈
      DTE_NOPLaneChangeWarnTypeFb: category=VALUE, type=ADT_ADAS_enum_NOPLaneChangeWarnType  # 领航辅助变道报警类型
      DTE_NOPLCPermitSt: category=VALUE, type=ADT_ADAS_enum_LCPermitSt  # 领航辅助变道允许状态
      DTE_HNOACruiseSpdOffsetModFb: category=VALUE, type=ADT_ADAS_enum_HNOACruiseSpdOffsetModFb  # 车速偏移方式反馈
      DTE_HNOACruiseSpdOffsetSpdFb: category=VALUE, type=ADT_ADAS_val_HNOACruiseSpdOffsetSpdFb  # 固定偏移速度反馈
      DTE_HNOACruiseSpdOffsetPercentFb: category=VALUE, type=ADT_ADAS_val_HNOACruiseSpdOffsetPercentFb  # 百分比偏移速度反馈
      DTE_DrivingTrajectoryPointList: category=STRUCTURE, type=ADT_ADAS_strt_DrivingTrajectoryPointList  # 决策引导线
      DTE_StopLineFlag: category=VALUE, type=ADT_ADAS_enum_StopLineFlag  # 引导线中的停止线是否生效标志
      DTE_DrivingGuidingSurfacePointList: category=STRUCTURE, type=ADT_ADAS_strt_DrivingTrajectoryPointList  # 引导面
      DTE_NOALCCSwitchBtnONOFFSts: category=VALUE, type=ADT_ADAS_enum_NOALCCSwitchBtnONOFFSts  # NOA与LCC切换按钮显示状态
      DTE_NOARemainingMileageFromODD: category=VALUE, type=ADT_ADAS_enum_NOARemainingMileageFromODD  # 距离前方ODD终点里程数
      DTE_HNOPConfidence: category=VALUE, type=ADT_ADAS_enum_HNOPConfidence  # 高速领航辅助置信度
      DTE_HNOPSupplementInfoReserved: category=ARRAY, type=ADT_HNOPSupplementInfo_arr_Reserved  # 预留
  app type ADT_ADAS_enum_SglRespondCongestion: category=VALUE, compu {phys=raw for raw 0..65535; unit pcs}, range phys 0..65535  # 应对加塞
  application array data type ADT_ICC_arr_NaviCameraRes: category=ARRAY, dynamic-array-size-profile=VSA_LINEAR  # 导航模式下电子眼信息
    element ADT_ICC_arr_NaviCameraRes: category=STRUCTURE, type=ADT_ICC_strt_NaviIntervalCameraInfo1, array-size-handling=ALL-INDICES-SAME-ARRAY-SIZE, array-size-semantics=VARIABLE-SIZE, max-number-of-elements=2
  app type ADT_ADAS_val_HPAVPAGiveWayVehTimes: category=VALUE, compu {phys=raw for raw 0..255; unit time}, range phys 0..255
  app type ADT_ADAS_enum_LineType: category=VALUE, compu {phys=raw for raw 0..255}, range phys 0..255
  app type ADT_Enum_TBOXOTAAPPTSet: category=VALUE, compu {0=OTAAPPTSetFail, 1=OTAAPPTSetSuccess}, range phys 0..255  # 设置预约升级时间
  application record data type ADT_ICC_strt_TollGateInfo: category=STRUCTURE  # 收费站信息
    application record element DTE_TollGateExists: category=VALUE, type=ADT_ICC_boolean_exists
    application record element DTE_TollGateDistance: category=VALUE, type=ADT_ICC_int32_Dist
    application record element DTE_TollGateInfoReserved: category=ARRAY, type=ADT_TollGateInfo_arr_Reserved  # 预留
  app type ADT_ADAS_enum_BAFASts: category=VALUE, compu {phys=raw for raw 0..255}, range phys 0..255
  application array data type ADT_ADAS_arr_RoadMarkerSupplement: category=ARRAY, dynamic-array-size-profile=VSA_LINEAR
    element ADT_ADAS_arr_RoadMarkerSupplement: category=STRUCTURE, type=ADT_ADAS_strt_RoadMarkerSupplement, array-size-handling=ALL-INDICES-SAME-ARRAY-SIZE, array-size-semantics=VARIABLE-SIZE, max-number-of-elements=28
  application array data type ADT_CameraStreamStatusMessage: category=ARRAY, dynamic-array-size-profile=VSA_LINEAR  # ADS到CDC的视频流状态消息
    element ADT_CameraStreamStatusMessage: category=VALUE, type=ADT_CameraStreamBasicElement, array-size-handling=ALL-INDICES-SAME-ARRAY-SIZE, array-size-semantics=VARIABLE-SIZE, max-number-of-elements=1048576
  application record data type ADT_ADAS_strt_VPASelfBuildMapInfo: category=STRUCTURE  # 自建图的地图列表信息
    application record element DTE_VPASelfBuildMapList: category=ARRAY, type=ADT_ADAS_arr_VPASelfBuildMap  # 自建图地图列表
  application array data type ADT_ADAS_arr_HPAParkingStaticObjects: category=ARRAY, dynamic-array-size-profile=VSA_LINEAR  # 泊车静态目标数组
    element ADT_ADAS_arr_HPAParkingStaticObjects: category=STRUCTURE, type=ADT_ADAS_strt_HPAStaticObject, array-size-handling=ALL-INDICES-SAME-ARRAY-SIZE, array-size-semantics=VARIABLE-SIZE, max-number-of-elements=300
  app type ADT_ADAS_enum_FSRASpdSetMod: category=VALUE, compu {phys=raw for raw 0..255}, range phys 0..255
  app type ADT_ADAS_enum_AebAcitveSt: category=VALUE, compu {phys=raw for raw 0..255}, range phys 0..255
  app type ADT_ADAS_enum_TolAutoMergeChangeLane: category=VALUE, compu {phys=raw for raw 0..18446744073709551615; unit pcs}, range phys 0..18446744073709551615  # 自动并道换道
  application record data type ADT_ICC_strt_NaviInfoPanel: category=STRUCTURE
    7 x application record element:
      DTE_PanelManeuverID: category=VALUE, type=ADT_Gen_int32_ManeuverID  # 动态转向ID,满足顺行展示距离时为顺行图标
      DTE_PanelSegmentRemain: category=STRUCTURE, type=ADT_ICC_strt_TimeAndDist  # 当前导航段剩余距离（单位米）和剩余时间（单位秒）
      DTE_PanelNextRouteName: category=STRING, type=ADT_ICC_string_RoadName  # 下条道路名称
      DTE_PnlNextRoadNameSegIdx: category=VALUE, type=ADT_ICC_int32_Index  # 下条道路名称所在的SegIdx
      DTE_PnlNextRoadNameLinkIdx: category=VALUE, type=ADT_ICC_int32_Index  # 下条道路名称所在的linkIdx
      DTE_NaviInfoPanelSplit: category=VALUE, type=ADT_ICC_int32_NaviSplit  # 当前导航段是否被拆分
      DTE_NaviInfoPanelReserved: category=ARRAY, type=ADT_NaviInfoPanel_arr_Reserved  # 预留
  6 x app type, all with category=VALUE:
    ADT_LCM_IMU_Acc_Y: compu {phys=raw-40 for raw -40..39.9985745; unit m/s²}, range phys -40..39.9985745
    ADT_LCM_IMU_Acc_Z: compu {phys=raw-40 for raw -40..39.9985745; unit m/s²}, range phys -40..39.9985745
    ADT_ICC_boolean_exists: compu {phys=raw for raw 0..2147483647}, range phys 0..2147483647  # 信息是否存在
    ADT_LCM_IMU_Acc_X: compu {phys=raw-40 for raw -40..39.9985745; unit m/s²}, range phys -40..39.9985745
    ADT_ADAS_Seg_CycCnt: compu {phys=raw for raw 0..3}, range phys 0..3
    ADT_DVRcameraSts: compu {phys=raw for raw 0..1}, range phys 0..1
  application record data type ADT_ADAS_strt_ParkingGenaralInfo_2: category=STRUCTURE
    19 x application record element:
      DTE_ParkingActiveSubFuncSt: category=VALUE, type=ADT_ADAS_enum_ParkingActiveSubFuncSt  # 泊车子功能激活状态
      DTE_ParkingQuitInd: category=VALUE, type=ADT_ADAS_enum_ParkingQuitInd  # 泊车退出提示
      DTE_ParkingDriOperateInd: category=VALUE, type=ADT_ADAS_enum_ParkingDriOperateInd  # 驾驶员操作提示
      DTE_ParkingPauseInd: category=VALUE, type=ADT_ADAS_enum_ParkingPauseInd  # 泊车暂停提示
      DTE_ParkingFailureReasonInd: category=VALUE, type=ADT_ADAS_enum_ParkingFailureReasonInd  # 泊车故障原因
      DTE_ParkingVoiceRemind: category=VALUE, type=ADT_ADAS_enum_ParkingVoiceRemind  # 泊车语音提示
      DTE_ADAS_ParkingScreen_ctrl: category=VALUE, type=ADT_ADAS_enum_ParkingScreen_ctrl  # APA大屏界面显示信号
      DTE_APAFucButtonSts: category=VALUE, type=ADT_ADAS_enum_ParkingButtonSts  # APA功能按钮显示状态
      DTE_HPAFucButtonSts: category=VALUE, type=ADT_ADAS_enum_ParkingButtonSts  # HPA功能按钮显示状态
      DTE_MRAFucButtonSts: category=VALUE, type=ADT_ADAS_enum_ParkingButtonSts  # MRA功能按钮显示状态
      DTE_FreeParkFucButtonSts: category=VALUE, type=ADT_ADAS_enum_ParkingButtonSts  # 自定义泊车功能按钮显示状态
      DTE_ParkingLotButtonSts: category=VALUE, type=ADT_ADAS_enum_ParkingButtonSts  # 收藏停车场图标显示状态
      DTE_RoadClassReq: category=VALUE, type=ADT_Gen_enum_AvailableSts  # 获取道路等级请求
      DTE_RPASet: category=VALUE, type=ADT_ADAS_enum_RPAset  # 遥控泊车设置项
      DTE_ParkingSpeedSet: category=VALUE, type=ADT_ADAS_enum_ParkingSpeedSet  # 泊车车速控制设置项
      DTE_HPACrusingSpeedSet: category=VALUE, type=ADT_ADAS_enum_ParkingSpeedSet  # 泊车巡航车速控制设置项
      DTE_ParkingChimeVoice: category=VALUE, type=ADT_ADAS_enum_ParkingChimeVoice  # 泊车提示音
      DTE_AMAPSts: category=VALUE, type=ADT_ADAS_enum_AMAPSts  # 加速踏板防误踩状态机信息
      DTE_PrkgGenaralReserved: category=ARRAY, type=ADT_PrkgGenaral_arr_Reserved  # 预留
  application record data type ADT_ADAS_strt_Traffic3DSign: category=STRUCTURE  # 交通标识信息
    4 x application record element:
      DTE_Traffic3DSignID: category=VALUE, type=ADT_Gen_val_ID  # 交通标识ID
      DTE_Traffic3DSignPos: category=STRUCTURE, type=ADT_ADAS_strt_Traffic3DSignPos  # 交通标识位置
      DTE_Traffic3DSignType: category=VALUE, type=ADT_ADAS_enum_Traffic3DSignType  # 交通标识类型
      DTE_Traffic3DSignReserved: category=ARRAY, type=ADT_Traffic3DSign_arr_Reserved  # 预留
  application array data type ADT_ADAS_arr_HPAOnWayLabelReplay: category=ARRAY, dynamic-array-size-profile=VSA_LINEAR
    element ADT_ADAS_arr_HPAOnWayLabelReplay: category=STRUCTURE, type=ADT_ADAS_strt_HPAOnWayLabel, array-size-handling=ALL-INDICES-SAME-ARRAY-SIZE, array-size-semantics=VARIABLE-SIZE, max-number-of-elements=10
  application record data type ADT_RequestVhrRemoteCall: category=STRUCTURE  # VHR日志远程调取--请求
    5 x application record element:
      DTE_vhrCompID: category=STRING, type=ADT_VhrCompID  # 部件ID
      DTE_vhrLogList: category=ARRAY, type=ADT_VhrLogList  # 日志列表
      DTE_vhrRelatedId: category=STRING, type=ADT_VhrRelatedId  # 日志关联id
      DTE_vhrLogStartTime: category=VALUE, type=ADT_VhrLogStartTime  # 请求的日志开始时间
      DTE_vhrLogEndTime: category=VALUE, type=ADT_VhrLogEndTime  # 请求的日志结束时间
  app type ADT_ADAS_enum_HNOPScenariosReminder: category=VALUE, compu {phys=raw for raw 0..255}, range phys 0..255
  application record data type ADT_ICC_strt_CruiseFacilityInfo: category=STRUCTURE  # 巡航电子眼
    5 x application record element:
      DTE_CruiseFacilityPos: category=STRUCTURE, type=ADT_ICC_strt_Coord2DDouble  # 位置
      DTE_CruiseFacilitType: category=VALUE, type=ADT_ICC_int32_CruiseFacilitType  # 类型
      DTE_CruiseFacilitDistance: category=VALUE, type=ADT_ICC_int32_Dist  # 距离设施的剩余距离，单位:m
      DTE_CruiseFacilitLimitSpeed: category=VALUE, type=ADT_ICC_int32_Speed  # 限速值，单位:km/h
      DTE_CruiseFacilityReserved: category=ARRAY, type=ADT_CruiseFacility_arr_Reserved  # 预留
  application array data type ADT_ADAS_arr_TrafficLightList: category=ARRAY, dynamic-array-size-profile=VSA_LINEAR  # 交通灯箱数组
    element ADT_ADAS_arr_TrafficLightList: category=STRUCTURE, type=ADT_ADAS_strt_TrafficLightInfo, array-size-handling=ALL-INDICES-SAME-ARRAY-SIZE, array-size-semantics=VARIABLE-SIZE, max-number-of-elements=10
  application array data type ADT_HPAPathOperation_arr_Reserved: category=ARRAY  # 预留
    element ADT_HPAPathOperation_arr_Reserved: category=VALUE, type=ADT_Reserved_uint8_Type, array-size-semantics=FIXED-SIZE, max-number-of-elements=30
  application array data type ADT_OCCInfo_arr_Reserved: category=ARRAY
    element ADT_OCCInfo_arr_Reserved: category=VALUE, type=ADT_Reserved_uint8_Type, array-size-semantics=FIXED-SIZE, max-number-of-elements=10
  app type ADT_Enum_UsbUpdateStart: category=VALUE, compu {phys=raw for raw 0..1}, range phys 0..1  # 发起TBOX升级
  app type ADT_DataUint64: category=VALUE, compu {phys=raw for raw 0..18446744073709551615; unit ms}, range phys 0..18446744073709551615  # 无符号64位整型
  app type ADT_ADAS_enum_IntelligentEvasionBtnStFb: category=VALUE, compu {phys=raw for raw 0..255}, range phys 0..255  # 智慧躲闪软开关设置反馈
  application record data type ADT_ICC_strt_HpaFcnOperating: category=STRUCTURE
    7 x application record element:
      DTE_HPAOperationId: category=VALUE, type=ADT_ICC_enum_HPAOperationId  # HPA功能操作指令
      DTE_HPALearnOperationId: category=VALUE, type=ADT_ICC_enum_LearnOperationId  # HPA学习操作指令
      DTE_HPAPathOperation: category=STRUCTURE, type=ADT_ICC_strt_HPAPathOperation  # HPA路线操作指令
      DTE_SelectSlotId: category=VALUE, type=ADT_ICC_uint16_SelectSlotID  # HPA选择流动车位ID
      DTE_SelectPathId: category=VALUE, type=ADT_ICC_uint8_SelectPathId  # HPA选择路线ID
      DTE_HPAUndoOperationID: category=VALUE, type=ADT_ICC_enum_HPAUndoOperationID  # HPA功能撤回操作指令
      DTE_HPASlotSearchOperationID: category=VALUE, type=ADT_ICC_enum_HPASlotSearchOperationID  # HPA沿途找车位操作指令
  app type ADT_port: category=VALUE, compu {phys=raw for raw 0..65535}, range phys 0..65535  # 端口号
  application array data type ADT_ADAS_arr_OccPoint: category=ARRAY, dynamic-array-size-profile=VSA_LINEAR
    element ADT_ADAS_arr_OccPoint: category=STRUCTURE, type=ADT_ADAS_strt_OccPoint, array-size-handling=ALL-INDICES-SAME-ARRAY-SIZE, array-size-semantics=VARIABLE-SIZE, max-number-of-elements=1000
  app type ADT_ICC_enum_HandsOffWarningStyle: category=VALUE, compu {phys=raw for raw 0..255}, range phys 0..255  # 脱手报警风格
  application record data type ADT_Struct_BEICALL: category=STRUCTURE  # 请求电话操作（B/E/I call）
    application record element DTE_CallType: category=VALUE, type=ADT_Enum_CallType  # 呼叫号码列表
    application record element DTE_CallOperation: category=VALUE, type=ADT_Enum_CallOperation  # 电话操作
    application record element DTE_Telephonenumber: category=STRING, type=ADT_StrVar_Telephonenumber  # 电话号码
  app type ADT_ICC_int32_ExtenLaneAction: category=VALUE, compu {phys=raw for raw 0..2147483647}, range phys 0..2147483647
  application record data type ADT_Struct_BleModuleInfo: category=STRUCTURE  # 蓝牙信息
    9 x application record element:
      DTE_BleMasterMac: category=STRING, type=ADT_StrVar_BleMasterMac  # 蓝牙主模块 MAC 地址
      DTE_BleSlaverLeftMac: category=STRING, type=ADT_StrVar_BleSlaverLeftMac  # 蓝牙左从模块 MAC 地址
      DTE_BleSlaverRightMac: category=STRING, type=ADT_StrVar_BleSlaverRightMac  # 蓝牙右从模块 MAC 地址
      DTE_BleSlaverRearMac: category=STRING, type=ADT_StrVar_BleSlaverRearMac  # 蓝牙后从模块MAC 地址
      DTE_BleMasterVer: category=STRING, type=ADT_StrVar_BleMasterVer  # 蓝牙主模块软件版本
      DTE_BleSlaverLeftVer: category=STRING, type=ADT_StrVar_BleSlaverLeftVer  # 蓝牙左从模块软件版本
      DTE_BleSlaverRightVer: category=STRING, type=ADT_StrVar_BleSlaverRightVer  # 蓝牙右从模块软件版本
      DTE_BleSlaverRearVer: category=STRING, type=ADT_StrVar_BleSlaverRearVer  # 蓝牙后从模块软件版本
      DTE_BleKeyFilling: category=VALUE, type=ADT_Enum_BleKeyFilling  # 蓝牙秘钥灌装状态
  application record data type ADT_ADAS_strt_Traffic3DSignList: category=STRUCTURE  # 3D交通标识信息数组
    application record element DTE_Traffic3DSignNum: category=VALUE, type=ADT_ADAS_val_Traffic3DSignNum  # 交通标识个数
    application record element DTE_Traffic3DSignList: category=ARRAY, type=ADT_ADAS_arr_Traffic3DSignList  # 交通标识数组
  application array data type ADT_ADAS_arr_HPAPathslot: category=ARRAY, dynamic-array-size-profile=VSA_LINEAR
    element ADT_ADAS_arr_HPAPathslot: category=STRUCTURE, type=ADT_ADAS_strt_ParkingSlot, array-size-handling=ALL-INDICES-SAME-ARRAY-SIZE, array-size-semantics=VARIABLE-SIZE, max-number-of-elements=1000
  5 x app type, all with category=VALUE:
    ADT_Enum_WorkModel: compu {phys=raw for raw 0..2}, range phys 0..2  # TBOX工作模式
    ADT_ADAS_enum_SglLCCMileage: compu {phys=raw for raw 0..100000; unit km}, range phys 0..100000  # LCC行驶里程
    ADT_ADAS_enum_LineColor: compu {phys=raw for raw 0..255}, range phys 0..255
    ADT_ADAS_enum_FcwWarnDist: compu {phys=raw for raw 0..255}, range phys 0..255
    ADT_ADAS_enum_TolAPAParkedOutTime: compu {phys=raw for raw 0..18446744073709551615; unit s}, range phys 0..18446744073709551615  # APA泊出时长
  application record data type ADT_ICC_strt_TimeAndDist: category=STRUCTURE
    application record element DTE_Dist: category=VALUE, type=ADT_ICC_int32_Dist  # 距离（单位米）
    application record element DTE_Time: category=VALUE, type=ADT_ICC_int32_Time  # 时间（单位秒）
  app type ADT_ICC_enum_AEBSettingSt: category=VALUE, compu {phys=raw for raw 0..255}, range phys 0..255  # AEB功能设置状态
  application array data type ADT_IcaNcaL3StateReserved: category=ARRAY  # ICA/L2NCA/L3智驾激活与否状态信息扩展预留字段
    element ADT_IcaNcaL3StateReserved: category=VALUE, type=ADT_ADS_ReservedUnit8, array-size-semantics=FIXED-SIZE, max-number-of-elements=16
  app type ADT_TimeInfoYear: category=VALUE, compu {phys=raw for raw 0..2159}, range phys 0..2159  # 年
  app type ADT_ADAS_enum_ISLISpdOffsetMod: category=VALUE, compu {phys=raw for raw 0..255}, range phys 0..255
  application record data type ADT_GnssInfo: category=STRUCTURE  # GNSS数据上报
    9 x application record element, all with category=VALUE:
      DTE_gpsStatus: type=ADT_GpsStatus  # GPS定位状态
      DTE_longitude: type=ADT_Longitude  # 经度
      DTE_latitude: type=ADT_Latitude  # 纬度
      DTE_speed: type=ADT_Speed  # 速度
      DTE_heading: type=ADT_Heading  # 航向
      DTE_satelliteNum: type=ADT_SatelliteNum  # 搜星数量
      DTE_hdop: type=ADT_HDOP  # 水平定位精度
      DTE_utcTime: type=ADT_UTC  # UTC时间戳
      DTE_altitude: type=ADT_Altitude  # 海拔高速
  app type ADT_ICC_enum_HPAUndoOperationID: category=VALUE, compu {phys=raw for raw 0..255}, range phys 0..255
  application record data type ADT_ADAS_strt_HPARepalyPathInfo: category=STRUCTURE
    9 x application record element:
      DTE_HpaReplayPathID: category=VALUE, type=ADT_Gen_val_ID  # 路线ID
      DTE_ReplayPathName: category=STRING, type=ADT_ADAS_string_PathName  # 路线名称
      DTE_ReplayDrivingDist: category=VALUE, type=ADT_ADAS_val_ParkingDist  # 路线行驶距离
      DTE_HPARepayRemainingDist: category=VALUE, type=ADT_ADAS_val_ParkingDist  # 记忆泊车回放剩余距离
      DTE_ReplayLinePoint: category=ARRAY, type=ADT_ADAS_arr_PathPoint  # 路线学习点集
      DTE_HPAReplayPathSlotInfo: category=ARRAY, type=ADT_ADAS_arr_HPAPathslot  # 路线记忆车位
      DTE_HPASpeedBumpInfo: category=ARRAY, type=ADT_ADAS_arr_HPASpeedBumpInfo  # 路线记忆减速带
      DTE_ReplayPathLabel: category=VALUE, type=ADT_ADAS_enum_PathLabel  # 路线标签
      DTE_HpaEndPos: category=STRUCTURE, type=ADT_ADAS_strt_HpaEndPos  # HPA终点信息
  5 x app type, all with category=VALUE:
    ADT_ADAS_Seg_EffSpdLmt: compu {phys=raw for raw 0..31; unit km/h or mph}, range phys 0..31
    ADT_ADAS_enum_RoadMarkerTrackingSts: compu {phys=raw for raw 0..255}, range phys 0..255  # 路面标记跟踪状态
    ADT_Enum_TollStationPathSet: compu {phys=raw for raw 0..255}, range phys 0..255  # 收费站通道设置 Toll gate lane setting
    ADT_ADAS_uint64_laneID: compu {phys=raw for raw 0..18446744073709551615}, range phys 0..18446744073709551615  # 目标所属车道ID
    ADT_ADAS_enum_StaticObjectType: compu {phys=raw for raw 0..255}, range phys 0..255
  application record data type ADT_ICC_strt_VpaParkingLotInfo: category=STRUCTURE
    5 x application record element:
      DTE_VPAParkingLotID: category=VALUE, type=ADT_Gen_val_ID  # 停车场id
      DTE_VPAParkingLotName: category=STRING, type=ADT_ADAS_string_VPAParkingLotName  # 停车场名字
      DTE_VPASpotLabel: category=ARRAY, type=ADT_ADAS_arr_VPASpots  # 用户特殊车位的标签信息
      DTE_VPASlotID: category=VALUE, type=ADT_ADAS_val_SlotID  # 车位ID
      DTE_VPAParkingLotAddress: category=STRING, type=ADT_ADAS_string_VPAParkingLotAddress  # 停车场地址
  9 x app type:
    ADT_ICC_val_Distance: category=VALUE, compu {phys=raw for raw 0..42949672.95; unit m}, range phys 0..42949672.95
    ADT_ADAS_Stub_FuncRoadClass: category=VALUE, compu {phys=raw for raw 0..7}, range phys 0..7
    ADT_CellularRsrp: category=VALUE, compu {phys=raw for raw -255..255}, range phys -255..255  # 电平（兼容4G/5G制式）
    ADT_ICC_enum_EfficientPassageBtnSt: category=VALUE, compu {phys=raw for raw 0..255}, range phys 0..255  # 高效通行软开关
    ADT_Enum_LogFTPSts: category=VALUE, compu {phys=raw for raw 0..1}, range phys 0..1  # FTP状态
    ADT_ADAS_val_PathSaveProgress: category=VALUE, compu {phys=raw for raw 0..100; unit %}, range phys 0..100
    ADT_ADAS_enum_TolAPANum: category=VALUE, compu {phys=raw for raw 0..18446744073709551615; unit s}, range phys 0..18446744073709551615  # APA次数
    ADT_ICC_enum_VoiceRemindSettingMode: category=VALUE, compu {phys=raw for raw 0..255}, range phys 0..255  # 语音播报模式
    ADT_StrVar_ECUHardwareNumber: category=STRING, sw-text-props={array-size-semantics=VARIABLE-SIZE, sw-max-text-size=5, base-type=UTF_8}  # ECU硬件号
  4 x application record data type, all with category=STRUCTURE:
    ADT_SimSwitchRequest  # 切换Sim卡命令
      application record element DTE_simSwitchMode: category=VALUE, type=ADT_SimMode  # 切换到指定模式
      application record element DTE_simSwitchOperator: category=VALUE, type=ADT_SimOperator  # 切换到指定运营商
    ADT_SentryModeRpt  # 哨兵模式运行报告
      application record element DTE_sentryModeRunDuration: category=VALUE, type=ADT_SentryModeDuration  # 哨兵模式运行时长(mins)
      application record element DTE_sentryModeAlarmLv1Cnt: category=VALUE, type=ADT_SentryModeAlarmCnt  # 哨兵模式告警总次数
      application record element DTE_sentryModeAlarmLv2Cnt: category=VALUE, type=ADT_SentryModeAlarmCnt  # 哨兵模式警报告警次数
    ADT_ADAS_strt_SlotWheelStopperInfo  # 轮挡信息
      application record element DTE_IsSlotHasWheelStopper: category=VALUE, type=ADT_ADAS_enum_IsSlotHasWheelStopper  # 轮挡是否存在
      application record element DTE_WheelStopInfo: category=STRUCTURE, type=ADT_ADAS_strt_WheelStopInfo  # 轮挡信息
    ADT_ICC_strt_NaviIntervalCameraInfo
      4 x application record element, all with category=VALUE:
        DTE_NavigationSpeedLimitValue: type=ADT_ICC_enum_SpeedLimitValue  # 区间限速值
        DTE_NavigationSpeedLimitUnit: type=ADT_ICC_enum_SpeedLimitUnit  # 区间限速单位
        DTE_NavigationCameraDistanceEnd: type=ADT_ICC_val_Distance  # 进入区间测速终路段后实时的区间路段剩余距离
        DTE_NavigationCameraDistanceStart: type=ADT_ICC_val_Distance  # 进入区间测速起始点的距离（单位:米）
  app type ADT_CelluarServiceStatus: category=VALUE, compu {0=INI_NO_SERVICE, 1=INI_SERVICE_LIMITED, 2=INI_SERVICE_VALID, 3=INI_AREA_SERVICE_LIMITED, 4=INI_SLEEP_STATE}
  application record data type ADT_ICC_str_NaviCongestionExtend: category=STRUCTURE
    4 x application record element:
      DTE_cause: category=VALUE, type=ADT_ICC_enum_Cause  # 拥堵原因:车祸、车道变窄、更换高速 0-无 icon 不展示 1-施工，2-交通事故，3-管制调 度,4-积水，5-积冰，6-积雪，7-红绿灯
      DTE_trend: category=VALUE, type=ADT_ICC_enum_Trend  # 拥堵趋势
      DTE_EventID: category=VALUE, type=ADT_ICC_val_ID  # 拥堵事件ID
      DTE_CongestionAffect: category=STRING, type=ADT_ICC_enum_Affect  # 拥堵影响车道
  7 x app type, all with category=VALUE:
    ADT_ADAS_enum_ELKLeftActiveSt: compu {phys=raw for raw 0..255}, range phys 0..255
    ADT_ICC_uint16_SelectSlotID: compu {phys=raw for raw 0..65535}, range phys 0..65535
    ADT_SentryModePlanFb: compu {0=SETTING_SUCCESS, 1=SETTING_FAILS}  # 哨兵模式预约设置反馈
    ADT_CellularMcc: compu {phys=raw for raw 0..4294967295}, range phys 0..4294967295  # 移动国家码
    ADT_ADAS_ProfShort_Offset: compu {phys=raw for raw 0..8191}, range phys 0..8191
    ADT_SeqNum: compu {phys=raw for raw 0..4294967295}, range phys 0..4294967295  # 序列号
    ADT_Gen_val_Width: compu {phys=raw for raw 0..65535; unit cm}, range phys 0..65535  # 宽
  application array data type ADT_ICC_arr_FrontExtenLanes: category=ARRAY, dynamic-array-size-profile=VSA_LINEAR
    element ADT_ICC_arr_FrontExtenLanes: category=STRUCTURE, type=ADT_ICC_strt_ExtenLaneAction, array-size-handling=ALL-INDICES-SAME-ARRAY-SIZE, array-size-semantics=VARIABLE-SIZE, max-number-of-elements=32
  app type ADT_ADAS_enum_VPAStation: category=VALUE, compu {phys=raw for raw 0..255}, range phys 0..255
  app type ADT_SimMode: category=VALUE, compu {phys=raw for raw 0..255}, range phys 0..255  # 切换到指定模式
  application record data type ADT_ADAS_strt_RoadMarker: category=STRUCTURE
    8 x application record element, all with category=VALUE:
      DTE_RoadMarkerType: type=ADT_ADAS_enum_RoadMarkerType  # 路面标记类型
      DTE_RoadMarkerID: type=ADT_Gen_val_ID  # 路面标记ID
      DTE_RoadMarkerTrackingSts: type=ADT_ADAS_enum_RoadMarkerTrackingSts  # 路面标记跟踪状态
      DTE_RoadMarkerPose1X: type=ADT_Gen_val_Coordinate_X  # 路面标记点1X坐标
      DTE_RoadMarkerPose1Y: type=ADT_Gen_val_Coordinate_Y  # 路面标记点1Y坐标
      DTE_RoadMarkerPose2X: type=ADT_Gen_val_Coordinate_X  # 路面标记点2X坐标
      DTE_RoadMarkerPose2Y: type=ADT_Gen_val_Coordinate_Y  # 路面标记点2Y坐标
      DTE_RoadMarkerWidth: type=ADT_Gen_val_Width  # 路面标记(人行道）宽度
  application record data type ADT_ApnInfo: category=STRUCTURE
    6 x application record element, all with category=VALUE:
      DTE_apnIndex: type=ADT_ApnIndex  # apn索引
      DTE_connStatus: type=ADT_ConnStatus  # apn的拨号连接状态
      DTE_upRate: type=ADT_UpRate  # apn对应的上行实时流量速率（字节/秒）
      DTE_downRate: type=ADT_DownRate  # apn对应的下行实时流量速率（字节/秒）
      DTE_upFlow: type=ADT_UpFlow  # apn对应的上行流量（字节）
      DTE_downFlow: type=ADT_DownFlow  # apn对应的下行流量（字节）
  4 x app type, all with category=VALUE:
    ADT_ADAS_enum_CruiseAccelerateSts: compu {phys=raw for raw 0..255}, range phys 0..255
    ADT_ADAS_val_SetSpd: compu {phys=raw for raw 0..255}, range phys 0..255
    ADT_Gen_int32_ID: compu {phys=raw for raw 0..2147483647}, range phys 0..2147483647
    ADT_ADAS_Stub_TurnAngl: compu {phys=raw for raw 0..255; unit °}, range phys 0..255
  application array data type ADT_MNPInfo_arr_Reserved: category=ARRAY  # 预留
    element ADT_MNPInfo_arr_Reserved: category=VALUE, type=ADT_Reserved_uint8_Type, array-size-semantics=FIXED-SIZE, max-number-of-elements=50
  application array data type ADT_ADAS_arr_VPATunnel: category=ARRAY, dynamic-array-size-profile=VSA_LINEAR  # VPA通道列表
    element ADT_ADAS_arr_VPATunnel: category=STRING, type=ADT_ADAS_val_VPATunnel, array-size-handling=ALL-INDICES-SAME-ARRAY-SIZE, array-size-semantics=VARIABLE-SIZE, max-number-of-elements=100
  application record data type ADT_ICC_strt_NotAvoidInfo: category=STRUCTURE
    7 x application record element:
      DTE_NotAvoidType: category=VALUE, type=ADT_ICC_int32_NotAvoidType  # 类型
      DTE_NotAvoidDistToCar: category=VALUE, type=ADT_ICC_int32_Dist  # 到自车的距离
      DTE_NotAvoidCoord2D: category=STRUCTURE, type=ADT_ICC_strt_Coord2DDouble  # 二维位置
      DTE_NotAvoidCoord3D: category=STRUCTURE, type=ADT_ICC_strt_Coord3DDouble  # 三维位置
      DTE_NotAvoidForbidType: category=VALUE, type=ADT_ICC_int32_ForbidType  # 禁行类型
      DTE_NotAvoidValid: category=VALUE, type=ADT_ICC_boolean_Valid  # 是否有效
      DTE_NotAvoidReserved: category=ARRAY, type=ADT_NotAvoid_arr_Reserved  # 预留
  application array data type ADT_ICC_arr_FrontLaneTypes: category=ARRAY, dynamic-array-size-profile=VSA_LINEAR
    element ADT_ICC_arr_FrontLaneTypes: category=STRUCTURE, type=ADT_ICC_strt_LaneCategoryType, array-size-handling=ALL-INDICES-SAME-ARRAY-SIZE, array-size-semantics=VARIABLE-SIZE, max-number-of-elements=32
  application array data type ADT_ADAS_arr_StaticObjects_2: category=ARRAY, dynamic-array-size-profile=VSA_LINEAR  # 行车静态目标数组
    element ADT_ADAS_arr_StaticObjects_2: category=STRUCTURE, type=ADT_ADAS_strt_StaticObject_2, array-size-handling=ALL-INDICES-SAME-ARRAY-SIZE, array-size-semantics=VARIABLE-SIZE, max-number-of-elements=100
  5 x app type, all with category=VALUE:
    ADT_ADAS_enum_AESSts: compu {phys=raw for raw 0..255}, range phys 0..255
    ADT_Enum_GNSSType1: compu {phys=raw for raw 0..1}, range phys 0..1  # GNSS信息
    ADT_Enum_GNSSType2: compu {phys=raw for raw 0..1}, range phys 0..1  # GNSS信息
    ADT_DataInt8: compu {phys=raw for raw -128..127}, range phys -128..127  # 有符号8型数据
    ADT_ADAS_enum_NarrowRoadAssistTextInfo: compu {phys=raw for raw 0..255}, range phys 0..255  # 窄路辅助提示信息
  application record data type ADT_ADAS_strt_ParkingSlot_2: category=STRUCTURE
    10 x application record element:
      DTE_SlotID: category=VALUE, type=ADT_ADAS_val_SlotID  # 车位ID
      DTE_SlotType: category=VALUE, type=ADT_ADAS_enum_SlotType  # 车位类型
      DTE_SlotStatus: category=VALUE, type=ADT_ADAS_enum_SlotStatus  # 车位可用状态
      DTE_SlotPointTop1: category=STRUCTURE, type=ADT_ADAS_strt_HPAVPAPathInfo  # 车位顶点1
      DTE_SlotPointTop2: category=STRUCTURE, type=ADT_ADAS_strt_HPAVPAPathInfo  # 车位顶点2
      DTE_SlotPointBottom1: category=STRUCTURE, type=ADT_ADAS_strt_HPAVPAPathInfo  # 车位顶点3
      DTE_SlotPointBottom2: category=STRUCTURE, type=ADT_ADAS_strt_HPAVPAPathInfo  # 车位顶点4
      DTE_SlotNum: category=VALUE, type=ADT_Gen_val_ID  # 车位序号
      DTE_SlotFloor: category=VALUE, type=ADT_ADAS_enum_HPAFloor  # 车位楼层
      DTE_ParkingSlotReserved: category=ARRAY, type=ADT_PrkgSlot_arr_Reserved  # 预留
  5 x app type:
    ADT_ICC_enum_NRASettingSt: category=VALUE, compu {phys=raw for raw 0..255}, range phys 0..255  # 窄路辅助操作指令
    ADT_ValetParkingActiveStatus: category=VALUE, compu {phys=raw for raw 0..255}, range phys 0..255  # 代客泊车运行激活状态
    ADT_ADAS_uint8_Available: category=VALUE, compu {phys=raw for raw 0..255}, range phys 0..255
    ADT_ADAS_string_VPAParkingLotAddress: category=STRING, sw-text-props={array-size-semantics=VARIABLE-SIZE, sw-max-text-size=100, base-type=UTF_8}
    ADT_ADAS_enum_ISLISt: category=VALUE, compu {phys=raw for raw 0..255}, range phys 0..255
  application array data type ADT_ADAS_arr_VPASpeedBump: category=ARRAY, dynamic-array-size-profile=VSA_LINEAR  # 减速带列表
    element ADT_ADAS_arr_VPASpeedBump: category=STRUCTURE, type=ADT_ADAS_strt_VPASpeedBump, array-size-handling=ALL-INDICES-SAME-ARRAY-SIZE, array-size-semantics=VARIABLE-SIZE, max-number-of-elements=200
  app type ADT_ICC_enum_DrivingVoiceRemindSettingSt: category=VALUE, compu {phys=raw for raw 0..255}, range phys 0..255  # 行车语音播报功能设置状态
  application record data type ADT_ADAS_strt_Traffic3DSignPos: category=STRUCTURE  # 交通标识位置
    application record element DTE_Traffic3DSignPosX: category=VALUE, type=ADT_Gen_val_Coordinate_X  # 交通标识位置X
    application record element DTE_Traffic3DSignPosY: category=VALUE, type=ADT_Gen_val_Coordinate_Y  # 交通标识位置Y
    application record element DTE_Traffic3DSignPosZ: category=VALUE, type=ADT_Gen_val_Coordinate_Z  # 交通标识位置Z
  application array data type ADT_ADAS_arr_MNPMemRoutePosition: category=ARRAY, dynamic-array-size-profile=VSA_LINEAR  # 路线轨迹点数组
    element ADT_ADAS_arr_MNPMemRoutePosition: category=STRUCTURE, type=ADT_ADAS_strt_MNPMemRoutePosition, array-size-handling=ALL-INDICES-SAME-ARRAY-SIZE, array-size-semantics=VARIABLE-SIZE, max-number-of-elements=1000
  application array data type ADT_LaneInfo_arr_Reserved: category=ARRAY
    element ADT_LaneInfo_arr_Reserved: category=VALUE, type=ADT_Reserved_int32_Type, array-size-semantics=FIXED-SIZE, max-number-of-elements=20
  5 x app type, all with category=VALUE:
    ADT_ADAS_enum_iLOASts: compu {phys=raw for raw 0..255}, range phys 0..255
    ADT_ADAS_Meta_ProtVer_Major: compu {phys=raw for raw 0..3}, range phys 0..3
    ADT_ADAS_enum_NOPLaneChangeInfo: compu {phys=raw for raw 0..255}, range phys 0..255  # 领航辅助变道状态信息
    ADT_ADAS_val_MeterPerPixelx: compu {phys=raw for raw -1000..1000; unit m}, range phys -1000..1000
    ADT_ADAS_val_MeterPerPixely: compu {phys=raw for raw -1000..1000; unit m}, range phys -1000..1000
  application record data type ADT_SentryModePlanTime: category=STRUCTURE
    8 x application record element, all with category=VALUE:
      DTE_sentryModePlanTime_flag: type=ADT_SentryModePlanTime_flag  # 哨兵模式预约开启开关
      DTE_sentryModePlanStartTime_date: type=ADT_SentryModePlanStartTime_date  # 哨兵模式预约开启时间（年月日）
      DTE_sentryModePlanStartTime_hour: type=ADT_SentryModePlanStartTime_hour  # 哨兵模式预约开启时间（时）
      DTE_sentryModePlanStartTime_minute: type=ADT_SentryModePlanStartTime_minute  # 哨兵模式预约开启时间（分）
      DTE_sentryModePlanEndTime_flag: type=ADT_SentryModePlanEndTime_flag  # 哨兵模式预约结束时间标识
      DTE_sentryModePlanEndTime_date: type=ADT_SentryModePlanEndTime_date  # 哨兵模式预约结束时间（年月日）
      DTE_sentryModePlanEndTime_hour: type=ADT_SentryModePlanEndTime_hour  # 哨兵模式预约结束时间（时）
      DTE_sentryModePlanEndTime_minute: type=ADT_SentryModePlanEndTime_minute  # 哨兵模式预约结束时间（分）
  application record data type ADT_ADAS_strt_SglNtfADDrivingCardinfo: category=STRUCTURE
    10 x application record element:
      DTE_SglNOAMileage: category=VALUE, type=ADT_ADAS_enum_SglNOAMileage  # NOA行驶里程
      DTE_SglLCCMileage: category=VALUE, type=ADT_ADAS_enum_SglLCCMileage  # LCC行驶里程
      DTE_SglAutoRoadCrossingsNum: category=VALUE, type=ADT_ADAS_enum_SglAutoRoadCrossingsNum  # 自动过路口数量
      DTE_SglAutoMergeChangeLane: category=VALUE, type=ADT_ADAS_enum_SglAutoMergeChangeLane  # 自动并道换道
      DTE_SglAccessRemitramp: category=VALUE, type=ADT_ADAS_enum_SglAccessRemitramp  # 汇入汇出匝道
      DTE_SglAutoAvoidObstacle: category=VALUE, type=ADT_ADAS_enum_SglAutoAvoidObstacle  # 自动避障（避障变道和避障bypass）
      DTE_SglRespondCongestion: category=VALUE, type=ADT_ADAS_enum_SglRespondCongestion  # 应对加塞
      DTE_SglU_turnsNum: category=VALUE, type=ADT_ADAS_enum_SglU_turnsNum  # 掉头次数
      DTE_SglSendMode: category=VALUE, type=ADT_ADAS_enum_SglSendMode  # 发送模式 Transmission mode
      DTE_SglNtfADDrivingCardinfoReserved: category=ARRAY, type=ADT_SglNtfADDrivingCardinfo_arr_Reserved  # 预留
  4 x app type, all with category=VALUE:
    ADT_Enum_MobileNetworkType: compu {phys=raw for raw 0..6}, range phys 0..6  # 移动网络类型
    ADT_ADAS_enum_HpaActiveCheckSts: compu {phys=raw for raw 0..255}, range phys 0..255
    ADT_Enum_CamStreamSt: compu {phys=raw for raw 0..255}, range phys 0..255  # 相机视频流状态反馈 Camera Video Stream Status Response
    ADT_ADAS_enum_AMAPSts: compu {phys=raw for raw 0..255}, range phys 0..255
  application record data type ADT_ADAS_strt_VPAStaticObjects: category=STRUCTURE  # VPA静态障碍物
    application record element DTE_StaticObjects: category=STRUCTURE, type=ADT_ADAS_strt_StaticObject  # 静态障碍物
    application record element DTE_StaticObjectsFloor: category=VALUE, type=ADT_ADAS_enum_VPAFloor  # 静态障碍物所属楼层
  app type ADT_TBOX_ReturnCode: category=VALUE, compu {phys=raw for raw 0..255}, range phys 0..255  # TBOX返回值
  app type ADT_StrVar_BleSlaverRearVer: category=STRING, sw-text-props={array-size-semantics=VARIABLE-SIZE, sw-max-text-size=24, base-type=UTF_8}  # 蓝牙后从模块软件版本
  app type ADT_ADAS_enum_ACCQuitReason: category=VALUE, compu {phys=raw for raw 0..255}, range phys 0..255
  application array data type ADT_Array_RenderData: category=ARRAY, dynamic-array-size-profile=VSA_LINEAR  # 渲染数据情报
    element ADT_Array_RenderData: category=VALUE, type=ADT_DataUint8, array-size-handling=ALL-INDICES-SAME-ARRAY-SIZE, array-size-semantics=VARIABLE-SIZE, max-number-of-elements=1300
  8 x app type, all with category=VALUE:
    ADT_ICC_enum_NOPEnableBtnSts: compu {phys=raw for raw 0..255}, range phys 0..255  # NOP功能使能开关
    ADT_ICC_enum_U_NOPEnableBtnSts: compu {phys=raw for raw 0..255}, range phys 0..255  # 城区NOP功能使能开关
    ADT_ADAS_enum_LCPermitSt: compu {phys=raw for raw 0..255}, range phys 0..255
    ADT_ICC_int32_Index: compu {phys=raw for raw -2147483648..2147483647}, range phys -2147483648..2147483647
    ADT_ICC_int32_NaviSplit: compu {phys=raw for raw 0..2147483647}, range phys 0..2147483647
    ADT_ICC_enum_NOPLaneChangeStyle: compu {phys=raw for raw 0..255}, range phys 0..255  # NOP超车变道风格
    ADT_ICC_float_Percent: compu {phys=raw for raw 0..100; unit %}, range phys 0..100
    ADT_Enum_DataConnection: compu {phys=raw for raw 0..1}, range phys 0..1  # 数据连接是否有效
  application record data type ADT_ADAS_strt_TrafficLightList: category=STRUCTURE  # 交通信号灯信息数组
    application record element DTE_TrafficLightNum: category=VALUE, type=ADT_ADAS_val_TrafficLightNum  # 交通灯箱个数
    application record element DTE_TrafficLightList: category=ARRAY, type=ADT_ADAS_arr_TrafficLightList  # 交通灯箱数组
  4 x app type:
    ADT_ICC_string_SetPathName: category=STRING, sw-text-props={array-size-semantics=VARIABLE-SIZE, sw-max-text-size=20, base-type=UTF_8}
    ADT_ADAS_enum_APAActiveFuncInd: category=VALUE, compu {phys=raw for raw 0..255}, range phys 0..255
    ADT_Enum_TBOXReady: category=VALUE, compu {0=TBOX_not_ready, 1=TBOX_ready}, range phys 0..255  # TBOX环境是否准备就绪
    ADT_ADAS_enum_FSRACruiseSpdModFb: category=VALUE, compu {phys=raw for raw 0..255}, range phys 0..255
  application record data type ADT_ADAS_strt_VPASelfBuildMap: category=STRUCTURE  # 自建图基本信息
    11 x application record element:
      DTE_VPAParkingSlotList: category=ARRAY, type=ADT_ADAS_arr_VPAParkingSLot  # 自建图车位列表
      DTE_VPATargetParkingSlotId: category=VALUE, type=ADT_ADAS_val_SlotID  # VPA选中的目标库位
      DTE_VPARoadLineList: category=ARRAY, type=ADT_ADAS_arr_VPARoadLine  # VPA地图的道路路线
      DTE_VPATargetEntranceId: category=VALUE, type=ADT_Gen_val_ID  # 目标停车场入口id
      DTE_VPAEntrance: category=ARRAY, type=ADT_ADAS_arr_VPAEntrance  # VPA入口信息
      DTE_VPASpots: category=ARRAY, type=ADT_ADAS_arr_VPASpots  # VPA用户特殊车位属性信息
      DTE_VPALayerInfo: category=STRUCTURE, type=ADT_ADAS_strt_VPALayerInfo  # VPA自建图所有层级信息
      DTE_VPALayerRange: category=ARRAY, type=ADT_ADAS_arr_VPARange  # VPA每一层的地图的范围，用于大地图渲染
      DTE_VPASpeedBumpList: category=ARRAY, type=ADT_ADAS_arr_VPASpeedBump  # 自建图减速带信息
      DTE_VPADefaultParkingSlotId: category=VALUE, type=ADT_ADAS_val_SlotID  # 默认车位id
      DTE_VPAStaticObjects: category=ARRAY, type=ADT_ADAS_arr_VPAStaticObjects  # 静态障碍物，包含柱子
  5 x app type, all with category=VALUE:
    ADT_U32_TBOXOSRTC: compu {phys=raw for raw 0..4294967295}, range phys 0..4294967295  # TBOX的系统RTC时间
    ADT_Enum_TBOXOTAAPPTCancel: compu {0=OTAAPPTCancelFail, 1=OTAAPPTCancelSuccess}, range phys 0..255  # TBOX取消预约升级
    ADT_ADAS_enum_FcwSts: compu {phys=raw for raw 0..255}, range phys 0..255
    ADT_SentryModePlanTime_flag: compu {0=OFF, 1=ON}  # 哨兵模式预约开启开关
    ADT_ADAS_enum_RPAset: compu {phys=raw for raw 0..255}, range phys 0..255
  application array data type ADT_LightState_arr_Reserved: category=ARRAY
    element ADT_LightState_arr_Reserved: category=VALUE, type=ADT_Reserved_int32_Type, array-size-semantics=FIXED-SIZE, max-number-of-elements=20
  app type ADT_ICC_int32_RoadClass: category=VALUE, compu {phys=raw for raw -2147483648..2147483647}, range phys -2147483648..2147483647
  app type ADT_ADAS_enum_NOPLaneChangeMod: category=VALUE, compu {phys=raw for raw 0..255}, range phys 0..255
  application record data type ADT_ADAS_strt_VPAParkingLotBaseData: category=STRUCTURE  # VPA的停车场的基本信息
    6 x application record element:
      DTE_ParkingLotID: category=VALUE, type=ADT_Gen_val_ID  # 停车场id
      DTE_ParkingLotName: category=STRING, type=ADT_ADAS_string_VPAParkingLotName  # 路线名称
      DTE_TotalMileage: category=VALUE, type=ADT_Gen_val_float32  # 总长度
      DTE_ParkinglotNumber: category=VALUE, type=ADT_DataUint16  # 总车位数量
      DTE_ParkinglotLayerNumber: category=VALUE, type=ADT_DataUint16  # 总层数
      DTE_ParkingLotAddress: category=STRING, type=ADT_ADAS_string_VPAParkingLotAddress  # 停车场地址
  application record data type ADT_ICC_strt_LightState: category=STRUCTURE  # 灯态
    5 x application record element:
      DTE_LightType: category=VALUE, type=ADT_ICC_int32_LightType  # 红绿灯状态类型
      DTE_LastSeconds: category=VALUE, type=ADT_ICC_int32_LastSeconds
      DTE_LightStateStime: category=VALUE, type=ADT_ICC_int64_Time  # 灯态开始时间戳，单位秒,1970,utc+8
      DTE_LightStateEtime: category=VALUE, type=ADT_ICC_int64_Time  # 灯态结束时间戳，单位秒,1970,utc+8
      DTE_LightStateReserved: category=ARRAY, type=ADT_LightState_arr_Reserved  # 预留
  4 x app type:
    ADT_ADAS_Seg_RelProbb: category=VALUE, compu {phys=raw for raw 0..31}, range phys 0..31
    ADT_Str_HardwareVers: category=STRING, sw-text-props={array-size-semantics=VARIABLE-SIZE, sw-max-text-size=40, base-type=UTF_8}  # ADAS硬件零件号 ADAS hardware part number
    ADT_ADAS_Stub_RelProbb: category=VALUE, compu {phys=raw for raw 0..31}, range phys 0..31
    ADT_SentryModePlanEndTime_flag: category=VALUE, compu {0=OFF, 1=ON}  # 哨兵模式预约结束时间标识
  application array data type ADT_ADAS_arr_StaticObjects: category=ARRAY, dynamic-array-size-profile=VSA_LINEAR  # 行车静态目标数组
    element ADT_ADAS_arr_StaticObjects: category=STRUCTURE, type=ADT_ADAS_strt_StaticObject, array-size-handling=ALL-INDICES-SAME-ARRAY-SIZE, array-size-semantics=VARIABLE-SIZE, max-number-of-elements=42
  application array data type ADT_ADAS_arr_HPAPathDetail: category=ARRAY, dynamic-array-size-profile=VSA_LINEAR
    element ADT_ADAS_arr_HPAPathDetail: category=STRUCTURE, type=ADT_ADAS_strt_HPAPathDetail, array-size-handling=ALL-INDICES-SAME-ARRAY-SIZE, array-size-semantics=VARIABLE-SIZE, max-number-of-elements=10
  5 x app type, all with category=VALUE:
    ADT_ADAS_enum_FDMSt: compu {phys=raw for raw 0..255}, range phys 0..255
    ADT_ADAS_enum_SVSSts: compu {phys=raw for raw 0..255}, range phys 0..255
    ADT_UpRate: compu {phys=raw for raw 0..4294967295}, range phys 0..4294967295
    ADT_ADAS_enum_LeaveFastLaneSts: compu {phys=raw for raw 0..255}, range phys 0..255
    ADT_ICC_enum_CruiseFacilityType: compu {phys=raw for raw -1..127}, range phys -1..127
  application record data type ADT_ICC_strt_NaviCruiseFacilityInfo: category=STRUCTURE
    4 x application record element, all with category=VALUE:
      DTE_CameraDistance: type=ADT_ICC_val_Distance  # 自车距离电子眼的距离
      DTE_CruiseFacilityType: type=ADT_ICC_enum_CruiseFacilityType  # 巡航状态下电子眼类型
      DTE_CruiseSpeedLimitValue: type=ADT_ICC_enum_SpeedLimitValue  # 限速值
      DTE_CruiseSpeedLimitUnit: type=ADT_ICC_enum_SpeedLimitUnit  # 限速单位
  app type ADT_ICC_string_AoiName: category=STRING, sw-text-props={array-size-semantics=VARIABLE-SIZE, sw-max-text-size=1000, base-type=UTF_8}
  app type ADT_ICC_enum_FreeSlotType: category=VALUE, compu {phys=raw for raw 0..255}, range phys 0..255
  application array data type ADT_SurfaceMesh_arr_Reserved: category=ARRAY  # 预留
    element ADT_SurfaceMesh_arr_Reserved: category=VALUE, type=ADT_Reserved_uint8_Type, array-size-semantics=FIXED-SIZE, max-number-of-elements=100
  6 x app type, all with category=VALUE:
    ADT_ADAS_enum_PicPocType: compu {phys=raw for raw 0..255}, range phys 0..255
    ADT_ADAS_enum_ACCSts: compu {phys=raw for raw 0..255}, range phys 0..255
    ADT_ADAS_enum_VPAWarningInfo: compu {phys=raw for raw 0..255}, range phys 0..255
    ADT_ICC_enum_TSREnableBtnSt: compu {phys=raw for raw 0..255}, range phys 0..255  # TSR功能使能开关
    ADT_Enum_MicState: compu {phys=raw for raw 0..1}, range phys 0..1  # Mic状态信息
    ADT_ADAS_enum_SetSpdUnit: compu {phys=raw for raw 0..255}, range phys 0..255
  application record data type ADT_Struct_NOA_SDMapShortInfo: category=STRUCTURE  # 标准地图信息_Short
    11 x application record element, all with category=VALUE:
      DTE_ProfShort_MsgType: type=ADT_ADAS_MsgType  # 标识该消息是Profile ShortMessage
      DTE_ProfShort_CycCnt: type=ADT_ADAS_ProfShort_CycCnt  # messages这个messagetype和profile type的循环计数器:重构器可以用这个值来检测丢失的消息
      DTE_ProfShort_PathIdx: type=ADT_ADAS_ProfShort_PathIdx  # 这个profile所在path的索引值
      DTE_ProfShort_Offset: type=ADT_ADAS_ProfShort_Offset  # 起点位置到第一个profilespot的位移距离
      DTE_ProfShort_Update: type=ADT_ADAS_ProfShort_Update  # Profile short消息更新
      DTE_ProfShort_ProfType: type=ADT_ADAS_ProfShort_ProfType  # profile short 类别
      DTE_ProfShort_CtrlPoint: type=ADT_ADAS_ProfShort_CtrlPoint  # 控制点
      DTE_ProfShort_Value0: type=ADT_ADAS_ProfShort_Value0  # 在offset的profile值
      DTE_ProfShort_Dist1: type=ADT_ADAS_ProfShort_Dist1  # 从第一个profilespot到第二个的距离
      DTE_ProfShort_Value1: type=ADT_ADAS_ProfShort_Value1  # 在offset+distance1处的profile值
      DTE_ProfShort_AccurClass: type=ADT_ADAS_ProfShort_AccurClass  # 准确度
  app type ADT_ADAS_Posn_PosProbb: category=VALUE, compu {phys=raw for raw 0..31}, range phys 0..31
  application array data type ADT_ADAS_arr_HPAParkingSlot: category=ARRAY, dynamic-array-size-profile=VSA_LINEAR
    element ADT_ADAS_arr_HPAParkingSlot: category=STRUCTURE, type=ADT_ADAS_strt_ParkingSlot_2, array-size-handling=ALL-INDICES-SAME-ARRAY-SIZE, array-size-semantics=VARIABLE-SIZE, max-number-of-elements=2000
  app type ADT_ICC_enum_FCWWarnDistance: category=VALUE, compu {phys=raw for raw 0..255}, range phys 0..255  # FCW报警距离限制
  app type ADT_ADAS_Meta_CountryCode: category=VALUE, compu {phys=raw for raw 0..255}, range phys 0..255
  application record data type ADT_ADAS_strt_MNPRouteStateInfo: category=STRUCTURE  # 记忆路线状态信息
    application record element DTE_MapRouteID: category=STRING, type=ADT_Str_MemRouteInfo  # 路线ID
    application record element DTE_MemRouteState: category=VALUE, type=ADT_ADAS_enum_MNPMemRouteState  # 路线状态
  app type ADT_ADAS_enum_iLOAActdirection: category=VALUE, compu {phys=raw for raw 0..255}, range phys 0..255
  application record data type ADT_ADAS_strt_MNPAllRoutesInfo: category=STRUCTURE  # 全部路线信息
    application record element DTE_MNPRoutesInfo: category=ARRAY, type=ADT_ADAS_arr_MNPRoutesInfo  # 记忆路线信息数组
    application record element DTE_MNPMemRoutesNum: category=VALUE, type=ADT_ADAS_arr_MNPMemRoutesNum  # 记忆路线数量
  7 x app type:
    ADT_ICC_enum_SpeedLimitValue: category=VALUE, compu {phys=raw for raw 0..255}, range phys 0..255
    ADT_ADAS_enum_NOPLaneChangeStyle: category=VALUE, compu {phys=raw for raw 0..255}, range phys 0..255
    ADT_ADAS_enum_TSISgnGiWay: category=VALUE, compu {phys=raw for raw 0..255}, range phys 0..255  # TSR让行类标识牌
    ADT_ICC_enum_WeatherID: category=VALUE, compu {phys=raw for raw 0..65535}, range phys 0..65535
    ADT_ICC_int32_NotAvoidType: category=VALUE, compu {phys=raw for raw 0..2147483647}, range phys 0..2147483647
    ADT_ICC_boolean_isNew: category=VALUE, compu {phys=raw for raw 0..2147483647}, range phys 0..2147483647  # 是否是新增电子眼
    ADT_ICC_string_Address: category=STRING, sw-text-props={array-size-semantics=VARIABLE-SIZE, sw-max-text-size=1000, base-type=UTF_8}
  application array data type ADT_CameraSpeed_arr_Reserved: category=ARRAY
    element ADT_CameraSpeed_arr_Reserved: category=VALUE, type=ADT_Reserved_int32_Type, array-size-semantics=FIXED-SIZE, max-number-of-elements=10
  app type ADT_ICC_enum_DatauploadBtn: category=VALUE, compu {phys=raw for raw 0..255}, range phys 0..255  # 一键数据回传使能
  application array data type ADT_ADAS_arr_VPAParkingSLot: category=ARRAY, dynamic-array-size-profile=VSA_LINEAR  # VPA停车位列表
    element ADT_ADAS_arr_VPAParkingSLot: category=STRUCTURE, type=ADT_ADAS_strt_VPAParkingSLot, array-size-handling=ALL-INDICES-SAME-ARRAY-SIZE, array-size-semantics=VARIABLE-SIZE, max-number-of-elements=2000
  app type ADT_ADAS_enum_TolAPAParkingTime: category=VALUE, compu {phys=raw for raw 0..18446744073709551615; unit s}, range phys 0..18446744073709551615  # APA泊入时长
  app type ADT_SentryModePlanEndTime_date: category=VALUE, compu {phys=raw for raw 0..4294967295}, range phys 0..4294967295  # 哨兵模式预约结束时间（年月日）
  application record data type ADT_ADAS_strt_ICAInfo_2: category=STRUCTURE
    16 x application record element:
      DTE_ICASts: category=VALUE, type=ADT_ADAS_enum_ICASts  # ICA 工作状态
      DTE_ICATextInfo: category=VALUE, type=ADT_ADAS_enum_ICATextInfo  # ICA 提示信息
      DTE_ICAQuitReason: category=VALUE, type=ADT_ADAS_enum_ICAQuitReason  # ICA 退出原因
      DTE_ICASenarioReminder: category=VALUE, type=ADT_ADAS_enum_ICASenarioReminder  # ICA场景提示
      DTE_ICAPlusONOFFSts: category=VALUE, type=ADT_ADAS_enum_ICAPlusONOFFSts  # ICAPlus开关状态
      DTE_HandsOffWarningStyle: category=VALUE, type=ADT_ADAS_enum_HandsOffWarningStyle  # 脱手报警风格
      DTE_TrafficLightAssistBtnStFb: category=VALUE, type=ADT_ADAS_enum_TrafficLightAssistBtnStFb  # 红绿灯辅助设置反馈
      DTE_DetourAroundObstacleBtnStFb: category=VALUE, type=ADT_ADAS_enum_DetourAroundObstacleBtnStFb  # 借道绕行障碍物设置反馈
      DTE_EfficientPassageBtnStFb: category=VALUE, type=ADT_ADAS_enum_EfficientPassageBtnStFb  # 高效通行软开关设置反馈
      DTE_IntelligentEvasionBtnStFb: category=VALUE, type=ADT_ADAS_enum_IntelligentEvasionBtnStFb  # 智慧躲闪软开关设置反馈
      DTE_RADSEnableBtnStFb: category=VALUE, type=ADT_ADAS_enum_RADSEnableBtnStFb  # 循迹倒车设置反馈
      DTE_OutsideParkingBtnStFb: category=VALUE, type=ADT_ADAS_enum_OutsideParkingBtnStFb  # 离车泊入开关设置反馈
      DTE_RGearDefaultFunctionBtnStFb: category=VALUE, type=ADT_ADAS_enum_RGearDefaultFunctionBtnStFb  # R挡默认打开项设置反馈
      DTE_ICAConfidence: category=VALUE, type=ADT_ADAS_enum_ICAConfidence  # ICA置信度
      DTE_TollStationPathStFb: category=VALUE, type=ADT_Enum_TollStationPathStFb  # 收费通道选择状态 Toll Station Path select status
      DTE_ICAInfoReserved: category=ARRAY, type=ADT_ICAInfo_arr_Reserved  # 预留
  6 x app type:
    ADT_StrVar_MCUVersion: category=STRING, sw-text-props={array-size-semantics=VARIABLE-SIZE, sw-max-text-size=16, base-type=UTF_8}  # MCU版本号
    ADT_ADAS_val_laneID: category=VALUE, compu {phys=raw for raw -128..127; unit /}, range phys -128..127
    ADT_ADAS_ProfShort_PathIdx: category=VALUE, compu {phys=raw for raw 0..63}, range phys 0..63
    ADT_ICC_string_RouteInfo: category=STRING, sw-text-props={array-size-semantics=VARIABLE-SIZE, sw-max-text-size=100000000, base-type=UTF_8}
    ADT_VhrRelatedId: category=STRING, sw-text-props={array-size-semantics=VARIABLE-SIZE, sw-max-text-size=128, base-type=UTF_8}
    ADT_Gen_enum_ValidityStatus: category=VALUE, compu {phys=raw for raw 0..255}, range phys 0..255
  application record data type ADT_ICC_strt_NaviWeatherInfo_1: category=STRUCTURE
    6 x application record element:
      DTE_NaviWeatherID: category=VALUE, type=ADT_ICC_int32_WeatherID  # 天气 ID
      DTE_AlertLevelId: category=VALUE, type=ADT_ICC_int32_AlertLevel  # 预警等级
      DTE_DistanceToCar: category=VALUE, type=ADT_ICC_int32_Dist  # 距离
      DTE_WeatherName: category=STRING, type=ADT_ICC_string_WeatherName  # 天气名称
      DTE_AlertLevelName: category=STRING, type=ADT_ICC_string_LevelName  # 预警名称
      DTE_WeatherInfoReserved_1: category=ARRAY, type=ADT_WeatherInfo_arr_Reserved_1  # 预留
  application record data type ADT_ICC_strt_CruiseInfo: category=STRUCTURE  # 巡航信息
    application record element DTE_CruiseRoadName: category=STRING, type=ADT_ICC_string_RoadName  # 道路名称
    application record element DTE_CruiseRoadClass: category=VALUE, type=ADT_ICC_int32_RoadClass  # 当前自车所在道路等级
    application record element DTE_CruiseInfoReserved: category=ARRAY, type=ADT_CruiseInfo_arr_Reserved  # 预留
  application array data type ADT_Light_arr_Reserved: category=ARRAY
    element ADT_Light_arr_Reserved: category=VALUE, type=ADT_Reserved_uint8_Type, array-size-semantics=FIXED-SIZE, max-number-of-elements=10
  application array data type ADT_ADAS_arr_MNPRoutesStateInfo: category=ARRAY, dynamic-array-size-profile=VSA_LINEAR  # 记忆路线状态信息数组
    element ADT_ADAS_arr_MNPRoutesStateInfo: category=STRUCTURE, type=ADT_ADAS_strt_MNPRouteStateInfo, array-size-handling=ALL-INDICES-SAME-ARRAY-SIZE, array-size-semantics=VARIABLE-SIZE, max-number-of-elements=20
  application array data type ADT_NaviInfo_arr_Reserved: category=ARRAY
    element ADT_NaviInfo_arr_Reserved: category=VALUE, type=ADT_Reserved_int32_Type, array-size-semantics=FIXED-SIZE, max-number-of-elements=20
  app type ADT_ADAS_enum_RoadMarkerColor: category=VALUE, compu {phys=raw for raw 0..255}, range phys 0..255  # 路面标记颜色
  application record data type ADT_ADAS_strt_DAIInfo: category=STRUCTURE
    application record element DTE_DAISts: category=VALUE, type=ADT_ADAS_enum_DAISts  # 起步提醒功能状态
    application record element DTE_DAIReminder: category=VALUE, type=ADT_ADAS_enum_DAIReminder  # 起步提醒
  6 x app type, all with category=VALUE:
    ADT_ICC_enum_NavSpeedLimitUnits: compu {phys=raw for raw 0..255}, range phys 0..255  # 导航限速单位
    ADT_ICC_enum_TLAEnableBtnSt: compu {phys=raw for raw 0..255}, range phys 0..255  # TLA功能使能开关
    ADT_ADAS_val_altitude: compu {phys=raw for raw 0..5000; unit m}, range phys 0..5000
    ADT_Enum_UnixTimestamp: compu {phys=raw for raw 0..18446744073709551615; unit ms}, range phys 0..18446744073709551615  # Unix绝对时间戳 Unix absolute timestamp
    ADT_ADAS_enum_Percent: compu {phys=raw for raw 0..255; unit %}, range phys 0..255
    ADT_ICC_int32_Time: compu {phys=raw for raw 0..2147483647; unit s}, range phys 0..2147483647
  application array data type ADT_ADSHMIRequestMessage: category=ARRAY, dynamic-array-size-profile=VSA_LINEAR  # ADS HMI数据通道请求
    element ADT_ADSHMIRequestMessage: category=VALUE, type=ADT_ADSHMIBasicElement, array-size-handling=ALL-INDICES-SAME-ARRAY-SIZE, array-size-semantics=VARIABLE-SIZE, max-number-of-elements=1048576
  application array data type ADT_CellularCellMapArray: category=ARRAY, dynamic-array-size-profile=VSA_LINEAR  # 小区网络地图数组
    element ADT_CellularCellMapArray: category=STRUCTURE, type=ADT_CellularCellMapInfo, array-size-handling=ALL-INDICES-SAME-ARRAY-SIZE, array-size-semantics=VARIABLE-SIZE, max-number-of-elements=32
  app type ADT_ICC_enum_MEBSwtSet: category=VALUE, compu {phys=raw for raw 0..255}, range phys 0..255  # MEB设置项开关
  app type ADT_ADAS_enum_HODWarnSettingStFb: category=VALUE, compu {phys=raw for raw 0..255}, range phys 0..255  # 脱手模式
  application record data type ADT_ADAS_strt_VPARoadLinePoint: category=STRUCTURE  # VPA中心道路点的结构
    application record element DTE_Point: category=STRUCTURE, type=ADT_ADAS_strt_VPAPointType  # 路线点
    application record element DTE_Layer: category=VALUE, type=ADT_ADAS_enum_VPAFloor  # 所属楼层
  4 x app type, all with category=VALUE:
    ADT_ADAS_float_Point: compu {phys=raw for raw -4294967296..4294967296; unit m}, range phys -4294967296..4294967296
    ADT_ADAS_enum_TolRecordUploadBtnFb: compu {phys=raw for raw 0..255}, range phys 0..255  # 录音上传状态反馈
    ADT_ADAS_enum_ALCTakeOverRequest: compu {phys=raw for raw 0..255}, range phys 0..255
    ADT_ADAS_enum_MNPRouteMileage: compu {phys=raw for raw 0..300; unit km}, range phys 0..300  # 记忆里程数
  application array data type ADT_ViaPoint_arr_Reserved: category=ARRAY
    element ADT_ViaPoint_arr_Reserved: category=VALUE, type=ADT_Reserved_int32_Type, array-size-semantics=FIXED-SIZE, max-number-of-elements=20
  10 x app type, all with category=VALUE:
    ADT_WiFiUploadDataStatus: compu {0=INI_NO_DATA, 1=INI_HAVE_DATA}
    ADT_ICC_int32_TunnelFlag: compu {phys=raw for raw 0..2147483647}, range phys 0..2147483647
    ADT_ICC_enum_FSRACruiseSpdOffsetPercent: compu {phys=raw for raw -20..20; unit %}, range phys -20..20  # 百分比偏移速度
    ADT_ICC_int32_LightPhase: compu {phys=raw for raw 0..2147483647}, range phys 0..2147483647  # 左转和直行是否同相位
    ADT_ICC_enum_MNPMemRouteQuitBtnSt: compu {phys=raw for raw 0..255}, range phys 0..255  # 退出路线学习按钮
    ADT_ADAS_enum_MNPMemRouteState: compu {phys=raw for raw 0..255}, range phys 0..255  # 路线状态
    ADT_ICC_enum_VPASubModReq: compu {phys=raw for raw 0..255}, range phys 0..255
    ADT_ephemerisDataIndexTotal: compu {phys=raw for raw 0..255}, range phys 0..255  # 星历数据一共有几包，A/P填写实际包个数；实时星历，固定填0
    ADT_Gen_enum_CalibrationSts: compu {phys=raw for raw 0..255}, range phys 0..255
    ADT_ADAS_enum_TSISgnForb: compu {phys=raw for raw 0..255}, range phys 0..255  # TSR禁止类标识牌
  application record data type ADT_ValetParkingRealtimeInfo: category=STRUCTURE  # 代客泊车实时信息
    4 x application record element:
      DTE_valetParkingNetworkQuality: category=VALUE, type=ADT_ValetParkingNetworkQuality  # 代客泊车感知网络质量状态
      DTE_valetParkingCurrentIndex: category=VALUE, type=ADT_ValetParkingCurrentIndex  # 代客泊车当前所处索引点
      DTE_valetParkingLayer: category=VALUE, type=ADT_ValetParkingLayer  # 楼层
      DTE_reserved: category=ARRAY, type=ADT_ValetParkingRealtimeInfoReserved  # 预留字段
  application record data type ADT_ADAS_strt_ISLIInfo_2: category=STRUCTURE
    12 x application record element:
      DTE_ISLISt: category=VALUE, type=ADT_ADAS_enum_ISLISt  # 超速报警功能状态
      DTE_ISLISpeedLimitSign: category=VALUE, type=ADT_ADAS_enum_ISLISpeedLimitSign  # 限速标志
      DTE_ISLISpeedLimitUnit: category=VALUE, type=ADT_ADAS_enum_ISLISpeedLimitUnit  # 限速标志单位
      DTE_ISLIOverSpeedWarn: category=VALUE, type=ADT_ADAS_enum_ISLIOverSpeedWarn  # 超速报警状态
      DTE_ISLIWarningModFb: category=VALUE, type=ADT_ADAS_enum_ISLIWarningMod  # 超速报警模式反馈
      DTE_ISLISpdLimType: category=VALUE, type=ADT_ADAS_enum_ISLISpdLimType  # 超速限制类型
      DTE_ISLICruiseSpdAbsOffsetFb: category=VALUE, type=ADT_ADAS_val_SpdLimitAbsOffset  # 限速绝对偏差值反馈
      DTE_ISLICruiseSpdRelOffsetFb: category=VALUE, type=ADT_ADAS_val_SpdLimitRelOffset  # 限速相对偏差值反馈
      DTE_ISLISpdOffsetMod: category=VALUE, type=ADT_ADAS_enum_ISLISpdOffsetMod  # 限速提醒偏移方式
      DTE_ISLICruiseSpdOffsetAbs: category=VALUE, type=ADT_ADAS_val_SpdLimitOffsetAbs  # 固定限速偏移量
      DTE_ISLITextInfomation: category=VALUE, type=ADT_ADAS_enum_ISLITextInfo  # ISLI文言提示信息
      DTE_ISLIInfoReserved: category=ARRAY, type=ADT_ISLIInfo_arr_Reserved  # 预留
  application array data type ADT_ICC_arr_NaviInfoPanel: category=ARRAY, dynamic-array-size-profile=VSA_LINEAR  # NaviInfo标签板显示内容专用
    element ADT_ICC_arr_NaviInfoPanel: category=STRUCTURE, type=ADT_ICC_strt_NaviInfoPanel, array-size-handling=ALL-INDICES-SAME-ARRAY-SIZE, array-size-semantics=VARIABLE-SIZE, max-number-of-elements=10
  app type ADT_DVRSts: category=VALUE, compu {phys=raw for raw 0..2}, range phys 0..2
  app type ADT_Enum_KL15State: category=VALUE, compu {phys=raw for raw 0..2}, range phys 0..2  # 查询TBOX KL15状态
  application record data type ADT_ADAS_strt_MNPRouteInfo: category=STRUCTURE  # 记忆路线信息
    12 x application record element:
      DTE_MapRouteID: category=STRING, type=ADT_Str_MemRouteInfo  # 路线ID
      DTE_MapRouteName: category=STRING, type=ADT_Str_MemRouteInfo  # 路线名称
      DTE_MapRouteStartName: category=STRING, type=ADT_Str_MemRouteInfo  # 路线起点名称
      DTE_MapRouteEndName: category=STRING, type=ADT_Str_MemRouteInfo  # 路线终点名称
      DTE_MapRouteEndPoint: category=STRUCTURE, type=ADT_ADAS_strt_MNPMemRoutePosition  # 路线终点坐标
      DTE_MapRouteMileage: category=VALUE, type=ADT_ADAS_enum_MNPRouteMileage  # 路线里程数
      DTE_MapRouteGrade: category=VALUE, type=ADT_ADAS_enum_MNPMemRouteGrade  # 路线评分
      DTE_MapRouteUseFreq: category=VALUE, type=ADT_ADAS_enum_MNPMemRouteUseFreq  # 路线使用频率（暂未使用，预留）
      DTE_MapRouteCreatTime: category=VALUE, type=ADT_ADAS_val_MemRouteCreatTime  # 路线创建时间
      DTE_MemRouteStartPoint: category=STRUCTURE, type=ADT_ADAS_strt_MNPMemRoutePosition  # 路线起点坐标
      DTE_MNPMemRoutePointsInfo: category=STRUCTURE, type=ADT_ADAS_strt_MNPMemRoutePointsInfo  # 路线轨迹点信息
      DTE_MNPRouteInfoReserved: category=ARRAY, type=ADT_MNPRouteInfo_arr_Reserved  # 预留
  app type ADT_ADAS_enum_PathLabel: category=VALUE, compu {phys=raw for raw 0..255}, range phys 0..255
  application array data type ADT_Arr_VersInfoReserved: category=ARRAY  # 预留 Reserved
    element ADT_Arr_VersInfoReserved: category=VALUE, type=ADT_Reserved_uint8_Type, array-size-semantics=FIXED-SIZE, max-number-of-elements=450
  5 x app type, all with category=VALUE:
    ADT_ICC_enum_ISLICruiseSpdRelOffset: compu {phys=raw for raw -20..20; unit %}, range phys -20..20  # 相对限制值（预留）
    ADT_ADAS_val_HNOACruiseSpdOffsetPercentFb: compu {phys=raw for raw -20..20; unit %}, range phys -20..20  # 百分比偏移速度反馈
    ADT_ADAS_enum_AebSts: compu {phys=raw for raw 0..255}, range phys 0..255
    ADT_Bool_Almanac: compu {phys=raw for raw 0..255}, range phys 0..255  # 是否有历书信息 Is there any almanac information
    ADT_Gen_val_Height: compu {phys=raw for raw 0..65535; unit cm}, range phys 0..65535  # 高
  application record data type ADT_Struct_UpdateFTPSts: category=STRUCTURE  # FTP状态
    5 x application record element:
      DTE_Action: category=VALUE, type=ADT_Enum_Action  # FTP动作
      DTE_FTPState: category=VALUE, type=ADT_Enum_FTPState  # FTP状态
      DTE_port: category=VALUE, type=ADT_port  # 端口号
      DTE_user: category=STRING, type=ADT_StrVar_user  # 用户名
      DTE_password: category=STRING, type=ADT_StrVar_password  # 密码
  application array data type ADT_Arr_GNSSInfoResd: category=ARRAY  # 预留 Reserved
    element ADT_Arr_GNSSInfoResd: category=VALUE, type=ADT_Reserved_uint8_Type, array-size-semantics=FIXED-SIZE, max-number-of-elements=20
  application array data type ADT_SglNtfADDrivingCardinfo_arr_Reserved: category=ARRAY
    element ADT_SglNtfADDrivingCardinfo_arr_Reserved: category=VALUE, type=ADT_Reserved_uint8_Type, array-size-semantics=FIXED-SIZE, max-number-of-elements=49
  application array data type ADT_ADAS_arr_PathPoint: category=ARRAY, dynamic-array-size-profile=VSA_LINEAR
    element ADT_ADAS_arr_PathPoint: category=STRUCTURE, type=ADT_ADAS_strt_HPAVPAPathInfo, array-size-handling=ALL-INDICES-SAME-ARRAY-SIZE, array-size-semantics=VARIABLE-SIZE, max-number-of-elements=2000
  4 x app type, all with category=VALUE:
    ADT_ADAS_enum_VPAFunctionType: compu {phys=raw for raw 0..255}, range phys 0..255
    ADT_ADAS_enum_ALCDirIndicator: compu {phys=raw for raw 0..255}, range phys 0..255
    ADT_ADAS_Stub_CycCnt: compu {phys=raw for raw 0..3}, range phys 0..3
    ADT_Enum_DataInLoopUnit: compu {phys=raw for raw 0..255}, range phys 0..255
  application array data type ADT_ADAS_arr_PathPoint_2: category=ARRAY, dynamic-array-size-profile=VSA_LINEAR
    element ADT_ADAS_arr_PathPoint_2: category=STRUCTURE, type=ADT_ADAS_strt_HPAVPAPathInfo, array-size-handling=ALL-INDICES-SAME-ARRAY-SIZE, array-size-semantics=VARIABLE-SIZE, max-number-of-elements=5000
  app type ADT_Enum_CamCalPrmsData: category=VALUE, compu {phys=raw for raw 0..255}, range phys 0..255  # 相机参数原始标定参数（含内外参） Camera Raw Calibration Parameters (Intrinsic & Extrinsic)
  app type ADT_CellularRat: category=VALUE, compu {phys=raw for raw 0..4294967295}, range phys 0..4294967295  # 网络制式
  application record data type ADT_ICC_strt_NaviCongestionDetailInfo: category=STRUCTURE
    4 x application record element:
      DTE_scopeFlag: category=VALUE, type=ADT_ICC_boolean_scopeFlag  # 自车位置是否在拥堵区域内
      DTE_CongestionStatus: category=VALUE, type=ADT_ICC_enum_CongestionStatus  # 拥堵程度:0:道路状态未知,1:道路通畅,2:道路缓行, 3:道路阻塞,4:严重拥 堵,5:结尾状态，不应该使用
      DTE_beginExactPoint: category=STRUCTURE, type=ADT_ICC_Navi_GpsPoint  # 拥堵起点位置信息
      DTE_endExactPoint: category=STRUCTURE, type=ADT_ICC_Navi_GpsPoint  # 拥堵终点点位置信息
  app type ADT_ADAS_enum_EfficientPassageBtnStFb: category=VALUE, compu {phys=raw for raw 0..255}, range phys 0..255  # 高效通行软开关设置反馈
  application array data type ADT_ADAS_arr_Traffic3DSignList: category=ARRAY, dynamic-array-size-profile=VSA_LINEAR  # 交通标识数组
    element ADT_ADAS_arr_Traffic3DSignList: category=STRUCTURE, type=ADT_ADAS_strt_Traffic3DSign, array-size-handling=ALL-INDICES-SAME-ARRAY-SIZE, array-size-semantics=VARIABLE-SIZE, max-number-of-elements=50
  app type ADT_Gen_val_unit8: category=VALUE, compu {phys=raw for raw 0..255}, range phys 0..255  # uint8整数
  application record data type ADT_ADAS_strt_MNPMemRoutePosition: category=STRUCTURE  # 路线轨迹点坐标
    application record element DTE_MemRoutePointX: category=VALUE, type=ADT_ADAS_val_longitude  # 记忆路线轨迹点坐标X
    application record element DTE_MemRoutePointY: category=VALUE, type=ADT_ADAS_val_latitude  # 记忆路线轨迹点坐标Y
    application record element DTE_MemRoutePointZ: category=VALUE, type=ADT_ADAS_val_altitude  # 记忆路线轨迹点坐标Z
  app type ADT_ICC_uint64_Time: category=VALUE, compu {phys=raw for raw 0..18446744073709551615; unit s}, range phys 0..18446744073709551615
  app type ADT_Enum_BEICALL: category=VALUE, compu {phys=raw for raw 0..1}, range phys 0..1  # 请求电话操作（B/E/I call）
  app type ADT_ADAS_val_TrafficLightNum: category=VALUE, compu {phys=raw for raw 0..255}, range phys 0..255  # 交通灯箱个数
  application record data type ADT_ICC_strt_ExtenLaneAction: category=STRUCTURE
    application record element DTE_ExtenLaneAction: category=VALUE, type=ADT_ICC_int32_ExtenLaneAction  # 车道信息
  application record data type ADT_Struct_CallNumberList: category=STRUCTURE  # 电话号码列表
    application record element DTE_CallType: category=VALUE, type=ADT_Enum_CallType  # 电话号码类型
    application record element DTE_PhoneNumber: category=STRING, type=ADT_StrVar_PhoneNumber  # 电话号码
  6 x app type:
    ADT_ADAS_enum_NOPLaneChangeReason: category=VALUE, compu {phys=raw for raw 0..255}, range phys 0..255
    ADT_SentryModeSt: category=VALUE, compu {0=ON, 1=OFF, 2=END_TIME, 3=LOW_BATTERY, 4=SYSTEM_FAILURE, 5=UNLOCKED}  # 哨兵模式开关状态
    ADT_StrVar_ScheduleID: category=STRING, sw-text-props={array-size-semantics=VARIABLE-SIZE, sw-max-text-size=64, base-type=UTF_8}
    ADT_ADAS_enum_PathState: category=VALUE, compu {phys=raw for raw 0..255}, range phys 0..255
    ADT_ADAS_enum_ACCVoiceReminder: category=VALUE, compu {phys=raw for raw 0..255}, range phys 0..255  # 巡航速度和距离调节语音提醒
    ADT_Gen_val_Yaw: category=VALUE, compu {phys=raw for raw -180..180; unit deg}, range phys -180..180  # 偏航角
  application record data type ADT_Struct_LogFTPSts: category=STRUCTURE  # FTP状态
    5 x application record element:
      DTE_Action: category=VALUE, type=ADT_Enum_Action  # FTP动作
      DTE_FTPState: category=VALUE, type=ADT_Enum_FTPState  # FTP状态
      DTE_port: category=VALUE, type=ADT_port  # 端口号
      DTE_user: category=STRING, type=ADT_StrVar_user  # 用户名
      DTE_password: category=STRING, type=ADT_StrVar_password  # 密码
  application record data type ADT_ADAS_strt_ApaTargetSlotInfo: category=STRUCTURE
    7 x application record element:
      DTE_TargetSlotPoint0Top1: category=STRUCTURE, type=ADT_ADAS_strt_SlotPoint  # 车位顶点1
      DTE_TargetSlotPoint1Top2: category=STRUCTURE, type=ADT_ADAS_strt_SlotPoint  # 车位顶点2
      DTE_TargetSlotPoint2Bottom1: category=STRUCTURE, type=ADT_ADAS_strt_SlotPoint  # 车位顶点3
      DTE_TargetSlotPoint3Bottom2: category=STRUCTURE, type=ADT_ADAS_strt_SlotPoint  # 车位顶点4
      DTE_TargetSlotType: category=VALUE, type=ADT_ADAS_enum_SlotType  # 车位类型
      DTE_TargetSlotAvailableParkInType: category=VALUE, type=ADT_ADAS_enum_TargetSlotAvailableParkInType  # 车位可用泊入类型
      DTE_SlotWheelStopperInfo: category=STRUCTURE, type=ADT_ADAS_strt_SlotWheelStopperInfo  # 车位轮挡信息
  app type ADT_ICC_int32_DestDirection: category=VALUE, compu {phys=raw for raw 0..2147483647}, range phys 0..2147483647
  app type ADT_ADAS_enum_ParkInDirectionAvaType: category=VALUE, compu {phys=raw for raw 0..255}, range phys 0..255
  application record data type ADT_ADAS_strt_DrivingSoundInfo: category=STRUCTURE
    application record element DTE_DrivingSoundWarn: category=VALUE, type=ADT_ADAS_enum_DrivingSoundWarn  # chime音报警
    application record element DTE_DrivingSoundReserved: category=ARRAY, type=ADT_DrivingSound_arr_Reserved  # 预留
  app type ADT_ADAS_ProfLong_CycCnt: category=VALUE, compu {phys=raw for raw 0..3}, range phys 0..3
  app type ADT_ADAS_val_timestampnSec: category=VALUE, compu {phys=raw for raw 0..4294967295; unit ns}, range phys 0..4294967295
  app type ADT_ADAS_Stub_NumOfLaneDrvDir: category=VALUE, compu {phys=raw for raw 0..7}, range phys 0..7
  application array data type ADT_PrkgGenaral_arr_Reserved: category=ARRAY  # 预留
    element ADT_PrkgGenaral_arr_Reserved: category=VALUE, type=ADT_Reserved_uint8_Type, array-size-semantics=FIXED-SIZE, max-number-of-elements=50
  10 x app type, all with category=VALUE:
    ADT_TimeInfoMonth: compu {phys=raw for raw 1..12}, range phys 1..12  # 月
    ADT_SentryModeFaults: compu {1=CMA_ABNORMAL, 2=USS_ABNORMAL, 3=INS_ABNORMAL, 4=STORAGE_ABNORMAL}  # 哨兵模式异常状态
    ADT_ICC_enum_NOPLaneChangeMod: compu {phys=raw for raw 0..255}, range phys 0..255  # NOP变道模式
    ADT_Gen_val_ID: compu {phys=raw for raw 0..255}, range phys 0..255  # ID
    ADT_ADAS_enum_ESSSts: compu {phys=raw for raw 0..255}, range phys 0..255
    ADT_ICC_int32_LaneAction: compu {phys=raw for raw 0..2147483647}, range phys 0..2147483647
    ADT_ADAS_enum_VPAPickUpPosSelectReq: compu {phys=raw for raw 0..255}, range phys 0..255
    ADT_Enum_FTPState: compu {phys=raw for raw 0..255}, range phys 0..255
    ADT_ADAS_enum_TolDatauploadBtnFb: compu {phys=raw for raw 0..255}, range phys 0..255  # 一键数据回传信息反馈
    ADT_OutgoingTotalTime: compu {phys=raw for raw 0..4294967295}, range phys 0..4294967295  # 拨出电话时长总计
  application array data type ADT_ADAS_arr_DynamicObjects: category=ARRAY, dynamic-array-size-profile=VSA_LINEAR  # 行车动态目标数组
    element ADT_ADAS_arr_DynamicObjects: category=STRUCTURE, type=ADT_ADAS_strt_DynamicObject, array-size-handling=ALL-INDICES-SAME-ARRAY-SIZE, array-size-semantics=VARIABLE-SIZE, max-number-of-elements=42
  app type ADT_ADAS_enum_APAPopup: category=VALUE, compu {phys=raw for raw 0..255}, range phys 0..255
  application record data type ADT_ADAS_strt_VPARange: category=STRUCTURE  # VPA地图范围
    application record element DTE_VPARangeFloor: category=VALUE, type=ADT_ADAS_enum_VPAFloor  # 范围所属楼层
    application record element DTE_VPARangeMinPoint: category=STRUCTURE, type=ADT_ADAS_strt_VPAPointType  # 最小点
    application record element DTE_VPARangeMaxPoint: category=STRUCTURE, type=ADT_ADAS_strt_VPAPointType  # 最大点
  app type ADT_ICC_int64_Index: category=VALUE, compu {phys=raw for raw -9223372036854775808..9223372036854775807}, range phys -9223372036854775808..9223372036854775807
  application record data type ADT_ICC_strt_NaviRoadInfo: category=STRUCTURE  # 导航道路信息
    5 x application record element:
      DTE_NaviRoadName: category=STRING, type=ADT_ICC_string_RoadName  # 道路名称
      DTE_NaviRoadClass: category=VALUE, type=ADT_ICC_int32_RoadClass  # 当前自车所在道路等级
      DTE_Navicurrentroadspd: category=VALUE, type=ADT_ICC_int32_Speed  # 道路限速
      DTE_NaviFormWay: category=VALUE, type=ADT_ICC_int32_FormWay  # 道路属性
      DTE_NaviRoadInfoReserved: category=ARRAY, type=ADT_NaviRoadInfo_arr_Reserved  # 预留
  application record data type ADT_Struct_UsbUpdateSta: category=STRUCTURE  # TBOX上报升级状态
    application record element DTE_UpdSta: category=VALUE, type=ADT_Enum_UpdSta  # TBOX升级状态
    application record element DTE_Progress: category=VALUE, type=ADT_Progress  # TBOX升级进度
  application array data type ADT_TollGateInfo_arr_Reserved: category=ARRAY  # 预留
    element ADT_TollGateInfo_arr_Reserved: category=VALUE, type=ADT_Reserved_int32_Type, array-size-semantics=FIXED-SIZE, max-number-of-elements=100
  4 x app type:
    ADT_StrVar_BleMasterMac: category=STRING, sw-text-props={array-size-semantics=VARIABLE-SIZE, sw-max-text-size=24, base-type=UTF_8}  # 蓝牙主模块 MAC 地址
    ADT_ADAS_Seg_BuildUpArea: category=VALUE, compu {phys=raw for raw 0..3}, range phys 0..3
    ADT_ADAS_Seg_Bridge: category=VALUE, compu {phys=raw for raw 0..3}, range phys 0..3
    ADT_Heading: category=VALUE, compu {phys=raw for raw 0..10000}, range phys 0..10000
  application record data type ADT_ADAS_strt_RoadMarker_2: category=STRUCTURE
    8 x application record element, all with category=VALUE:
      DTE_RoadMarkerType: type=ADT_ADAS_enum_RoadMarkerType  # 路面标记类型
      DTE_RoadMarkerID: type=ADT_Gen_uint64_ID  # 路面标记ID
      DTE_RoadMarkerTrackingSts: type=ADT_ADAS_enum_RoadMarkerTrackingSts  # 路面标记跟踪状态
      DTE_RoadMarkerPose1X: type=ADT_Gen_val_Coordinate_X  # 路面标记点1X坐标
      DTE_RoadMarkerPose1Y: type=ADT_Gen_val_Coordinate_Y  # 路面标记点1Y坐标
      DTE_RoadMarkerPose2X: type=ADT_Gen_val_Coordinate_X  # 路面标记点2X坐标
      DTE_RoadMarkerPose2Y: type=ADT_Gen_val_Coordinate_Y  # 路面标记点2Y坐标
      DTE_RoadMarkerWidth: type=ADT_Gen_val_Width  # 路面标记(人行道）宽度
  11 x app type:
    ADT_CellularMnc: category=VALUE, compu {phys=raw for raw 0..4294967295}, range phys 0..4294967295  # 移动网络码
    ADT_ADAS_enum_Confidencelevel: category=VALUE, compu {phys=raw for raw 0..255}, range phys 0..255
    ADT_SentryModeDuration: category=VALUE, compu {phys=raw for raw 0..100000; unit min}, range phys 0..100000  # 哨兵模式时长参数
    ADT_Gen_val_int16: category=VALUE, compu {phys=raw for raw 0..32767}, range phys 0..32767
    ADT_StrVar_NMEA: category=STRING, sw-text-props={array-size-semantics=VARIABLE-SIZE, sw-max-text-size=3072, base-type=UTF_8}
    ADT_Enum_State: category=VALUE, compu {phys=raw for raw 0..5}, range phys 0..5  # 通话状态
    ADT_ICC_enum_DAIEnableBtnSt: category=VALUE, compu {phys=raw for raw 0..255}, range phys 0..255  # DAI功能使能开关
    ADT_StrVar_SIM_ICCID: category=STRING, sw-text-props={array-size-semantics=VARIABLE-SIZE, sw-max-text-size=20, base-type=UTF_8}  # 20位数字组成的集成电路卡识别码
    ADT_ADAS_val_MemRouteCreatTime: category=VALUE, compu {phys=raw for raw 0..18446744073709551615; unit ns}, range phys 0..18446744073709551615  # 路线创建时间
    ADT_Gen_uint64_ID: category=VALUE, compu {phys=raw for raw 0..18446744073709551615}, range phys 0..18446744073709551615  # ID
    ADT_ICC_int32_CityCode: category=VALUE, compu {phys=raw for raw 0..2147483647}, range phys 0..2147483647
  application array data type ADT_ACCSupplementInfo_arr_Reserved: category=ARRAY
    element ADT_ACCSupplementInfo_arr_Reserved: category=VALUE, type=ADT_Reserved_uint8_Type, array-size-semantics=FIXED-SIZE, max-number-of-elements=30
  application record data type ADT_ADAS_strt_TrafficSign_2: category=STRUCTURE
    6 x application record element, all with category=VALUE:
      DTE_TSRSt: type=ADT_ADAS_enum_TSRSt  # TSR功能状态
      DTE_TrafficSignId: type=ADT_Gen_uint64_ID  # 交通标志ID
      DTE_TrafficSignType: type=ADT_ADAS_enum_TrafficSignType  # 交通标志类型
      DTE_TrafficSignPosX: type=ADT_Gen_val_Coordinate_X  # 交通标志位置X
      DTE_TrafficSignPosY: type=ADT_Gen_val_Coordinate_Y  # 交通标志位置Y
      DTE_TrafficSignPosZ: type=ADT_Gen_val_Coordinate_Z  # 交通标志位置Z
  application record data type ADT_ADAS_strt_ACCSupplementInfo: category=STRUCTURE
    application record element DTE_ACCVoiceReminder: category=VALUE, type=ADT_ADAS_enum_ACCVoiceReminder  # 巡航速度和距离调节语音提醒
    application record element DTE_SceneSts: category=VALUE, type=ADT_ADAS_enum_SceneSts  # 行泊切换状态机
    application record element DTE_ACCSupplementInfoReserved: category=ARRAY, type=ADT_ACCSupplementInfo_arr_Reserved  # 预留
  app type ADT_ICC_enum_ApaModeReq: category=VALUE, compu {phys=raw for raw 0..255}, range phys 0..255
  app type ADT_ADAS_enum_LKS_warning: category=VALUE, compu {phys=raw for raw 0..255}, range phys 0..255
  application record data type ADT_ICC_strt_HpaFcnOperating_2: category=STRUCTURE
    10 x application record element:
      DTE_HPAOperationId: category=VALUE, type=ADT_ICC_enum_HPAOperationId  # HPA功能操作指令
      DTE_HPALearnOperationId: category=VALUE, type=ADT_ICC_enum_LearnOperationId  # HPA学习操作指令
      DTE_HPAPathOperation: category=STRUCTURE, type=ADT_ICC_strt_HPAPathOperation_2  # HPA路线操作指令
      DTE_SelectSlotId: category=VALUE, type=ADT_ICC_uint16_SelectSlotID  # HPA选择流动车位ID
      DTE_SelectPathId: category=VALUE, type=ADT_ICC_uint8_SelectPathId  # HPA选择路线ID
      DTE_HPAUndoOperationID: category=VALUE, type=ADT_ICC_enum_HPAUndoOperationID  # HPA功能撤回操作指令
      DTE_HPASlotSearchOperationID: category=VALUE, type=ADT_ICC_enum_HPASlotSearchOperationID  # HPA沿途找车位操作指令
      DTE_HPASetOnwayLabel: category=STRUCTURE, type=ADT_ICC_strt_HPASetOnwayLabel  # 设置沿途标签
      DTE_HPALTEdbm: category=VALUE, type=ADT_ICC_enum_HPALTEdbm  # 座舱LTE网络强度
      DTE_HpaFcnReserved: category=ARRAY, type=ADT_HpaFcn_arr_Reserved  # 预留
  app type ADT_ICC_string_Cause: category=STRING, sw-text-props={array-size-semantics=VARIABLE-SIZE, sw-max-text-size=1000, base-type=UTF_8}
  app type ADT_Bool_PrevPosnUesdInfo: category=VALUE, compu {phys=raw for raw 0..255}, range phys 0..255  # 是否在前次定位中使用过信息 Was the information used in the previous positioning
  application record data type ADT_TimeManagement: category=STRUCTURE  # 时间信息
    application record element DTE_UTCTime: category=VALUE, type=ADT_TimeStamp64  # UTC时间
    application record element DTE_TimeInfoMsg: category=STRUCTURE, type=ADT_TimeInfoMsg  # 年月日时分秒
  4 x app type, all with category=VALUE, range phys 0..255:
    ADT_ICC_enum_NaviCountryID: compu {phys=raw for raw 0..255}
    ADT_ADAS_enum_HPAPopup: compu {phys=raw for raw 0..255}
    ADT_ADAS_Posn_Rehead: compu {phys=raw for raw 0..255; unit °}
    ADT_EphemerisDataFormat: compu {phys=raw for raw 0..255}  # 星历数据格式
  application array data type ADT_AdvPrkg_arr_Reserved: category=ARRAY  # 预留
    element ADT_AdvPrkg_arr_Reserved: category=VALUE, type=ADT_Reserved_uint8_Type, array-size-semantics=FIXED-SIZE, max-number-of-elements=50
  app type ADT_MultiSimSwitchMode: category=VALUE, compu {phys=raw for raw 0..255}, range phys 0..255  # 多SIM切换模式
  app type ADT_GpsStatus: category=VALUE, compu {phys=raw for raw 0..10000}, range phys 0..10000
  app type ADT_ADAS_enum_UNOPScenariosReminder: category=VALUE, compu {phys=raw for raw 0..255}, range phys 0..255
  application record data type ADT_ADAS_strt_FusionMapInfo: category=STRUCTURE  # HMI app用于地图元素渲染的数据，主要是服务端经过复杂的三角剖分处理，分担app的计算性能。
    7 x application record element:
      DTE_Boundary: category=STRUCTURE, type=ADT_ADAS_strt_FusionMapPoint  # 车道线信息(包含停止线)
      DTE_Curb: category=STRUCTURE, type=ADT_ADAS_strt_FusionMapPoint  # 路沿信息
      DTE_RoadLine: category=STRUCTURE, type=ADT_ADAS_strt_FusionMapPoint  # 车行驶的中间道路信息
      DTE_CrossWalk: category=STRUCTURE, type=ADT_ADAS_strt_FusionMapPoint  # 斑马线信息
      DTE_FreeSpace: category=STRUCTURE, type=ADT_ADAS_strt_FusionMapPoint  # 可行驶区域
      DTE_NOPLaneChangeTargetPosition: category=STRUCTURE, type=ADT_ADAS_strt_EgoPose  # 领航辅助变道的目标位置
      DTE_NOPLaneChangeLaneCenterPoint: category=ARRAY, type=ADT_ADAS_arr_LaneCenterPoint  # 领航辅助变道的中心线
  app type ADT_ADAS_enum_StopLineFlag: category=VALUE, compu {phys=raw for raw 0..255}, range phys 0..255  # 引导线中的停止线是否生效标志
  app type ADT_ADAS_enum_ParkinDirectionSts: category=VALUE, compu {phys=raw for raw 0..255}, range phys 0..255
  app type ADT_ICC_enum_APASettingSt: category=VALUE, compu {phys=raw for raw 0..255}, range phys 0..255  # APA功能设置状态
  application record data type ADT_ADAS_strt_VPAPointType: category=STRUCTURE  # vpa点类型
    application record element DTE_Coordinate_X: category=VALUE, type=ADT_Gen_val_Coordinate_X  # X坐标
    application record element DTE_Coordinate_Y: category=VALUE, type=ADT_Gen_val_Coordinate_Y  # Y坐标
    application record element DTE_Coordinate_Z: category=VALUE, type=ADT_Gen_val_Coordinate_Z  # Z坐标
  application array data type ADT_HPAPathInfo_arr_Reserved: category=ARRAY  # 预留
    element ADT_HPAPathInfo_arr_Reserved: category=VALUE, type=ADT_Reserved_uint8_Type, array-size-semantics=FIXED-SIZE, max-number-of-elements=5
  app type ADT_SimOperator: category=VALUE, compu {phys=raw for raw 0..255}, range phys 0..255  # 切换到指定运营商
  app type ADT_ICC_enum_ParkingSpeedSet: category=VALUE, compu {phys=raw for raw 0..255}, range phys 0..255  # 泊车速度设置状态
  application record data type ADT_SimSwitchCheckResponse: category=STRUCTURE  # 切换Sim卡检查结果
    application record element DTE_simSwitchCheckResult: category=VALUE, type=ADT_SimSwitchCheckResult  # 切换Sim卡检查结果
    application record element DTE_simSwitchCheckFailReason: category=VALUE, type=ADT_SimSwitchCheckFailReason  # 切卡检查失败原因
  5 x app type, all with category=VALUE:
    ADT_TimezoneUtcHours: compu {phys=raw for raw -12..14}, range phys -12..14  # 时区小时偏差信息
    ADT_ADAS_enum_ParkingScreen_ctrl: compu {phys=raw for raw 0..255}, range phys 0..255
    ADT_Enum_BleKeyFilling: compu {phys=raw for raw 0..1}, range phys 0..1  # 蓝牙秘钥灌装状态
    ADT_LCM_IMU_gpsWeek: compu {phys=raw for raw 0..65535; unit week}, range phys 0..65535
    ADT_ADAS_enum_VPAQuitInd: compu {phys=raw for raw 0..255}, range phys 0..255
  application record data type ADT_TimeInfoMsg: category=STRUCTURE  # 年月日时分秒
    7 x application record element, all with category=VALUE:
      DTE_TimeInfoDay: type=ADT_TimeInfoDay  # 日
      DTE_TimeInfoHour: type=ADT_TimeInfoHour  # 时
      DTE_TimeInfoMinute: type=ADT_TimeInfoMinute  # 分
      DTE_TimeInfoMonth: type=ADT_TimeInfoMonth  # 月
      DTE_TimeInfoSecond: type=ADT_TimeInfoSecond  # 秒
      DTE_TimeInfoYear: type=ADT_TimeInfoYear  # 年
      DTE_TimeValid: type=ADT_Basic_enum_Valid  # 时间有效位
  11 x app type, all with category=VALUE:
    ADT_Gen_val_int32: compu {phys=raw for raw 0..2147483647}, range phys 0..2147483647
    ADT_ICC_enum_DetourAroundObstacleBtnSt: compu {phys=raw for raw 0..255}, range phys 0..255  # 借道绕行障碍物软开关
    ADT_ICC_enum_HNOACruiseSpdOffsetSpd: compu {phys=raw for raw -20..20; unit kph}, range phys -20..20  # 固定偏移速度
    ADT_ICC_int64_HeavyTraffic: compu {phys=raw for raw 0..9223372036854775807}, range phys 0..9223372036854775807
    ADT_SecondTimeStampOffset: compu {phys=raw for raw -9223372036854775808..9223372036854775807; unit s}, range phys -9223372036854775808..9223372036854775807  # 秒差值
    ADT_ADAS_enum_ParkingVoiceRemind: compu {phys=raw for raw 0..255}, range phys 0..255
    ADT_ADAS_uint64_TargetObjID: compu {phys=raw for raw 0..18446744073709551615}, range phys 0..18446744073709551615  # 目标ID
    ADT_ICC_int64_Dist: compu {phys=raw for raw 0..9223372036854775807; unit m}, range phys 0..9223372036854775807
    ADT_ICC_int32_OwnerShip: compu {phys=raw for raw -2147483648..2147483647}, range phys -2147483648..2147483647
    ADT_ADAS_enum_ParkingFailureReasonInd: compu {phys=raw for raw 0..255}, range phys 0..255
    ADT_ADAS_enum_LongiTakeOverReq: compu {phys=raw for raw 0..255}, range phys 0..255
  application record data type ADT_ADAS_strt_ALCInfo_2: category=STRUCTURE
    11 x application record element:
      DTE_ALCStatus: category=VALUE, type=ADT_ADAS_enum_ALCSts  # 拨杆变道功能状态
      DTE_ALCDirIndicator: category=VALUE, type=ADT_ADAS_enum_ALCDirIndicator  # 拨杆变道方向
      DTE_ALCAbortReason: category=VALUE, type=ADT_ADAS_enum_ALCAbortReason  # 变道退出原因
      DTE_ALCSoundWarn: category=VALUE, type=ADT_ADAS_enum_ALCSoundWarn  # 变道声音报警
      DTE_ALCTextInfomation: category=VALUE, type=ADT_ADAS_enum_ALCTextInfo  # 变道提示信息
      DTE_ALCTakeOverRequest: category=VALUE, type=ADT_ADAS_enum_ALCTakeOverRequest  # 变道接管请求
      DTE_ALCPermitSt: category=VALUE, type=ADT_ADAS_enum_LCPermitSt  # 拨杆变道允许状态
      DTE_ALCDestPoseX: category=VALUE, type=ADT_Gen_val_Coordinate_X  # 变道目标车位框中心X坐标
      DTE_ALCDestPoseY: category=VALUE, type=ADT_Gen_val_Coordinate_Y  # 变道目标车位框中心Y坐标
      DTE_ALCDestPoseHeading: category=VALUE, type=ADT_Gen_val_Yaw  # 变道目标车位框航向角
      DTE_ALCInfoReserved: category=ARRAY, type=ADT_ALCInfo_arr_Reserved  # 预留
  app type ADT_EphemerisDataType: category=VALUE, compu {phys=raw for raw 0..255}, range phys 0..255  # 星历数据类型
  application record data type ADT_ADAS_strt_ParkingHMIInfo: category=STRUCTURE
    5 x application record element:
      DTE_ApaCorridor_left: category=ARRAY, type=ADT_ADAS_arr_TrajectoryPoint  # 左侧泊车路径通道
      DTE_ApaCorridor_right: category=ARRAY, type=ADT_ADAS_arr_TrajectoryPoint  # 右侧泊车路径通道
      DTE_RemainingPercentage: category=VALUE, type=ADT_ADAS_enum_Percent  # 剩余距离百分比
      DTE_PlannedPath: category=STRUCTURE, type=ADT_ADAS_strt_PlannedPath  # 一次性规划轨迹
      DTE_Occ_point: category=ARRAY, type=ADT_ADAS_arr_OccPoint  # 道路边缘显示
  8 x app type, all with category=VALUE:
    ADT_LanePositionInfo_length: compu {phys=raw for raw 0..4294967296; unit m}, range phys 0..4294967296
    ADT_CamIntrinsicsData: compu {phys=raw for raw 0..255}, range phys 0..255  # 相机内参原始数据
    ADT_TimezoneUtcMinutes: compu {phys=raw for raw -59..59}, range phys -59..59  # 时区分钟偏差信息
    ADT_ICC_enum_AMAPSettingSt: compu {phys=raw for raw 0..255}, range phys 0..255  # AMAP功能设置状态
    ADT_ADAS_enum_TSINoParkWarn: compu {phys=raw for raw 0..255}, range phys 0..255  # 禁止停车提示
    ADT_SimRealNameInfo: compu {phys=raw for raw 0..255}, range phys 0..255  # 实名制信息
    ADT_ADAS_enum_NOPQuitReason: compu {phys=raw for raw 0..255}, range phys 0..255
    ADT_ADAS_enum_NOALCCSwitchBtnONOFFSts: compu {phys=raw for raw 0..255}, range phys 0..255  # NOA与LCC切换按钮显示状态
  application array data type ADT_HpaFcn_arr_Reserved: category=ARRAY  # 预留
    element ADT_HpaFcn_arr_Reserved: category=VALUE, type=ADT_Reserved_uint8_Type, array-size-semantics=FIXED-SIZE, max-number-of-elements=50
  6 x app type:
    ADT_ICC_uint8_SelectPathId: category=VALUE, compu {phys=raw for raw 0..255}, range phys 0..255
    ADT_StrVar_MNC: category=STRING, sw-text-props={array-size-semantics=VARIABLE-SIZE, sw-max-text-size=2, base-type=UTF_8}  # 移动网络号码
    ADT_Enum_SPKState: category=VALUE, compu {phys=raw for raw 0..255}, range phys 0..255
    ADT_ADAS_val_DrivingTrajectoryPointNum: category=VALUE, compu {phys=raw for raw 0..65535}, range phys 0..65535  # 轨迹形点个数
    ADT_ICC_int32_NaviType: category=VALUE, compu {phys=raw for raw 0..2147483647}, range phys 0..2147483647
    ADT_ADAS_Stub_LastStub: category=VALUE, compu {phys=raw for raw 0..1}, range phys 0..1
  application array data type ADT_ICC_arr_NaviSubCameraExt: category=ARRAY, dynamic-array-size-profile=VSA_LINEAR
    element ADT_ICC_arr_NaviSubCameraExt: category=STRUCTURE, type=ADT_ICC_strt_NaviSubCameraExt, array-size-handling=ALL-INDICES-SAME-ARRAY-SIZE, array-size-semantics=VARIABLE-SIZE, max-number-of-elements=10
  app type ADT_ADAS_enum_HNOPConfidence: category=VALUE, compu {phys=raw for raw 0..255}, range phys 0..255  # 高速领航辅助置信度
  application record data type ADT_Strt_GNSSInfo: category=STRUCTURE  # GNSS信息
    12 x application record element:
      DTE_LongitudeInfo: category=VALUE, type=ADT_ADAS_val_longitude  # 经度信息 Longitude information
      DTE_LatitudeInfo: category=VALUE, type=ADT_ADAS_val_latitude  # 纬度信息 Latitude information
      DTE_HDOPInfo: category=VALUE, type=ADT_Dbl_HDOPfInfo  # 水平精度因子信息 Horizontal dilution of precision information
      DTE_AltitudeInfo: category=VALUE, type=ADT_ADAS_val_altitude  # 海拔高度信息 Altitude information
      DTE_VDOPInfo: category=VALUE, type=ADT_Dbl_VDOPInfo  # 垂直精度因子信息 Vertical dilution of precision information
      DTE_PDOPInfo: category=VALUE, type=ADT_Dbl_PDOPInfo  # 位置精度因子信息 Position dilution of precision information
      DTE_GndSpdInfo: category=VALUE, type=ADT_Flt_GndSpdInfo  # 地面速度 (米每秒)信息 Ground velocity (meters per second) information
      DTE_TimeInfo: category=STRUCTURE, type=ADT_TimeManagement  # 时间信息 time information
      DTE_GndHeadInfo: category=VALUE, type=ADT_Dbl_GndHeadInfo  # 地面航向信息 Ground course information
      DTE_SatelTotNrInfo: category=VALUE, type=ADT_Enum_SatelTotNrInfo  # 卫星总个数信息 Total number of satellites information
      DTE_SatelInfo: category=ARRAY, type=ADT_Arr_SatelInfo  # 卫星信息 satellites information
      DTE_GNSSInfoResd: category=ARRAY, type=ADT_Arr_GNSSInfoResd  # 预留 Reserved
  application array data type ADT_ADAS_arr_VPAStaticObjects: category=ARRAY, dynamic-array-size-profile=VSA_LINEAR  # vpa静态障碍物列表
    element ADT_ADAS_arr_VPAStaticObjects: category=STRUCTURE, type=ADT_ADAS_strt_VPAStaticObjects, array-size-handling=ALL-INDICES-SAME-ARRAY-SIZE, array-size-semantics=VARIABLE-SIZE, max-number-of-elements=300
  application record data type ADT_ADAS_strt_OCCInfo: category=STRUCTURE  # freespace信息
    5 x application record element:
      DTE_OCCPosition: category=STRUCTURE, type=ADT_ADAS_strt_OCCPosition  # OCC位置
      DTE_OCCType: category=VALUE, type=ADT_ADAS_enum_OCCType  # OCC类型
      DTE_OCCLength: category=VALUE, type=ADT_Gen_val_Length  # OCC栅格长度
      DTE_OCCWidth: category=VALUE, type=ADT_Gen_val_Width  # OCC栅格宽度
      DTE_OCCInfoReserved: category=ARRAY, type=ADT_OCCInfo_arr_Reserved  # 预留
  app type ADT_ADAS_val_longitude: category=VALUE, compu {phys=raw for raw 0..180; unit degree}, range phys 0..180
  app type ADT_ADAS_Seg_CmplxInsct: category=VALUE, compu {phys=raw for raw 0..3}, range phys 0..3
  app type ADT_ICC_int32_Speed: category=VALUE, compu {phys=raw for raw 0..2147483647; unit km/h}, range phys 0..2147483647
  application record data type ADT_ICC_strt_NaviGreenWaveCarSpeed: category=STRUCTURE  # 绿波车速
    6 x application record element:
      DTE_GreenWavePathId: category=VALUE, type=ADT_Gen_int64_ID  # 路线ID
      DTE_GreenWaveType: category=VALUE, type=ADT_ICC_int32_GreenWaveType  # 绿灯数量类型
      DTE_GreenWaveMaxSpeed: category=VALUE, type=ADT_ICC_int64_Speed  # 最大建议车速
      DTE_GreenWaveMinSpeed: category=VALUE, type=ADT_ICC_int64_Speed  # 最小建议车速
      DTE_RemainLightCount: category=VALUE, type=ADT_Gen_val_int64  # 剩余绿灯数量
      DTE_GreenWaveReserved: category=ARRAY, type=ADT_GreenWave_arr_Reserved  # 预留
  application array data type ADT_MixForkInfo_arr_Reserved: category=ARRAY
    element ADT_MixForkInfo_arr_Reserved: category=VALUE, type=ADT_Reserved_int32_Type, array-size-semantics=FIXED-SIZE, max-number-of-elements=20
  application record data type ADT_ICC_strt_LocMatchInfo: category=STRUCTURE  # 定位信息
    7 x application record element:
      DTE_Formway: category=VALUE, type=ADT_ICC_int32_FormWay
      DTE_LinkType: category=VALUE, type=ADT_ICC_int32_LinkType
      DTE_OwnerShip: category=VALUE, type=ADT_ICC_int32_OwnerShip
      DTE_RoadClass: category=VALUE, type=ADT_ICC_int32_RoadClass
      DTE_CurrentRoadSpeed: category=VALUE, type=ADT_ICC_int32_Speed
      DTE_RoadName: category=STRING, type=ADT_ICC_string_RoadName
      DTE_LocMatchInfoReserved: category=ARRAY, type=ADT_LocMatchInfo_arr_Reserved  # 预留
  application record data type ADT_ADAS_struct_NRAInfo: category=STRUCTURE
    5 x application record element:
      DTE_NarrowRoadAssistSts: category=VALUE, type=ADT_ADAS_enum_NarrowRoadAssistSts  # 窄路辅助功能状态
      DTE_NRATrajectoryPoint: category=ARRAY, type=ADT_ADAS_arr_TrajectoryPoint  # 窄路辅助轨迹线
      DTE_NarrowRoadAssistTextInfo: category=VALUE, type=ADT_ADAS_enum_NarrowRoadAssistTextInfo  # 窄路辅助提示信息
      DTE_NRAQuitReason: category=VALUE, type=ADT_ADAS_enum_NRAQuitReason  # 退出原因
      DTE_NRAPreScanSts: category=VALUE, type=ADT_ADAS_enum_NRAPreScanSts  # 预瞄状态
  application array data type ADT_ICC_arr_NaviIntCameraDynInfo: category=ARRAY, dynamic-array-size-profile=VSA_LINEAR  # 导航区间测速电子眼实时动态信息
    element ADT_ICC_arr_NaviIntCameraDynInfo: category=STRUCTURE, type=ADT_ICC_strt_NaviIntCameraDynInfo, array-size-handling=ALL-INDICES-SAME-ARRAY-SIZE, array-size-semantics=VARIABLE-SIZE, max-number-of-elements=10
  14 x app type, all with category=VALUE:
    ADT_Enum_SatelTypeInfo: compu {phys=raw for raw 0..255}, range phys 0..255  # 卫星类型信息 Satellite type information
    ADT_ADAS_val_ParkingDist: compu {phys=raw for raw 0..42949672.95; unit m}, range phys 0..42949672.95
    ADT_ICC_val_Direction: compu {phys=raw for raw 0..255}, range phys 0..255
    ADT_SentryModeCmdFb: compu {0=SUCCESS, 1=FAILURE}  # 哨兵模式开关设置反馈
    ADT_ADAS_Posn_Age: compu {phys=raw for raw 0..511; unit ms}, range phys 0..511
    ADT_INI_ReturnCode: compu {0=INI_SUCCESS, 1=INI_FAILED}  # 操作返回值
    ADT_LAC: compu {phys=raw for raw 0..65535}, range phys 0..65535  # 位置区域代码
    ADT_ADAS_enum_LSSTextInfo: compu {phys=raw for raw 0..255}, range phys 0..255  # LSS文言提示信息
    ADT_ValetParkingPointNum: compu {phys=raw for raw 0..4294967295}, range phys 0..4294967295  # 代客泊车路点个数
    ADT_ValetParkingCurrentIndex: compu {phys=raw for raw 0..4294967295}, range phys 0..4294967295  # 代客泊车当前所处索引点
    ADT_ADAS_ProfLong_Value: compu {phys=raw for raw 0..4294967295}, range phys 0..4294967295
    ADT_ICC_enum_ISLICruiseSpdOffsetAbd: compu {phys=raw for raw -20..20; unit kph}, range phys -20..20  # 固定限速偏移量
    ADT_ICC_float_Point: compu {phys=raw for raw -4294967296..4294967296; unit cm}, range phys -4294967296..4294967296
    ADT_ICC_int16_Index: compu {phys=raw for raw -32768..32767}, range phys -32768..32767
  application record data type ADT_ICC_strt_HPASetOnwayLabel: category=STRUCTURE
    4 x application record element:
      DTE_SetOnwayLabelID: category=VALUE, type=ADT_Gen_val_ID  # 设置沿途标签的ID
      DTE_SetOnwayLabelType: category=VALUE, type=ADT_ICC_enum_SetOnwayLabelType  # 设置沿途标签的类型
      DTE_SetOnwayLabelPoit: category=STRUCTURE, type=ADT_ICC_strt_HPAPathInfo  # 设置标签的坐标
      DTE_HPASetOnwayReserved: category=ARRAY, type=ADT_HPASetOnway_arr_Reserved  # 预留
  app type ADT_Basic_enum_Valid: category=VALUE, compu {phys=raw for raw 0..255}, range phys 0..255  # 时间有效位
  application array data type ADT_NaviRoadInfo_arr_Reserved: category=ARRAY
    element ADT_NaviRoadInfo_arr_Reserved: category=VALUE, type=ADT_Reserved_int32_Type, array-size-semantics=FIXED-SIZE, max-number-of-elements=20
  6 x app type, all with category=VALUE:
    ADT_ICC_int32_MainAction: compu {phys=raw for raw 0..2147483647}, range phys 0..2147483647
    ADT_ICC_enum_LDWWarnType: compu {phys=raw for raw 0..255}, range phys 0..255  # LDW/LDP报警方式
    ADT_ICC_val_ID: compu {phys=raw for raw 0..65535}, range phys 0..65535
    ADT_ADAS_enum_VPADriOperateInd: compu {phys=raw for raw 0..255}, range phys 0..255
    ADT_Enum_SKLearnFlag: compu {phys=raw for raw 0..7}, range phys 0..7  # SK学习标识
    ADT_GnssRawInfoElement: compu {phys=raw for raw 0..255}, range phys 0..255  # GNSS原始数据消息元素
  application record data type ADT_ADAS_strt_TLRInfo: category=STRUCTURE  # TLR功能输出信息
    6 x application record element:
      DTE_TLRONOFFSts: category=VALUE, type=ADT_ADAS_enum_TLRONOFFSts  # 交通灯识别系统开关状态
      DTE_TLRSts: category=VALUE, type=ADT_ADAS_enum_TLRSts  # 交通灯识别功能状态
      DTE_LeftTrafficLight: category=STRUCTURE, type=ADT_ADAS_strt_Light  # 左转红绿灯信息
      DTE_StraightTrafficLight: category=STRUCTURE, type=ADT_ADAS_strt_Light  # 直行红绿灯信息
      DTE_RightTrafficLight: category=STRUCTURE, type=ADT_ADAS_strt_Light  # 右转红绿灯信息
      DTE_TLRInfoReserved: category=ARRAY, type=ADT_TLRInfo_arr_Reserved  # 预留
  application array data type ADT_ICC_arr_NaviIntervalCameraInfo: category=ARRAY, dynamic-array-size-profile=VSA_LINEAR  # 导航模式下区间测速信息
    element ADT_ICC_arr_NaviIntervalCameraInfo: category=STRUCTURE, type=ADT_ICC_strt_NaviIntervalCameraInfo, array-size-handling=ALL-INDICES-SAME-ARRAY-SIZE, array-size-semantics=VARIABLE-SIZE, max-number-of-elements=2
  app type ADT_ICC_enum_VoiceControlCruiseSpeedAdjust: category=VALUE, compu {phys=raw for raw 0..255}, range phys 0..255  # 语音巡航速度调节指令
  app type ADT_StrVar_ECUSoftwareNumber: category=STRING, sw-text-props={array-size-semantics=VARIABLE-SIZE, sw-max-text-size=8, base-type=UTF_8}  # ECU软件号
  application array data type ADT_ADAS_arr_TrafficLight: category=ARRAY, dynamic-array-size-profile=VSA_LINEAR
    element ADT_ADAS_arr_TrafficLight: category=STRUCTURE, type=ADT_ADAS_strt_TrafficLight, array-size-handling=ALL-INDICES-SAME-ARRAY-SIZE, array-size-semantics=VARIABLE-SIZE, max-number-of-elements=10
  app type ADT_ADAS_enum_ISLITextInfo: category=VALUE, compu {phys=raw for raw 0..255}, range phys 0..255  # ISLI文言提示信息
  application array data type ADT_ADSHMIDeamonMessage: category=ARRAY, dynamic-array-size-profile=VSA_LINEAR  # HMI Server(ADS)到守护应用的通知事件
    element ADT_ADSHMIDeamonMessage: category=VALUE, type=ADT_ADSHMIBasicElement, array-size-handling=ALL-INDICES-SAME-ARRAY-SIZE, array-size-semantics=VARIABLE-SIZE, max-number-of-elements=1048576
  app type ADT_ADAS_enum_TLASts: category=VALUE, compu {phys=raw for raw 0..255}, range phys 0..255  # 红绿灯提醒功能状态
  application record data type ADT_ICC_strt_NaviSubCameraExt: category=STRUCTURE
    11 x application record element:
      DTE_SubCameraId: category=VALUE, type=ADT_Gen_int32_ID  # 细类电子眼id
      DTE_BuswayTimeEnable: category=VALUE, type=ADT_ICC_int32_Busway  # 公交车道是否生效
      DTE_SubType: category=VALUE, type=ADT_ICC_int32_SubType  # 电子眼的详细违章类型
      DTE_Penalty: category=VALUE, type=ADT_ICC_int32_Penalty  # 高罚数据是否生效
      DTE_CameraPriority: category=VALUE, type=ADT_ICC_int32_CameraPriority  # 电子眼显示优先级
      DTE_CameraisNew: category=VALUE, type=ADT_ICC_boolean_isNew  # 是否是新增电子眼
      DTE_CameraisVariableSpeed: category=VALUE, type=ADT_ICC_boolean_isVariable  # 是否可变限速电子眼
      DTE_CameraisMatch: category=VALUE, type=ADT_ICC_boolean_isMatch  # 区间测速是否配对:仅对区间测速电子眼生效
      DTE_CameraisSpecial: category=VALUE, type=ADT_ICC_boolean_isSpecial  # 城市特色电子眼标识
      DTE_CameraSpeedLimit: category=ARRAY, type=ADT_ICC_arr_CameraSpeed  # 电子眼限速
      DTE_SubCameraExtReserved: category=ARRAY, type=ADT_SubCameraExt_arr_Reserved  # 预留
  app type ADT_SentryModePlanEndTime_hour: category=VALUE, compu {phys=raw for raw 0..23}, range phys 0..23  # 哨兵模式预约结束时间（时）
  app type ADT_ADAS_enum_LightColor: category=VALUE, compu {phys=raw for raw 0..255}, range phys 0..255  # 红绿灯颜色
  app type ADT_Enum_KPI_DataInLoopUnit: category=VALUE, compu {phys=raw for raw 0..255}, range phys 0..255
  application array data type ADT_DrivingSound_arr_Reserved: category=ARRAY  # 预留
    element ADT_DrivingSound_arr_Reserved: category=VALUE, type=ADT_Reserved_uint8_Type, array-size-semantics=FIXED-SIZE, max-number-of-elements=30
  app type ADT_ADAS_enum_ICAConfidence: category=VALUE, compu {phys=raw for raw 0..255}, range phys 0..255  # ICA置信度
  app type ADT_ADAS_Posn_CycCnt: category=VALUE, compu {phys=raw for raw 0..3}, range phys 0..3
  application array data type ADT_ValetParkingPoinNetArray: category=ARRAY, dynamic-array-size-profile=VSA_LINEAR  # 代客泊车各点小区信息数组
    element ADT_ValetParkingPoinNetArray: category=STRUCTURE, type=ADT_RoadPointCellStruct, array-size-handling=ALL-INDICES-SAME-ARRAY-SIZE, array-size-semantics=VARIABLE-SIZE, max-number-of-elements=1024
  app type ADT_SentryModePlanStartTime_minute: category=VALUE, compu {phys=raw for raw 0..59}, range phys 0..59  # 哨兵模式预约开启时间（分）
  app type ADT_ADAS_enumTargetObjID: category=VALUE, compu {phys=raw for raw 0..255}, range phys 0..255  # 目标ID
  application array data type ADT_APARPAInfo_arr_Reserved: category=ARRAY  # 预留
    element ADT_APARPAInfo_arr_Reserved: category=VALUE, type=ADT_Reserved_uint8_Type, array-size-semantics=FIXED-SIZE, max-number-of-elements=48
  app type ADT_ADAS_enum_ICATextInfo: category=VALUE, compu {phys=raw for raw 0..255}, range phys 0..255
  application record data type ADT_ADAS_strt_OCCPosition: category=STRUCTURE  # OCC位置
    application record element DTE_OCCPositionX: category=VALUE, type=ADT_Gen_val_Coordinate_X  # OCC位置X
    application record element DTE_OCCPositionY: category=VALUE, type=ADT_Gen_val_Coordinate_Y  # OCC位置Y
    application record element DTE_OCCPositionZ: category=VALUE, type=ADT_Gen_val_Coordinate_Z  # OCC位置Z
  application record data type ADT_ADAS_strt_VPAParkingLotInfo: category=STRUCTURE  # VPA停车场信息
    application record element DTE_VPAParkingLotList: category=ARRAY, type=ADT_ADAS_arr_VPAParkingLotInfo  # VPA的状态
  app type ADT_ADAS_enum_LKSRightTrackingSt: category=VALUE, compu {phys=raw for raw 0..255}, range phys 0..255
  application array data type ADT_NaviInfoPanel_arr_Reserved: category=ARRAY
    element ADT_NaviInfoPanel_arr_Reserved: category=VALUE, type=ADT_Reserved_int32_Type, array-size-semantics=FIXED-SIZE, max-number-of-elements=20
  app type ADT_ADAS_enum_TrafficLightColor: category=VALUE, compu {phys=raw for raw 0..255}, range phys 0..255
  app type ADT_ICC_val_Time: category=VALUE, compu {phys=raw for raw 0..4294967295; unit s}, range phys 0..4294967295
  app type ADT_Gen_val_Roll: category=VALUE, compu {phys=raw for raw -180..180; unit deg}, range phys -180..180  # 翻滚角
  application array data type ADT_RoadMarkerSupplement_arr_Reserved: category=ARRAY  # 预留
    element ADT_RoadMarkerSupplement_arr_Reserved: category=VALUE, type=ADT_Reserved_uint8_Type, array-size-semantics=FIXED-SIZE, max-number-of-elements=30
  app type ADT_ICC_uint8_PathId: category=VALUE, compu {phys=raw for raw 0..10}, range phys 0..10
  app type ADT_ADAS_Meta_CycCnt: category=VALUE, compu {phys=raw for raw 0..3}, range phys 0..3
  application record data type ADT_Struct_RouteMatchingResult: category=STRUCTURE  # 路线匹配结果
    6 x application record element:
      DTE_sdRtHandle: category=VALUE, type=ADT_DataUint16
      DTE_hdRtHandle: category=VALUE, type=ADT_DataUint16
      DTE_routeMMStatus: category=VALUE, type=ADT_Enum_RouteMMStatus
      DTE_routeMMError: category=VALUE, type=ADT_Enum_RouteMMError
      DTE_routeMMErrorValid: category=VALUE, type=ADT_DataInt8
      DTE_routeMatchSegs: category=ARRAY, type=ADT_Array_RouteMMSeg  # HD路线匹配片段数组
  app type ADT_ICC_boolean_ScopeFlag_1: category=VALUE, compu {phys=raw for raw 0..2147483647}, range phys 0..2147483647
  application array data type ADT_HPASetOnway_arr_Reserved: category=ARRAY  # 预留
    element ADT_HPASetOnway_arr_Reserved: category=VALUE, type=ADT_Reserved_uint8_Type, array-size-semantics=FIXED-SIZE, max-number-of-elements=30
  app type ADT_ADAS_enum_DetourAroundObstacleBtnStFb: category=VALUE, compu {phys=raw for raw 0..255}, range phys 0..255  # 借道绕行障碍物设置反馈
  application record data type ADT_Struct_Cellinfo: category=STRUCTURE  # TBOX通知基站信息
    6 x application record element:
      DTE_Count: category=VALUE, type=ADT_Count  # 基站信息个数
      DTE_MCC: category=STRING, type=ADT_StrVar_MCC  # 移动国家代码，中国固定460
      DTE_MNC: category=STRING, type=ADT_StrVar_MNC  # 移动网络号码
      DTE_LAC: category=VALUE, type=ADT_LAC  # 位置区域代码
      DTE_CID: category=VALUE, type=ADT_CID  # 基站编号0开始的整数
      DTE_Result: category=VALUE, type=ADT_Enum_Result  # 是否取得结果
  application record data type ADT_ICC_strt_TunnelInfo: category=STRUCTURE  # 隧道信息
    4 x application record element:
      DTE_TunnelExists: category=VALUE, type=ADT_ICC_boolean_exists
      DTE_TunnelDistance: category=VALUE, type=ADT_ICC_int32_Dist
      DTE_TunnelLength: category=VALUE, type=ADT_ICC_int32_Dist
      DTE_TunnelInfoReserved: category=ARRAY, type=ADT_TunnelInfo_arr_Reserved  # 预留
  app type ADT_ADAS_enum_ALCAbortReason: category=VALUE, compu {phys=raw for raw 0..255}, range phys 0..255
  app type ADT_ADAS_Seg_NumOfLaneOppDir: category=VALUE, compu {phys=raw for raw 0..3}, range phys 0..3
  app type ADT_ADAS_Seg_NumOfLaneDrvDir: category=VALUE, compu {phys=raw for raw 0..7}, range phys 0..7
  application array data type ADT_ICC_arr_TimeAndDist: category=ARRAY, dynamic-array-size-profile=VSA_LINEAR
    element ADT_ICC_arr_TimeAndDist: category=STRUCTURE, type=ADT_ICC_strt_TimeAndDist, array-size-handling=ALL-INDICES-SAME-ARRAY-SIZE, array-size-semantics=VARIABLE-SIZE, max-number-of-elements=50
  5 x app type, all with category=VALUE:
    ADT_Gen_enum_SystemSts: compu {phys=raw for raw 0..255}, range phys 0..255
    ADT_ICC_enum_RADSEnableBtnSt: compu {phys=raw for raw 0..255}, range phys 0..255  # 循迹倒车软开关
    ADT_ADAS_enum_ObjectColor: compu {phys=raw for raw 0..255}, range phys 0..255
    ADT_ADAS_Meta_DrvSide: compu {phys=raw for raw 0..1}, range phys 0..1
    ADT_ADAS_Meta_ProtVer_Minor: compu {phys=raw for raw 0..15}, range phys 0..15
  application array data type ADT_ValetParkingRealtimeInfoReserved: category=ARRAY  # 代客泊车实时信息预留
    element ADT_ValetParkingRealtimeInfoReserved: category=VALUE, type=ADT_ADS_ReservedUnit8, array-size-semantics=FIXED-SIZE, max-number-of-elements=32
  app type ADT_ADAS_Stub_SubPathIdx: category=VALUE, compu {phys=raw for raw 0..63}, range phys 0..63
  application record data type ADT_ADAS_strt_HodDmsInfo: category=STRUCTURE
    4 x application record element, all with category=VALUE:
      DTE_DriverhandsoffWarning: type=ADT_ADAS_enum_DriverHandsoffWarning  # 脱手报警
      DTE_DMSWarning: type=ADT_ADAS_enum_DMSWarning  # 脱眼报警
      DTE_HandsOnReq: type=ADT_ADAS_enum_HandsOnReq  # 请求驾驶员握住方向盘提示
      DTE_HODWarnSettingStFb: type=ADT_ADAS_enum_HODWarnSettingStFb  # 脱手模式
  app type ADT_Gen_val_int64: category=VALUE, compu {phys=raw for raw 0..9223372036854775807}, range phys 0..9223372036854775807
  application record data type ADT_ADAS_strt_WheelStopInfo: category=STRUCTURE  # 轮挡信息
    application record element DTE_WheelStopperStartPoint: category=STRUCTURE, type=ADT_ADAS_strt_SlotPoint  # 轮挡端点1
    application record element DTE_WheelStopperEndPoint: category=STRUCTURE, type=ADT_ADAS_strt_SlotPoint  # 轮挡端点2
    application record element DTE_WheelStopperWidth: category=VALUE, type=ADT_Gen_val_Width  # 轮挡宽度(cm)
  application array data type ADT_ADAS_arr_LaneCenterPoint: category=ARRAY
    element ADT_ADAS_arr_LaneCenterPoint: category=STRUCTURE, type=ADT_ADAS_strt_LaneCenterPoint, array-size-semantics=FIXED-SIZE, max-number-of-elements=64
  application array data type ADT_VhrLogList: category=ARRAY, dynamic-array-size-profile=VSA_LINEAR  # 日志类型 动态数组
    element ADT_VhrLogList: category=STRING, type=ADT_VhrLogString, array-size-handling=ALL-INDICES-SAME-ARRAY-SIZE, array-size-semantics=VARIABLE-SIZE, max-number-of-elements=50
  application record data type ADT_Struct_LogPrepare: category=STRUCTURE  # TBOX日志上传准备状态
    application record element DTE_LogPrepareState: category=VALUE, type=ADT_Enum_LogPrepareState  # 日志上传是否准备好
    application record element DTE_fileName: category=STRING, type=ADT_StrVar_fileName  # log文件名称
  application record data type ADT_TimeInfoSync: category=STRUCTURE  # 携带TimeOffset 信息
    4 x application record element, all with category=STRUCTURE:
      DTE_ntpTimeOffset: type=ADT_TimeStampOffset  # NTP时间与gPTP时间的差值
      DTE_gnssTimeOffset: type=ADT_TimeStampOffset  # GNSS时间与gPTP时间的差值
      DTE_nitzTimeOffset: type=ADT_TimeStampOffset  # NITZ时间与gPTP时间的差值
      DTE_timeZoneInfo: type=ADT_TimeZoneInfo  # 当地时区信息，包含夏令时影响
  app type ADT_ADAS_enum_DegradeReminder: category=VALUE, compu {phys=raw for raw 0..255}, range phys 0..255
  app type ADT_ICC_enum_VoiceControlCruiseDistanceAdjust: category=VALUE, compu {phys=raw for raw 0..255}, range phys 0..255  # 语音巡航距离调节指令
  application record data type ADT_ADAS_strt_LSSInfo_2: category=STRUCTURE
    13 x application record element:
      DTE_LKSSts: category=VALUE, type=ADT_ADAS_enum_LKSSts  # 车道辅助系统状态
      DTE_LKSMod: category=VALUE, type=ADT_ADAS_enum_LKSMod  # 车道辅助模式
      DTE_ELKSts: category=VALUE, type=ADT_ADAS_enum_ELKSts  # 紧急车道保持状态
      DTE_LKSLeftTrackingSt: category=VALUE, type=ADT_ADAS_enum_LKSLeftTrackingSt  # 左侧跟踪状态
      DTE_LKSRightTrackingSt: category=VALUE, type=ADT_ADAS_enum_LKSRightTrackingSt  # 右侧跟踪状态
      DTE_ELKLeftActiveSt: category=VALUE, type=ADT_ADAS_enum_ELKLeftActiveSt  # ELK 左侧激活状态
      DTE_ELKRightActiveSt: category=VALUE, type=ADT_ADAS_enum_ELKRightActiveSt  # ELK 右侧激活状态
      DTE_LKSwarning: category=VALUE, type=ADT_ADAS_enum_LKS_warning  # LDP声音报警信号
      DTE_LKSWarnSensitivity: category=VALUE, type=ADT_ADAS_enum_LKS_WarnSensitivity  # LKS预警灵敏度
      DTE_LSSTextInfomation: category=VALUE, type=ADT_ADAS_enum_LSSTextInfo  # LSS文言提示信息
      DTE_LDPSts: category=VALUE, type=ADT_ADAS_enum_LDPSts  # 车道偏离抑制系统状态
      DTE_LDWSts: category=VALUE, type=ADT_ADAS_enum_LDWSts  # 车道偏离预警系统状态
      DTE_LSSInfoReserved: category=ARRAY, type=ADT_LSSInfo_arr_Reserved  # 预留
  app type ADT_DownRate: category=VALUE, compu {phys=raw for raw 0..4294967295}, range phys 0..4294967295
  application record data type ADT_ADAS_strt_HPAVPAPathInfo: category=STRUCTURE
    application record element DTE_Coordinate_X: category=VALUE, type=ADT_Gen_val_Coordinate_X  # X坐标
    application record element DTE_Coordinate_Y: category=VALUE, type=ADT_Gen_val_Coordinate_Y  # Y坐标
    application record element DTE_Coordinate_Z: category=VALUE, type=ADT_Gen_val_Coordinate_Z  # Z坐标
  application array data type ADT_ADAS_arr_ParkingDynamicObjects: category=ARRAY, dynamic-array-size-profile=VSA_LINEAR  # 泊车动态目标数组
    element ADT_ADAS_arr_ParkingDynamicObjects: category=STRUCTURE, type=ADT_ADAS_strt_DynamicObject, array-size-handling=ALL-INDICES-SAME-ARRAY-SIZE, array-size-semantics=VARIABLE-SIZE, max-number-of-elements=42
  application record data type ADT_Struct_VehicleDiagStatus: category=STRUCTURE  # TBOX上报诊断状态
    application record element DTE_DiagnosisState: category=VALUE, type=ADT_Enum_DiagnosisState  # 诊断状态
    application record element DTE_Step: category=VALUE, type=ADT_Step  # 诊断步骤
    application record element DTE_TotalStep: category=VALUE, type=ADT_TotalStep  # 诊断步骤总数
  application record data type ADT_RoadPointCellStruct: category=STRUCTURE  # 代客泊车各点信息
    application record element DTE_PointIndex: category=VALUE, type=ADT_PointIndex  # 单点索引
    application record element DTE_RoadPointCellArray: category=ARRAY, type=ADT_RoadPointCellArray  # 单点小区信息数组
  app type ADT_ICC_int32_Angle: category=VALUE, compu {phys=raw for raw 0..360; unit degree}, range phys 0..360
  application array data type ADT_ADAS_arr_ParkingStaticObjects: category=ARRAY, dynamic-array-size-profile=VSA_LINEAR  # 泊车静态目标数组
    element ADT_ADAS_arr_ParkingStaticObjects: category=STRUCTURE, type=ADT_ADAS_strt_StaticObject, array-size-handling=ALL-INDICES-SAME-ARRAY-SIZE, array-size-semantics=VARIABLE-SIZE, max-number-of-elements=42
  app type ADT_ADAS_enum_AutoResumeNotifier: category=VALUE, compu {phys=raw for raw 0..255}, range phys 0..255
  application record data type ADT_ADAS_strt_SensorSt: category=STRUCTURE  # ADAS域控及传感器状态
    29 x application record element, all with category=VALUE:
      DTE_ADASSysSts: type=ADT_Gen_enum_SystemSts  # ADAS系统状态
      DTE_FLCameraSysSts: type=ADT_Gen_enum_SystemSts  # 左前摄像头故障状态
      DTE_FLCameraCalSts: type=ADT_Gen_enum_CalibrationSts  # 左前摄像头状标定态
      DTE_FRCameraSysSts: type=ADT_Gen_enum_SystemSts  # 右前摄像头故障状态
      DTE_FRCameraCalSts: type=ADT_Gen_enum_CalibrationSts  # 右前摄像头状标定态
      DTE_RLCameraSysSts: type=ADT_Gen_enum_SystemSts  # 左后摄像头故障状态
      DTE_RLCameraCalSts: type=ADT_Gen_enum_CalibrationSts  # 左后摄像头状标定态
      DTE_RRCameraSysSts: type=ADT_Gen_enum_SystemSts  # 右后摄像头故障状态
      DTE_RRCameraCalSts: type=ADT_Gen_enum_CalibrationSts  # 右后摄像头状标定态
      DTE_RearCameraSysSts: type=ADT_Gen_enum_SystemSts  # 后摄像头故障状态
      DTE_RearCameraCalSts: type=ADT_Gen_enum_CalibrationSts  # 后摄像头状标定态
      DTE_FrontFarCameraSysSts: type=ADT_Gen_enum_SystemSts  # 前远距摄像头故障状态
      DTE_FrontFarCameraCalSts: type=ADT_Gen_enum_CalibrationSts  # 前远距摄像头状标定态
      DTE_FrontNearCameraSysSts: type=ADT_Gen_enum_SystemSts  # 前广角摄像头故障状态
      DTE_FrontNearCameraCalSts: type=ADT_Gen_enum_CalibrationSts  # 前广角摄像头状标定态
      DTE_MainLidarSysSts: type=ADT_Gen_enum_SystemSts  # 主激光雷达故障状态
      DTE_MainLidarCalSts: type=ADT_Gen_enum_CalibrationSts  # 主激光雷达标定状态
      DTE_FLLidarSysSts: type=ADT_Gen_enum_SystemSts  # 前左激光雷达故障状态
      DTE_FLLidarCalSts: type=ADT_Gen_enum_CalibrationSts  # 前左激光雷达标定状态
      DTE_FRLidarSysSts: type=ADT_Gen_enum_SystemSts  # 前右激光雷达故障状态
      DTE_FRLidarCalSts: type=ADT_Gen_enum_CalibrationSts  # 前右激光雷达标定状态
      DTE_SVSFrontCameraSysSts: type=ADT_Gen_enum_SystemSts  # 前环视相机故障状态
      DTE_SVSLeftCameraSysSts: type=ADT_Gen_enum_SystemSts  # 左环视相机故障状态
      DTE_SVSRightCameraSysSts: type=ADT_Gen_enum_SystemSts  # 右环视相机故障状态
      DTE_SVSRearCameraSysSts: type=ADT_Gen_enum_SystemSts  # 后环视相机故障状态
      DTE_SVSFrontCameraCalSts: type=ADT_Gen_enum_CalibrationSts  # 前环视相机标定状态
      DTE_SVSLeftCameraCalSts: type=ADT_Gen_enum_CalibrationSts  # 左环视相机标定状态
      DTE_SVSRightCameraCalSts: type=ADT_Gen_enum_CalibrationSts  # 右环视相机标定状态
      DTE_SVSRearCameraCalSts: type=ADT_Gen_enum_CalibrationSts  # 后环视相机标定状态
  app type ADT_SimSwitchCheckResult: category=VALUE, compu {phys=raw for raw 0..255}, range phys 0..255  # 切卡结果
package /DataTypes/ImplementationDataTypes
  1376 x impl type:
    IDT_ADAS_enum_ACCholdSts: category=VALUE, base-type=uint8
    IDT_VhrRelatedId: category=STRUCTURE, dynamic-array-size-profile=VSA_LINEAR
      element sizeIndicator: implementation-data-type=specialIDT_DynamicLengthField_uint32
      element IDT_VhrRelatedId: category=ARRAY
        element IDT_VhrRelatedId: array-size=128, array-size-handling=ALL-INDICES-SAME-ARRAY-SIZE, array-size-semantics=VARIABLE-SIZE, implementation-data-type=specialIDT_StringRef
    IDT_ICAInfo_arr_Reserved: category=ARRAY  # 预留
      element Reserved_uint8_Type: array-size=40, array-size-semantics=FIXED-SIZE, implementation-data-type=IDT_Reserved_uint8_Type
    IDT_ADAS_arr_ScoreMap: category=ARRAY  # 网格置信度
      element ADAS_uint8_ScoreMap: array-size=30720, array-size-semantics=FIXED-SIZE, implementation-data-type=IDT_ADAS_uint8_ScoreMap
    IDT_ADAS_enum_FcwSts: category=VALUE, base-type=uint8
    IDT_LCM_IMU_Acc_X: category=VALUE, base-type=float32
    IDT_ICC_string_CongestionId: category=STRUCTURE, dynamic-array-size-profile=VSA_LINEAR
      element sizeIndicator: implementation-data-type=specialIDT_DynamicLengthField_uint32
      element IDT_ICC_string_CongestionId: category=ARRAY
        element IDT_ICC_string_CongestionId: array-size=100, array-size-handling=ALL-INDICES-SAME-ARRAY-SIZE, array-size-semantics=VARIABLE-SIZE, implementation-data-type=specialIDT_StringRef
    IDT_LCM_IMU_Acc_Z: category=VALUE, base-type=float32
    IDT_SimSwitchStatus: category=VALUE, base-type=uint32  # 切卡过程状态
    IDT_LCM_IMU_Acc_Y: category=VALUE, base-type=float32
    IDT_ViaPoint_arr_Reserved: category=ARRAY
      element Reserved_int32_Type: array-size=20, array-size-semantics=FIXED-SIZE, implementation-data-type=IDT_Reserved_int32_Type
    IDT_ADAS_val_YboundMin: category=VALUE, base-type=float32
    IDT_ICC_val_longitude: category=VALUE, base-type=float64  # 经度
    IDT_TotalStep: category=VALUE, base-type=uint8  # 诊断步骤总数
    IDT_ADAS_enum_HNOACruiseSpdOffsetModFb: category=VALUE, base-type=uint8  # 车速偏移方式反馈
    IDT_ADAS_arr_TrafficLight: category=STRUCTURE, dynamic-array-size-profile=VSA_LINEAR
      element sizeIndicator: implementation-data-type=specialIDT_DynamicLengthField_uint32
      element IDT_ADAS_arr_TrafficLight: category=ARRAY
        element IDT_ADAS_arr_TrafficLight: array-size=10, array-size-handling=ALL-INDICES-SAME-ARRAY-SIZE, array-size-semantics=VARIABLE-SIZE, implementation-data-type=IDT_ADAS_strt_TrafficLight
    IDT_ADAS_enum_SafeStopReminder: category=VALUE, base-type=uint8  # 领航辅助执行安全停车提示
    IDT_Gen_val_unit8: category=VALUE, base-type=uint8  # uint8整数
    IDT_Str_HardwareVers: category=STRUCTURE, dynamic-array-size-profile=VSA_LINEAR  # ADAS硬件零件号 ADAS hardware part number
      element sizeIndicator: implementation-data-type=specialIDT_DynamicLengthField_uint32
      element IDT_Str_HardwareVers: category=ARRAY
        element IDT_Str_HardwareVers: array-size=40, array-size-handling=ALL-INDICES-SAME-ARRAY-SIZE, array-size-semantics=VARIABLE-SIZE, implementation-data-type=specialIDT_StringRef
    IDT_ADAS_enum_ALCDirIndicator: category=VALUE, base-type=uint8
    IDT_ICC_arr_NaviIntCameraDynInfo: category=STRUCTURE, dynamic-array-size-profile=VSA_LINEAR  # 导航区间测速电子眼实时动态信息
      element sizeIndicator: implementation-data-type=specialIDT_DynamicLengthField_uint32
      element IDT_ICC_arr_NaviIntCameraDynInfo: category=ARRAY
        element IDT_ICC_arr_NaviIntCameraDynInfo: array-size=10, array-size-handling=ALL-INDICES-SAME-ARRAY-SIZE, array-size-semantics=VARIABLE-SIZE, implementation-data-type=IDT_ICC_strt_NaviIntCameraDynInfo
    IDT_Enum_TBOXOTAAPPTCancel: category=VALUE, base-type=uint8  # TBOX取消预约升级
    IDT_FactoryResetResult: category=VALUE, base-type=uint32  # 恢厂执行结果
    IDT_ICC_enum_NavRampInfo: category=VALUE, base-type=uint8  # 前方路口匝道信息
    IDT_Gen_val_Width: category=VALUE, base-type=uint16  # 宽
    IDT_ADAS_enum_SlotStatus: category=VALUE, base-type=uint8
    IDT_ADAS_enum_MNPRouteMileage: category=VALUE, base-type=float32  # 记忆里程数
    IDT_CellularRsrp: category=VALUE, base-type=sint32  # 电平（兼容4G/5G制式）
    IDT_vhrReportEnable: category=VALUE, base-type=sint32
    IDT_ADAS_enum_NOALCCSwitchBtnONOFFSts: category=VALUE, base-type=uint8  # NOA与LCC切换按钮显示状态
    IDT_ICC_strt_HPASetOnwayLabel: category=STRUCTURE
      4 x element, all with category=TYPE_REFERENCE:
        DTE_SetOnwayLabelID: implementation-data-type=IDT_Gen_val_ID  # 设置沿途标签的ID
        DTE_SetOnwayLabelType: implementation-data-type=IDT_ICC_enum_SetOnwayLabelType  # 设置沿途标签的类型
        DTE_SetOnwayLabelPoit: implementation-data-type=IDT_ICC_strt_HPAPathInfo  # 设置标签的坐标
        DTE_HPASetOnwayReserved: implementation-data-type=IDT_HPASetOnway_arr_Reserved  # 预留
    IDT_ICC_enum_RGearDefaultFunctionBtnSt: category=VALUE, base-type=uint8  # R挡默认打开项设置
    IDT_ICC_enum_FSRACruiseSpdOffsetMod: category=VALUE, base-type=uint8  # 设定偏移方式
    IDT_Enum_GNSSType2: category=VALUE, base-type=uint8  # GNSS信息
    IDT_Enum_GNSSType1: category=VALUE, base-type=uint8  # GNSS信息
    IDT_CellularCellId: category=VALUE, base-type=uint64  # 小区信息
    IDT_ADASSettingInfo_arr_Reserved2: category=ARRAY  # 预留
      element Reserved_uint8_Type: array-size=89, array-size-semantics=FIXED-SIZE, implementation-data-type=IDT_Reserved_uint8_Type
    IDT_ADAS_arr_ParkingStaticObjects: category=STRUCTURE, dynamic-array-size-profile=VSA_LINEAR  # 泊车静态目标数组
      element sizeIndicator: implementation-data-type=specialIDT_DynamicLengthField_uint32
      element IDT_ADAS_arr_ParkingStaticObjects: category=ARRAY
        element IDT_ADAS_arr_ParkingStaticObjects: array-size=42, array-size-handling=ALL-INDICES-SAME-ARRAY-SIZE, array-size-semantics=VARIABLE-SIZE, implementation-data-type=IDT_ADAS_strt_StaticObject
    IDT_ICC_enum_AMAPSwtSet: category=VALUE, base-type=uint8  # 加速踏板防误踩设置项开关
    IDT_ADAS_strt_MRAInfo: category=STRUCTURE
      7 x element, all with category=TYPE_REFERENCE:
        DTE_MRASts: implementation-data-type=IDT_ADAS_enum_MRASts  # 循迹倒车状态信息
        DTE_MRATrajRecordDist: implementation-data-type=IDT_ADAS_val_ParkingDist  # 循迹倒车记录路径长度
        DTE_MRACheckSts: implementation-data-type=IDT_ADAS_enum_MRACheckSts  # 循迹倒车不能激活原因
        DTE_MRATrajRemainingDist: implementation-data-type=IDT_ADAS_val_ParkingDist  # 循迹倒车剩余距离
        DTE_MRAAvaliableStatus: implementation-data-type=IDT_Gen_enum_AvailableSts  # 循迹倒车可用状态
        DTE_MRATrajectory: implementation-data-type=IDT_ADAS_arr_TrajectoryPoint  # 循迹倒车规划引导线
        DTE_MraOperationResp: implementation-data-type=IDT_ADAS_enum_ParkingOperationResp  # MRA按键状态反馈
    IDT_StrVar_BleMasterVer: category=STRUCTURE, dynamic-array-size-profile=VSA_LINEAR  # 蓝牙主模块软件版本
      element sizeIndicator: implementation-data-type=specialIDT_DynamicLengthField_uint32
      element IDT_StrVar_BleMasterVer: category=ARRAY
        element IDT_StrVar_BleMasterVer: array-size=24, array-size-handling=ALL-INDICES-SAME-ARRAY-SIZE, array-size-semantics=VARIABLE-SIZE, implementation-data-type=specialIDT_StringRef
    IDT_Bool_Almanac: category=VALUE, base-type=uint8  # 是否有历书信息 Is there any almanac information
    IDT_ICC_enum_NavIsTimeSpeedLimit: category=VALUE, base-type=uint8  # 时间限速状态
    IDT_ADAS_arr_VPARoadLine: category=STRUCTURE, dynamic-array-size-profile=VSA_LINEAR  # VPA中心道路信息
      element sizeIndicator: implementation-data-type=specialIDT_DynamicLengthField_uint32
      element IDT_ADAS_arr_VPARoadLine: category=ARRAY
        element IDT_ADAS_arr_VPARoadLine: array-size=100, array-size-handling=ALL-INDICES-SAME-ARRAY-SIZE, array-size-semantics=VARIABLE-SIZE, implementation-data-type=IDT_ADAS_strt_VPARoadLinePoint
    IDT_ADAS_enum_LDPSts: category=VALUE, base-type=uint8
    IDT_Enum_KPI_DataInLoopUnit: category=VALUE, base-type=uint8
    IDT_ICC_strt_CongestionInfo: category=STRUCTURE  # 交通拥堵详细信息
      24 x element, all with category=TYPE_REFERENCE:
        DTE_TimeOfSeconds: implementation-data-type=IDT_ICC_int32_Time  # 预计通过该拥堵段的时长（单位:秒）
        DTE_ScopeFlag: implementation-data-type=IDT_ICC_boolean_ScopeFlag_1  # 当前自车位置是否在拥堵区域内
        DTE_BeginSegmentIndex: implementation-data-type=IDT_ICC_int32_Index  # 拥堵段的起始导航段索引
        DTE_BeginLinkIndex: implementation-data-type=IDT_ICC_int32_Index  # 拥堵段的起始link段索引
        DTE_BeginLinkRoadName: implementation-data-type=IDT_ICC_string_RoadName  # 拥堵段的起始link段的道路名
        DTE_BeginSectionIndex: implementation-data-type=IDT_ICC_int32_Index  # 拥堵段的起始精细化段索引
        DTE_EndSegmentIndex: implementation-data-type=IDT_ICC_int32_Index  # 拥堵段的结束导航段索引
        DTE_EndLinkIndex: implementation-data-type=IDT_ICC_int32_Index  # 拥堵段的结束link段索引
        DTE_EndSectionIndex: implementation-data-type=IDT_ICC_int32_Index  # 拥堵段的结束精细化段索引
        DTE_CongestionStatus: implementation-data-type=IDT_ICC_int32_CongestionStatus  # 拥堵程度
        DTE_RemainDist: implementation-data-type=IDT_ICC_int32_Dist  # 当前剩余拥堵长度
        DTE_BeginExactLength: implementation-data-type=IDT_ICC_int32_Dist  # 起始段精细化段的距离，若为0表示起始段为非精细化段
        DTE_BeginCoorIndex: implementation-data-type=IDT_ICC_int32_Index  # 拥堵起点区域最近（拥堵起始点前）的形状点索引
        DTE_EndExactLength: implementation-data-type=IDT_ICC_int32_Dist  # 结束段精细化段的距离，若为0表示结束段为非精细化段
        DTE_EndCoorIndex: implementation-data-type=IDT_ICC_int32_Index  # 拥堵结束区域最近（拥堵结束点前）的形状点索引
        DTE_BeginExactLength3D: implementation-data-type=IDT_ICC_int32_Dist  # 3D起始段精细化段的距离，若为0表示起始段为非精细化段
        DTE_BeginExactPoint3D: implementation-data-type=IDT_ICC_strt_Coord3DDouble  # 3D拥堵区域的起始点真实坐标
        DTE_BeginCoorIndex3D: implementation-data-type=IDT_ICC_int32_Index  # 3D拥堵起点区域最近（拥堵起始点前）的形状点索引
        DTE_EndExactLength3D: implementation-data-type=IDT_ICC_int32_Dist  # 3D结束段精细化段的距离，若为0表示结束段为非精细化段
        DTE_EndExactPoint3D: implementation-data-type=IDT_ICC_strt_Coord3DDouble  # 3D拥堵区域的结束点真实坐标
        DTE_EndCoorIndex3D: implementation-data-type=IDT_ICC_int32_Index  # 3D拥堵结束区域最近（拥堵结束点前）的形状点索引
        DTE_BeginExactPoint: implementation-data-type=IDT_ICC_strt_Coord2DDouble  # 拥堵区域的起始点真实坐标
        DTE_EndExactPoint: implementation-data-type=IDT_ICC_strt_Coord2DDouble  # 拥堵区域的结束点真实坐标
        DTE_CongestionReserved: implementation-data-type=IDT_Congestion_arr_Reserved  # 预留
    IDT_ICC_enum_SetOnwayLabelType: category=VALUE, base-type=uint8
    IDT_ADAS_strt_RoadMarkerSupplement: category=STRUCTURE
      6 x element, all with category=TYPE_REFERENCE:
        DTE_RoadMarkerPose3X: implementation-data-type=IDT_Gen_val_Coordinate_X  # 路面标记点3X坐标
        DTE_RoadMarkerPose3Y: implementation-data-type=IDT_Gen_val_Coordinate_Y  # 路面标记点3Y坐标
        DTE_RoadMarkerPose4X: implementation-data-type=IDT_Gen_val_Coordinate_X  # 路面标记点4X坐标
        DTE_RoadMarkerPose4Y: implementation-data-type=IDT_Gen_val_Coordinate_Y  # 路面标记点4Y坐标
        DTE_RoadMarkerColor: implementation-data-type=IDT_ADAS_enum_RoadMarkerColor  # 路面标记颜色
        DTE_RoadMarkerSupplementReserved: implementation-data-type=IDT_RoadMarkerSupplement_arr_Reserved  # 预留
    IDT_ADAS_enum_SlotType: category=VALUE, base-type=uint8
    IDT_ADAS_enum_LKS_WarnSensitivity: category=VALUE, base-type=uint8  # LKS预警灵敏度
    IDT_ADAS_enum_VPAFunctionType: category=VALUE, base-type=uint8
    IDT_ADAS_enum_AESActiveSt: category=VALUE, base-type=uint8
    IDT_ApnIndex: category=VALUE, base-type=sint32
    IDT_DSTFlag: category=VALUE, base-type=uint8  # 表示当前是否处于夏令时
    IDT_ADAS_strt_ParkingSlot: category=STRUCTURE
      9 x element, all with category=TYPE_REFERENCE:
        DTE_SlotID: implementation-data-type=IDT_ADAS_val_SlotID  # 车位ID
        DTE_SlotType: implementation-data-type=IDT_ADAS_enum_SlotType  # 车位类型
        DTE_SlotStatus: implementation-data-type=IDT_ADAS_enum_SlotStatus  # 车位可用状态
        DTE_SlotPointTop1: implementation-data-type=IDT_ADAS_strt_SlotPoint  # 车位顶点1
        DTE_SlotPointTop2: implementation-data-type=IDT_ADAS_strt_SlotPoint  # 车位顶点2
        DTE_SlotPointBottom1: implementation-data-type=IDT_ADAS_strt_SlotPoint  # 车位顶点3
        DTE_SlotPointBottom2: implementation-data-type=IDT_ADAS_strt_SlotPoint  # 车位顶点4
        DTE_SlotNum: implementation-data-type=IDT_Gen_val_ID  # 车位序号
        DTE_SlotWheelStopperInfo: implementation-data-type=IDT_ADAS_strt_SlotWheelStopperInfo  # 车位轮挡信息
    IDT_StrVar_IMEIInfo: category=STRUCTURE, dynamic-array-size-profile=VSA_LINEAR  # 国际移动台设备识别码信息
      element sizeIndicator: implementation-data-type=specialIDT_DynamicLengthField_uint32
      element IDT_StrVar_IMEIInfo: category=ARRAY
        element IDT_StrVar_IMEIInfo: array-size=15, array-size-handling=ALL-INDICES-SAME-ARRAY-SIZE, array-size-semantics=VARIABLE-SIZE, implementation-data-type=specialIDT_StringRef
    IDT_ADAS_enum_DAIReminder: category=VALUE, base-type=uint8
    IDT_ICC_Navi_Latitude: category=VALUE, base-type=float32
    IDT_ResetCommand: category=VALUE, base-type=uint32  # 恢厂命令
    IDT_ICC_int32_CityCode: category=VALUE, base-type=sint32
    IDT_Traffic3DSign_arr_Reserved: category=ARRAY
      element Reserved_uint8_Type: array-size=10, array-size-semantics=FIXED-SIZE, implementation-data-type=IDT_Reserved_uint8_Type
    IDT_ADAS_val_SlotID: category=VALUE, base-type=uint16
    IDT_ADAS_enum_VPAQuitInd: category=VALUE, base-type=uint8
    IDT_Struct_CallNumberList: category=STRUCTURE  # 电话号码列表
      element DTE_CallType: implementation-data-type=IDT_Enum_CallType  # 电话号码类型
      element DTE_PhoneNumber: implementation-data-type=IDT_StrVar_PhoneNumber  # 电话号码
    IDT_Gen_int32_ID: category=VALUE, base-type=sint32
    IDT_ADAS_enum_NOPLaneChangeInfo: category=VALUE, base-type=uint8  # 领航辅助变道状态信息
    IDT_Gen_val_int64: category=VALUE, base-type=sint64
    IDT_EphemerisDataSwitch: category=STRUCTURE  # 星历请求/停止命令
      element DTE_ephemerisDataSwitchCmd: implementation-data-type=IDT_EphemerisDataSwitchCmd  # 星历数据开关指令
      element DTE_ephemerisDataType: implementation-data-type=IDT_EphemerisDataType  # 星历数据类型
    IDT_ADAS_strt_TrafficLight: category=STRUCTURE
      7 x element, all with category=TYPE_REFERENCE:
        DTE_trafficLightId: implementation-data-type=IDT_Gen_val_ID  # 交通灯ID
        DTE_trafficLightType: implementation-data-type=IDT_ADAS_enum_TrafficLightType  # 交通灯类型
        DTE_trafficLightColor: implementation-data-type=IDT_ADAS_enum_TrafficLightColor  # 交通灯颜色
        DTE_remainingTime: implementation-data-type=IDT_ADAS_val_TrafficLightCountdownNumber  # 交通灯剩余时间
        DTE_TrafficLightPosX: implementation-data-type=IDT_Gen_val_Coordinate_X  # 交通灯位置X
        DTE_TrafficLightPosY: implementation-data-type=IDT_Gen_val_Coordinate_Y  # 交通灯位置Y
        DTE_TrafficLightPosZ: implementation-data-type=IDT_Gen_val_Coordinate_Z  # 交通灯位置Z
    IDT_L2NCAState: category=VALUE, base-type=uint8  # L2NCA状态信息
    IDT_Heading: category=VALUE, base-type=float32
    IDT_ADAS_strt_SpeedBumpInfo: category=STRUCTURE
      7 x element, all with category=TYPE_REFERENCE:
        DTE_SpeedBumpId: implementation-data-type=IDT_Gen_val_ID  # 减速带id
        DTE_SpeedBumpPoseX: implementation-data-type=IDT_Gen_val_Coordinate_X  # 减速带X坐标
        DTE_SpeedBumpPoseY: implementation-data-type=IDT_Gen_val_Coordinate_Y  # 减速带Y坐标
        DTE_SpeedBumpPoseZ: implementation-data-type=IDT_Gen_val_Coordinate_Z  # 减速带Z坐标
        DTE_SpeedBumpLength: implementation-data-type=IDT_Gen_val_Length  # 减速带长度
        DTE_SpeedBumpWidth: implementation-data-type=IDT_Gen_val_Width  # 减速带宽度
        DTE_SpeedBumpHeight: implementation-data-type=IDT_Gen_val_Height  # 减速带高度
    IDT_ADAS_val_FusionMetaData: category=VALUE, base-type=float64
    IDT_ValetParkingActiveStatus: category=VALUE, base-type=uint32  # 代客泊车运行激活状态
    IDT_NanoSecondTimeStampOffset: category=VALUE, base-type=sint64  # 纳秒差值
    IDT_StrVar_EcuVerison: category=STRUCTURE, dynamic-array-size-profile=VSA_LINEAR  # ECU版本号
      element sizeIndicator: implementation-data-type=specialIDT_DynamicLengthField_uint32
      element IDT_StrVar_EcuVerison: category=ARRAY
        element IDT_StrVar_EcuVerison: array-size=64, array-size-handling=ALL-INDICES-SAME-ARRAY-SIZE, array-size-semantics=VARIABLE-SIZE, implementation-data-type=specialIDT_StringRef
    IDT_ADAS_strt_HPATrainingPathInfo: category=STRUCTURE
      8 x element, all with category=TYPE_REFERENCE:
        DTE_HpaTrainingPathID: implementation-data-type=IDT_Gen_val_ID  # 路线ID
        DTE_TrainingPathName: implementation-data-type=IDT_ADAS_string_PathName  # 路线名称
        DTE_HPAtrainingPathCurrentDist: implementation-data-type=IDT_ADAS_val_ParkingDist  # 记忆泊车路线学习实时累计距离
        DTE_TrainingPathLength: implementation-data-type=IDT_ADAS_val_ParkingDist  # 路线长度
        DTE_TrainingLinePoint: implementation-data-type=IDT_ADAS_arr_PathPoint  # 路线学习点集
        DTE_HPATrainingPathSlotInfo: implementation-data-type=IDT_ADAS_arr_HPAPathslot  # 路线记忆车位
        DTE_HPASpeedBumpInfo: implementation-data-type=IDT_ADAS_arr_HPASpeedBumpInfo  # 路线记忆减速带
        DTE_TrainingPathLabel: implementation-data-type=IDT_ADAS_enum_PathLabel  # 路线标签
    IDT_ADAS_enum_DegradeReminder: category=VALUE, base-type=uint8
    IDT_ADS_ReservedUnit8: category=VALUE, base-type=uint8  # uint8类型保留字段
    IDT_ADAS_strt_RoadSurfaceMesh: category=STRUCTURE  # 可行驶区域渲染
      11 x element, all with category=TYPE_REFERENCE:
        DTE_SurfaceMeshAvailable: implementation-data-type=IDT_ADAS_uint8_Available
        DTE_SurfaceMeshScoreMap: implementation-data-type=IDT_ADAS_arr_ScoreMap  # 网格置信度
        DTE_SurfaceMeshBevh: implementation-data-type=IDT_ADAS_uint16_SurfaceMeshBevh
        DTE_SurfaceMeshBevw: implementation-data-type=IDT_ADAS_uint16_SurfaceMeshBevw
        DTE_SurfaceMeshXboundMin: implementation-data-type=IDT_ADAS_val_XboundMin
        DTE_SurfaceMeshXboundMax: implementation-data-type=IDT_ADAS_val_XboundMax
        DTE_SurfaceMeshYboundMin: implementation-data-type=IDT_ADAS_val_YboundMin
        DTE_SurfaceMeshYboundMax: implementation-data-type=IDT_ADAS_val_YboundMax
        DTE_MeshMeterPerPixelx: implementation-data-type=IDT_ADAS_val_MeterPerPixelx
        DTE_MeshMeterPerPixely: implementation-data-type=IDT_ADAS_val_MeterPerPixely
        DTE_SurfaceMeshReserved: implementation-data-type=IDT_SurfaceMesh_arr_Reserved
    IDT_Struct_NetworkStatus: category=STRUCTURE  # 移动网络状态信息
      7 x element, all with category=TYPE_REFERENCE:
        DTE_DataConnection: implementation-data-type=IDT_Enum_DataConnection  # 数据连接是否有效
        DTE_SimCardRegistraionStatus: implementation-data-type=IDT_Enum_SimCardRegistraionStatus  # Sim卡注册状态
        DTE_MobileNetworkType: implementation-data-type=IDT_Enum_MobileNetworkType  # 移动网络类型
        DTE_Roaming: implementation-data-type=IDT_Enum_Roaming  # 是否出于漫游中
        DTE_SignalStrength: implementation-data-type=IDT_Integer_SignalStrength  # 信号强度
        DTE_RouterIPAddress: implementation-data-type=IDT_StrVar_RouterIPAddress  # 路由器IP
        DTE_VPNIPAddress: implementation-data-type=IDT_StrVar_VPNIPAddress  # VPN IP
    IDT_ADAS_Stub_FuncRoadClass: category=VALUE, base-type=uint8
    IDT_ADAS_enum_ACCQuitReason: category=VALUE, base-type=uint8
    IDT_ADAS_arr_VPAFloor: category=STRUCTURE, dynamic-array-size-profile=VSA_LINEAR  # VPA楼层列表
      element sizeIndicator: implementation-data-type=specialIDT_DynamicLengthField_uint32
      element IDT_ADAS_arr_VPAFloor: category=ARRAY
        element IDT_ADAS_arr_VPAFloor: array-size=50, array-size-handling=ALL-INDICES-SAME-ARRAY-SIZE, array-size-semantics=VARIABLE-SIZE, implementation-data-type=IDT_ADAS_enum_VPAFloor
    IDT_Enum_BleKeyFilling: category=VALUE, base-type=uint8  # 蓝牙秘钥灌装状态
    IDT_CellularMnc: category=VALUE, base-type=uint32  # 移动网络码
    IDT_ADAS_enum_ALCTakeOverRequest: category=VALUE, base-type=uint8
    IDT_PrkgSlot_arr_Reserved: category=ARRAY  # 预留
      element Reserved_uint8_Type: array-size=20, array-size-semantics=FIXED-SIZE, implementation-data-type=IDT_Reserved_uint8_Type
    IDT_ADAS_enum_TolDatauploadBtnFb: category=VALUE, base-type=uint8  # 一键数据回传信息反馈
    IDT_ICC_string_LightDesc: category=STRUCTURE, dynamic-array-size-profile=VSA_LINEAR  # 灯态列表
      element sizeIndicator: implementation-data-type=specialIDT_DynamicLengthField_uint32
      element IDT_ICC_string_LightDesc: category=ARRAY
        element IDT_ICC_string_LightDesc: array-size=1000, array-size-handling=ALL-INDICES-SAME-ARRAY-SIZE, array-size-semantics=VARIABLE-SIZE, implementation-data-type=specialIDT_StringRef
    IDT_MRAInfo_arr_Reserved: category=ARRAY
      element Reserved_uint8_Type: array-size=50, array-size-semantics=FIXED-SIZE, implementation-data-type=IDT_Reserved_uint8_Type
    IDT_ICC_strt_ApaRpaFcnOperating: category=STRUCTURE
      5 x element, all with category=TYPE_REFERENCE:
        DTE_ApaOperationId: implementation-data-type=IDT_ICC_enum_ApaOperationId  # APA功能操作指令
        DTE_ApaModeReq: implementation-data-type=IDT_ICC_enum_ApaModeReq  # APA模式选择指令
        DTE_ApaSelectSlotID: implementation-data-type=IDT_ICC_uint16_SelectSlotID  # APA选择车位ID
        DTE_ApaPocDirection: implementation-data-type=IDT_ICC_enum_ApaPocDirection  # APA泊出方向指令
        DTE_ApaFreeSlotInfo: implementation-data-type=IDT_ICC_strt_ApaFreeSlotInfo  # APA自选车位信息
    IDT_ICC_strt_TmcInfoDataBean: category=STRUCTURE
      6 x element, all with category=TYPE_REFERENCE:
        DTE_TmcInfoNumber: implementation-data-type=IDT_Gen_val_int32  # 路况柱状图每段的编号，编号越小越靠近起点，从1开始
        DTE_TmcInfoStatus: implementation-data-type=IDT_ICC_int32_TmcInfoStatus  # 每段柱状图信息
        DTE_TmcInfoDistance: implementation-data-type=IDT_ICC_int32_Dist  # 路况柱状图每段的路程距离，单位米
        DTE_TmcInfoPercent: implementation-data-type=IDT_ICC_float_Percent  # 每段路况柱状图占总路程的百分比（0～1）
        DTE_TmcInfoTravelTime: implementation-data-type=IDT_ICC_int32_Time  # 路况柱状图每一段的预计通行时间，单位s
        DTE_TmcInfoReserved: implementation-data-type=IDT_TmcInfo_arr_Reserved  # 预留
    IDT_Struct_TBOXOTAState: category=STRUCTURE  # 发送OTA状态给TBOX
      4 x element, all with category=TYPE_REFERENCE:
        DTE_usid: implementation-data-type=IDT_StrVar_usid  # 会话ID
        DTE_ScheduleID: implementation-data-type=IDT_StrVar_ScheduleID  # OTA的任务ID
        DTE_ScheduleTime: implementation-data-type=IDT_ScheduleTime  # OTA的任务时间
        DTE_State: implementation-data-type=IDT_StrVar_State  # OTA状态
    IDT_ICC_enum_FSRACruiseSpdOffsetPercent: category=VALUE, base-type=sint8  # 百分比偏移速度
    IDT_Gen_enum_OnOffSts: category=VALUE, base-type=uint8
    IDT_Altitude: category=VALUE, base-type=float32
    IDT_ADAS_enum_TrafficLightType: category=VALUE, base-type=uint8
    IDT_ADAS_enum_AebSts: category=VALUE, base-type=uint8
    IDT_ADAS_string_VPASpotName: category=STRUCTURE, dynamic-array-size-profile=VSA_LINEAR  # VPA车位名
      element sizeIndicator: implementation-data-type=specialIDT_DynamicLengthField_uint32
      element IDT_ADAS_string_VPASpotName: category=ARRAY
        element IDT_ADAS_string_VPASpotName: array-size=50, array-size-handling=ALL-INDICES-SAME-ARRAY-SIZE, array-size-semantics=VARIABLE-SIZE, implementation-data-type=specialIDT_StringRef
    IDT_ADAS_strt_VPASelfBuildMap: category=STRUCTURE  # 自建图基本信息
      11 x element, all with category=TYPE_REFERENCE:
        DTE_VPAParkingSlotList: implementation-data-type=IDT_ADAS_arr_VPAParkingSLot  # 自建图车位列表
        DTE_VPATargetParkingSlotId: implementation-data-type=IDT_ADAS_val_SlotID  # VPA选中的目标库位
        DTE_VPARoadLineList: implementation-data-type=IDT_ADAS_arr_VPARoadLine  # VPA地图的道路路线
        DTE_VPATargetEntranceId: implementation-data-type=IDT_Gen_val_ID  # 目标停车场入口id
        DTE_VPAEntrance: implementation-data-type=IDT_ADAS_arr_VPAEntrance  # VPA入口信息
        DTE_VPASpots: implementation-data-type=IDT_ADAS_arr_VPASpots  # VPA用户特殊车位属性信息
        DTE_VPALayerInfo: implementation-data-type=IDT_ADAS_strt_VPALayerInfo  # VPA自建图所有层级信息
        DTE_VPALayerRange: implementation-data-type=IDT_ADAS_arr_VPARange  # VPA每一层的地图的范围，用于大地图渲染
        DTE_VPASpeedBumpList: implementation-data-type=IDT_ADAS_arr_VPASpeedBump  # 自建图减速带信息
        DTE_VPADefaultParkingSlotId: implementation-data-type=IDT_ADAS_val_SlotID  # 默认车位id
        DTE_VPAStaticObjects: implementation-data-type=IDT_ADAS_arr_VPAStaticObjects  # 静态障碍物，包含柱子
    IDT_ICC_enum_CruiseFacilityType: category=VALUE, base-type=sint8
    IDT_ICC_int32_NotAvoidType: category=VALUE, base-type=sint32
    IDT_Enum_TBOXOTAState: category=VALUE, base-type=uint8  # 响应收到发送OTA状态给TBOX
    IDT_ADAS_val_timestampnSec: category=VALUE, base-type=uint64
    IDT_ICC_strt_NaviWeatherInfo: category=STRUCTURE  # 天气信息
      element DTE_NaviPathID: implementation-data-type=IDT_Gen_int64_ID  # 路线ID
      element DTE_NaviWeatherInfo: implementation-data-type=IDT_ICC_arr_NaviWeatherInfo  # 天气详细信息
      element DTE_NaviWeatherReserved: implementation-data-type=IDT_NaviWeather_arr_Reserved  # 预留
    IDT_ADAS_arr_LinePoint: category=STRUCTURE, dynamic-array-size-profile=VSA_LINEAR  # 车道线形点数组
      element sizeIndicator: implementation-data-type=specialIDT_DynamicLengthField_uint32
      element IDT_ADAS_arr_LinePoint: category=ARRAY
        element IDT_ADAS_arr_LinePoint: array-size=300, array-size-handling=ALL-INDICES-SAME-ARRAY-SIZE, array-size-semantics=VARIABLE-SIZE, implementation-data-type=IDT_ADAS_strt_LinePoint
    IDT_ICC_string_LevelName: category=STRUCTURE, dynamic-array-size-profile=VSA_LINEAR  # 预警名称
      element sizeIndicator: implementation-data-type=specialIDT_DynamicLengthField_uint32
      element IDT_ICC_string_LevelName: category=ARRAY
        element IDT_ICC_string_LevelName: array-size=200, array-size-handling=ALL-INDICES-SAME-ARRAY-SIZE, array-size-semantics=VARIABLE-SIZE, implementation-data-type=specialIDT_StringRef
    IDT_HpaFcn_arr_Reserved: category=ARRAY  # 预留
      element Reserved_uint8_Type: array-size=50, array-size-semantics=FIXED-SIZE, implementation-data-type=IDT_Reserved_uint8_Type
    IDT_UTC: category=VALUE, base-type=sint64
    IDT_ACCURACY: category=VALUE, base-type=uint32  # 精度
    IDT_ADAS_enum_ParkingChimeVoice: category=VALUE, base-type=uint8
    IDT_ADAS_val_FSRACruiseSpdOffsetSpdFb: category=VALUE, base-type=sint8
    IDT_ADAS_Meta_MapVerYear: category=VALUE, base-type=uint8
    IDT_ADAS_enum_MNPMemRouteUseFreq: category=VALUE, base-type=uint8  # 路线使用频率
    IDT_ICC_enum_HPAUndoOperationID: category=VALUE, base-type=uint8
    IDT_StrVar_Telephonenumber: category=STRUCTURE, dynamic-array-size-profile=VSA_LINEAR  # 电话号码
      element sizeIndicator: implementation-data-type=specialIDT_DynamicLengthField_uint32
      element IDT_StrVar_Telephonenumber: category=ARRAY
        element IDT_StrVar_Telephonenumber: array-size=15, array-size-handling=ALL-INDICES-SAME-ARRAY-SIZE, array-size-semantics=VARIABLE-SIZE, implementation-data-type=specialIDT_StringRef
    IDT_ADAS_Stub_CycCnt: category=VALUE, base-type=uint8
    IDT_ICC_val_altitude: category=VALUE, base-type=float64  # 高度
    IDT_LanePositionInfo_offset: category=VALUE, base-type=float32
    IDT_ADAS_enum_LightColor: category=VALUE, base-type=uint8  # 红绿灯颜色
    IDT_ADAS_strt_TrafficSign_2: category=STRUCTURE
      6 x element, all with category=TYPE_REFERENCE:
        DTE_TSRSt: implementation-data-type=IDT_ADAS_enum_TSRSt  # TSR功能状态
        DTE_TrafficSignId: implementation-data-type=IDT_Gen_uint64_ID  # 交通标志ID
        DTE_TrafficSignType: implementation-data-type=IDT_ADAS_enum_TrafficSignType  # 交通标志类型
        DTE_TrafficSignPosX: implementation-data-type=IDT_Gen_val_Coordinate_X  # 交通标志位置X
        DTE_TrafficSignPosY: implementation-data-type=IDT_Gen_val_Coordinate_Y  # 交通标志位置Y
        DTE_TrafficSignPosZ: implementation-data-type=IDT_Gen_val_Coordinate_Z  # 交通标志位置Z
    IDT_ADAS_enum_MNPDelRouteSts: category=VALUE, base-type=uint8  # 删除路线是否成功
    IDT_ADAS_enum_HpaActiveCheckSts: category=VALUE, base-type=uint8
    IDT_EphemerisDataFormat: category=VALUE, base-type=uint32  # 星历数据格式
    IDT_Enum_TollLaneType: category=VALUE, base-type=sint32  # 收费站通道类型 Toll gate lane types
