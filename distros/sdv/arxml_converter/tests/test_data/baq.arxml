[part 2 of 11: package /Communication/PDUs]
AUTOSAR XML (schema 00048)
package /Communication/PDUs  (continued)
  pdu SIGIPDU_RR_RR_BleModuleInfo_call_Cis_LCM_TBOX_SystemInfo: has-dynamic-length=true, length=8, transmission-mode-true-timing=event-controlled-timing=number-of-repetitions=0
    signal SIG_RR_RR_BleModuleInfo_call_Cis_LCM_TBOX_SystemInfo: start 0, 0 bit, opaque, data-transformations=SOME_IP_Default_Transformation, data-type-policy=TRANSFORMING-I-SIGNAL, someip-transformation-i-signal-props{transformer=SOME_IP_Default_Transformer, message-type=REQUEST}, dynamic-length=true, transfer-property=TRIGGERED, to TBOX
  pdu SIGIPDU_RR_RR_BleModuleInfo_return_Cis_LCM_TBOX_SystemInfo: has-dynamic-length=false, length=236, transmission-mode-true-timing=event-controlled-timing=number-of-repetitions=0
    signal SIG_RR_RR_BleModuleInfo_return_Cis_LCM_TBOX_SystemInfo: start 0, 1824 bit, opaque, data-transformations=SOME_IP_Default_Transformation, data-type-policy=TRANSFORMING-I-SIGNAL, someip-transformation-i-signal-props{transformer=SOME_IP_Default_Transformer, message-type=RESPONSE}, transfer-property=TRIGGERED, to LCM
  pdu SIGIPDU_RR_RR_VIN_call_Cis_LCM_TBOX_SystemInfo: has-dynamic-length=true, length=8, transmission-mode-true-timing=event-controlled-timing=number-of-repetitions=0
    signal SIG_RR_RR_VIN_call_Cis_LCM_TBOX_SystemInfo: start 0, 0 bit, opaque, data-transformations=SOME_IP_Default_Transformation, data-type-policy=TRANSFORMING-I-SIGNAL, someip-transformation-i-signal-props{transformer=SOME_IP_Default_Transformer, message-type=REQUEST}, dynamic-length=true, transfer-property=TRIGGERED, to TBOX
  pdu SIGIPDU_RR_RR_VIN_return_Cis_LCM_TBOX_SystemInfo: has-dynamic-length=true, length=32, transmission-mode-true-timing=event-controlled-timing=number-of-repetitions=0
    signal SIG_RR_RR_VIN_return_Cis_LCM_TBOX_SystemInfo: start 0, 192 bit, opaque, data-transformations=SOME_IP_Default_Transformation, data-type-policy=TRANSFORMING-I-SIGNAL, someip-transformation-i-signal-props{transformer=SOME_IP_Default_Transformer, message-type=RESPONSE}, dynamic-length=true, transfer-property=TRIGGERED, to LCM
  pdu SIGIPDU_RR_RR_SIMCardinfo_call_Cis_LCM_TBOX_SystemInfo: has-dynamic-length=true, length=8, transmission-mode-true-timing=event-controlled-timing=number-of-repetitions=0
    signal SIG_RR_RR_SIMCardinfo_call_Cis_LCM_TBOX_SystemInfo: start 0, 0 bit, opaque, data-transformations=SOME_IP_Default_Transformation, data-type-policy=TRANSFORMING-I-SIGNAL, someip-transformation-i-signal-props{transformer=SOME_IP_Default_Transformer, message-type=REQUEST}, dynamic-length=true, transfer-property=TRIGGERED, to TBOX
  pdu SIGIPDU_RR_RR_SIMCardinfo_return_Cis_LCM_TBOX_SystemInfo: has-dynamic-length=false, length=76, transmission-mode-true-timing=event-controlled-timing=number-of-repetitions=0
    signal SIG_RR_RR_SIMCardinfo_return_Cis_LCM_TBOX_SystemInfo: start 0, 544 bit, opaque, data-transformations=SOME_IP_Default_Transformation, data-type-policy=TRANSFORMING-I-SIGNAL, someip-transformation-i-signal-props{transformer=SOME_IP_Default_Transformer, message-type=RESPONSE}, transfer-property=TRIGGERED, to LCM
  pdu SIGIPDU_RR_RR_IMEIInfo_call_Cis_LCM_TBOX_SystemInfo: has-dynamic-length=true, length=8, transmission-mode-true-timing=event-controlled-timing=number-of-repetitions=0
    signal SIG_RR_RR_IMEIInfo_call_Cis_LCM_TBOX_SystemInfo: start 0, 0 bit, opaque, data-transformations=SOME_IP_Default_Transformation, data-type-policy=TRANSFORMING-I-SIGNAL, someip-transformation-i-signal-props{transformer=SOME_IP_Default_Transformer, message-type=REQUEST}, dynamic-length=true, transfer-property=TRIGGERED, to TBOX
  pdu SIGIPDU_RR_RR_IMEIInfo_return_Cis_LCM_TBOX_SystemInfo: has-dynamic-length=true, length=28, transmission-mode-true-timing=event-controlled-timing=number-of-repetitions=0
    signal SIG_RR_RR_IMEIInfo_return_Cis_LCM_TBOX_SystemInfo: start 0, 160 bit, opaque, data-transformations=SOME_IP_Default_Transformation, data-type-policy=TRANSFORMING-I-SIGNAL, someip-transformation-i-signal-props{transformer=SOME_IP_Default_Transformer, message-type=RESPONSE}, dynamic-length=true, transfer-property=TRIGGERED, to LCM
  pdu SIGIPDU_RR_RR_CallNumberList_call_Cis_LCM_TBOX_SystemInfo: has-dynamic-length=true, length=8, transmission-mode-true-timing=event-controlled-timing=number-of-repetitions=0
    signal SIG_RR_RR_CallNumberList_call_Cis_LCM_TBOX_SystemInfo: start 0, 0 bit, opaque, data-transformations=SOME_IP_Default_Transformation, data-type-policy=TRANSFORMING-I-SIGNAL, someip-transformation-i-signal-props{transformer=SOME_IP_Default_Transformer, message-type=REQUEST}, dynamic-length=true, transfer-property=TRIGGERED, to TBOX
  pdu SIGIPDU_RR_RR_CallNumberList_return_Cis_LCM_TBOX_SystemInfo: has-dynamic-length=true, length=84, transmission-mode-true-timing=event-controlled-timing=number-of-repetitions=0
    signal SIG_RR_RR_CallNumberList_return_Cis_LCM_TBOX_SystemInfo: start 0, 608 bit, opaque, data-transformations=SOME_IP_Default_Transformation, data-type-policy=TRANSFORMING-I-SIGNAL, someip-transformation-i-signal-props{transformer=SOME_IP_Default_Transformer, message-type=RESPONSE}, dynamic-length=true, transfer-property=TRIGGERED, to LCM
  pdu SIGIPDU_RR_RR_WorkModel_call_Cis_LCM_TBOX_SystemInfo: has-dynamic-length=true, length=8, transmission-mode-true-timing=event-controlled-timing=number-of-repetitions=0
    signal SIG_RR_RR_WorkModel_call_Cis_LCM_TBOX_SystemInfo: start 0, 0 bit, opaque, data-transformations=SOME_IP_Default_Transformation, data-type-policy=TRANSFORMING-I-SIGNAL, someip-transformation-i-signal-props{transformer=SOME_IP_Default_Transformer, message-type=REQUEST}, dynamic-length=true, transfer-property=TRIGGERED, to TBOX
  pdu SIGIPDU_RR_RR_WorkModel_return_Cis_LCM_TBOX_SystemInfo: has-dynamic-length=false, length=9, transmission-mode-true-timing=event-controlled-timing=number-of-repetitions=0
    signal SIG_RR_RR_WorkModel_return_Cis_LCM_TBOX_SystemInfo: start 0, 8 bit, opaque, data-transformations=SOME_IP_Default_Transformation, data-type-policy=TRANSFORMING-I-SIGNAL, someip-transformation-i-signal-props{transformer=SOME_IP_Default_Transformer, message-type=RESPONSE}, transfer-property=TRIGGERED, to LCM
  pdu SIGIPDU_RR_RR_CertificateIssuedMark_call_Cis_LCM_TBOX_SystemInfo: has-dynamic-length=true, length=8, transmission-mode-true-timing=event-controlled-timing=number-of-repetitions=0
    signal SIG_RR_RR_CertificateIssuedMark_call_Cis_LCM_TBOX_SystemInfo: start 0, 0 bit, opaque, data-transformations=SOME_IP_Default_Transformation, data-type-policy=TRANSFORMING-I-SIGNAL, someip-transformation-i-signal-props{transformer=SOME_IP_Default_Transformer, message-type=REQUEST}, dynamic-length=true, transfer-property=TRIGGERED, to TBOX
  pdu SIGIPDU_RR_RR_CertificateIssuedMark_return_Cis_LCM_TBOX_SystemInfo: has-dynamic-length=false, length=11, transmission-mode-true-timing=event-controlled-timing=number-of-repetitions=0
    signal SIG_RR_RR_CertificateIssuedMark_return_Cis_LCM_TBOX_SystemInfo: start 0, 24 bit, opaque, data-transformations=SOME_IP_Default_Transformation, data-type-policy=TRANSFORMING-I-SIGNAL, someip-transformation-i-signal-props{transformer=SOME_IP_Default_Transformer, message-type=RESPONSE}, transfer-property=TRIGGERED, to LCM
  pdu SIGIPDU_RR_RR_SetCallNumber_call_Cis_LCM_TBOX_SystemInfo: has-dynamic-length=false, length=32, transmission-mode-true-timing=event-controlled-timing=number-of-repetitions=0
    signal SIG_RR_RR_SetCallNumber_call_Cis_LCM_TBOX_SystemInfo: start 0, 192 bit, opaque, data-transformations=SOME_IP_Default_Transformation, data-type-policy=TRANSFORMING-I-SIGNAL, someip-transformation-i-signal-props{transformer=SOME_IP_Default_Transformer, message-type=REQUEST}, transfer-property=TRIGGERED, to TBOX
  pdu SIGIPDU_RR_RR_SetCallNumber_return_Cis_LCM_TBOX_SystemInfo: has-dynamic-length=false, length=32, transmission-mode-true-timing=event-controlled-timing=number-of-repetitions=0
    signal SIG_RR_RR_SetCallNumber_return_Cis_LCM_TBOX_SystemInfo: start 0, 192 bit, opaque, data-transformations=SOME_IP_Default_Transformation, data-type-policy=TRANSFORMING-I-SIGNAL, someip-transformation-i-signal-props{transformer=SOME_IP_Default_Transformer, message-type=RESPONSE}, transfer-property=TRIGGERED, to LCM
  pdu SIGIPDU_RR_RR_Cellinfo_call_Cis_LCM_TBOX_SystemInfo: has-dynamic-length=true, length=8, transmission-mode-true-timing=event-controlled-timing=number-of-repetitions=0
    signal SIG_RR_RR_Cellinfo_call_Cis_LCM_TBOX_SystemInfo: start 0, 0 bit, opaque, data-transformations=SOME_IP_Default_Transformation, data-type-policy=TRANSFORMING-I-SIGNAL, someip-transformation-i-signal-props{transformer=SOME_IP_Default_Transformer, message-type=REQUEST}, dynamic-length=true, transfer-property=TRIGGERED, to TBOX
  pdu SIGIPDU_RR_RR_Cellinfo_return_Cis_LCM_TBOX_SystemInfo: has-dynamic-length=false, length=36, transmission-mode-true-timing=event-controlled-timing=number-of-repetitions=0
    signal SIG_RR_RR_Cellinfo_return_Cis_LCM_TBOX_SystemInfo: start 0, 224 bit, opaque, data-transformations=SOME_IP_Default_Transformation, data-type-policy=TRANSFORMING-I-SIGNAL, someip-transformation-i-signal-props{transformer=SOME_IP_Default_Transformer, message-type=RESPONSE}, transfer-property=TRIGGERED, to LCM
  pdu SIGIPDU_RR_RR_VehicleDiag_call_Cis_LCM_TBOX_SystemInfo: has-dynamic-length=true, length=8, transmission-mode-true-timing=event-controlled-timing=number-of-repetitions=0
    signal SIG_RR_RR_VehicleDiag_call_Cis_LCM_TBOX_SystemInfo: start 0, 0 bit, opaque, data-transformations=SOME_IP_Default_Transformation, data-type-policy=TRANSFORMING-I-SIGNAL, someip-transformation-i-signal-props{transformer=SOME_IP_Default_Transformer, message-type=REQUEST}, dynamic-length=true, transfer-property=TRIGGERED, to TBOX
  pdu SIGIPDU_RR_RR_VehicleDiag_return_Cis_LCM_TBOX_SystemInfo: has-dynamic-length=false, length=9, transmission-mode-true-timing=event-controlled-timing=number-of-repetitions=0
    signal SIG_RR_RR_VehicleDiag_return_Cis_LCM_TBOX_SystemInfo: start 0, 8 bit, opaque, data-transformations=SOME_IP_Default_Transformation, data-type-policy=TRANSFORMING-I-SIGNAL, someip-transformation-i-signal-props{transformer=SOME_IP_Default_Transformer, message-type=RESPONSE}, transfer-property=TRIGGERED, to LCM
  pdu SIGIPDU_RR_RR_CurrenMonthTalkTime_call_Cis_LCM_TBOX_SystemInfo: has-dynamic-length=true, length=8, transmission-mode-true-timing=event-controlled-timing=number-of-repetitions=0
    signal SIG_RR_RR_CurrenMonthTalkTime_call_Cis_LCM_TBOX_SystemInfo: start 0, 0 bit, opaque, data-transformations=SOME_IP_Default_Transformation, data-type-policy=TRANSFORMING-I-SIGNAL, someip-transformation-i-signal-props{transformer=SOME_IP_Default_Transformer, message-type=REQUEST}, dynamic-length=true, transfer-property=TRIGGERED, to TBOX
  pdu SIGIPDU_RR_RR_CurrenMonthTalkTime_return_Cis_LCM_TBOX_SystemInfo: has-dynamic-length=false, length=20, transmission-mode-true-timing=event-controlled-timing=number-of-repetitions=0
    signal SIG_RR_RR_CurrenMonthTalkTime_return_Cis_LCM_TBOX_SystemInfo: start 0, 96 bit, opaque, data-transformations=SOME_IP_Default_Transformation, data-type-policy=TRANSFORMING-I-SIGNAL, someip-transformation-i-signal-props{transformer=SOME_IP_Default_Transformer, message-type=RESPONSE}, transfer-property=TRIGGERED, to LCM
  pdu SIGIPDU_RR_RR_TSPConnectionState_call_Cis_LCM_TBOX_SystemInfo: has-dynamic-length=true, length=8, transmission-mode-true-timing=event-controlled-timing=number-of-repetitions=0
    signal SIG_RR_RR_TSPConnectionState_call_Cis_LCM_TBOX_SystemInfo: start 0, 0 bit, opaque, data-transformations=SOME_IP_Default_Transformation, data-type-policy=TRANSFORMING-I-SIGNAL, someip-transformation-i-signal-props{transformer=SOME_IP_Default_Transformer, message-type=REQUEST}, dynamic-length=true, transfer-property=TRIGGERED, to TBOX
  pdu SIGIPDU_RR_RR_TSPConnectionState_return_Cis_LCM_TBOX_SystemInfo: has-dynamic-length=false, length=9, transmission-mode-true-timing=event-controlled-timing=number-of-repetitions=0
    signal SIG_RR_RR_TSPConnectionState_return_Cis_LCM_TBOX_SystemInfo: start 0, 8 bit, opaque, data-transformations=SOME_IP_Default_Transformation, data-type-policy=TRANSFORMING-I-SIGNAL, someip-transformation-i-signal-props{transformer=SOME_IP_Default_Transformer, message-type=RESPONSE}, transfer-property=TRIGGERED, to LCM
  pdu SIGIPDU_RR_RR_MicState_call_Cis_LCM_TBOX_SystemInfo: has-dynamic-length=true, length=8, transmission-mode-true-timing=event-controlled-timing=number-of-repetitions=0
    signal SIG_RR_RR_MicState_call_Cis_LCM_TBOX_SystemInfo: start 0, 0 bit, opaque, data-transformations=SOME_IP_Default_Transformation, data-type-policy=TRANSFORMING-I-SIGNAL, someip-transformation-i-signal-props{transformer=SOME_IP_Default_Transformer, message-type=REQUEST}, dynamic-length=true, transfer-property=TRIGGERED, to TBOX
  pdu SIGIPDU_RR_RR_MicState_return_Cis_LCM_TBOX_SystemInfo: has-dynamic-length=false, length=9, transmission-mode-true-timing=event-controlled-timing=number-of-repetitions=0
    signal SIG_RR_RR_MicState_return_Cis_LCM_TBOX_SystemInfo: start 0, 8 bit, opaque, data-transformations=SOME_IP_Default_Transformation, data-type-policy=TRANSFORMING-I-SIGNAL, someip-transformation-i-signal-props{transformer=SOME_IP_Default_Transformer, message-type=RESPONSE}, transfer-property=TRIGGERED, to LCM
  pdu SIGIPDU_RR_RR_ECUVersion_call_Cis_LCM_TBOX_SystemInfo: has-dynamic-length=true, length=8, transmission-mode-true-timing=event-controlled-timing=number-of-repetitions=0
    signal SIG_RR_RR_ECUVersion_call_Cis_LCM_TBOX_SystemInfo: start 0, 0 bit, opaque, data-transformations=SOME_IP_Default_Transformation, data-type-policy=TRANSFORMING-I-SIGNAL, someip-transformation-i-signal-props{transformer=SOME_IP_Default_Transformer, message-type=REQUEST}, dynamic-length=true, transfer-property=TRIGGERED, to TBOX
  pdu SIGIPDU_RR_RR_ECUVersion_return_Cis_LCM_TBOX_SystemInfo: has-dynamic-length=false, length=80, transmission-mode-true-timing=event-controlled-timing=number-of-repetitions=0
    signal SIG_RR_RR_ECUVersion_return_Cis_LCM_TBOX_SystemInfo: start 0, 576 bit, opaque, data-transformations=SOME_IP_Default_Transformation, data-type-policy=TRANSFORMING-I-SIGNAL, someip-transformation-i-signal-props{transformer=SOME_IP_Default_Transformer, message-type=RESPONSE}, transfer-property=TRIGGERED, to LCM
  pdu SIGIPDU_RR_RR_CanConfig_call_Cis_LCM_TBOX_SystemInfo: has-dynamic-length=true, length=8, transmission-mode-true-timing=event-controlled-timing=number-of-repetitions=0
    signal SIG_RR_RR_CanConfig_call_Cis_LCM_TBOX_SystemInfo: start 0, 0 bit, opaque, data-transformations=SOME_IP_Default_Transformation, data-type-policy=TRANSFORMING-I-SIGNAL, someip-transformation-i-signal-props{transformer=SOME_IP_Default_Transformer, message-type=REQUEST}, dynamic-length=true, transfer-property=TRIGGERED, to TBOX
  pdu SIGIPDU_RR_RR_CanConfig_return_Cis_LCM_TBOX_SystemInfo: has-dynamic-length=true, length=268, transmission-mode-true-timing=event-controlled-timing=number-of-repetitions=0
    signal SIG_RR_RR_CanConfig_return_Cis_LCM_TBOX_SystemInfo: start 0, 2080 bit, opaque, data-transformations=SOME_IP_Default_Transformation, data-type-policy=TRANSFORMING-I-SIGNAL, someip-transformation-i-signal-props{transformer=SOME_IP_Default_Transformer, message-type=RESPONSE}, dynamic-length=true, transfer-property=TRIGGERED, to LCM
  pdu SIGIPDU_RR_RR_KL15State_call_Cis_LCM_TBOX_SystemInfo: has-dynamic-length=true, length=8, transmission-mode-true-timing=event-controlled-timing=number-of-repetitions=0
    signal SIG_RR_RR_KL15State_call_Cis_LCM_TBOX_SystemInfo: start 0, 0 bit, opaque, data-transformations=SOME_IP_Default_Transformation, data-type-policy=TRANSFORMING-I-SIGNAL, someip-transformation-i-signal-props{transformer=SOME_IP_Default_Transformer, message-type=REQUEST}, dynamic-length=true, transfer-property=TRIGGERED, to TBOX
  pdu SIGIPDU_RR_RR_KL15State_return_Cis_LCM_TBOX_SystemInfo: has-dynamic-length=false, length=9, transmission-mode-true-timing=event-controlled-timing=number-of-repetitions=0
    signal SIG_RR_RR_KL15State_return_Cis_LCM_TBOX_SystemInfo: start 0, 8 bit, opaque, data-transformations=SOME_IP_Default_Transformation, data-type-policy=TRANSFORMING-I-SIGNAL, someip-transformation-i-signal-props{transformer=SOME_IP_Default_Transformer, message-type=RESPONSE}, transfer-property=TRIGGERED, to LCM
  pdu SIGIPDU_RR_RR_SPKState_call_Cis_LCM_TBOX_SystemInfo: has-dynamic-length=true, length=8, transmission-mode-true-timing=event-controlled-timing=number-of-repetitions=0
    signal SIG_RR_RR_SPKState_call_Cis_LCM_TBOX_SystemInfo: start 0, 0 bit, opaque, data-transformations=SOME_IP_Default_Transformation, data-type-policy=TRANSFORMING-I-SIGNAL, someip-transformation-i-signal-props{transformer=SOME_IP_Default_Transformer, message-type=REQUEST}, dynamic-length=true, transfer-property=TRIGGERED, to TBOX
  pdu SIGIPDU_RR_RR_SPKState_return_Cis_LCM_TBOX_SystemInfo: has-dynamic-length=false, length=9, transmission-mode-true-timing=event-controlled-timing=number-of-repetitions=0
    signal SIG_RR_RR_SPKState_return_Cis_LCM_TBOX_SystemInfo: start 0, 8 bit, opaque, data-transformations=SOME_IP_Default_Transformation, data-type-policy=TRANSFORMING-I-SIGNAL, someip-transformation-i-signal-props{transformer=SOME_IP_Default_Transformer, message-type=RESPONSE}, transfer-property=TRIGGERED, to LCM
  pdu SIGIPDU_RR_RR_AntState_call_Cis_LCM_TBOX_SystemInfo: has-dynamic-length=true, length=8, transmission-mode-true-timing=event-controlled-timing=number-of-repetitions=0
    signal SIG_RR_RR_AntState_call_Cis_LCM_TBOX_SystemInfo: start 0, 0 bit, opaque, data-transformations=SOME_IP_Default_Transformation, data-type-policy=TRANSFORMING-I-SIGNAL, someip-transformation-i-signal-props{transformer=SOME_IP_Default_Transformer, message-type=REQUEST}, dynamic-length=true, transfer-property=TRIGGERED, to TBOX
  pdu SIGIPDU_RR_RR_AntState_return_Cis_LCM_TBOX_SystemInfo: has-dynamic-length=false, length=9, transmission-mode-true-timing=event-controlled-timing=number-of-repetitions=0
    signal SIG_RR_RR_AntState_return_Cis_LCM_TBOX_SystemInfo: start 0, 8 bit, opaque, data-transformations=SOME_IP_Default_Transformation, data-type-policy=TRANSFORMING-I-SIGNAL, someip-transformation-i-signal-props{transformer=SOME_IP_Default_Transformer, message-type=RESPONSE}, transfer-property=TRIGGERED, to LCM
  pdu SIGIPDU_Event_Event_NetworkStatus_TBOX_SystemInfo_2: has-dynamic-length=false, length=88, transmission-mode-true-timing=event-controlled-timing=number-of-repetitions=0
    signal SIG_Event_Event_NetworkStatus_TBOX_SystemInfo_2: start 0, 640 bit, opaque, data-transformations=SOME_IP_Default_Transformation, data-type-policy=TRANSFORMING-I-SIGNAL, someip-transformation-i-signal-props{transformer=SOME_IP_Default_Transformer, message-type=NOTIFICATION}, transfer-property=TRIGGERED, to ICC_8155_Android
  pdu SIGIPDU_Event_Event_VehicleDiagStatus_TBOX_SystemInfo_2: has-dynamic-length=false, length=11, transmission-mode-true-timing=event-controlled-timing=number-of-repetitions=0
    signal SIG_Event_Event_VehicleDiagStatus_TBOX_SystemInfo_2: start 0, 24 bit, opaque, data-transformations=SOME_IP_Default_Transformation, data-type-policy=TRANSFORMING-I-SIGNAL, someip-transformation-i-signal-props{transformer=SOME_IP_Default_Transformer, message-type=NOTIFICATION}, transfer-property=TRIGGERED, to ICC_8155_Android
  pdu SIGIPDU_RR_RR_TBoxVersionInfo_call_Cis_ICC_8155_Android_TBOX_SystemInfo: has-dynamic-length=true, length=8, transmission-mode-true-timing=event-controlled-timing=number-of-repetitions=0
    signal SIG_RR_RR_TBoxVersionInfo_call_Cis_ICC_8155_Android_TBOX_SystemInfo: start 0, 0 bit, opaque, data-transformations=SOME_IP_Default_Transformation, data-type-policy=TRANSFORMING-I-SIGNAL, someip-transformation-i-signal-props{transformer=SOME_IP_Default_Transformer, message-type=REQUEST}, dynamic-length=true, transfer-property=TRIGGERED, to TBOX
  pdu SIGIPDU_RR_RR_TBoxVersionInfo_return_Cis_ICC_8155_Android_TBOX_SystemInfo: has-dynamic-length=false, length=188, transmission-mode-true-timing=event-controlled-timing=number-of-repetitions=0
    signal SIG_RR_RR_TBoxVersionInfo_return_Cis_ICC_8155_Android_TBOX_SystemInfo: start 0, 1440 bit, opaque, data-transformations=SOME_IP_Default_Transformation, data-type-policy=TRANSFORMING-I-SIGNAL, someip-transformation-i-signal-props{transformer=SOME_IP_Default_Transformer, message-type=RESPONSE}, transfer-property=TRIGGERED, to ICC_8155_Android
  pdu SIGIPDU_RR_RR_BleModuleInfo_call_Cis_ICC_8155_Android_TBOX_SystemInfo: has-dynamic-length=true, length=8, transmission-mode-true-timing=event-controlled-timing=number-of-repetitions=0
    signal SIG_RR_RR_BleModuleInfo_call_Cis_ICC_8155_Android_TBOX_SystemInfo: start 0, 0 bit, opaque, data-transformations=SOME_IP_Default_Transformation, data-type-policy=TRANSFORMING-I-SIGNAL, someip-transformation-i-signal-props{transformer=SOME_IP_Default_Transformer, message-type=REQUEST}, dynamic-length=true, transfer-property=TRIGGERED, to TBOX
  pdu SIGIPDU_RR_RR_BleModuleInfo_return_Cis_ICC_8155_Android_TBOX_SystemInfo: has-dynamic-length=false, length=236, transmission-mode-true-timing=event-controlled-timing=number-of-repetitions=0
    signal SIG_RR_RR_BleModuleInfo_return_Cis_ICC_8155_Android_TBOX_SystemInfo: start 0, 1824 bit, opaque, data-transformations=SOME_IP_Default_Transformation, data-type-policy=TRANSFORMING-I-SIGNAL, someip-transformation-i-signal-props{transformer=SOME_IP_Default_Transformer, message-type=RESPONSE}, transfer-property=TRIGGERED, to ICC_8155_Android
  pdu SIGIPDU_RR_RR_VIN_call_Cis_ICC_8155_Android_TBOX_SystemInfo: has-dynamic-length=true, length=8, transmission-mode-true-timing=event-controlled-timing=number-of-repetitions=0
    signal SIG_RR_RR_VIN_call_Cis_ICC_8155_Android_TBOX_SystemInfo: start 0, 0 bit, opaque, data-transformations=SOME_IP_Default_Transformation, data-type-policy=TRANSFORMING-I-SIGNAL, someip-transformation-i-signal-props{transformer=SOME_IP_Default_Transformer, message-type=REQUEST}, dynamic-length=true, transfer-property=TRIGGERED, to TBOX
  pdu SIGIPDU_RR_RR_VIN_return_Cis_ICC_8155_Android_TBOX_SystemInfo: has-dynamic-length=true, length=32, transmission-mode-true-timing=event-controlled-timing=number-of-repetitions=0
    signal SIG_RR_RR_VIN_return_Cis_ICC_8155_Android_TBOX_SystemInfo: start 0, 192 bit, opaque, data-transformations=SOME_IP_Default_Transformation, data-type-policy=TRANSFORMING-I-SIGNAL, someip-transformation-i-signal-props{transformer=SOME_IP_Default_Transformer, message-type=RESPONSE}, dynamic-length=true, transfer-property=TRIGGERED, to ICC_8155_Android
  pdu SIGIPDU_RR_RR_SIMCardinfo_call_Cis_ICC_8155_Android_TBOX_SystemInfo: has-dynamic-length=true, length=8, transmission-mode-true-timing=event-controlled-timing=number-of-repetitions=0
    signal SIG_RR_RR_SIMCardinfo_call_Cis_ICC_8155_Android_TBOX_SystemInfo: start 0, 0 bit, opaque, data-transformations=SOME_IP_Default_Transformation, data-type-policy=TRANSFORMING-I-SIGNAL, someip-transformation-i-signal-props{transformer=SOME_IP_Default_Transformer, message-type=REQUEST}, dynamic-length=true, transfer-property=TRIGGERED, to TBOX
  pdu SIGIPDU_RR_RR_SIMCardinfo_return_Cis_ICC_8155_Android_TBOX_SystemInfo: has-dynamic-length=false, length=76, transmission-mode-true-timing=event-controlled-timing=number-of-repetitions=0
    signal SIG_RR_RR_SIMCardinfo_return_Cis_ICC_8155_Android_TBOX_SystemInfo: start 0, 544 bit, opaque, data-transformations=SOME_IP_Default_Transformation, data-type-policy=TRANSFORMING-I-SIGNAL, someip-transformation-i-signal-props{transformer=SOME_IP_Default_Transformer, message-type=RESPONSE}, transfer-property=TRIGGERED, to ICC_8155_Android
  pdu SIGIPDU_RR_RR_IMEIInfo_call_Cis_ICC_8155_Android_TBOX_SystemInfo: has-dynamic-length=true, length=8, transmission-mode-true-timing=event-controlled-timing=number-of-repetitions=0
    signal SIG_RR_RR_IMEIInfo_call_Cis_ICC_8155_Android_TBOX_SystemInfo: start 0, 0 bit, opaque, data-transformations=SOME_IP_Default_Transformation, data-type-policy=TRANSFORMING-I-SIGNAL, someip-transformation-i-signal-props{transformer=SOME_IP_Default_Transformer, message-type=REQUEST}, dynamic-length=true, transfer-property=TRIGGERED, to TBOX
  pdu SIGIPDU_RR_RR_IMEIInfo_return_Cis_ICC_8155_Android_TBOX_SystemInfo: has-dynamic-length=true, length=28, transmission-mode-true-timing=event-controlled-timing=number-of-repetitions=0
    signal SIG_RR_RR_IMEIInfo_return_Cis_ICC_8155_Android_TBOX_SystemInfo: start 0, 160 bit, opaque, data-transformations=SOME_IP_Default_Transformation, data-type-policy=TRANSFORMING-I-SIGNAL, someip-transformation-i-signal-props{transformer=SOME_IP_Default_Transformer, message-type=RESPONSE}, dynamic-length=true, transfer-property=TRIGGERED, to ICC_8155_Android
  pdu SIGIPDU_RR_RR_CallNumberList_call_Cis_ICC_8155_Android_TBOX_SystemInfo: has-dynamic-length=true, length=8, transmission-mode-true-timing=event-controlled-timing=number-of-repetitions=0
    signal SIG_RR_RR_CallNumberList_call_Cis_ICC_8155_Android_TBOX_SystemInfo: start 0, 0 bit, opaque, data-transformations=SOME_IP_Default_Transformation, data-type-policy=TRANSFORMING-I-SIGNAL, someip-transformation-i-signal-props{transformer=SOME_IP_Default_Transformer, message-type=REQUEST}, dynamic-length=true, transfer-property=TRIGGERED, to TBOX
  pdu SIGIPDU_RR_RR_CallNumberList_return_Cis_ICC_8155_Android_TBOX_SystemInfo: has-dynamic-length=true, length=84, transmission-mode-true-timing=event-controlled-timing=number-of-repetitions=0
    signal SIG_RR_RR_CallNumberList_return_Cis_ICC_8155_Android_TBOX_SystemInfo: start 0, 608 bit, opaque, data-transformations=SOME_IP_Default_Transformation, data-type-policy=TRANSFORMING-I-SIGNAL, someip-transformation-i-signal-props{transformer=SOME_IP_Default_Transformer, message-type=RESPONSE}, dynamic-length=true, transfer-property=TRIGGERED, to ICC_8155_Android
  pdu SIGIPDU_RR_RR_WorkModel_call_Cis_ICC_8155_Android_TBOX_SystemInfo: has-dynamic-length=true, length=8, transmission-mode-true-timing=event-controlled-timing=number-of-repetitions=0
    signal SIG_RR_RR_WorkModel_call_Cis_ICC_8155_Android_TBOX_SystemInfo: start 0, 0 bit, opaque, data-transformations=SOME_IP_Default_Transformation, data-type-policy=TRANSFORMING-I-SIGNAL, someip-transformation-i-signal-props{transformer=SOME_IP_Default_Transformer, message-type=REQUEST}, dynamic-length=true, transfer-property=TRIGGERED, to TBOX
  pdu SIGIPDU_RR_RR_WorkModel_return_Cis_ICC_8155_Android_TBOX_SystemInfo: has-dynamic-length=false, length=9, transmission-mode-true-timing=event-controlled-timing=number-of-repetitions=0
    signal SIG_RR_RR_WorkModel_return_Cis_ICC_8155_Android_TBOX_SystemInfo: start 0, 8 bit, opaque, data-transformations=SOME_IP_Default_Transformation, data-type-policy=TRANSFORMING-I-SIGNAL, someip-transformation-i-signal-props{transformer=SOME_IP_Default_Transformer, message-type=RESPONSE}, transfer-property=TRIGGERED, to ICC_8155_Android
  pdu SIGIPDU_RR_RR_CertificateIssuedMark_call_Cis_ICC_8155_Android_TBOX_SystemInfo: has-dynamic-length=true, length=8, transmission-mode-true-timing=event-controlled-timing=number-of-repetitions=0
    signal SIG_RR_RR_CertificateIssuedMark_call_Cis_ICC_8155_Android_TBOX_SystemInfo: start 0, 0 bit, opaque, data-transformations=SOME_IP_Default_Transformation, data-type-policy=TRANSFORMING-I-SIGNAL, someip-transformation-i-signal-props{transformer=SOME_IP_Default_Transformer, message-type=REQUEST}, dynamic-length=true, transfer-property=TRIGGERED, to TBOX
  pdu SIGIPDU_RR_RR_CertificateIssuedMark_return_Cis_ICC_8155_Android_TBOX_SystemInfo: has-dynamic-length=false, length=11, transmission-mode-true-timing=event-controlled-timing=number-of-repetitions=0
    signal SIG_RR_RR_CertificateIssuedMark_return_Cis_ICC_8155_Android_TBOX_SystemInfo: start 0, 24 bit, opaque, data-transformations=SOME_IP_Default_Transformation, data-type-policy=TRANSFORMING-I-SIGNAL, someip-transformation-i-signal-props{transformer=SOME_IP_Default_Transformer, message-type=RESPONSE}, transfer-property=TRIGGERED, to ICC_8155_Android
  pdu SIGIPDU_RR_RR_SetCallNumber_call_Cis_ICC_8155_Android_TBOX_SystemInfo: has-dynamic-length=false, length=32, transmission-mode-true-timing=event-controlled-timing=number-of-repetitions=0
    signal SIG_RR_RR_SetCallNumber_call_Cis_ICC_8155_Android_TBOX_SystemInfo: start 0, 192 bit, opaque, data-transformations=SOME_IP_Default_Transformation, data-type-policy=TRANSFORMING-I-SIGNAL, someip-transformation-i-signal-props{transformer=SOME_IP_Default_Transformer, message-type=REQUEST}, transfer-property=TRIGGERED, to TBOX
  pdu SIGIPDU_RR_RR_SetCallNumber_return_Cis_ICC_8155_Android_TBOX_SystemInfo: has-dynamic-length=false, length=32, transmission-mode-true-timing=event-controlled-timing=number-of-repetitions=0
    signal SIG_RR_RR_SetCallNumber_return_Cis_ICC_8155_Android_TBOX_SystemInfo: start 0, 192 bit, opaque, data-transformations=SOME_IP_Default_Transformation, data-type-policy=TRANSFORMING-I-SIGNAL, someip-transformation-i-signal-props{transformer=SOME_IP_Default_Transformer, message-type=RESPONSE}, transfer-property=TRIGGERED, to ICC_8155_Android
  pdu SIGIPDU_RR_RR_Cellinfo_call_Cis_ICC_8155_Android_TBOX_SystemInfo: has-dynamic-length=true, length=8, transmission-mode-true-timing=event-controlled-timing=number-of-repetitions=0
    signal SIG_RR_RR_Cellinfo_call_Cis_ICC_8155_Android_TBOX_SystemInfo: start 0, 0 bit, opaque, data-transformations=SOME_IP_Default_Transformation, data-type-policy=TRANSFORMING-I-SIGNAL, someip-transformation-i-signal-props{transformer=SOME_IP_Default_Transformer, message-type=REQUEST}, dynamic-length=true, transfer-property=TRIGGERED, to TBOX
  pdu SIGIPDU_RR_RR_Cellinfo_return_Cis_ICC_8155_Android_TBOX_SystemInfo: has-dynamic-length=false, length=36, transmission-mode-true-timing=event-controlled-timing=number-of-repetitions=0
    signal SIG_RR_RR_Cellinfo_return_Cis_ICC_8155_Android_TBOX_SystemInfo: start 0, 224 bit, opaque, data-transformations=SOME_IP_Default_Transformation, data-type-policy=TRANSFORMING-I-SIGNAL, someip-transformation-i-signal-props{transformer=SOME_IP_Default_Transformer, message-type=RESPONSE}, transfer-property=TRIGGERED, to ICC_8155_Android
  pdu SIGIPDU_RR_RR_VehicleDiag_call_Cis_ICC_8155_Android_TBOX_SystemInfo: has-dynamic-length=true, length=8, transmission-mode-true-timing=event-controlled-timing=number-of-repetitions=0
    signal SIG_RR_RR_VehicleDiag_call_Cis_ICC_8155_Android_TBOX_SystemInfo: start 0, 0 bit, opaque, data-transformations=SOME_IP_Default_Transformation, data-type-policy=TRANSFORMING-I-SIGNAL, someip-transformation-i-signal-props{transformer=SOME_IP_Default_Transformer, message-type=REQUEST}, dynamic-length=true, transfer-property=TRIGGERED, to TBOX
  pdu SIGIPDU_RR_RR_VehicleDiag_return_Cis_ICC_8155_Android_TBOX_SystemInfo: has-dynamic-length=false, length=9, transmission-mode-true-timing=event-controlled-timing=number-of-repetitions=0
    signal SIG_RR_RR_VehicleDiag_return_Cis_ICC_8155_Android_TBOX_SystemInfo: start 0, 8 bit, opaque, data-transformations=SOME_IP_Default_Transformation, data-type-policy=TRANSFORMING-I-SIGNAL, someip-transformation-i-signal-props{transformer=SOME_IP_Default_Transformer, message-type=RESPONSE}, transfer-property=TRIGGERED, to ICC_8155_Android
  pdu SIGIPDU_RR_RR_CurrenMonthTalkTime_call_Cis_ICC_8155_Android_TBOX_SystemInfo: has-dynamic-length=true, length=8, transmission-mode-true-timing=event-controlled-timing=number-of-repetitions=0
    signal SIG_RR_RR_CurrenMonthTalkTime_call_Cis_ICC_8155_Android_TBOX_SystemInfo: start 0, 0 bit, opaque, data-transformations=SOME_IP_Default_Transformation, data-type-policy=TRANSFORMING-I-SIGNAL, someip-transformation-i-signal-props{transformer=SOME_IP_Default_Transformer, message-type=REQUEST}, dynamic-length=true, transfer-property=TRIGGERED, to TBOX
  pdu SIGIPDU_RR_RR_CurrenMonthTalkTime_return_Cis_ICC_8155_Android_TBOX_SystemInfo: has-dynamic-length=false, length=20, transmission-mode-true-timing=event-controlled-timing=number-of-repetitions=0
    signal SIG_RR_RR_CurrenMonthTalkTime_return_Cis_ICC_8155_Android_TBOX_SystemInfo: start 0, 96 bit, opaque, data-transformations=SOME_IP_Default_Transformation, data-type-policy=TRANSFORMING-I-SIGNAL, someip-transformation-i-signal-props{transformer=SOME_IP_Default_Transformer, message-type=RESPONSE}, transfer-property=TRIGGERED, to ICC_8155_Android
  pdu SIGIPDU_RR_RR_TSPConnectionState_call_Cis_ICC_8155_Android_TBOX_SystemInfo: has-dynamic-length=true, length=8, transmission-mode-true-timing=event-controlled-timing=number-of-repetitions=0
    signal SIG_RR_RR_TSPConnectionState_call_Cis_ICC_8155_Android_TBOX_SystemInfo: start 0, 0 bit, opaque, data-transformations=SOME_IP_Default_Transformation, data-type-policy=TRANSFORMING-I-SIGNAL, someip-transformation-i-signal-props{transformer=SOME_IP_Default_Transformer, message-type=REQUEST}, dynamic-length=true, transfer-property=TRIGGERED, to TBOX
  pdu SIGIPDU_RR_RR_TSPConnectionState_return_Cis_ICC_8155_Android_TBOX_SystemInfo: has-dynamic-length=false, length=9, transmission-mode-true-timing=event-controlled-timing=number-of-repetitions=0
    signal SIG_RR_RR_TSPConnectionState_return_Cis_ICC_8155_Android_TBOX_SystemInfo: start 0, 8 bit, opaque, data-transformations=SOME_IP_Default_Transformation, data-type-policy=TRANSFORMING-I-SIGNAL, someip-transformation-i-signal-props{transformer=SOME_IP_Default_Transformer, message-type=RESPONSE}, transfer-property=TRIGGERED, to ICC_8155_Android
  pdu SIGIPDU_RR_RR_MicState_call_Cis_ICC_8155_Android_TBOX_SystemInfo: has-dynamic-length=true, length=8, transmission-mode-true-timing=event-controlled-timing=number-of-repetitions=0
    signal SIG_RR_RR_MicState_call_Cis_ICC_8155_Android_TBOX_SystemInfo: start 0, 0 bit, opaque, data-transformations=SOME_IP_Default_Transformation, data-type-policy=TRANSFORMING-I-SIGNAL, someip-transformation-i-signal-props{transformer=SOME_IP_Default_Transformer, message-type=REQUEST}, dynamic-length=true, transfer-property=TRIGGERED, to TBOX
  pdu SIGIPDU_RR_RR_MicState_return_Cis_ICC_8155_Android_TBOX_SystemInfo: has-dynamic-length=false, length=9, transmission-mode-true-timing=event-controlled-timing=number-of-repetitions=0
    signal SIG_RR_RR_MicState_return_Cis_ICC_8155_Android_TBOX_SystemInfo: start 0, 8 bit, opaque, data-transformations=SOME_IP_Default_Transformation, data-type-policy=TRANSFORMING-I-SIGNAL, someip-transformation-i-signal-props{transformer=SOME_IP_Default_Transformer, message-type=RESPONSE}, transfer-property=TRIGGERED, to ICC_8155_Android
  pdu SIGIPDU_RR_RR_ECUVersion_call_Cis_ICC_8155_Android_TBOX_SystemInfo: has-dynamic-length=true, length=8, transmission-mode-true-timing=event-controlled-timing=number-of-repetitions=0
    signal SIG_RR_RR_ECUVersion_call_Cis_ICC_8155_Android_TBOX_SystemInfo: start 0, 0 bit, opaque, data-transformations=SOME_IP_Default_Transformation, data-type-policy=TRANSFORMING-I-SIGNAL, someip-transformation-i-signal-props{transformer=SOME_IP_Default_Transformer, message-type=REQUEST}, dynamic-length=true, transfer-property=TRIGGERED, to TBOX
  pdu SIGIPDU_RR_RR_ECUVersion_return_Cis_ICC_8155_Android_TBOX_SystemInfo: has-dynamic-length=false, length=80, transmission-mode-true-timing=event-controlled-timing=number-of-repetitions=0
    signal SIG_RR_RR_ECUVersion_return_Cis_ICC_8155_Android_TBOX_SystemInfo: start 0, 576 bit, opaque, data-transformations=SOME_IP_Default_Transformation, data-type-policy=TRANSFORMING-I-SIGNAL, someip-transformation-i-signal-props{transformer=SOME_IP_Default_Transformer, message-type=RESPONSE}, transfer-property=TRIGGERED, to ICC_8155_Android
  pdu SIGIPDU_RR_RR_CanConfig_call_Cis_ICC_8155_Android_TBOX_SystemInfo: has-dynamic-length=true, length=8, transmission-mode-true-timing=event-controlled-timing=number-of-repetitions=0
    signal SIG_RR_RR_CanConfig_call_Cis_ICC_8155_Android_TBOX_SystemInfo: start 0, 0 bit, opaque, data-transformations=SOME_IP_Default_Transformation, data-type-policy=TRANSFORMING-I-SIGNAL, someip-transformation-i-signal-props{transformer=SOME_IP_Default_Transformer, message-type=REQUEST}, dynamic-length=true, transfer-property=TRIGGERED, to TBOX
  pdu SIGIPDU_RR_RR_CanConfig_return_Cis_ICC_8155_Android_TBOX_SystemInfo: has-dynamic-length=true, length=268, transmission-mode-true-timing=event-controlled-timing=number-of-repetitions=0
    signal SIG_RR_RR_CanConfig_return_Cis_ICC_8155_Android_TBOX_SystemInfo: start 0, 2080 bit, opaque, data-transformations=SOME_IP_Default_Transformation, data-type-policy=TRANSFORMING-I-SIGNAL, someip-transformation-i-signal-props{transformer=SOME_IP_Default_Transformer, message-type=RESPONSE}, dynamic-length=true, transfer-property=TRIGGERED, to ICC_8155_Android
  pdu SIGIPDU_RR_RR_KL15State_call_Cis_ICC_8155_Android_TBOX_SystemInfo: has-dynamic-length=true, length=8, transmission-mode-true-timing=event-controlled-timing=number-of-repetitions=0
    signal SIG_RR_RR_KL15State_call_Cis_ICC_8155_Android_TBOX_SystemInfo: start 0, 0 bit, opaque, data-transformations=SOME_IP_Default_Transformation, data-type-policy=TRANSFORMING-I-SIGNAL, someip-transformation-i-signal-props{transformer=SOME_IP_Default_Transformer, message-type=REQUEST}, dynamic-length=true, transfer-property=TRIGGERED, to TBOX
  pdu SIGIPDU_RR_RR_KL15State_return_Cis_ICC_8155_Android_TBOX_SystemInfo: has-dynamic-length=false, length=9, transmission-mode-true-timing=event-controlled-timing=number-of-repetitions=0
    signal SIG_RR_RR_KL15State_return_Cis_ICC_8155_Android_TBOX_SystemInfo: start 0, 8 bit, opaque, data-transformations=SOME_IP_Default_Transformation, data-type-policy=TRANSFORMING-I-SIGNAL, someip-transformation-i-signal-props{transformer=SOME_IP_Default_Transformer, message-type=RESPONSE}, transfer-property=TRIGGERED, to ICC_8155_Android
  pdu SIGIPDU_RR_RR_SPKState_call_Cis_ICC_8155_Android_TBOX_SystemInfo: has-dynamic-length=true, length=8, transmission-mode-true-timing=event-controlled-timing=number-of-repetitions=0
    signal SIG_RR_RR_SPKState_call_Cis_ICC_8155_Android_TBOX_SystemInfo: start 0, 0 bit, opaque, data-transformations=SOME_IP_Default_Transformation, data-type-policy=TRANSFORMING-I-SIGNAL, someip-transformation-i-signal-props{transformer=SOME_IP_Default_Transformer, message-type=REQUEST}, dynamic-length=true, transfer-property=TRIGGERED, to TBOX
  pdu SIGIPDU_RR_RR_SPKState_return_Cis_ICC_8155_Android_TBOX_SystemInfo: has-dynamic-length=false, length=9, transmission-mode-true-timing=event-controlled-timing=number-of-repetitions=0
    signal SIG_RR_RR_SPKState_return_Cis_ICC_8155_Android_TBOX_SystemInfo: start 0, 8 bit, opaque, data-transformations=SOME_IP_Default_Transformation, data-type-policy=TRANSFORMING-I-SIGNAL, someip-transformation-i-signal-props{transformer=SOME_IP_Default_Transformer, message-type=RESPONSE}, transfer-property=TRIGGERED, to ICC_8155_Android
  pdu SIGIPDU_RR_RR_AntState_call_Cis_ICC_8155_Android_TBOX_SystemInfo: has-dynamic-length=true, length=8, transmission-mode-true-timing=event-controlled-timing=number-of-repetitions=0
    signal SIG_RR_RR_AntState_call_Cis_ICC_8155_Android_TBOX_SystemInfo: start 0, 0 bit, opaque, data-transformations=SOME_IP_Default_Transformation, data-type-policy=TRANSFORMING-I-SIGNAL, someip-transformation-i-signal-props{transformer=SOME_IP_Default_Transformer, message-type=REQUEST}, dynamic-length=true, transfer-property=TRIGGERED, to TBOX
  pdu SIGIPDU_RR_RR_AntState_return_Cis_ICC_8155_Android_TBOX_SystemInfo: has-dynamic-length=false, length=9, transmission-mode-true-timing=event-controlled-timing=number-of-repetitions=0
    signal SIG_RR_RR_AntState_return_Cis_ICC_8155_Android_TBOX_SystemInfo: start 0, 8 bit, opaque, data-transformations=SOME_IP_Default_Transformation, data-type-policy=TRANSFORMING-I-SIGNAL, someip-transformation-i-signal-props{transformer=SOME_IP_Default_Transformer, message-type=RESPONSE}, transfer-property=TRIGGERED, to ICC_8155_Android
  pdu SIGIPDU_Event_Event_UploadBEICALLSts_TBOX_BEICALL: has-dynamic-length=false, length=36, transmission-mode-true-timing=event-controlled-timing=number-of-repetitions=0
    signal SIG_Event_Event_UploadBEICALLSts_TBOX_BEICALL: start 0, 224 bit, opaque, data-transformations=SOME_IP_Default_Transformation, data-type-policy=TRANSFORMING-I-SIGNAL, someip-transformation-i-signal-props{transformer=SOME_IP_Default_Transformer, message-type=NOTIFICATION}, transfer-property=TRIGGERED, to ICC_8155_Android
  pdu SIGIPDU_Event_notifyEcallMdoe_TBOX_BEICALL: has-dynamic-length=false, length=9, transmission-mode-true-timing=event-controlled-timing=number-of-repetitions=0
    signal SIG_Event_notifyEcallMdoe_TBOX_BEICALL: start 0, 8 bit, opaque, data-transformations=SOME_IP_Default_Transformation, data-type-policy=TRANSFORMING-I-SIGNAL, someip-transformation-i-signal-props{transformer=SOME_IP_Default_Transformer, message-type=NOTIFICATION}, transfer-property=TRIGGERED, to ICC_8155_Android
  pdu SIGIPDU_RR_RR_BEICALL_call_Cis_ICC_8155_Android_TBOX_BEICALL: has-dynamic-length=false, length=32, transmission-mode-true-timing=event-controlled-timing=number-of-repetitions=0
    signal SIG_RR_RR_BEICALL_call_Cis_ICC_8155_Android_TBOX_BEICALL: start 0, 192 bit, opaque, data-transformations=SOME_IP_Default_Transformation, data-type-policy=TRANSFORMING-I-SIGNAL, someip-transformation-i-signal-props{transformer=SOME_IP_Default_Transformer, message-type=REQUEST}, transfer-property=TRIGGERED, to TBOX
  pdu SIGIPDU_RR_RR_BEICALL_return_Cis_ICC_8155_Android_TBOX_BEICALL: has-dynamic-length=false, length=9, transmission-mode-true-timing=event-controlled-timing=number-of-repetitions=0
    signal SIG_RR_RR_BEICALL_return_Cis_ICC_8155_Android_TBOX_BEICALL: start 0, 8 bit, opaque, data-transformations=SOME_IP_Default_Transformation, data-type-policy=TRANSFORMING-I-SIGNAL, someip-transformation-i-signal-props{transformer=SOME_IP_Default_Transformer, message-type=RESPONSE}, transfer-property=TRIGGERED, to ICC_8155_Android
  pdu SIGIPDU_Event_Event_UsbUpdateSta_TBOX_USBUpdate: has-dynamic-length=false, length=10, transmission-mode-true-timing=event-controlled-timing=number-of-repetitions=0
    signal SIG_Event_Event_UsbUpdateSta_TBOX_USBUpdate: start 0, 16 bit, opaque, data-transformations=SOME_IP_Default_Transformation, data-type-policy=TRANSFORMING-I-SIGNAL, someip-transformation-i-signal-props{transformer=SOME_IP_Default_Transformer, message-type=NOTIFICATION}, transfer-property=TRIGGERED, to ICC_8155_Android
  pdu SIGIPDU_RR_RR_UpdatePrepare_call_Cis_ICC_8155_Android_TBOX_USBUpdate: has-dynamic-length=true, length=8, transmission-mode-true-timing=event-controlled-timing=number-of-repetitions=0
    signal SIG_RR_RR_UpdatePrepare_call_Cis_ICC_8155_Android_TBOX_USBUpdate: start 0, 0 bit, opaque, data-transformations=SOME_IP_Default_Transformation, data-type-policy=TRANSFORMING-I-SIGNAL, someip-transformation-i-signal-props{transformer=SOME_IP_Default_Transformer, message-type=REQUEST}, dynamic-length=true, transfer-property=TRIGGERED, to TBOX
  pdu SIGIPDU_RR_RR_UpdatePrepare_return_Cis_ICC_8155_Android_TBOX_USBUpdate: has-dynamic-length=false, length=9, transmission-mode-true-timing=event-controlled-timing=number-of-repetitions=0
    signal SIG_RR_RR_UpdatePrepare_return_Cis_ICC_8155_Android_TBOX_USBUpdate: start 0, 8 bit, opaque, data-transformations=SOME_IP_Default_Transformation, data-type-policy=TRANSFORMING-I-SIGNAL, someip-transformation-i-signal-props{transformer=SOME_IP_Default_Transformer, message-type=RESPONSE}, transfer-property=TRIGGERED, to ICC_8155_Android
  pdu SIGIPDU_RR_RR_UpdateFTPSts_call_Cis_ICC_8155_Android_TBOX_USBUpdate: has-dynamic-length=false, length=9, transmission-mode-true-timing=event-controlled-timing=number-of-repetitions=0
    signal SIG_RR_RR_UpdateFTPSts_call_Cis_ICC_8155_Android_TBOX_USBUpdate: start 0, 8 bit, opaque, data-transformations=SOME_IP_Default_Transformation, data-type-policy=TRANSFORMING-I-SIGNAL, someip-transformation-i-signal-props{transformer=SOME_IP_Default_Transformer, message-type=REQUEST}, transfer-property=TRIGGERED, to TBOX
  pdu SIGIPDU_RR_RR_UpdateFTPSts_return_Cis_ICC_8155_Android_TBOX_USBUpdate: has-dynamic-length=false, length=52, transmission-mode-true-timing=event-controlled-timing=number-of-repetitions=0
    signal SIG_RR_RR_UpdateFTPSts_return_Cis_ICC_8155_Android_TBOX_USBUpdate: start 0, 352 bit, opaque, data-transformations=SOME_IP_Default_Transformation, data-type-policy=TRANSFORMING-I-SIGNAL, someip-transformation-i-signal-props{transformer=SOME_IP_Default_Transformer, message-type=RESPONSE}, transfer-property=TRIGGERED, to ICC_8155_Android
  pdu SIGIPDU_RR_RR_UsbUpdateStart_call_Cis_ICC_8155_Android_TBOX_USBUpdate: has-dynamic-length=true, length=8, transmission-mode-true-timing=event-controlled-timing=number-of-repetitions=0
    signal SIG_RR_RR_UsbUpdateStart_call_Cis_ICC_8155_Android_TBOX_USBUpdate: start 0, 0 bit, opaque, data-transformations=SOME_IP_Default_Transformation, data-type-policy=TRANSFORMING-I-SIGNAL, someip-transformation-i-signal-props{transformer=SOME_IP_Default_Transformer, message-type=REQUEST}, dynamic-length=true, transfer-property=TRIGGERED, to TBOX
  pdu SIGIPDU_RR_RR_UsbUpdateStart_return_Cis_ICC_8155_Android_TBOX_USBUpdate: has-dynamic-length=false, length=9, transmission-mode-true-timing=event-controlled-timing=number-of-repetitions=0
    signal SIG_RR_RR_UsbUpdateStart_return_Cis_ICC_8155_Android_TBOX_USBUpdate: start 0, 8 bit, opaque, data-transformations=SOME_IP_Default_Transformation, data-type-policy=TRANSFORMING-I-SIGNAL, someip-transformation-i-signal-props{transformer=SOME_IP_Default_Transformer, message-type=RESPONSE}, transfer-property=TRIGGERED, to ICC_8155_Android
  pdu SIGIPDU_FF_FF_UpdateCompleted_Cis_ICC_8155_Android_TBOX_USBUpdate: has-dynamic-length=false, length=9, transmission-mode-true-timing=event-controlled-timing=number-of-repetitions=0
    signal SIG_FF_FF_UpdateCompleted_Cis_ICC_8155_Android_TBOX_USBUpdate: start 0, 8 bit, opaque, data-transformations=SOME_IP_Default_Transformation, data-type-policy=TRANSFORMING-I-SIGNAL, someip-transformation-i-signal-props{transformer=SOME_IP_Default_Transformer, message-type=REQUEST-NO-RETURN}, transfer-property=TRIGGERED, to TBOX
  pdu SIGIPDU_RR_RR_logPrepare_call_Cis_ICC_8155_Android_TBOX_USBTBOXlog: has-dynamic-length=true, length=8, transmission-mode-true-timing=event-controlled-timing=number-of-repetitions=0
    signal SIG_RR_RR_logPrepare_call_Cis_ICC_8155_Android_TBOX_USBTBOXlog: start 0, 0 bit, opaque, data-transformations=SOME_IP_Default_Transformation, data-type-policy=TRANSFORMING-I-SIGNAL, someip-transformation-i-signal-props{transformer=SOME_IP_Default_Transformer, message-type=REQUEST}, dynamic-length=true, transfer-property=TRIGGERED, to TBOX
  pdu SIGIPDU_RR_RR_logPrepare_return_Cis_ICC_8155_Android_TBOX_USBTBOXlog: has-dynamic-length=false, length=48, transmission-mode-true-timing=event-controlled-timing=number-of-repetitions=0
    signal SIG_RR_RR_logPrepare_return_Cis_ICC_8155_Android_TBOX_USBTBOXlog: start 0, 320 bit, opaque, data-transformations=SOME_IP_Default_Transformation, data-type-policy=TRANSFORMING-I-SIGNAL, someip-transformation-i-signal-props{transformer=SOME_IP_Default_Transformer, message-type=RESPONSE}, transfer-property=TRIGGERED, to ICC_8155_Android
  pdu SIGIPDU_RR_RR_LogFTPSts_call_Cis_ICC_8155_Android_TBOX_USBTBOXlog: has-dynamic-length=false, length=9, transmission-mode-true-timing=event-controlled-timing=number-of-repetitions=0
    signal SIG_RR_RR_LogFTPSts_call_Cis_ICC_8155_Android_TBOX_USBTBOXlog: start 0, 8 bit, opaque, data-transformations=SOME_IP_Default_Transformation, data-type-policy=TRANSFORMING-I-SIGNAL, someip-transformation-i-signal-props{transformer=SOME_IP_Default_Transformer, message-type=REQUEST}, transfer-property=TRIGGERED, to TBOX
  pdu SIGIPDU_RR_RR_LogFTPSts_return_Cis_ICC_8155_Android_TBOX_USBTBOXlog: has-dynamic-length=false, length=52, transmission-mode-true-timing=event-controlled-timing=number-of-repetitions=0
    signal SIG_RR_RR_LogFTPSts_return_Cis_ICC_8155_Android_TBOX_USBTBOXlog: start 0, 352 bit, opaque, data-transformations=SOME_IP_Default_Transformation, data-type-policy=TRANSFORMING-I-SIGNAL, someip-transformation-i-signal-props{transformer=SOME_IP_Default_Transformer, message-type=RESPONSE}, transfer-property=TRIGGERED, to ICC_8155_Android
  pdu SIGIPDU_Event_Event_GNSSInfo1_TBOX_GNSSInfo: has-dynamic-length=false, length=3092, transmission-mode-true-timing=event-controlled-timing=number-of-repetitions=0
    signal SIG_Event_Event_GNSSInfo1_TBOX_GNSSInfo: start 0, 24672 bit, opaque, data-transformations=SOME_IP_Default_Transformation, data-type-policy=TRANSFORMING-I-SIGNAL, someip-transformation-i-signal-props{transformer=SOME_IP_Default_Transformer, message-type=NOTIFICATION}, transfer-property=TRIGGERED, to ICC_8155_Android
  general purpose i pdu TPSIGIPDU_Event_Event_GNSSInfo1_TBOX_GNSSInfo: category=SOMEIP_SEGMENTED_IPDU, length=1400
  pdu SIGIPDU_RR_RR_DMCGNSSType_call_Cis_ICC_8155_Android_TBOX_GNSSInfo: has-dynamic-length=false, length=9, transmission-mode-true-timing=event-controlled-timing=number-of-repetitions=0
    signal SIG_RR_RR_DMCGNSSType_call_Cis_ICC_8155_Android_TBOX_GNSSInfo: start 0, 8 bit, opaque, data-transformations=SOME_IP_Default_Transformation, data-type-policy=TRANSFORMING-I-SIGNAL, someip-transformation-i-signal-props{transformer=SOME_IP_Default_Transformer, message-type=REQUEST}, transfer-property=TRIGGERED, to TBOX
  pdu SIGIPDU_RR_RR_DMCGNSSType_return_Cis_ICC_8155_Android_TBOX_GNSSInfo: has-dynamic-length=false, length=9, transmission-mode-true-timing=event-controlled-timing=number-of-repetitions=0
    signal SIG_RR_RR_DMCGNSSType_return_Cis_ICC_8155_Android_TBOX_GNSSInfo: start 0, 8 bit, opaque, data-transformations=SOME_IP_Default_Transformation, data-type-policy=TRANSFORMING-I-SIGNAL, someip-transformation-i-signal-props{transformer=SOME_IP_Default_Transformer, message-type=RESPONSE}, transfer-property=TRIGGERED, to ICC_8155_Android
  pdu SIGIPDU_Event_Event_GNSSInfo1_TBOX_GNSSInfo_1: has-dynamic-length=false, length=3092, transmission-mode-true-timing=event-controlled-timing=number-of-repetitions=0
    signal SIG_Event_Event_GNSSInfo1_TBOX_GNSSInfo_1: start 0, 24672 bit, opaque, data-transformations=SOME_IP_Default_Transformation, data-type-policy=TRANSFORMING-I-SIGNAL, someip-transformation-i-signal-props{transformer=SOME_IP_Default_Transformer, message-type=NOTIFICATION}, transfer-property=TRIGGERED, to ADCC
  general purpose i pdu TPSIGIPDU_Event_Event_GNSSInfo1_TBOX_GNSSInfo_1: category=SOMEIP_SEGMENTED_IPDU, length=1400
  pdu SIGIPDU_RR_RR_DMCGNSSType_call_Cis_ADCC_TBOX_GNSSInfo: has-dynamic-length=false, length=9, transmission-mode-true-timing=event-controlled-timing=number-of-repetitions=0
    signal SIG_RR_RR_DMCGNSSType_call_Cis_ADCC_TBOX_GNSSInfo: start 0, 8 bit, opaque, data-transformations=SOME_IP_Default_Transformation, data-type-policy=TRANSFORMING-I-SIGNAL, someip-transformation-i-signal-props{transformer=SOME_IP_Default_Transformer, message-type=REQUEST}, transfer-property=TRIGGERED, to TBOX
  pdu SIGIPDU_RR_RR_DMCGNSSType_return_Cis_ADCC_TBOX_GNSSInfo: has-dynamic-length=false, length=9, transmission-mode-true-timing=event-controlled-timing=number-of-repetitions=0
    signal SIG_RR_RR_DMCGNSSType_return_Cis_ADCC_TBOX_GNSSInfo: start 0, 8 bit, opaque, data-transformations=SOME_IP_Default_Transformation, data-type-policy=TRANSFORMING-I-SIGNAL, someip-transformation-i-signal-props{transformer=SOME_IP_Default_Transformer, message-type=RESPONSE}, transfer-property=TRIGGERED, to ADCC
  pdu SIGIPDU_Event_notifyEcallMdoeFed_ICC_Android_OutService: has-dynamic-length=false, length=9, transmission-mode-true-timing=event-controlled-timing=number-of-repetitions=0
    signal SIG_Event_notifyEcallMdoeFed_ICC_Android_OutService: start 0, 8 bit, opaque, data-transformations=SOME_IP_Default_Transformation, data-type-policy=TRANSFORMING-I-SIGNAL, someip-transformation-i-signal-props{transformer=SOME_IP_Default_Transformer, message-type=NOTIFICATION}, transfer-property=TRIGGERED, to TBOX
  pdu SIGIPDU_Event_notifyADCC_Command_ICC_Aom: has-dynamic-length=false, length=9, transmission-mode-true-timing=event-controlled-timing=number-of-repetitions=0
    signal SIG_Event_notifyADCC_Command_ICC_Aom: start 0, 8 bit, opaque, data-transformations=SOME_IP_Default_Transformation, data-type-policy=TRANSFORMING-I-SIGNAL, someip-transformation-i-signal-props{transformer=SOME_IP_Default_Transformer, message-type=NOTIFICATION}, transfer-property=TRIGGERED, to ADCC
  pdu SIGIPDU_RR_GetRenderDBInfo_call_Cis_ADCC_ICC_Aom: has-dynamic-length=true, length=1312, transmission-mode-true-timing=event-controlled-timing=number-of-repetitions=0
    signal SIG_RR_GetRenderDBInfo_call_Cis_ADCC_ICC_Aom: start 0, 10432 bit, opaque, data-transformations=SOME_IP_Default_Transformation, data-type-policy=TRANSFORMING-I-SIGNAL, someip-transformation-i-signal-props{transformer=SOME_IP_Default_Transformer, message-type=REQUEST}, dynamic-length=true, transfer-property=TRIGGERED, to ICC_8155_Android
  pdu SIGIPDU_RR_GetRenderDBInfo_return_Cis_ADCC_ICC_Aom: has-dynamic-length=true, length=1312, transmission-mode-true-timing=event-controlled-timing=number-of-repetitions=0
    signal SIG_RR_GetRenderDBInfo_return_Cis_ADCC_ICC_Aom: start 0, 10432 bit, opaque, data-transformations=SOME_IP_Default_Transformation, data-type-policy=TRANSFORMING-I-SIGNAL, someip-transformation-i-signal-props{transformer=SOME_IP_Default_Transformer, message-type=RESPONSE}, dynamic-length=true, transfer-property=TRIGGERED, to ADCC
  pdu SIGIPDU_Event_NtfSDmapInfo_ICC_SDmapInfo: has-dynamic-length=false, length=1524, transmission-mode-true-timing=event-controlled-timing=number-of-repetitions=0
    signal SIG_Event_NtfSDmapInfo_ICC_SDmapInfo: start 0, 12128 bit, opaque, data-transformations=SOME_IP_Default_Transformation, data-type-policy=TRANSFORMING-I-SIGNAL, someip-transformation-i-signal-props{transformer=SOME_IP_Default_Transformer, message-type=NOTIFICATION}, transfer-property=TRIGGERED, to ADCC
  general purpose i pdu TPSIGIPDU_Event_NtfSDmapInfo_ICC_SDmapInfo: category=SOMEIP_SEGMENTED_IPDU, length=1400
  pdu SIGIPDU_Event_notifyNOA_SDMapPosInfo_ICC_SDmapInfo: has-dynamic-length=false, length=24, transmission-mode-true-timing=event-controlled-timing=number-of-repetitions=0
    signal SIG_Event_notifyNOA_SDMapPosInfo_ICC_SDmapInfo: start 0, 128 bit, opaque, data-transformations=SOME_IP_Default_Transformation, data-type-policy=TRANSFORMING-I-SIGNAL, someip-transformation-i-signal-props{transformer=SOME_IP_Default_Transformer, message-type=NOTIFICATION}, transfer-property=TRIGGERED, to ADCC
  pdu SIGIPDU_Event_notifyNOA_SDMapStubInfo_ICC_SDmapInfo: has-dynamic-length=false, length=26, transmission-mode-true-timing=event-controlled-timing=number-of-repetitions=0
    signal SIG_Event_notifyNOA_SDMapStubInfo_ICC_SDmapInfo: start 0, 144 bit, opaque, data-transformations=SOME_IP_Default_Transformation, data-type-policy=TRANSFORMING-I-SIGNAL, someip-transformation-i-signal-props{transformer=SOME_IP_Default_Transformer, message-type=NOTIFICATION}, transfer-property=TRIGGERED, to ADCC
  pdu SIGIPDU_Event_notifyNOA_SDMapSegmentInfo_ICC_SDmapInfo: has-dynamic-length=false, length=28, transmission-mode-true-timing=event-controlled-timing=number-of-repetitions=0
    signal SIG_Event_notifyNOA_SDMapSegmentInfo_ICC_SDmapInfo: start 0, 160 bit, opaque, data-transformations=SOME_IP_Default_Transformation, data-type-policy=TRANSFORMING-I-SIGNAL, someip-transformation-i-signal-props{transformer=SOME_IP_Default_Transformer, message-type=NOTIFICATION}, transfer-property=TRIGGERED, to ADCC
  pdu SIGIPDU_Event_notifyNOA_SDMapShortInfo_ICC_SDmapInfo: has-dynamic-length=false, length=26, transmission-mode-true-timing=event-controlled-timing=number-of-repetitions=0
    signal SIG_Event_notifyNOA_SDMapShortInfo_ICC_SDmapInfo: start 0, 144 bit, opaque, data-transformations=SOME_IP_Default_Transformation, data-type-policy=TRANSFORMING-I-SIGNAL, someip-transformation-i-signal-props{transformer=SOME_IP_Default_Transformer, message-type=NOTIFICATION}, transfer-property=TRIGGERED, to ADCC
  pdu SIGIPDU_Event_notifyNOA_SDMapLongInfo_ICC_SDmapInfo: has-dynamic-length=false, length=24, transmission-mode-true-timing=event-controlled-timing=number-of-repetitions=0
    signal SIG_Event_notifyNOA_SDMapLongInfo_ICC_SDmapInfo: start 0, 128 bit, opaque, data-transformations=SOME_IP_Default_Transformation, data-type-policy=TRANSFORMING-I-SIGNAL, someip-transformation-i-signal-props{transformer=SOME_IP_Default_Transformer, message-type=NOTIFICATION}, transfer-property=TRIGGERED, to ADCC
  pdu SIGIPDU_Event_notifyNOA_SDMapMetaInfo_ICC_SDmapInfo: has-dynamic-length=false, length=26, transmission-mode-true-timing=event-controlled-timing=number-of-repetitions=0
    signal SIG_Event_notifyNOA_SDMapMetaInfo_ICC_SDmapInfo: start 0, 144 bit, opaque, data-transformations=SOME_IP_Default_Transformation, data-type-policy=TRANSFORMING-I-SIGNAL, someip-transformation-i-signal-props{transformer=SOME_IP_Default_Transformer, message-type=NOTIFICATION}, transfer-property=TRIGGERED, to ADCC
  pdu SIGIPDU_Event_NtfSDmapInfo_international_ICC_SDmapInfo: has-dynamic-length=false, length=28, transmission-mode-true-timing=event-controlled-timing=number-of-repetitions=0
    signal SIG_Event_NtfSDmapInfo_international_ICC_SDmapInfo: start 0, 160 bit, opaque, data-transformations=SOME_IP_Default_Transformation, data-type-policy=TRANSFORMING-I-SIGNAL, someip-transformation-i-signal-props{transformer=SOME_IP_Default_Transformer, message-type=NOTIFICATION}, transfer-property=TRIGGERED, to ADCC
  pdu SIGIPDU_Event_NtfSDmapLaneInfo_ICC_SDmapInfo: has-dynamic-length=false, length=60, transmission-mode-true-timing=event-controlled-timing=number-of-repetitions=0
    signal SIG_Event_NtfSDmapLaneInfo_ICC_SDmapInfo: start 0, 416 bit, opaque, data-transformations=SOME_IP_Default_Transformation, data-type-policy=TRANSFORMING-I-SIGNAL, someip-transformation-i-signal-props{transformer=SOME_IP_Default_Transformer, message-type=NOTIFICATION}, transfer-property=TRIGGERED, to ADCC
  pdu SIGIPDU_Event_NtfSDmapInfo_ICC_SDmapInfo_1: has-dynamic-length=false, length=1524, transmission-mode-true-timing=event-controlled-timing=number-of-repetitions=0
    signal SIG_Event_NtfSDmapInfo_ICC_SDmapInfo_1: start 0, 12128 bit, opaque, data-transformations=SOME_IP_Default_Transformation, data-type-policy=TRANSFORMING-I-SIGNAL, someip-transformation-i-signal-props{transformer=SOME_IP_Default_Transformer, message-type=NOTIFICATION}, transfer-property=TRIGGERED, to FCM
  general purpose i pdu TPSIGIPDU_Event_NtfSDmapInfo_ICC_SDmapInfo_1: category=SOMEIP_SEGMENTED_IPDU, length=1400
  pdu SIGIPDU_Event_notifyNOA_SDMapPosInfo_ICC_SDmapInfo_1: has-dynamic-length=false, length=24, transmission-mode-true-timing=event-controlled-timing=number-of-repetitions=0
    signal SIG_Event_notifyNOA_SDMapPosInfo_ICC_SDmapInfo_1: start 0, 128 bit, opaque, data-transformations=SOME_IP_Default_Transformation, data-type-policy=TRANSFORMING-I-SIGNAL, someip-transformation-i-signal-props{transformer=SOME_IP_Default_Transformer, message-type=NOTIFICATION}, transfer-property=TRIGGERED, to FCM
  pdu SIGIPDU_Event_notifyNOA_SDMapStubInfo_ICC_SDmapInfo_1: has-dynamic-length=false, length=26, transmission-mode-true-timing=event-controlled-timing=number-of-repetitions=0
    signal SIG_Event_notifyNOA_SDMapStubInfo_ICC_SDmapInfo_1: start 0, 144 bit, opaque, data-transformations=SOME_IP_Default_Transformation, data-type-policy=TRANSFORMING-I-SIGNAL, someip-transformation-i-signal-props{transformer=SOME_IP_Default_Transformer, message-type=NOTIFICATION}, transfer-property=TRIGGERED, to FCM
  pdu SIGIPDU_Event_notifyNOA_SDMapSegmentInfo_ICC_SDmapInfo_1: has-dynamic-length=false, length=28, transmission-mode-true-timing=event-controlled-timing=number-of-repetitions=0
    signal SIG_Event_notifyNOA_SDMapSegmentInfo_ICC_SDmapInfo_1: start 0, 160 bit, opaque, data-transformations=SOME_IP_Default_Transformation, data-type-policy=TRANSFORMING-I-SIGNAL, someip-transformation-i-signal-props{transformer=SOME_IP_Default_Transformer, message-type=NOTIFICATION}, transfer-property=TRIGGERED, to FCM
  pdu SIGIPDU_Event_notifyNOA_SDMapShortInfo_ICC_SDmapInfo_1: has-dynamic-length=false, length=26, transmission-mode-true-timing=event-controlled-timing=number-of-repetitions=0
    signal SIG_Event_notifyNOA_SDMapShortInfo_ICC_SDmapInfo_1: start 0, 144 bit, opaque, data-transformations=SOME_IP_Default_Transformation, data-type-policy=TRANSFORMING-I-SIGNAL, someip-transformation-i-signal-props{transformer=SOME_IP_Default_Transformer, message-type=NOTIFICATION}, transfer-property=TRIGGERED, to FCM
  pdu SIGIPDU_Event_notifyNOA_SDMapLongInfo_ICC_SDmapInfo_1: has-dynamic-length=false, length=24, transmission-mode-true-timing=event-controlled-timing=number-of-repetitions=0
    signal SIG_Event_notifyNOA_SDMapLongInfo_ICC_SDmapInfo_1: start 0, 128 bit, opaque, data-transformations=SOME_IP_Default_Transformation, data-type-policy=TRANSFORMING-I-SIGNAL, someip-transformation-i-signal-props{transformer=SOME_IP_Default_Transformer, message-type=NOTIFICATION}, transfer-property=TRIGGERED, to FCM
  pdu SIGIPDU_Event_notifyNOA_SDMapMetaInfo_ICC_SDmapInfo_1: has-dynamic-length=false, length=26, transmission-mode-true-timing=event-controlled-timing=number-of-repetitions=0
    signal SIG_Event_notifyNOA_SDMapMetaInfo_ICC_SDmapInfo_1: start 0, 144 bit, opaque, data-transformations=SOME_IP_Default_Transformation, data-type-policy=TRANSFORMING-I-SIGNAL, someip-transformation-i-signal-props{transformer=SOME_IP_Default_Transformer, message-type=NOTIFICATION}, transfer-property=TRIGGERED, to FCM
  pdu SIGIPDU_Event_NtfSDmapInfo_international_ICC_SDmapInfo_1: has-dynamic-length=false, length=28, transmission-mode-true-timing=event-controlled-timing=number-of-repetitions=0
    signal SIG_Event_NtfSDmapInfo_international_ICC_SDmapInfo_1: start 0, 160 bit, opaque, data-transformations=SOME_IP_Default_Transformation, data-type-policy=TRANSFORMING-I-SIGNAL, someip-transformation-i-signal-props{transformer=SOME_IP_Default_Transformer, message-type=NOTIFICATION}, transfer-property=TRIGGERED, to FCM
  pdu SIGIPDU_Event_NtfSDmapLaneInfo_ICC_SDmapInfo_1: has-dynamic-length=false, length=60, transmission-mode-true-timing=event-controlled-timing=number-of-repetitions=0
    signal SIG_Event_NtfSDmapLaneInfo_ICC_SDmapInfo_1: start 0, 416 bit, opaque, data-transformations=SOME_IP_Default_Transformation, data-type-policy=TRANSFORMING-I-SIGNAL, someip-transformation-i-signal-props{transformer=SOME_IP_Default_Transformer, message-type=NOTIFICATION}, transfer-property=TRIGGERED, to FCM
  pdu SIGIPDU_Event_NtfSDmapRouteInfo_ICC_SDmapInfo_2: has-dynamic-length=true, length=100000012, transmission-mode-true-timing=event-controlled-timing=number-of-repetitions=0
    signal SIG_Event_NtfSDmapRouteInfo_ICC_SDmapInfo_2: start 0, 800000032 bit, opaque, data-transformations=SOME_IP_Default_Transformation, data-type-policy=TRANSFORMING-I-SIGNAL, someip-transformation-i-signal-props{transformer=SOME_IP_Default_Transformer, message-type=NOTIFICATION}, dynamic-length=true, transfer-property=TRIGGERED, to ADCC
  general purpose i pdu TPSIGIPDU_Event_NtfSDmapRouteInfo_ICC_SDmapInfo_2: category=SOMEIP_SEGMENTED_IPDU, length=1400
  pdu SIGIPDU_Event_NtfSDmapTBTNaviInfo_ICC_SDmapInfo_2: has-dynamic-length=false, length=91196, transmission-mode-true-timing=event-controlled-timing=number-of-repetitions=0
    signal SIG_Event_NtfSDmapTBTNaviInfo_ICC_SDmapInfo_2: start 0, 729504 bit, opaque, data-transformations=SOME_IP_Default_Transformation, data-type-policy=TRANSFORMING-I-SIGNAL, someip-transformation-i-signal-props{transformer=SOME_IP_Default_Transformer, message-type=NOTIFICATION}, transfer-property=TRIGGERED, to ADCC
  general purpose i pdu TPSIGIPDU_Event_NtfSDmapTBTNaviInfo_ICC_SDmapInfo_2: category=SOMEIP_SEGMENTED_IPDU, length=1400
  pdu SIGIPDU_Event_NtfSDmapNaviCameraInfo_ICC_SDmapInfo_2: has-dynamic-length=false, length=5764, transmission-mode-true-timing=event-controlled-timing=number-of-repetitions=0
    signal SIG_Event_NtfSDmapNaviCameraInfo_ICC_SDmapInfo_2: start 0, 46048 bit, opaque, data-transformations=SOME_IP_Default_Transformation, data-type-policy=TRANSFORMING-I-SIGNAL, someip-transformation-i-signal-props{transformer=SOME_IP_Default_Transformer, message-type=NOTIFICATION}, transfer-property=TRIGGERED, to ADCC
  general purpose i pdu TPSIGIPDU_Event_NtfSDmapNaviCameraInfo_ICC_SDmapInfo_2: category=SOMEIP_SEGMENTED_IPDU, length=1400
  pdu SIGIPDU_Event_NtfSDmapCruiseFacilityInfo_ICC_SDmapInfo_2: has-dynamic-length=false, length=120, transmission-mode-true-timing=event-controlled-timing=number-of-repetitions=0
    signal SIG_Event_NtfSDmapCruiseFacilityInfo_ICC_SDmapInfo_2: start 0, 896 bit, opaque, data-transformations=SOME_IP_Default_Transformation, data-type-policy=TRANSFORMING-I-SIGNAL, someip-transformation-i-signal-props{transformer=SOME_IP_Default_Transformer, message-type=NOTIFICATION}, transfer-property=TRIGGERED, to ADCC
  pdu SIGIPDU_Event_NtfSDmapTrafficLightCDInfo_ICC_SDmapInfo_2: has-dynamic-length=true, length=13496, transmission-mode-true-timing=event-controlled-timing=number-of-repetitions=0
    signal SIG_Event_NtfSDmapTrafficLightCDInfo_ICC_SDmapInfo_2: start 0, 107904 bit, opaque, data-transformations=SOME_IP_Default_Transformation, data-type-policy=TRANSFORMING-I-SIGNAL, someip-transformation-i-signal-props{transformer=SOME_IP_Default_Transformer, message-type=NOTIFICATION}, dynamic-length=true, transfer-property=TRIGGERED, to ADCC
  general purpose i pdu TPSIGIPDU_Event_NtfSDmapTrafficLightCDInfo_ICC_SDmapInfo_2: category=SOMEIP_SEGMENTED_IPDU, length=1400
  pdu SIGIPDU_Event_NtfSDmapNaviIntCamDynInfo_ICC_SDmapInfo_2: has-dynamic-length=true, length=5412, transmission-mode-true-timing=event-controlled-timing=number-of-repetitions=0
    signal SIG_Event_NtfSDmapNaviIntCamDynInfo_ICC_SDmapInfo_2: start 0, 43232 bit, opaque, data-transformations=SOME_IP_Default_Transformation, data-type-policy=TRANSFORMING-I-SIGNAL, someip-transformation-i-signal-props{transformer=SOME_IP_Default_Transformer, message-type=NOTIFICATION}, dynamic-length=true, transfer-property=TRIGGERED, to ADCC
  general purpose i pdu TPSIGIPDU_Event_NtfSDmapNaviIntCamDynInfo_ICC_SDmapInfo_2: category=SOMEIP_SEGMENTED_IPDU, length=1400
  pdu SIGIPDU_Event_NtfSDmapNaviWeatherInfo_ICC_SDmapInfo_2: has-dynamic-length=false, length=4860, transmission-mode-true-timing=event-controlled-timing=number-of-repetitions=0
    signal SIG_Event_NtfSDmapNaviWeatherInfo_ICC_SDmapInfo_2: start 0, 38816 bit, opaque, data-transformations=SOME_IP_Default_Transformation, data-type-policy=TRANSFORMING-I-SIGNAL, someip-transformation-i-signal-props{transformer=SOME_IP_Default_Transformer, message-type=NOTIFICATION}, transfer-property=TRIGGERED, to ADCC
  general purpose i pdu TPSIGIPDU_Event_NtfSDmapNaviWeatherInfo_ICC_SDmapInfo_2: category=SOMEIP_SEGMENTED_IPDU, length=1400
  pdu SIGIPDU_Event_NtfSDmapNaviCongestionInfo_ICC_SDmapInfo_2: has-dynamic-length=false, length=27820, transmission-mode-true-timing=event-controlled-timing=number-of-repetitions=0
    signal SIG_Event_NtfSDmapNaviCongestionInfo_ICC_SDmapInfo_2: start 0, 222496 bit, opaque, data-transformations=SOME_IP_Default_Transformation, data-type-policy=TRANSFORMING-I-SIGNAL, someip-transformation-i-signal-props{transformer=SOME_IP_Default_Transformer, message-type=NOTIFICATION}, transfer-property=TRIGGERED, to ADCC
  general purpose i pdu TPSIGIPDU_Event_NtfSDmapNaviCongestionInfo_ICC_SDmapInfo_2: category=SOMEIP_SEGMENTED_IPDU, length=1400
  pdu SIGIPDU_Event_NtfSDmapNaviGreenWaveCarSpd_ICC_SDmapInfo_2: has-dynamic-length=true, length=10416, transmission-mode-true-timing=event-controlled-timing=number-of-repetitions=0
    signal SIG_Event_NtfSDmapNaviGreenWaveCarSpd_ICC_SDmapInfo_2: start 0, 83264 bit, opaque, data-transformations=SOME_IP_Default_Transformation, data-type-policy=TRANSFORMING-I-SIGNAL, someip-transformation-i-signal-props{transformer=SOME_IP_Default_Transformer, message-type=NOTIFICATION}, dynamic-length=true, transfer-property=TRIGGERED, to ADCC
  general purpose i pdu TPSIGIPDU_Event_NtfSDmapNaviGreenWaveCarSpd_ICC_SDmapInfo_2: category=SOMEIP_SEGMENTED_IPDU, length=1400
  pdu SIGIPDU_Event_notifySDmapLaneInfo_ICC_SDmapInfo_2: has-dynamic-length=false, length=1176, transmission-mode-true-timing=event-controlled-timing=number-of-repetitions=0
    signal SIG_Event_notifySDmapLaneInfo_ICC_SDmapInfo_2: start 0, 9344 bit, opaque, data-transformations=SOME_IP_Default_Transformation, data-type-policy=TRANSFORMING-I-SIGNAL, someip-transformation-i-signal-props{transformer=SOME_IP_Default_Transformer, message-type=NOTIFICATION}, transfer-property=TRIGGERED, to ADCC
  pdu SIGIPDU_Event_NtfSDmapMixForkInfo_ICC_SDmapInfo_2: has-dynamic-length=true, length=688, transmission-mode-true-timing=event-controlled-timing=number-of-repetitions=0
    signal SIG_Event_NtfSDmapMixForkInfo_ICC_SDmapInfo_2: start 0, 5440 bit, opaque, data-transformations=SOME_IP_Default_Transformation, data-type-policy=TRANSFORMING-I-SIGNAL, someip-transformation-i-signal-props{transformer=SOME_IP_Default_Transformer, message-type=NOTIFICATION}, dynamic-length=true, transfer-property=TRIGGERED, to ADCC
  pdu SIGIPDU_Event_NtfSDmapMyLocationInfo_ICC_SDmapInfo_2: has-dynamic-length=false, length=120, transmission-mode-true-timing=event-controlled-timing=number-of-repetitions=0
    signal SIG_Event_NtfSDmapMyLocationInfo_ICC_SDmapInfo_2: start 0, 896 bit, opaque, data-transformations=SOME_IP_Default_Transformation, data-type-policy=TRANSFORMING-I-SIGNAL, someip-transformation-i-signal-props{transformer=SOME_IP_Default_Transformer, message-type=NOTIFICATION}, transfer-property=TRIGGERED, to ADCC
  pdu SIGIPDU_Event_NtfSDmapNaviStatusInfo_ICC_SDmapInfo_2: has-dynamic-length=false, length=96, transmission-mode-true-timing=event-controlled-timing=number-of-repetitions=0
    signal SIG_Event_NtfSDmapNaviStatusInfo_ICC_SDmapInfo_2: start 0, 704 bit, opaque, data-transformations=SOME_IP_Default_Transformation, data-type-policy=TRANSFORMING-I-SIGNAL, someip-transformation-i-signal-props{transformer=SOME_IP_Default_Transformer, message-type=NOTIFICATION}, transfer-property=TRIGGERED, to ADCC
  pdu SIGIPDU_Event_NtfSDmapSoundInfo_ICC_SDmapInfo_2: has-dynamic-length=true, length=1012, transmission-mode-true-timing=event-controlled-timing=number-of-repetitions=0
    signal SIG_Event_NtfSDmapSoundInfo_ICC_SDmapInfo_2: start 0, 8032 bit, opaque, data-transformations=SOME_IP_Default_Transformation, data-type-policy=TRANSFORMING-I-SIGNAL, someip-transformation-i-signal-props{transformer=SOME_IP_Default_Transformer, message-type=NOTIFICATION}, dynamic-length=true, transfer-property=TRIGGERED, to ADCC
  pdu SIGIPDU_Event_NtfSDmapRouteOption_ICC_SDmapInfo_2: has-dynamic-length=false, length=12, transmission-mode-true-timing=event-controlled-timing=number-of-repetitions=0
    signal SIG_Event_NtfSDmapRouteOption_ICC_SDmapInfo_2: start 0, 32 bit, opaque, data-transformations=SOME_IP_Default_Transformation, data-type-policy=TRANSFORMING-I-SIGNAL, someip-transformation-i-signal-props{transformer=SOME_IP_Default_Transformer, message-type=NOTIFICATION}, transfer-property=TRIGGERED, to ADCC
  pdu SIGIPDU_Event_NtfSDmapCruiseInfo_ICC_SDmapInfo_2: has-dynamic-length=false, length=1096, transmission-mode-true-timing=event-controlled-timing=number-of-repetitions=0
    signal SIG_Event_NtfSDmapCruiseInfo_ICC_SDmapInfo_2: start 0, 8704 bit, opaque, data-transformations=SOME_IP_Default_Transformation, data-type-policy=TRANSFORMING-I-SIGNAL, someip-transformation-i-signal-props{transformer=SOME_IP_Default_Transformer, message-type=NOTIFICATION}, transfer-property=TRIGGERED, to ADCC
  pdu SIGIPDU_Event_NtfSDmapNaviRoadInfo_ICC_SDmapInfo_2: has-dynamic-length=false, length=1104, transmission-mode-true-timing=event-controlled-timing=number-of-repetitions=0
    signal SIG_Event_NtfSDmapNaviRoadInfo_ICC_SDmapInfo_2: start 0, 8768 bit, opaque, data-transformations=SOME_IP_Default_Transformation, data-type-policy=TRANSFORMING-I-SIGNAL, someip-transformation-i-signal-props{transformer=SOME_IP_Default_Transformer, message-type=NOTIFICATION}, transfer-property=TRIGGERED, to ADCC
  pdu SIGIPDU_Event_NtfSDmapAheadLaneInfo_ICC_SDmapInfo_2: has-dynamic-length=true, length=7024, transmission-mode-true-timing=event-controlled-timing=number-of-repetitions=0
    signal SIG_Event_NtfSDmapAheadLaneInfo_ICC_SDmapInfo_2: start 0, 56128 bit, opaque, data-transformations=SOME_IP_Default_Transformation, data-type-policy=TRANSFORMING-I-SIGNAL, someip-transformation-i-signal-props{transformer=SOME_IP_Default_Transformer, message-type=NOTIFICATION}, dynamic-length=true, transfer-property=TRIGGERED, to ADCC
  general purpose i pdu TPSIGIPDU_Event_NtfSDmapAheadLaneInfo_ICC_SDmapInfo_2: category=SOMEIP_SEGMENTED_IPDU, length=1400
  pdu SIGIPDU_Event_NtfSDmapTollGateInfo_ICC_SDmapInfo_2: has-dynamic-length=false, length=416, transmission-mode-true-timing=event-controlled-timing=number-of-repetitions=0
    signal SIG_Event_NtfSDmapTollGateInfo_ICC_SDmapInfo_2: start 0, 3264 bit, opaque, data-transformations=SOME_IP_Default_Transformation, data-type-policy=TRANSFORMING-I-SIGNAL, someip-transformation-i-signal-props{transformer=SOME_IP_Default_Transformer, message-type=NOTIFICATION}, transfer-property=TRIGGERED, to ADCC
  pdu SIGIPDU_Event_NtfSDmapServiceAreaInfo_ICC_SDmapInfo_2: has-dynamic-length=false, length=416, transmission-mode-true-timing=event-controlled-timing=number-of-repetitions=0
    signal SIG_Event_NtfSDmapServiceAreaInfo_ICC_SDmapInfo_2: start 0, 3264 bit, opaque, data-transformations=SOME_IP_Default_Transformation, data-type-policy=TRANSFORMING-I-SIGNAL, someip-transformation-i-signal-props{transformer=SOME_IP_Default_Transformer, message-type=NOTIFICATION}, transfer-property=TRIGGERED, to ADCC
  pdu SIGIPDU_Event_NtfSDmapTunnelInfo_ICC_SDmapInfo_2: has-dynamic-length=false, length=420, transmission-mode-true-timing=event-controlled-timing=number-of-repetitions=0
    signal SIG_Event_NtfSDmapTunnelInfo_ICC_SDmapInfo_2: start 0, 3296 bit, opaque, data-transformations=SOME_IP_Default_Transformation, data-type-policy=TRANSFORMING-I-SIGNAL, someip-transformation-i-signal-props{transformer=SOME_IP_Default_Transformer, message-type=NOTIFICATION}, transfer-property=TRIGGERED, to ADCC
  pdu SIGIPDU_Event_NtfSDmapRampInfo_ICC_SDmapInfo_2: has-dynamic-length=false, length=420, transmission-mode-true-timing=event-controlled-timing=number-of-repetitions=0
    signal SIG_Event_NtfSDmapRampInfo_ICC_SDmapInfo_2: start 0, 3296 bit, opaque, data-transformations=SOME_IP_Default_Transformation, data-type-policy=TRANSFORMING-I-SIGNAL, someip-transformation-i-signal-props{transformer=SOME_IP_Default_Transformer, message-type=NOTIFICATION}, transfer-property=TRIGGERED, to ADCC
  pdu SIGIPDU_Event_NtfSDmapFacilityInfo_ICC_SDmapInfo_2: has-dynamic-length=false, length=432, transmission-mode-true-timing=event-controlled-timing=number-of-repetitions=0
    signal SIG_Event_NtfSDmapFacilityInfo_ICC_SDmapInfo_2: start 0, 3392 bit, opaque, data-transformations=SOME_IP_Default_Transformation, data-type-policy=TRANSFORMING-I-SIGNAL, someip-transformation-i-signal-props{transformer=SOME_IP_Default_Transformer, message-type=NOTIFICATION}, transfer-property=TRIGGERED, to ADCC
  pdu SIGIPDU_Event_NtfSDmapLocMatchInfo_ICC_SDmapInfo_2: has-dynamic-length=false, length=1232, transmission-mode-true-timing=event-controlled-timing=number-of-repetitions=0
    signal SIG_Event_NtfSDmapLocMatchInfo_ICC_SDmapInfo_2: start 0, 9792 bit, opaque, data-transformations=SOME_IP_Default_Transformation, data-type-policy=TRANSFORMING-I-SIGNAL, someip-transformation-i-signal-props{transformer=SOME_IP_Default_Transformer, message-type=NOTIFICATION}, transfer-property=TRIGGERED, to ADCC
  pdu SIGIPDU_Event_notifySDmapTollGateLaneInfo_ICC_SDmapInfo_2: has-dynamic-length=true, length=4212, transmission-mode-true-timing=event-controlled-timing=number-of-repetitions=0
    signal SIG_Event_notifySDmapTollGateLaneInfo_ICC_SDmapInfo_2: start 0, 33632 bit, opaque, data-transformations=SOME_IP_Default_Transformation, data-type-policy=TRANSFORMING-I-SIGNAL, someip-transformation-i-signal-props{transformer=SOME_IP_Default_Transformer, message-type=NOTIFICATION}, dynamic-length=true, transfer-property=TRIGGERED, to ADCC
  general purpose i pdu TPSIGIPDU_Event_notifySDmapTollGateLaneInfo_ICC_SDmapInfo_2: category=SOMEIP_SEGMENTED_IPDU, length=1400
  pdu SIGIPDU_Event_notifySDmapNavArriveAim_ICC_SDmapInfo_2: has-dynamic-length=false, length=12, transmission-mode-true-timing=event-controlled-timing=number-of-repetitions=0
    signal SIG_Event_notifySDmapNavArriveAim_ICC_SDmapInfo_2: start 0, 32 bit, opaque, data-transformations=SOME_IP_Default_Transformation, data-type-policy=TRANSFORMING-I-SIGNAL, someip-transformation-i-signal-props{transformer=SOME_IP_Default_Transformer, message-type=NOTIFICATION}, transfer-property=TRIGGERED, to ADCC
  pdu SIGIPDU_Event_NtfSDmapRouteInfo_ICC_SDmapInfo_2_1: has-dynamic-length=true, length=100000012, transmission-mode-true-timing=event-controlled-timing=number-of-repetitions=0
    signal SIG_Event_NtfSDmapRouteInfo_ICC_SDmapInfo_2_1: start 0, 800000032 bit, opaque, data-transformations=SOME_IP_Default_Transformation, data-type-policy=TRANSFORMING-I-SIGNAL, someip-transformation-i-signal-props{transformer=SOME_IP_Default_Transformer, message-type=NOTIFICATION}, dynamic-length=true, transfer-property=TRIGGERED, to FCM
  general purpose i pdu TPSIGIPDU_Event_NtfSDmapRouteInfo_ICC_SDmapInfo_2_1: category=SOMEIP_SEGMENTED_IPDU, length=1400
  pdu SIGIPDU_Event_NtfSDmapTBTNaviInfo_ICC_SDmapInfo_2_1: has-dynamic-length=false, length=91196, transmission-mode-true-timing=event-controlled-timing=number-of-repetitions=0
    signal SIG_Event_NtfSDmapTBTNaviInfo_ICC_SDmapInfo_2_1: start 0, 729504 bit, opaque, data-transformations=SOME_IP_Default_Transformation, data-type-policy=TRANSFORMING-I-SIGNAL, someip-transformation-i-signal-props{transformer=SOME_IP_Default_Transformer, message-type=NOTIFICATION}, transfer-property=TRIGGERED, to FCM
  general purpose i pdu TPSIGIPDU_Event_NtfSDmapTBTNaviInfo_ICC_SDmapInfo_2_1: category=SOMEIP_SEGMENTED_IPDU, length=1400
  pdu SIGIPDU_Event_NtfSDmapNaviCameraInfo_ICC_SDmapInfo_2_1: has-dynamic-length=false, length=5764, transmission-mode-true-timing=event-controlled-timing=number-of-repetitions=0
    signal SIG_Event_NtfSDmapNaviCameraInfo_ICC_SDmapInfo_2_1: start 0, 46048 bit, opaque, data-transformations=SOME_IP_Default_Transformation, data-type-policy=TRANSFORMING-I-SIGNAL, someip-transformation-i-signal-props{transformer=SOME_IP_Default_Transformer, message-type=NOTIFICATION}, transfer-property=TRIGGERED, to FCM
  general purpose i pdu TPSIGIPDU_Event_NtfSDmapNaviCameraInfo_ICC_SDmapInfo_2_1: category=SOMEIP_SEGMENTED_IPDU, length=1400
  pdu SIGIPDU_Event_NtfSDmapCruiseFacilityInfo_ICC_SDmapInfo_2_1: has-dynamic-length=false, length=120, transmission-mode-true-timing=event-controlled-timing=number-of-repetitions=0
    signal SIG_Event_NtfSDmapCruiseFacilityInfo_ICC_SDmapInfo_2_1: start 0, 896 bit, opaque, data-transformations=SOME_IP_Default_Transformation, data-type-policy=TRANSFORMING-I-SIGNAL, someip-transformation-i-signal-props{transformer=SOME_IP_Default_Transformer, message-type=NOTIFICATION}, transfer-property=TRIGGERED, to FCM
  pdu SIGIPDU_Event_NtfSDmapTrafficLightCDInfo_ICC_SDmapInfo_2_1: has-dynamic-length=true, length=13496, transmission-mode-true-timing=event-controlled-timing=number-of-repetitions=0
    signal SIG_Event_NtfSDmapTrafficLightCDInfo_ICC_SDmapInfo_2_1: start 0, 107904 bit, opaque, data-transformations=SOME_IP_Default_Transformation, data-type-policy=TRANSFORMING-I-SIGNAL, someip-transformation-i-signal-props{transformer=SOME_IP_Default_Transformer, message-type=NOTIFICATION}, dynamic-length=true, transfer-property=TRIGGERED, to FCM
  general purpose i pdu TPSIGIPDU_Event_NtfSDmapTrafficLightCDInfo_ICC_SDmapInfo_2_1: category=SOMEIP_SEGMENTED_IPDU, length=1400
  pdu SIGIPDU_Event_NtfSDmapNaviIntCamDynInfo_ICC_SDmapInfo_2_1: has-dynamic-length=true, length=5412, transmission-mode-true-timing=event-controlled-timing=number-of-repetitions=0
    signal SIG_Event_NtfSDmapNaviIntCamDynInfo_ICC_SDmapInfo_2_1: start 0, 43232 bit, opaque, data-transformations=SOME_IP_Default_Transformation, data-type-policy=TRANSFORMING-I-SIGNAL, someip-transformation-i-signal-props{transformer=SOME_IP_Default_Transformer, message-type=NOTIFICATION}, dynamic-length=true, transfer-property=TRIGGERED, to FCM
  general purpose i pdu TPSIGIPDU_Event_NtfSDmapNaviIntCamDynInfo_ICC_SDmapInfo_2_1: category=SOMEIP_SEGMENTED_IPDU, length=1400
  pdu SIGIPDU_Event_NtfSDmapNaviWeatherInfo_ICC_SDmapInfo_2_1: has-dynamic-length=false, length=4860, transmission-mode-true-timing=event-controlled-timing=number-of-repetitions=0
    signal SIG_Event_NtfSDmapNaviWeatherInfo_ICC_SDmapInfo_2_1: start 0, 38816 bit, opaque, data-transformations=SOME_IP_Default_Transformation, data-type-policy=TRANSFORMING-I-SIGNAL, someip-transformation-i-signal-props{transformer=SOME_IP_Default_Transformer, message-type=NOTIFICATION}, transfer-property=TRIGGERED, to FCM
  general purpose i pdu TPSIGIPDU_Event_NtfSDmapNaviWeatherInfo_ICC_SDmapInfo_2_1: category=SOMEIP_SEGMENTED_IPDU, length=1400
  pdu SIGIPDU_Event_NtfSDmapNaviCongestionInfo_ICC_SDmapInfo_2_1: has-dynamic-length=false, length=27820, transmission-mode-true-timing=event-controlled-timing=number-of-repetitions=0
    signal SIG_Event_NtfSDmapNaviCongestionInfo_ICC_SDmapInfo_2_1: start 0, 222496 bit, opaque, data-transformations=SOME_IP_Default_Transformation, data-type-policy=TRANSFORMING-I-SIGNAL, someip-transformation-i-signal-props{transformer=SOME_IP_Default_Transformer, message-type=NOTIFICATION}, transfer-property=TRIGGERED, to FCM
  general purpose i pdu TPSIGIPDU_Event_NtfSDmapNaviCongestionInfo_ICC_SDmapInfo_2_1: category=SOMEIP_SEGMENTED_IPDU, length=1400
  pdu SIGIPDU_Event_NtfSDmapNaviGreenWaveCarSpd_ICC_SDmapInfo_2_1: has-dynamic-length=true, length=10416, transmission-mode-true-timing=event-controlled-timing=number-of-repetitions=0
    signal SIG_Event_NtfSDmapNaviGreenWaveCarSpd_ICC_SDmapInfo_2_1: start 0, 83264 bit, opaque, data-transformations=SOME_IP_Default_Transformation, data-type-policy=TRANSFORMING-I-SIGNAL, someip-transformation-i-signal-props{transformer=SOME_IP_Default_Transformer, message-type=NOTIFICATION}, dynamic-length=true, transfer-property=TRIGGERED, to FCM
  general purpose i pdu TPSIGIPDU_Event_NtfSDmapNaviGreenWaveCarSpd_ICC_SDmapInfo_2_1: category=SOMEIP_SEGMENTED_IPDU, length=1400
  pdu SIGIPDU_Event_notifySDmapLaneInfo_ICC_SDmapInfo_2_1: has-dynamic-length=false, length=1176, transmission-mode-true-timing=event-controlled-timing=number-of-repetitions=0
    signal SIG_Event_notifySDmapLaneInfo_ICC_SDmapInfo_2_1: start 0, 9344 bit, opaque, data-transformations=SOME_IP_Default_Transformation, data-type-policy=TRANSFORMING-I-SIGNAL, someip-transformation-i-signal-props{transformer=SOME_IP_Default_Transformer, message-type=NOTIFICATION}, transfer-property=TRIGGERED, to FCM
  pdu SIGIPDU_Event_NtfSDmapMixForkInfo_ICC_SDmapInfo_2_1: has-dynamic-length=true, length=688, transmission-mode-true-timing=event-controlled-timing=number-of-repetitions=0
    signal SIG_Event_NtfSDmapMixForkInfo_ICC_SDmapInfo_2_1: start 0, 5440 bit, opaque, data-transformations=SOME_IP_Default_Transformation, data-type-policy=TRANSFORMING-I-SIGNAL, someip-transformation-i-signal-props{transformer=SOME_IP_Default_Transformer, message-type=NOTIFICATION}, dynamic-length=true, transfer-property=TRIGGERED, to FCM
  pdu SIGIPDU_Event_NtfSDmapMyLocationInfo_ICC_SDmapInfo_2_1: has-dynamic-length=false, length=120, transmission-mode-true-timing=event-controlled-timing=number-of-repetitions=0
    signal SIG_Event_NtfSDmapMyLocationInfo_ICC_SDmapInfo_2_1: start 0, 896 bit, opaque, data-transformations=SOME_IP_Default_Transformation, data-type-policy=TRANSFORMING-I-SIGNAL, someip-transformation-i-signal-props{transformer=SOME_IP_Default_Transformer, message-type=NOTIFICATION}, transfer-property=TRIGGERED, to FCM
  pdu SIGIPDU_Event_NtfSDmapNaviStatusInfo_ICC_SDmapInfo_2_1: has-dynamic-length=false, length=96, transmission-mode-true-timing=event-controlled-timing=number-of-repetitions=0
    signal SIG_Event_NtfSDmapNaviStatusInfo_ICC_SDmapInfo_2_1: start 0, 704 bit, opaque, data-transformations=SOME_IP_Default_Transformation, data-type-policy=TRANSFORMING-I-SIGNAL, someip-transformation-i-signal-props{transformer=SOME_IP_Default_Transformer, message-type=NOTIFICATION}, transfer-property=TRIGGERED, to FCM
  pdu SIGIPDU_Event_NtfSDmapSoundInfo_ICC_SDmapInfo_2_1: has-dynamic-length=true, length=1012, transmission-mode-true-timing=event-controlled-timing=number-of-repetitions=0
    signal SIG_Event_NtfSDmapSoundInfo_ICC_SDmapInfo_2_1: start 0, 8032 bit, opaque, data-transformations=SOME_IP_Default_Transformation, data-type-policy=TRANSFORMING-I-SIGNAL, someip-transformation-i-signal-props{transformer=SOME_IP_Default_Transformer, message-type=NOTIFICATION}, dynamic-length=true, transfer-property=TRIGGERED, to FCM
  pdu SIGIPDU_Event_NtfSDmapRouteOption_ICC_SDmapInfo_2_1: has-dynamic-length=false, length=12, transmission-mode-true-timing=event-controlled-timing=number-of-repetitions=0
    signal SIG_Event_NtfSDmapRouteOption_ICC_SDmapInfo_2_1: start 0, 32 bit, opaque, data-transformations=SOME_IP_Default_Transformation, data-type-policy=TRANSFORMING-I-SIGNAL, someip-transformation-i-signal-props{transformer=SOME_IP_Default_Transformer, message-type=NOTIFICATION}, transfer-property=TRIGGERED, to FCM
  pdu SIGIPDU_Event_NtfSDmapCruiseInfo_ICC_SDmapInfo_2_1: has-dynamic-length=false, length=1096, transmission-mode-true-timing=event-controlled-timing=number-of-repetitions=0
    signal SIG_Event_NtfSDmapCruiseInfo_ICC_SDmapInfo_2_1: start 0, 8704 bit, opaque, data-transformations=SOME_IP_Default_Transformation, data-type-policy=TRANSFORMING-I-SIGNAL, someip-transformation-i-signal-props{transformer=SOME_IP_Default_Transformer, message-type=NOTIFICATION}, transfer-property=TRIGGERED, to FCM
  pdu SIGIPDU_Event_NtfSDmapNaviRoadInfo_ICC_SDmapInfo_2_1: has-dynamic-length=false, length=1104, transmission-mode-true-timing=event-controlled-timing=number-of-repetitions=0
    signal SIG_Event_NtfSDmapNaviRoadInfo_ICC_SDmapInfo_2_1: start 0, 8768 bit, opaque, data-transformations=SOME_IP_Default_Transformation, data-type-policy=TRANSFORMING-I-SIGNAL, someip-transformation-i-signal-props{transformer=SOME_IP_Default_Transformer, message-type=NOTIFICATION}, transfer-property=TRIGGERED, to FCM
  pdu SIGIPDU_Event_NtfSDmapAheadLaneInfo_ICC_SDmapInfo_2_1: has-dynamic-length=true, length=7024, transmission-mode-true-timing=event-controlled-timing=number-of-repetitions=0
    signal SIG_Event_NtfSDmapAheadLaneInfo_ICC_SDmapInfo_2_1: start 0, 56128 bit, opaque, data-transformations=SOME_IP_Default_Transformation, data-type-policy=TRANSFORMING-I-SIGNAL, someip-transformation-i-signal-props{transformer=SOME_IP_Default_Transformer, message-type=NOTIFICATION}, dynamic-length=true, transfer-property=TRIGGERED, to FCM
  general purpose i pdu TPSIGIPDU_Event_NtfSDmapAheadLaneInfo_ICC_SDmapInfo_2_1: category=SOMEIP_SEGMENTED_IPDU, length=1400
  pdu SIGIPDU_Event_NtfSDmapTollGateInfo_ICC_SDmapInfo_2_1: has-dynamic-length=false, length=416, transmission-mode-true-timing=event-controlled-timing=number-of-repetitions=0
    signal SIG_Event_NtfSDmapTollGateInfo_ICC_SDmapInfo_2_1: start 0, 3264 bit, opaque, data-transformations=SOME_IP_Default_Transformation, data-type-policy=TRANSFORMING-I-SIGNAL, someip-transformation-i-signal-props{transformer=SOME_IP_Default_Transformer, message-type=NOTIFICATION}, transfer-property=TRIGGERED, to FCM
  pdu SIGIPDU_Event_NtfSDmapServiceAreaInfo_ICC_SDmapInfo_2_1: has-dynamic-length=false, length=416, transmission-mode-true-timing=event-controlled-timing=number-of-repetitions=0
    signal SIG_Event_NtfSDmapServiceAreaInfo_ICC_SDmapInfo_2_1: start 0, 3264 bit, opaque, data-transformations=SOME_IP_Default_Transformation, data-type-policy=TRANSFORMING-I-SIGNAL, someip-transformation-i-signal-props{transformer=SOME_IP_Default_Transformer, message-type=NOTIFICATION}, transfer-property=TRIGGERED, to FCM
  pdu SIGIPDU_Event_NtfSDmapTunnelInfo_ICC_SDmapInfo_2_1: has-dynamic-length=false, length=420, transmission-mode-true-timing=event-controlled-timing=number-of-repetitions=0
    signal SIG_Event_NtfSDmapTunnelInfo_ICC_SDmapInfo_2_1: start 0, 3296 bit, opaque, data-transformations=SOME_IP_Default_Transformation, data-type-policy=TRANSFORMING-I-SIGNAL, someip-transformation-i-signal-props{transformer=SOME_IP_Default_Transformer, message-type=NOTIFICATION}, transfer-property=TRIGGERED, to FCM
  pdu SIGIPDU_Event_NtfSDmapRampInfo_ICC_SDmapInfo_2_1: has-dynamic-length=false, length=420, transmission-mode-true-timing=event-controlled-timing=number-of-repetitions=0
    signal SIG_Event_NtfSDmapRampInfo_ICC_SDmapInfo_2_1: start 0, 3296 bit, opaque, data-transformations=SOME_IP_Default_Transformation, data-type-policy=TRANSFORMING-I-SIGNAL, someip-transformation-i-signal-props{transformer=SOME_IP_Default_Transformer, message-type=NOTIFICATION}, transfer-property=TRIGGERED, to FCM
  pdu SIGIPDU_Event_NtfSDmapFacilityInfo_ICC_SDmapInfo_2_1: has-dynamic-length=false, length=432, transmission-mode-true-timing=event-controlled-timing=number-of-repetitions=0
    signal SIG_Event_NtfSDmapFacilityInfo_ICC_SDmapInfo_2_1: start 0, 3392 bit, opaque, data-transformations=SOME_IP_Default_Transformation, data-type-policy=TRANSFORMING-I-SIGNAL, someip-transformation-i-signal-props{transformer=SOME_IP_Default_Transformer, message-type=NOTIFICATION}, transfer-property=TRIGGERED, to FCM
  pdu SIGIPDU_Event_NtfSDmapLocMatchInfo_ICC_SDmapInfo_2_1: has-dynamic-length=false, length=1232, transmission-mode-true-timing=event-controlled-timing=number-of-repetitions=0
    signal SIG_Event_NtfSDmapLocMatchInfo_ICC_SDmapInfo_2_1: start 0, 9792 bit, opaque, data-transformations=SOME_IP_Default_Transformation, data-type-policy=TRANSFORMING-I-SIGNAL, someip-transformation-i-signal-props{transformer=SOME_IP_Default_Transformer, message-type=NOTIFICATION}, transfer-property=TRIGGERED, to FCM
  pdu SIGIPDU_Event_notifySDmapTollGateLaneInfo_ICC_SDmapInfo_2_1: has-dynamic-length=true, length=4212, transmission-mode-true-timing=event-controlled-timing=number-of-repetitions=0
    signal SIG_Event_notifySDmapTollGateLaneInfo_ICC_SDmapInfo_2_1: start 0, 33632 bit, opaque, data-transformations=SOME_IP_Default_Transformation, data-type-policy=TRANSFORMING-I-SIGNAL, someip-transformation-i-signal-props{transformer=SOME_IP_Default_Transformer, message-type=NOTIFICATION}, dynamic-length=true, transfer-property=TRIGGERED, to FCM
  general purpose i pdu TPSIGIPDU_Event_notifySDmapTollGateLaneInfo_ICC_SDmapInfo_2_1: category=SOMEIP_SEGMENTED_IPDU, length=1400
  pdu SIGIPDU_Event_notifySDmapNavArriveAim_ICC_SDmapInfo_2_1: has-dynamic-length=false, length=12, transmission-mode-true-timing=event-controlled-timing=number-of-repetitions=0
    signal SIG_Event_notifySDmapNavArriveAim_ICC_SDmapInfo_2_1: start 0, 32 bit, opaque, data-transformations=SOME_IP_Default_Transformation, data-type-policy=TRANSFORMING-I-SIGNAL, someip-transformation-i-signal-props{transformer=SOME_IP_Default_Transformer, message-type=NOTIFICATION}, transfer-property=TRIGGERED, to FCM
  pdu SIGIPDU_Event_NtfDynamicObjectList_Drvg_ADCC_DrivingHmiEnv: has-dynamic-length=true, length=2032, transmission-mode-true-timing=event-controlled-timing=number-of-repetitions=0
    signal SIG_Event_NtfDynamicObjectList_Drvg_ADCC_DrivingHmiEnv: start 0, 16192 bit, opaque, data-transformations=SOME_IP_Default_Transformation, data-type-policy=TRANSFORMING-I-SIGNAL, someip-transformation-i-signal-props{transformer=SOME_IP_Default_Transformer, message-type=NOTIFICATION}, dynamic-length=true, transfer-property=TRIGGERED, to ICC_8155_Android
  general purpose i pdu TPSIGIPDU_Event_NtfDynamicObjectList_Drvg_ADCC_DrivingHmiEnv: category=SOMEIP_SEGMENTED_IPDU, length=1400
  pdu SIGIPDU_Event_NtfStaticObjectList_Drvg_ADCC_DrivingHmiEnv: has-dynamic-length=true, length=1696, transmission-mode-true-timing=event-controlled-timing=number-of-repetitions=0
    signal SIG_Event_NtfStaticObjectList_Drvg_ADCC_DrivingHmiEnv: start 0, 13504 bit, opaque, data-transformations=SOME_IP_Default_Transformation, data-type-policy=TRANSFORMING-I-SIGNAL, someip-transformation-i-signal-props{transformer=SOME_IP_Default_Transformer, message-type=NOTIFICATION}, dynamic-length=true, transfer-property=TRIGGERED, to ICC_8155_Android
  general purpose i pdu TPSIGIPDU_Event_NtfStaticObjectList_Drvg_ADCC_DrivingHmiEnv: category=SOMEIP_SEGMENTED_IPDU, length=1400
  pdu SIGIPDU_Event_NtfLaneLineListt_Drvg_ADCC_DrivingHmiEnv: has-dynamic-length=true, length=332, transmission-mode-true-timing=event-controlled-timing=number-of-repetitions=0
    signal SIG_Event_NtfLaneLineListt_Drvg_ADCC_DrivingHmiEnv: start 0, 2592 bit, opaque, data-transformations=SOME_IP_Default_Transformation, data-type-policy=TRANSFORMING-I-SIGNAL, someip-transformation-i-signal-props{transformer=SOME_IP_Default_Transformer, message-type=NOTIFICATION}, dynamic-length=true, transfer-property=TRIGGERED, to ICC_8155_Android
  pdu SIGIPDU_Event_NtfEgoFusionPose_Drvg_ADCC_DrivingHmiEnv: has-dynamic-length=false, length=56, transmission-mode-true-timing=event-controlled-timing=number-of-repetitions=0
    signal SIG_Event_NtfEgoFusionPose_Drvg_ADCC_DrivingHmiEnv: start 0, 384 bit, opaque, data-transformations=SOME_IP_Default_Transformation, data-type-policy=TRANSFORMING-I-SIGNAL, someip-transformation-i-signal-props{transformer=SOME_IP_Default_Transformer, message-type=NOTIFICATION}, transfer-property=TRIGGERED, to ICC_8155_Android
  pdu SIGIPDU_Event_NtfRoadMarkerList_ADCC_DrivingHmiEnv: has-dynamic-length=true, length=684, transmission-mode-true-timing=event-controlled-timing=number-of-repetitions=0
    signal SIG_Event_NtfRoadMarkerList_ADCC_DrivingHmiEnv: start 0, 5408 bit, opaque, data-transformations=SOME_IP_Default_Transformation, data-type-policy=TRANSFORMING-I-SIGNAL, someip-transformation-i-signal-props{transformer=SOME_IP_Default_Transformer, message-type=NOTIFICATION}, dynamic-length=true, transfer-property=TRIGGERED, to ICC_8155_Android
  pdu SIGIPDU_Event_NtfLaneLineListt_Drvg_2_ADCC_DrivingHmiEnv: has-dynamic-length=true, length=146224, transmission-mode-true-timing=event-controlled-timing=number-of-repetitions=0
    signal SIG_Event_NtfLaneLineListt_Drvg_2_ADCC_DrivingHmiEnv: start 0, 1169728 bit, opaque, data-transformations=SOME_IP_Default_Transformation, data-type-policy=TRANSFORMING-I-SIGNAL, someip-transformation-i-signal-props{transformer=SOME_IP_Default_Transformer, message-type=NOTIFICATION}, dynamic-length=true, transfer-property=TRIGGERED, to ICC_8155_Android
  general purpose i pdu TPSIGIPDU_Event_NtfLaneLineListt_Drvg_2_ADCC_DrivingHmiEnv: category=SOMEIP_SEGMENTED_IPDU, length=1400
  pdu SIGIPDU_Event_NtfEgoPose_ADCC_DrivingHmiEnv: has-dynamic-length=false, length=32, transmission-mode-true-timing=event-controlled-timing=number-of-repetitions=0
    signal SIG_Event_NtfEgoPose_ADCC_DrivingHmiEnv: start 0, 192 bit, opaque, data-transformations=SOME_IP_Default_Transformation, data-type-policy=TRANSFORMING-I-SIGNAL, someip-transformation-i-signal-props{transformer=SOME_IP_Default_Transformer, message-type=NOTIFICATION}, transfer-property=TRIGGERED, to ICC_8155_Android
  pdu SIGIPDU_Event_NtfFusionMapData_ADCC_DrivingHmiEnv: has-dynamic-length=false, length=600664, transmission-mode-true-timing=event-controlled-timing=number-of-repetitions=0
    signal SIG_Event_NtfFusionMapData_ADCC_DrivingHmiEnv: start 0, 4805248 bit, opaque, data-transformations=SOME_IP_Default_Transformation, data-type-policy=TRANSFORMING-I-SIGNAL, someip-transformation-i-signal-props{transformer=SOME_IP_Default_Transformer, message-type=NOTIFICATION}, transfer-property=TRIGGERED, to ICC_8155_Android
  general purpose i pdu TPSIGIPDU_Event_NtfFusionMapData_ADCC_DrivingHmiEnv: category=SOMEIP_SEGMENTED_IPDU, length=1400
  pdu SIGIPDU_Event_NtfRoadMarkerListSupplement_ADCC_DrivingHmiEnv: has-dynamic-length=true, length=1356, transmission-mode-true-timing=event-controlled-timing=number-of-repetitions=0
    signal SIG_Event_NtfRoadMarkerListSupplement_ADCC_DrivingHmiEnv: start 0, 10784 bit, opaque, data-transformations=SOME_IP_Default_Transformation, data-type-policy=TRANSFORMING-I-SIGNAL, someip-transformation-i-signal-props{transformer=SOME_IP_Default_Transformer, message-type=NOTIFICATION}, dynamic-length=true, transfer-property=TRIGGERED, to ICC_8155_Android
  pdu SIGIPDU_Event_NtfTrafficLightList_Drvg_ADCC_DrivingHmiEnv: has-dynamic-length=false, length=806, transmission-mode-true-timing=event-controlled-timing=number-of-repetitions=0
    signal SIG_Event_NtfTrafficLightList_Drvg_ADCC_DrivingHmiEnv: start 0, 6384 bit, opaque, data-transformations=SOME_IP_Default_Transformation, data-type-policy=TRANSFORMING-I-SIGNAL, someip-transformation-i-signal-props{transformer=SOME_IP_Default_Transformer, message-type=NOTIFICATION}, transfer-property=TRIGGERED, to ICC_8155_Android
  pdu SIGIPDU_Event_NtfFreeSpaceList_Drvg_ADCC_DrivingHmiEnv: has-dynamic-length=false, length=280016, transmission-mode-true-timing=event-controlled-timing=number-of-repetitions=0
    signal SIG_Event_NtfFreeSpaceList_Drvg_ADCC_DrivingHmiEnv: start 0, 2240064 bit, opaque, data-transformations=SOME_IP_Default_Transformation, data-type-policy=TRANSFORMING-I-SIGNAL, someip-transformation-i-signal-props{transformer=SOME_IP_Default_Transformer, message-type=NOTIFICATION}, transfer-property=TRIGGERED, to ICC_8155_Android
  general purpose i pdu TPSIGIPDU_Event_NtfFreeSpaceList_Drvg_ADCC_DrivingHmiEnv: category=SOMEIP_SEGMENTED_IPDU, length=1400
  pdu SIGIPDU_Event_Ntf3DTrafficSignList_Drvg_ADCC_DrivingHmiEnv: has-dynamic-length=false, length=1616, transmission-mode-true-timing=event-controlled-timing=number-of-repetitions=0
    signal SIG_Event_Ntf3DTrafficSignList_Drvg_ADCC_DrivingHmiEnv: start 0, 12864 bit, opaque, data-transformations=SOME_IP_Default_Transformation, data-type-policy=TRANSFORMING-I-SIGNAL, someip-transformation-i-signal-props{transformer=SOME_IP_Default_Transformer, message-type=NOTIFICATION}, transfer-property=TRIGGERED, to ICC_8155_Android
  general purpose i pdu TPSIGIPDU_Event_Ntf3DTrafficSignList_Drvg_ADCC_DrivingHmiEnv: category=SOMEIP_SEGMENTED_IPDU, length=1400
  pdu SIGIPDU_Event_NtfDynamicObjectList_Drvg_2_ADCC_DrivingHmiEnv: has-dynamic-length=true, length=8416, transmission-mode-true-timing=event-controlled-timing=number-of-repetitions=0
    signal SIG_Event_NtfDynamicObjectList_Drvg_2_ADCC_DrivingHmiEnv: start 0, 67264 bit, opaque, data-transformations=SOME_IP_Default_Transformation, data-type-policy=TRANSFORMING-I-SIGNAL, someip-transformation-i-signal-props{transformer=SOME_IP_Default_Transformer, message-type=NOTIFICATION}, dynamic-length=true, transfer-property=TRIGGERED, to ICC_8155_Android
  general purpose i pdu TPSIGIPDU_Event_NtfDynamicObjectList_Drvg_2_ADCC_DrivingHmiEnv: category=SOMEIP_SEGMENTED_IPDU, length=1400
  pdu SIGIPDU_Event_NtfStaticObjectList_Drvg_2_ADCC_DrivingHmiEnv: has-dynamic-length=true, length=4816, transmission-mode-true-timing=event-controlled-timing=number-of-repetitions=0
    signal SIG_Event_NtfStaticObjectList_Drvg_2_ADCC_DrivingHmiEnv: start 0, 38464 bit, opaque, data-transformations=SOME_IP_Default_Transformation, data-type-policy=TRANSFORMING-I-SIGNAL, someip-transformation-i-signal-props{transformer=SOME_IP_Default_Transformer, message-type=NOTIFICATION}, dynamic-length=true, transfer-property=TRIGGERED, to ICC_8155_Android
  general purpose i pdu TPSIGIPDU_Event_NtfStaticObjectList_Drvg_2_ADCC_DrivingHmiEnv: category=SOMEIP_SEGMENTED_IPDU, length=1400
  pdu SIGIPDU_Event_NtfRoadMarkerList_2_ADCC_DrivingHmiEnv: has-dynamic-length=true, length=1136, transmission-mode-true-timing=event-controlled-timing=number-of-repetitions=0
    signal SIG_Event_NtfRoadMarkerList_2_ADCC_DrivingHmiEnv: start 0, 9024 bit, opaque, data-transformations=SOME_IP_Default_Transformation, data-type-policy=TRANSFORMING-I-SIGNAL, someip-transformation-i-signal-props{transformer=SOME_IP_Default_Transformer, message-type=NOTIFICATION}, dynamic-length=true, transfer-property=TRIGGERED, to ICC_8155_Android
  pdu SIGIPDU_Event_NtfRoadSurfaceMes_ADCC_DrivingHmiEnv: has-dynamic-length=false, length=30860, transmission-mode-true-timing=event-controlled-timing=number-of-repetitions=0
    signal SIG_Event_NtfRoadSurfaceMes_ADCC_DrivingHmiEnv: start 0, 246816 bit, opaque, data-transformations=SOME_IP_Default_Transformation, data-type-policy=TRANSFORMING-I-SIGNAL, someip-transformation-i-signal-props{transformer=SOME_IP_Default_Transformer, message-type=NOTIFICATION}, transfer-property=TRIGGERED, to ICC_8155_Android
  general purpose i pdu TPSIGIPDU_Event_NtfRoadSurfaceMes_ADCC_DrivingHmiEnv: category=SOMEIP_SEGMENTED_IPDU, length=1400
  pdu SIGIPDU_Event_NtfDynamicObjectList_Drvg_ADCC_DrivingHmiEnv_1: has-dynamic-length=true, length=2032, transmission-mode-true-timing=event-controlled-timing=number-of-repetitions=0
    signal SIG_Event_NtfDynamicObjectList_Drvg_ADCC_DrivingHmiEnv_1: start 0, 16192 bit, opaque, data-transformations=SOME_IP_Default_Transformation, data-type-policy=TRANSFORMING-I-SIGNAL, someip-transformation-i-signal-props{transformer=SOME_IP_Default_Transformer, message-type=NOTIFICATION}, dynamic-length=true, transfer-property=TRIGGERED, to ICC_8155_QNX
  general purpose i pdu TPSIGIPDU_Event_NtfDynamicObjectList_Drvg_ADCC_DrivingHmiEnv_1: category=SOMEIP_SEGMENTED_IPDU, length=1400
  pdu SIGIPDU_Event_NtfStaticObjectList_Drvg_ADCC_DrivingHmiEnv_1: has-dynamic-length=true, length=1696, transmission-mode-true-timing=event-controlled-timing=number-of-repetitions=0
    signal SIG_Event_NtfStaticObjectList_Drvg_ADCC_DrivingHmiEnv_1: start 0, 13504 bit, opaque, data-transformations=SOME_IP_Default_Transformation, data-type-policy=TRANSFORMING-I-SIGNAL, someip-transformation-i-signal-props{transformer=SOME_IP_Default_Transformer, message-type=NOTIFICATION}, dynamic-length=true, transfer-property=TRIGGERED, to ICC_8155_QNX
  general purpose i pdu TPSIGIPDU_Event_NtfStaticObjectList_Drvg_ADCC_DrivingHmiEnv_1: category=SOMEIP_SEGMENTED_IPDU, length=1400
  pdu SIGIPDU_Event_NtfLaneLineListt_Drvg_ADCC_DrivingHmiEnv_1: has-dynamic-length=true, length=332, transmission-mode-true-timing=event-controlled-timing=number-of-repetitions=0
    signal SIG_Event_NtfLaneLineListt_Drvg_ADCC_DrivingHmiEnv_1: start 0, 2592 bit, opaque, data-transformations=SOME_IP_Default_Transformation, data-type-policy=TRANSFORMING-I-SIGNAL, someip-transformation-i-signal-props{transformer=SOME_IP_Default_Transformer, message-type=NOTIFICATION}, dynamic-length=true, transfer-property=TRIGGERED, to ICC_8155_QNX
  pdu SIGIPDU_Event_NtfEgoFusionPose_Drvg_ADCC_DrivingHmiEnv_1: has-dynamic-length=false, length=56, transmission-mode-true-timing=event-controlled-timing=number-of-repetitions=0
    signal SIG_Event_NtfEgoFusionPose_Drvg_ADCC_DrivingHmiEnv_1: start 0, 384 bit, opaque, data-transformations=SOME_IP_Default_Transformation, data-type-policy=TRANSFORMING-I-SIGNAL, someip-transformation-i-signal-props{transformer=SOME_IP_Default_Transformer, message-type=NOTIFICATION}, transfer-property=TRIGGERED, to ICC_8155_QNX
  pdu SIGIPDU_Event_NtfRoadMarkerList_ADCC_DrivingHmiEnv_1: has-dynamic-length=true, length=684, transmission-mode-true-timing=event-controlled-timing=number-of-repetitions=0
    signal SIG_Event_NtfRoadMarkerList_ADCC_DrivingHmiEnv_1: start 0, 5408 bit, opaque, data-transformations=SOME_IP_Default_Transformation, data-type-policy=TRANSFORMING-I-SIGNAL, someip-transformation-i-signal-props{transformer=SOME_IP_Default_Transformer, message-type=NOTIFICATION}, dynamic-length=true, transfer-property=TRIGGERED, to ICC_8155_QNX
  pdu SIGIPDU_Event_NtfLaneLineListt_Drvg_2_ADCC_DrivingHmiEnv_1: has-dynamic-length=true, length=146224, transmission-mode-true-timing=event-controlled-timing=number-of-repetitions=0
    signal SIG_Event_NtfLaneLineListt_Drvg_2_ADCC_DrivingHmiEnv_1: start 0, 1169728 bit, opaque, data-transformations=SOME_IP_Default_Transformation, data-type-policy=TRANSFORMING-I-SIGNAL, someip-transformation-i-signal-props{transformer=SOME_IP_Default_Transformer, message-type=NOTIFICATION}, dynamic-length=true, transfer-property=TRIGGERED, to ICC_8155_QNX
  general purpose i pdu TPSIGIPDU_Event_NtfLaneLineListt_Drvg_2_ADCC_DrivingHmiEnv_1: category=SOMEIP_SEGMENTED_IPDU, length=1400
  pdu SIGIPDU_Event_NtfEgoPose_ADCC_DrivingHmiEnv_1: has-dynamic-length=false, length=32, transmission-mode-true-timing=event-controlled-timing=number-of-repetitions=0
    signal SIG_Event_NtfEgoPose_ADCC_DrivingHmiEnv_1: start 0, 192 bit, opaque, data-transformations=SOME_IP_Default_Transformation, data-type-policy=TRANSFORMING-I-SIGNAL, someip-transformation-i-signal-props{transformer=SOME_IP_Default_Transformer, message-type=NOTIFICATION}, transfer-property=TRIGGERED, to ICC_8155_QNX
  pdu SIGIPDU_Event_NtfFusionMapData_ADCC_DrivingHmiEnv_1: has-dynamic-length=false, length=600664, transmission-mode-true-timing=event-controlled-timing=number-of-repetitions=0
    signal SIG_Event_NtfFusionMapData_ADCC_DrivingHmiEnv_1: start 0, 4805248 bit, opaque, data-transformations=SOME_IP_Default_Transformation, data-type-policy=TRANSFORMING-I-SIGNAL, someip-transformation-i-signal-props{transformer=SOME_IP_Default_Transformer, message-type=NOTIFICATION}, transfer-property=TRIGGERED, to ICC_8155_QNX
  general purpose i pdu TPSIGIPDU_Event_NtfFusionMapData_ADCC_DrivingHmiEnv_1: category=SOMEIP_SEGMENTED_IPDU, length=1400
  pdu SIGIPDU_Event_NtfRoadMarkerListSupplement_ADCC_DrivingHmiEnv_1: has-dynamic-length=true, length=1356, transmission-mode-true-timing=event-controlled-timing=number-of-repetitions=0
    signal SIG_Event_NtfRoadMarkerListSupplement_ADCC_DrivingHmiEnv_1: start 0, 10784 bit, opaque, data-transformations=SOME_IP_Default_Transformation, data-type-policy=TRANSFORMING-I-SIGNAL, someip-transformation-i-signal-props{transformer=SOME_IP_Default_Transformer, message-type=NOTIFICATION}, dynamic-length=true, transfer-property=TRIGGERED, to ICC_8155_QNX
  pdu SIGIPDU_Event_NtfTrafficLightList_Drvg_ADCC_DrivingHmiEnv_1: has-dynamic-length=false, length=806, transmission-mode-true-timing=event-controlled-timing=number-of-repetitions=0
    signal SIG_Event_NtfTrafficLightList_Drvg_ADCC_DrivingHmiEnv_1: start 0, 6384 bit, opaque, data-transformations=SOME_IP_Default_Transformation, data-type-policy=TRANSFORMING-I-SIGNAL, someip-transformation-i-signal-props{transformer=SOME_IP_Default_Transformer, message-type=NOTIFICATION}, transfer-property=TRIGGERED, to ICC_8155_QNX
  pdu SIGIPDU_Event_NtfFreeSpaceList_Drvg_ADCC_DrivingHmiEnv_1: has-dynamic-length=false, length=280016, transmission-mode-true-timing=event-controlled-timing=number-of-repetitions=0
    signal SIG_Event_NtfFreeSpaceList_Drvg_ADCC_DrivingHmiEnv_1: start 0, 2240064 bit, opaque, data-transformations=SOME_IP_Default_Transformation, data-type-policy=TRANSFORMING-I-SIGNAL, someip-transformation-i-signal-props{transformer=SOME_IP_Default_Transformer, message-type=NOTIFICATION}, transfer-property=TRIGGERED, to ICC_8155_QNX
  general purpose i pdu TPSIGIPDU_Event_NtfFreeSpaceList_Drvg_ADCC_DrivingHmiEnv_1: category=SOMEIP_SEGMENTED_IPDU, length=1400
  pdu SIGIPDU_Event_Ntf3DTrafficSignList_Drvg_ADCC_DrivingHmiEnv_1: has-dynamic-length=false, length=1616, transmission-mode-true-timing=event-controlled-timing=number-of-repetitions=0
    signal SIG_Event_Ntf3DTrafficSignList_Drvg_ADCC_DrivingHmiEnv_1: start 0, 12864 bit, opaque, data-transformations=SOME_IP_Default_Transformation, data-type-policy=TRANSFORMING-I-SIGNAL, someip-transformation-i-signal-props{transformer=SOME_IP_Default_Transformer, message-type=NOTIFICATION}, transfer-property=TRIGGERED, to ICC_8155_QNX
  general purpose i pdu TPSIGIPDU_Event_Ntf3DTrafficSignList_Drvg_ADCC_DrivingHmiEnv_1: category=SOMEIP_SEGMENTED_IPDU, length=1400
  pdu SIGIPDU_Event_NtfDynamicObjectList_Drvg_2_ADCC_DrivingHmiEnv_1: has-dynamic-length=true, length=8416, transmission-mode-true-timing=event-controlled-timing=number-of-repetitions=0
    signal SIG_Event_NtfDynamicObjectList_Drvg_2_ADCC_DrivingHmiEnv_1: start 0, 67264 bit, opaque, data-transformations=SOME_IP_Default_Transformation, data-type-policy=TRANSFORMING-I-SIGNAL, someip-transformation-i-signal-props{transformer=SOME_IP_Default_Transformer, message-type=NOTIFICATION}, dynamic-length=true, transfer-property=TRIGGERED, to ICC_8155_QNX
  general purpose i pdu TPSIGIPDU_Event_NtfDynamicObjectList_Drvg_2_ADCC_DrivingHmiEnv_1: category=SOMEIP_SEGMENTED_IPDU, length=1400
  pdu SIGIPDU_Event_NtfStaticObjectList_Drvg_2_ADCC_DrivingHmiEnv_1: has-dynamic-length=true, length=4816, transmission-mode-true-timing=event-controlled-timing=number-of-repetitions=0
    signal SIG_Event_NtfStaticObjectList_Drvg_2_ADCC_DrivingHmiEnv_1: start 0, 38464 bit, opaque, data-transformations=SOME_IP_Default_Transformation, data-type-policy=TRANSFORMING-I-SIGNAL, someip-transformation-i-signal-props{transformer=SOME_IP_Default_Transformer, message-type=NOTIFICATION}, dynamic-length=true, transfer-property=TRIGGERED, to ICC_8155_QNX
  general purpose i pdu TPSIGIPDU_Event_NtfStaticObjectList_Drvg_2_ADCC_DrivingHmiEnv_1: category=SOMEIP_SEGMENTED_IPDU, length=1400
  pdu SIGIPDU_Event_NtfRoadMarkerList_2_ADCC_DrivingHmiEnv_1: has-dynamic-length=true, length=1136, transmission-mode-true-timing=event-controlled-timing=number-of-repetitions=0
    signal SIG_Event_NtfRoadMarkerList_2_ADCC_DrivingHmiEnv_1: start 0, 9024 bit, opaque, data-transformations=SOME_IP_Default_Transformation, data-type-policy=TRANSFORMING-I-SIGNAL, someip-transformation-i-signal-props{transformer=SOME_IP_Default_Transformer, message-type=NOTIFICATION}, dynamic-length=true, transfer-property=TRIGGERED, to ICC_8155_QNX
  pdu SIGIPDU_Event_NtfRoadSurfaceMes_ADCC_DrivingHmiEnv_1: has-dynamic-length=false, length=30860, transmission-mode-true-timing=event-controlled-timing=number-of-repetitions=0
    signal SIG_Event_NtfRoadSurfaceMes_ADCC_DrivingHmiEnv_1: start 0, 246816 bit, opaque, data-transformations=SOME_IP_Default_Transformation, data-type-policy=TRANSFORMING-I-SIGNAL, someip-transformation-i-signal-props{transformer=SOME_IP_Default_Transformer, message-type=NOTIFICATION}, transfer-property=TRIGGERED, to ICC_8155_QNX
  general purpose i pdu TPSIGIPDU_Event_NtfRoadSurfaceMes_ADCC_DrivingHmiEnv_1: category=SOMEIP_SEGMENTED_IPDU, length=1400
  pdu SIGIPDU_Event_NtfSensorSt_ADCC_SensorInfo: has-dynamic-length=false, length=37, transmission-mode-true-timing=event-controlled-timing=number-of-repetitions=0
    signal SIG_Event_NtfSensorSt_ADCC_SensorInfo: start 0, 232 bit, opaque, data-transformations=SOME_IP_Default_Transformation, data-type-policy=TRANSFORMING-I-SIGNAL, someip-transformation-i-signal-props{transformer=SOME_IP_Default_Transformer, message-type=NOTIFICATION}, transfer-property=TRIGGERED, to ICC_8155_Android
  pdu SIGIPDU_Event_CamStreamStResp_ADCC_SensorInfo: has-dynamic-length=false, length=40, transmission-mode-true-timing=event-controlled-timing=number-of-repetitions=0
    signal SIG_Event_CamStreamStResp_ADCC_SensorInfo: start 0, 256 bit, opaque, data-transformations=SOME_IP_Default_Transformation, data-type-policy=TRANSFORMING-I-SIGNAL, someip-transformation-i-signal-props{transformer=SOME_IP_Default_Transformer, message-type=NOTIFICATION}, transfer-property=TRIGGERED, to ICC_8155_Android
  pdu SIGIPDU_RR_getAvmCamIntrinsics_call_Cis_ICC_8155_Android_ADCC_SensorInfo: has-dynamic-length=false, length=9, transmission-mode-true-timing=event-controlled-timing=number-of-repetitions=0
    signal SIG_RR_getAvmCamIntrinsics_call_Cis_ICC_8155_Android_ADCC_SensorInfo: start 0, 8 bit, opaque, data-transformations=SOME_IP_Default_Transformation, data-type-policy=TRANSFORMING-I-SIGNAL, someip-transformation-i-signal-props{transformer=SOME_IP_Default_Transformer, message-type=REQUEST}, transfer-property=TRIGGERED, to ADCC
  pdu SIGIPDU_RR_getAvmCamIntrinsics_return_Cis_ICC_8155_Android_ADCC_SensorInfo: has-dynamic-length=false, length=840, transmission-mode-true-timing=event-controlled-timing=number-of-repetitions=0
    signal SIG_RR_getAvmCamIntrinsics_return_Cis_ICC_8155_Android_ADCC_SensorInfo: start 0, 6656 bit, opaque, data-transformations=SOME_IP_Default_Transformation, data-type-policy=TRANSFORMING-I-SIGNAL, someip-transformation-i-signal-props{transformer=SOME_IP_Default_Transformer, message-type=RESPONSE}, transfer-property=TRIGGERED, to ICC_8155_Android
  pdu SIGIPDU_RR_getAvmCamCalPrms_call_Cis_ICC_8155_Android_ADCC_SensorInfo: has-dynamic-length=false, length=9, transmission-mode-true-timing=event-controlled-timing=number-of-repetitions=0
    signal SIG_RR_getAvmCamCalPrms_call_Cis_ICC_8155_Android_ADCC_SensorInfo: start 0, 8 bit, opaque, data-transformations=SOME_IP_Default_Transformation, data-type-policy=TRANSFORMING-I-SIGNAL, someip-transformation-i-signal-props{transformer=SOME_IP_Default_Transformer, message-type=REQUEST}, transfer-property=TRIGGERED, to ADCC
  pdu SIGIPDU_RR_getAvmCamCalPrms_return_Cis_ICC_8155_Android_ADCC_SensorInfo: has-dynamic-length=false, length=840, transmission-mode-true-timing=event-controlled-timing=number-of-repetitions=0
    signal SIG_RR_getAvmCamCalPrms_return_Cis_ICC_8155_Android_ADCC_SensorInfo: start 0, 6656 bit, opaque, data-transformations=SOME_IP_Default_Transformation, data-type-policy=TRANSFORMING-I-SIGNAL, someip-transformation-i-signal-props{transformer=SOME_IP_Default_Transformer, message-type=RESPONSE}, transfer-property=TRIGGERED, to ICC_8155_Android
  pdu SIGIPDU_FF_CamStreamSwtReq_Cis_ICC_8155_Android_ADCC_SensorInfo: has-dynamic-length=false, length=40, transmission-mode-true-timing=event-controlled-timing=number-of-repetitions=0
    signal SIG_FF_CamStreamSwtReq_Cis_ICC_8155_Android_ADCC_SensorInfo: start 0, 256 bit, opaque, data-transformations=SOME_IP_Default_Transformation, data-type-policy=TRANSFORMING-I-SIGNAL, someip-transformation-i-signal-props{transformer=SOME_IP_Default_Transformer, message-type=REQUEST-NO-RETURN}, transfer-property=TRIGGERED, to ADCC
  pdu SIGIPDU_RR_RR_ADASVersInfo_call_Cis_ICC_8155_Android_ADCC_SensorInfo: has-dynamic-length=true, length=8, transmission-mode-true-timing=event-controlled-timing=number-of-repetitions=0
    signal SIG_RR_RR_ADASVersInfo_call_Cis_ICC_8155_Android_ADCC_SensorInfo: start 0, 0 bit, opaque, data-transformations=SOME_IP_Default_Transformation, data-type-policy=TRANSFORMING-I-SIGNAL, someip-transformation-i-signal-props{transformer=SOME_IP_Default_Transformer, message-type=REQUEST}, dynamic-length=true, transfer-property=TRIGGERED, to ADCC
  pdu SIGIPDU_RR_RR_ADASVersInfo_return_Cis_ICC_8155_Android_ADCC_SensorInfo: has-dynamic-length=false, length=680, transmission-mode-true-timing=event-controlled-timing=number-of-repetitions=0
    signal SIG_RR_RR_ADASVersInfo_return_Cis_ICC_8155_Android_ADCC_SensorInfo: start 0, 5376 bit, opaque, data-transformations=SOME_IP_Default_Transformation, data-type-policy=TRANSFORMING-I-SIGNAL, someip-transformation-i-signal-props{transformer=SOME_IP_Default_Transformer, message-type=RESPONSE}, transfer-property=TRIGGERED, to ICC_8155_Android
  pdu SIGIPDU_Event_NtfSensorSt_ADCC_SensorInfo_1: has-dynamic-length=false, length=37, transmission-mode-true-timing=event-controlled-timing=number-of-repetitions=0
    signal SIG_Event_NtfSensorSt_ADCC_SensorInfo_1: start 0, 232 bit, opaque, data-transformations=SOME_IP_Default_Transformation, data-type-policy=TRANSFORMING-I-SIGNAL, someip-transformation-i-signal-props{transformer=SOME_IP_Default_Transformer, message-type=NOTIFICATION}, transfer-property=TRIGGERED, to ICC_8155_QNX
  pdu SIGIPDU_Event_CamStreamStResp_ADCC_SensorInfo_1: has-dynamic-length=false, length=40, transmission-mode-true-timing=event-controlled-timing=number-of-repetitions=0
    signal SIG_Event_CamStreamStResp_ADCC_SensorInfo_1: start 0, 256 bit, opaque, data-transformations=SOME_IP_Default_Transformation, data-type-policy=TRANSFORMING-I-SIGNAL, someip-transformation-i-signal-props{transformer=SOME_IP_Default_Transformer, message-type=NOTIFICATION}, transfer-property=TRIGGERED, to ICC_8155_QNX
  pdu SIGIPDU_RR_getAvmCamIntrinsics_call_Cis_ICC_8155_QNX_ADCC_SensorInfo: has-dynamic-length=false, length=9, transmission-mode-true-timing=event-controlled-timing=number-of-repetitions=0
    signal SIG_RR_getAvmCamIntrinsics_call_Cis_ICC_8155_QNX_ADCC_SensorInfo: start 0, 8 bit, opaque, data-transformations=SOME_IP_Default_Transformation, data-type-policy=TRANSFORMING-I-SIGNAL, someip-transformation-i-signal-props{transformer=SOME_IP_Default_Transformer, message-type=REQUEST}, transfer-property=TRIGGERED, to ADCC
  pdu SIGIPDU_RR_getAvmCamIntrinsics_return_Cis_ICC_8155_QNX_ADCC_SensorInfo: has-dynamic-length=false, length=840, transmission-mode-true-timing=event-controlled-timing=number-of-repetitions=0
    signal SIG_RR_getAvmCamIntrinsics_return_Cis_ICC_8155_QNX_ADCC_SensorInfo: start 0, 6656 bit, opaque, data-transformations=SOME_IP_Default_Transformation, data-type-policy=TRANSFORMING-I-SIGNAL, someip-transformation-i-signal-props{transformer=SOME_IP_Default_Transformer, message-type=RESPONSE}, transfer-property=TRIGGERED, to ICC_8155_QNX
  pdu SIGIPDU_RR_getAvmCamCalPrms_call_Cis_ICC_8155_QNX_ADCC_SensorInfo: has-dynamic-length=false, length=9, transmission-mode-true-timing=event-controlled-timing=number-of-repetitions=0
    signal SIG_RR_getAvmCamCalPrms_call_Cis_ICC_8155_QNX_ADCC_SensorInfo: start 0, 8 bit, opaque, data-transformations=SOME_IP_Default_Transformation, data-type-policy=TRANSFORMING-I-SIGNAL, someip-transformation-i-signal-props{transformer=SOME_IP_Default_Transformer, message-type=REQUEST}, transfer-property=TRIGGERED, to ADCC
  pdu SIGIPDU_RR_getAvmCamCalPrms_return_Cis_ICC_8155_QNX_ADCC_SensorInfo: has-dynamic-length=false, length=840, transmission-mode-true-timing=event-controlled-timing=number-of-repetitions=0
    signal SIG_RR_getAvmCamCalPrms_return_Cis_ICC_8155_QNX_ADCC_SensorInfo: start 0, 6656 bit, opaque, data-transformations=SOME_IP_Default_Transformation, data-type-policy=TRANSFORMING-I-SIGNAL, someip-transformation-i-signal-props{transformer=SOME_IP_Default_Transformer, message-type=RESPONSE}, transfer-property=TRIGGERED, to ICC_8155_QNX
  pdu SIGIPDU_FF_CamStreamSwtReq_Cis_ICC_8155_QNX_ADCC_SensorInfo: has-dynamic-length=false, length=40, transmission-mode-true-timing=event-controlled-timing=number-of-repetitions=0
    signal SIG_FF_CamStreamSwtReq_Cis_ICC_8155_QNX_ADCC_SensorInfo: start 0, 256 bit, opaque, data-transformations=SOME_IP_Default_Transformation, data-type-policy=TRANSFORMING-I-SIGNAL, someip-transformation-i-signal-props{transformer=SOME_IP_Default_Transformer, message-type=REQUEST-NO-RETURN}, transfer-property=TRIGGERED, to ADCC
  pdu SIGIPDU_RR_RR_ADASVersInfo_call_Cis_ICC_8155_QNX_ADCC_SensorInfo: has-dynamic-length=true, length=8, transmission-mode-true-timing=event-controlled-timing=number-of-repetitions=0
    signal SIG_RR_RR_ADASVersInfo_call_Cis_ICC_8155_QNX_ADCC_SensorInfo: start 0, 0 bit, opaque, data-transformations=SOME_IP_Default_Transformation, data-type-policy=TRANSFORMING-I-SIGNAL, someip-transformation-i-signal-props{transformer=SOME_IP_Default_Transformer, message-type=REQUEST}, dynamic-length=true, transfer-property=TRIGGERED, to ADCC
  pdu SIGIPDU_RR_RR_ADASVersInfo_return_Cis_ICC_8155_QNX_ADCC_SensorInfo: has-dynamic-length=false, length=680, transmission-mode-true-timing=event-controlled-timing=number-of-repetitions=0
    signal SIG_RR_RR_ADASVersInfo_return_Cis_ICC_8155_QNX_ADCC_SensorInfo: start 0, 5376 bit, opaque, data-transformations=SOME_IP_Default_Transformation, data-type-policy=TRANSFORMING-I-SIGNAL, someip-transformation-i-signal-props{transformer=SOME_IP_Default_Transformer, message-type=RESPONSE}, transfer-property=TRIGGERED, to ICC_8155_QNX
  pdu SIGIPDU_Event_NtfTrafficSign_Drvg_ADCC_DrivingFuncInfo: has-dynamic-length=false, length=24, transmission-mode-true-timing=event-controlled-timing=number-of-repetitions=0
    signal SIG_Event_NtfTrafficSign_Drvg_ADCC_DrivingFuncInfo: start 0, 128 bit, opaque, data-transformations=SOME_IP_Default_Transformation, data-type-policy=TRANSFORMING-I-SIGNAL, someip-transformation-i-signal-props{transformer=SOME_IP_Default_Transformer, message-type=NOTIFICATION}, transfer-property=TRIGGERED, to ICC_8155_Android
  pdu SIGIPDU_Event_NtfISLIInfo_Drvg_ADCC_DrivingFuncInfo: has-dynamic-length=false, length=16, transmission-mode-true-timing=event-controlled-timing=number-of-repetitions=0
    signal SIG_Event_NtfISLIInfo_Drvg_ADCC_DrivingFuncInfo: start 0, 64 bit, opaque, data-transformations=SOME_IP_Default_Transformation, data-type-policy=TRANSFORMING-I-SIGNAL, someip-transformation-i-signal-props{transformer=SOME_IP_Default_Transformer, message-type=NOTIFICATION}, transfer-property=TRIGGERED, to ICC_8155_Android
  pdu SIGIPDU_Event_NtfACCInfo_Drvg_ADCC_DrivingFuncInfo: has-dynamic-length=false, length=40, transmission-mode-true-timing=event-controlled-timing=number-of-repetitions=0
    signal SIG_Event_NtfACCInfo_Drvg_ADCC_DrivingFuncInfo: start 0, 144 bit, opaque, data-transformations=SOMEIP_E2E_Transformer_PROFILE_04_B, data-type-policy=TRANSFORMING-I-SIGNAL, transfer-property=TRIGGERED, to ICC_8155_Android
  pdu SIGIPDU_Event_NtfALCInfo_Drvg_ADCC_DrivingFuncInfo: has-dynamic-length=false, length=15, transmission-mode-true-timing=event-controlled-timing=number-of-repetitions=0
    signal SIG_Event_NtfALCInfo_Drvg_ADCC_DrivingFuncInfo: start 0, 56 bit, opaque, data-transformations=SOME_IP_Default_Transformation, data-type-policy=TRANSFORMING-I-SIGNAL, someip-transformation-i-signal-props{transformer=SOME_IP_Default_Transformer, message-type=NOTIFICATION}, transfer-property=TRIGGERED, to ICC_8155_Android
  pdu SIGIPDU_Event_NtfICAInfo_Drvg_ADCC_DrivingFuncInfo: has-dynamic-length=false, length=12, transmission-mode-true-timing=event-controlled-timing=number-of-repetitions=0
    signal SIG_Event_NtfICAInfo_Drvg_ADCC_DrivingFuncInfo: start 0, 32 bit, opaque, data-transformations=SOME_IP_Default_Transformation, data-type-policy=TRANSFORMING-I-SIGNAL, someip-transformation-i-signal-props{transformer=SOME_IP_Default_Transformer, message-type=NOTIFICATION}, transfer-property=TRIGGERED, to ICC_8155_Android
  pdu SIGIPDU_Event_NtfIntelligentEvasionInfo_Drvg_ADCC_DrivingFuncInfo: has-dynamic-length=false, length=11, transmission-mode-true-timing=event-controlled-timing=number-of-repetitions=0
    signal SIG_Event_NtfIntelligentEvasionInfo_Drvg_ADCC_DrivingFuncInfo: start 0, 24 bit, opaque, data-transformations=SOME_IP_Default_Transformation, data-type-policy=TRANSFORMING-I-SIGNAL, someip-transformation-i-signal-props{transformer=SOME_IP_Default_Transformer, message-type=NOTIFICATION}, transfer-property=TRIGGERED, to ICC_8155_Android
  pdu SIGIPDU_Event_NtfHNOPfunctionInfo_Drvg_ADCC_DrivingFuncInfo: has-dynamic-length=false, length=536, transmission-mode-true-timing=event-controlled-timing=number-of-repetitions=0
    signal SIG_Event_NtfHNOPfunctionInfo_Drvg_ADCC_DrivingFuncInfo: start 0, 4224 bit, opaque, data-transformations=SOME_IP_Default_Transformation, data-type-policy=TRANSFORMING-I-SIGNAL, someip-transformation-i-signal-props{transformer=SOME_IP_Default_Transformer, message-type=NOTIFICATION}, transfer-property=TRIGGERED, to ICC_8155_Android
  pdu SIGIPDU_Event_NtfUNOPfunctionInfo_Drvg_ADCC_DrivingFuncInfo: has-dynamic-length=false, length=180, transmission-mode-true-timing=event-controlled-timing=number-of-repetitions=0
    signal SIG_Event_NtfUNOPfunctionInfo_Drvg_ADCC_DrivingFuncInfo: start 0, 1376 bit, opaque, data-transformations=SOME_IP_Default_Transformation, data-type-policy=TRANSFORMING-I-SIGNAL, someip-transformation-i-signal-props{transformer=SOME_IP_Default_Transformer, message-type=NOTIFICATION}, transfer-property=TRIGGERED, to ICC_8155_Android
  pdu SIGIPDU_Event_NtfHodDmsInfo_Drvg_ADCC_DrivingFuncInfo: has-dynamic-length=false, length=12, transmission-mode-true-timing=event-controlled-timing=number-of-repetitions=0
    signal SIG_Event_NtfHodDmsInfo_Drvg_ADCC_DrivingFuncInfo: start 0, 32 bit, opaque, data-transformations=SOME_IP_Default_Transformation, data-type-policy=TRANSFORMING-I-SIGNAL, someip-transformation-i-signal-props{transformer=SOME_IP_Default_Transformer, message-type=NOTIFICATION}, transfer-property=TRIGGERED, to ICC_8155_Android
  pdu SIGIPDU_Event_NtfLSSInfo_Drvg_ADCC_DrivingFuncInfo: has-dynamic-length=false, length=16, transmission-mode-true-timing=event-controlled-timing=number-of-repetitions=0
    signal SIG_Event_NtfLSSInfo_Drvg_ADCC_DrivingFuncInfo: start 0, 64 bit, opaque, data-transformations=SOME_IP_Default_Transformation, data-type-policy=TRANSFORMING-I-SIGNAL, someip-transformation-i-signal-props{transformer=SOME_IP_Default_Transformer, message-type=NOTIFICATION}, transfer-property=TRIGGERED, to ICC_8155_Android
  pdu SIGIPDU_Event_NtfESSInfo_Drvg_ADCC_DrivingFuncInfo: has-dynamic-length=false, length=12, transmission-mode-true-timing=event-controlled-timing=number-of-repetitions=0
    signal SIG_Event_NtfESSInfo_Drvg_ADCC_DrivingFuncInfo: start 0, 32 bit, opaque, data-transformations=SOME_IP_Default_Transformation, data-type-policy=TRANSFORMING-I-SIGNAL, someip-transformation-i-signal-props{transformer=SOME_IP_Default_Transformer, message-type=NOTIFICATION}, transfer-property=TRIGGERED, to ICC_8155_Android
  pdu SIGIPDU_Event_NtfDAIInfo_Drvg_ADCC_DrivingFuncInfo: has-dynamic-length=false, length=10, transmission-mode-true-timing=event-controlled-timing=number-of-repetitions=0
    signal SIG_Event_NtfDAIInfo_Drvg_ADCC_DrivingFuncInfo: start 0, 16 bit, opaque, data-transformations=SOME_IP_Default_Transformation, data-type-policy=TRANSFORMING-I-SIGNAL, someip-transformation-i-signal-props{transformer=SOME_IP_Default_Transformer, message-type=NOTIFICATION}, transfer-property=TRIGGERED, to ICC_8155_Android
  pdu SIGIPDU_Event_NtfNRAInfo_Drvg_ADCC_DrivingFuncInfo: has-dynamic-length=false, length=524, transmission-mode-true-timing=event-controlled-timing=number-of-repetitions=0
    signal SIG_Event_NtfNRAInfo_Drvg_ADCC_DrivingFuncInfo: start 0, 4128 bit, opaque, data-transformations=SOME_IP_Default_Transformation, data-type-policy=TRANSFORMING-I-SIGNAL, someip-transformation-i-signal-props{transformer=SOME_IP_Default_Transformer, message-type=NOTIFICATION}, transfer-property=TRIGGERED, to ICC_8155_Android
  pdu SIGIPDU_Event_NtfDrivingSoundInfo_Drvg_ADCC_DrivingFuncInfo: has-dynamic-length=false, length=39, transmission-mode-true-timing=event-controlled-timing=number-of-repetitions=0
    signal SIG_Event_NtfDrivingSoundInfo_Drvg_ADCC_DrivingFuncInfo: start 0, 248 bit, opaque, data-transformations=SOME_IP_Default_Transformation, data-type-policy=TRANSFORMING-I-SIGNAL, someip-transformation-i-signal-props{transformer=SOME_IP_Default_Transformer, message-type=NOTIFICATION}, transfer-property=TRIGGERED, to ICC_8155_Android
  pdu SIGIPDU_Event_NtfMNPInfo_Drvg_ADCC_DrivingFuncInfo: has-dynamic-length=false, length=72, transmission-mode-true-timing=event-controlled-timing=number-of-repetitions=0
    signal SIG_Event_NtfMNPInfo_Drvg_ADCC_DrivingFuncInfo: start 0, 512 bit, opaque, data-transformations=SOME_IP_Default_Transformation, data-type-policy=TRANSFORMING-I-SIGNAL, someip-transformation-i-signal-props{transformer=SOME_IP_Default_Transformer, message-type=NOTIFICATION}, transfer-property=TRIGGERED, to ICC_8155_Android
  pdu SIGIPDU_Event_NtfMNPRoutesInfo_Drvg_ADCC_DrivingFuncInfo: has-dynamic-length=false, length=1813104, transmission-mode-true-timing=event-controlled-timing=number-of-repetitions=0
    signal SIG_Event_NtfMNPRoutesInfo_Drvg_ADCC_DrivingFuncInfo: start 0, 14504768 bit, opaque, data-transformations=SOME_IP_Default_Transformation, data-type-policy=TRANSFORMING-I-SIGNAL, someip-transformation-i-signal-props{transformer=SOME_IP_Default_Transformer, message-type=NOTIFICATION}, transfer-property=TRIGGERED, to ICC_8155_Android
  general purpose i pdu TPSIGIPDU_Event_NtfMNPRoutesInfo_Drvg_ADCC_DrivingFuncInfo: category=SOMEIP_SEGMENTED_IPDU, length=1400
  pdu SIGIPDU_Event_NtfIHCInfo_Drvg_ADCC_DrivingFuncInfo: has-dynamic-length=false, length=60, transmission-mode-true-timing=event-controlled-timing=number-of-repetitions=0
    signal SIG_Event_NtfIHCInfo_Drvg_ADCC_DrivingFuncInfo: start 0, 416 bit, opaque, data-transformations=SOME_IP_Default_Transformation, data-type-policy=TRANSFORMING-I-SIGNAL, someip-transformation-i-signal-props{transformer=SOME_IP_Default_Transformer, message-type=NOTIFICATION}, transfer-property=TRIGGERED, to ICC_8155_Android
  pdu SIGIPDU_Event_NtfISLIInfo_Drvg_2_ADCC_DrivingFuncInfo: has-dynamic-length=false, length=69, transmission-mode-true-timing=event-controlled-timing=number-of-repetitions=0
    signal SIG_Event_NtfISLIInfo_Drvg_2_ADCC_DrivingFuncInfo: start 0, 488 bit, opaque, data-transformations=SOME_IP_Default_Transformation, data-type-policy=TRANSFORMING-I-SIGNAL, someip-transformation-i-signal-props{transformer=SOME_IP_Default_Transformer, message-type=NOTIFICATION}, transfer-property=TRIGGERED, to ICC_8155_Android
  pdu SIGIPDU_Event_NtfALCInfo_Drvg_2_ADCC_DrivingFuncInfo: has-dynamic-length=false, length=76, transmission-mode-true-timing=event-controlled-timing=number-of-repetitions=0
    signal SIG_Event_NtfALCInfo_Drvg_2_ADCC_DrivingFuncInfo: start 0, 544 bit, opaque, data-transformations=SOME_IP_Default_Transformation, data-type-policy=TRANSFORMING-I-SIGNAL, someip-transformation-i-signal-props{transformer=SOME_IP_Default_Transformer, message-type=NOTIFICATION}, transfer-property=TRIGGERED, to ICC_8155_Android
  pdu SIGIPDU_Event_NtfICAInfo_Drvg_2_ADCC_DrivingFuncInfo: has-dynamic-length=false, length=63, transmission-mode-true-timing=event-controlled-timing=number-of-repetitions=0
    signal SIG_Event_NtfICAInfo_Drvg_2_ADCC_DrivingFuncInfo: start 0, 440 bit, opaque, data-transformations=SOME_IP_Default_Transformation, data-type-policy=TRANSFORMING-I-SIGNAL, someip-transformation-i-signal-props{transformer=SOME_IP_Default_Transformer, message-type=NOTIFICATION}, transfer-property=TRIGGERED, to ICC_8155_Android
  pdu SIGIPDU_Event_NtfLSSInfo_Drvg_2_ADCC_DrivingFuncInfo: has-dynamic-length=false, length=68, transmission-mode-true-timing=event-controlled-timing=number-of-repetitions=0
    signal SIG_Event_NtfLSSInfo_Drvg_2_ADCC_DrivingFuncInfo: start 0, 480 bit, opaque, data-transformations=SOME_IP_Default_Transformation, data-type-policy=TRANSFORMING-I-SIGNAL, someip-transformation-i-signal-props{transformer=SOME_IP_Default_Transformer, message-type=NOTIFICATION}, transfer-property=TRIGGERED, to ICC_8155_Android
  pdu SIGIPDU_Event_NtfESSInfo_Drvg_2_ADCC_DrivingFuncInfo: has-dynamic-length=false, length=115, transmission-mode-true-timing=event-controlled-timing=number-of-repetitions=0
    signal SIG_Event_NtfESSInfo_Drvg_2_ADCC_DrivingFuncInfo: start 0, 856 bit, opaque, data-transformations=SOME_IP_Default_Transformation, data-type-policy=TRANSFORMING-I-SIGNAL, someip-transformation-i-signal-props{transformer=SOME_IP_Default_Transformer, message-type=NOTIFICATION}, transfer-property=TRIGGERED, to ICC_8155_Android
  pdu SIGIPDU_Event_NtfTrafficSignIdentify_Drvg_ADCC_DrivingFuncInfo: has-dynamic-length=false, length=42, transmission-mode-true-timing=event-controlled-timing=number-of-repetitions=0
    signal SIG_Event_NtfTrafficSignIdentify_Drvg_ADCC_DrivingFuncInfo: start 0, 272 bit, opaque, data-transformations=SOME_IP_Default_Transformation, data-type-policy=TRANSFORMING-I-SIGNAL, someip-transformation-i-signal-props{transformer=SOME_IP_Default_Transformer, message-type=NOTIFICATION}, transfer-property=TRIGGERED, to ICC_8155_Android
  pdu SIGIPDU_Event_NtfACCSupplementInfo_Drvg_ADCC_DrivingFuncInfo: has-dynamic-length=false, length=40, transmission-mode-true-timing=event-controlled-timing=number-of-repetitions=0
    signal SIG_Event_NtfACCSupplementInfo_Drvg_ADCC_DrivingFuncInfo: start 0, 256 bit, opaque, data-transformations=SOME_IP_Default_Transformation, data-type-policy=TRANSFORMING-I-SIGNAL, someip-transformation-i-signal-props{transformer=SOME_IP_Default_Transformer, message-type=NOTIFICATION}, transfer-property=TRIGGERED, to ICC_8155_Android
  pdu SIGIPDU_Event_NtfHNOPSupplementInfo_Drvg_ADCC_DrivingFuncInfo: has-dynamic-length=false, length=16612, transmission-mode-true-timing=event-controlled-timing=number-of-repetitions=0
    signal SIG_Event_NtfHNOPSupplementInfo_Drvg_ADCC_DrivingFuncInfo: start 0, 132832 bit, opaque, data-transformations=SOME_IP_Default_Transformation, data-type-policy=TRANSFORMING-I-SIGNAL, someip-transformation-i-signal-props{transformer=SOME_IP_Default_Transformer, message-type=NOTIFICATION}, transfer-property=TRIGGERED, to ICC_8155_Android
  general purpose i pdu TPSIGIPDU_Event_NtfHNOPSupplementInfo_Drvg_ADCC_DrivingFuncInfo: category=SOMEIP_SEGMENTED_IPDU, length=1400
  pdu SIGIPDU_Event_NtfMNPAllRoutesInfo_Drvg_ADCC_DrivingFuncInfo: has-dynamic-length=false, length=490584, transmission-mode-true-timing=event-controlled-timing=number-of-repetitions=0
    signal SIG_Event_NtfMNPAllRoutesInfo_Drvg_ADCC_DrivingFuncInfo: start 0, 3924608 bit, opaque, data-transformations=SOME_IP_Default_Transformation, data-type-policy=TRANSFORMING-I-SIGNAL, someip-transformation-i-signal-props{transformer=SOME_IP_Default_Transformer, message-type=NOTIFICATION}, transfer-property=TRIGGERED, to ICC_8155_Android
  general purpose i pdu TPSIGIPDU_Event_NtfMNPAllRoutesInfo_Drvg_ADCC_DrivingFuncInfo: category=SOMEIP_SEGMENTED_IPDU, length=1400
  pdu SIGIPDU_Event_NtfMNPMemRouteInfo_Drvg_ADCC_DrivingFuncInfo: has-dynamic-length=false, length=24536, transmission-mode-true-timing=event-controlled-timing=number-of-repetitions=0
    signal SIG_Event_NtfMNPMemRouteInfo_Drvg_ADCC_DrivingFuncInfo: start 0, 196224 bit, opaque, data-transformations=SOME_IP_Default_Transformation, data-type-policy=TRANSFORMING-I-SIGNAL, someip-transformation-i-signal-props{transformer=SOME_IP_Default_Transformer, message-type=NOTIFICATION}, transfer-property=TRIGGERED, to ICC_8155_Android
  general purpose i pdu TPSIGIPDU_Event_NtfMNPMemRouteInfo_Drvg_ADCC_DrivingFuncInfo: category=SOMEIP_SEGMENTED_IPDU, length=1400
  pdu SIGIPDU_Event_NtfTLRInfo_Drvg_ADCC_DrivingFuncInfo: has-dynamic-length=false, length=79, transmission-mode-true-timing=event-controlled-timing=number-of-repetitions=0
    signal SIG_Event_NtfTLRInfo_Drvg_ADCC_DrivingFuncInfo: start 0, 568 bit, opaque, data-transformations=SOME_IP_Default_Transformation, data-type-policy=TRANSFORMING-I-SIGNAL, someip-transformation-i-signal-props{transformer=SOME_IP_Default_Transformer, message-type=NOTIFICATION}, transfer-property=TRIGGERED, to ICC_8155_Android
  pdu SIGIPDU_Event_NtfTLAInfo_Drvg_ADCC_DrivingFuncInfo: has-dynamic-length=false, length=41, transmission-mode-true-timing=event-controlled-timing=number-of-repetitions=0
    signal SIG_Event_NtfTLAInfo_Drvg_ADCC_DrivingFuncInfo: start 0, 264 bit, opaque, data-transformations=SOME_IP_Default_Transformation, data-type-policy=TRANSFORMING-I-SIGNAL, someip-transformation-i-signal-props{transformer=SOME_IP_Default_Transformer, message-type=NOTIFICATION}, transfer-property=TRIGGERED, to ICC_8155_Android
  pdu SIGIPDU_Event_NtfMNPInfo_Drvg_2_ADCC_DrivingFuncInfo: has-dynamic-length=false, length=26876, transmission-mode-true-timing=event-controlled-timing=number-of-repetitions=0
    signal SIG_Event_NtfMNPInfo_Drvg_2_ADCC_DrivingFuncInfo: start 0, 214944 bit, opaque, data-transformations=SOME_IP_Default_Transformation, data-type-policy=TRANSFORMING-I-SIGNAL, someip-transformation-i-signal-props{transformer=SOME_IP_Default_Transformer, message-type=NOTIFICATION}, transfer-property=TRIGGERED, to ICC_8155_Android
  general purpose i pdu TPSIGIPDU_Event_NtfMNPInfo_Drvg_2_ADCC_DrivingFuncInfo: category=SOMEIP_SEGMENTED_IPDU, length=1400
  pdu SIGIPDU_Event_NtfTrafficSign_Drvg_2_ADCC_DrivingFuncInfo: has-dynamic-length=false, length=40, transmission-mode-true-timing=event-controlled-timing=number-of-repetitions=0
    signal SIG_Event_NtfTrafficSign_Drvg_2_ADCC_DrivingFuncInfo: start 0, 256 bit, opaque, data-transformations=SOME_IP_Default_Transformation, data-type-policy=TRANSFORMING-I-SIGNAL, someip-transformation-i-signal-props{transformer=SOME_IP_Default_Transformer, message-type=NOTIFICATION}, transfer-property=TRIGGERED, to ICC_8155_Android
  pdu SIGIPDU_Event_TolNtfADDrivingCardinfo_ADCC_DrivingFuncInfo: has-dynamic-length=false, length=200, transmission-mode-true-timing=event-controlled-timing=number-of-repetitions=0
    signal SIG_Event_TolNtfADDrivingCardinfo_ADCC_DrivingFuncInfo: start 0, 1536 bit, opaque, data-transformations=SOME_IP_Default_Transformation, data-type-policy=TRANSFORMING-I-SIGNAL, someip-transformation-i-signal-props{transformer=SOME_IP_Default_Transformer, message-type=NOTIFICATION}, transfer-property=TRIGGERED, to ICC_8155_Android
  pdu SIGIPDU_Event_SglNtfADDrivingCardinfo_ADCC_DrivingFuncInfo: has-dynamic-length=false, length=80, transmission-mode-true-timing=event-controlled-timing=number-of-repetitions=0
    signal SIG_Event_SglNtfADDrivingCardinfo_ADCC_DrivingFuncInfo: start 0, 576 bit, opaque, data-transformations=SOME_IP_Default_Transformation, data-type-policy=TRANSFORMING-I-SIGNAL, someip-transformation-i-signal-props{transformer=SOME_IP_Default_Transformer, message-type=NOTIFICATION}, transfer-property=TRIGGERED, to ICC_8155_Android
  pdu SIGIPDU_Event_NtfTrafficSign_Drvg_ADCC_DrivingFuncInfo_1: has-dynamic-length=false, length=24, transmission-mode-true-timing=event-controlled-timing=number-of-repetitions=0
    signal SIG_Event_NtfTrafficSign_Drvg_ADCC_DrivingFuncInfo_1: start 0, 128 bit, opaque, data-transformations=SOME_IP_Default_Transformation, data-type-policy=TRANSFORMING-I-SIGNAL, someip-transformation-i-signal-props{transformer=SOME_IP_Default_Transformer, message-type=NOTIFICATION}, transfer-property=TRIGGERED, to ICC_8155_QNX
  pdu SIGIPDU_Event_NtfISLIInfo_Drvg_ADCC_DrivingFuncInfo_1: has-dynamic-length=false, length=16, transmission-mode-true-timing=event-controlled-timing=number-of-repetitions=0
    signal SIG_Event_NtfISLIInfo_Drvg_ADCC_DrivingFuncInfo_1: start 0, 64 bit, opaque, data-transformations=SOME_IP_Default_Transformation, data-type-policy=TRANSFORMING-I-SIGNAL, someip-transformation-i-signal-props{transformer=SOME_IP_Default_Transformer, message-type=NOTIFICATION}, transfer-property=TRIGGERED, to ICC_8155_QNX
  pdu SIGIPDU_Event_NtfACCInfo_Drvg_ADCC_DrivingFuncInfo_1: has-dynamic-length=false, length=40, transmission-mode-true-timing=event-controlled-timing=number-of-repetitions=0
    signal SIG_Event_NtfACCInfo_Drvg_ADCC_DrivingFuncInfo_1: start 0, 144 bit, opaque, data-transformations=SOMEIP_E2E_Transformer_PROFILE_04_B, data-type-policy=TRANSFORMING-I-SIGNAL, transfer-property=TRIGGERED, to ICC_8155_QNX
  pdu SIGIPDU_Event_NtfALCInfo_Drvg_ADCC_DrivingFuncInfo_1: has-dynamic-length=false, length=15, transmission-mode-true-timing=event-controlled-timing=number-of-repetitions=0
    signal SIG_Event_NtfALCInfo_Drvg_ADCC_DrivingFuncInfo_1: start 0, 56 bit, opaque, data-transformations=SOME_IP_Default_Transformation, data-type-policy=TRANSFORMING-I-SIGNAL, someip-transformation-i-signal-props{transformer=SOME_IP_Default_Transformer, message-type=NOTIFICATION}, transfer-property=TRIGGERED, to ICC_8155_QNX
  pdu SIGIPDU_Event_NtfICAInfo_Drvg_ADCC_DrivingFuncInfo_1: has-dynamic-length=false, length=12, transmission-mode-true-timing=event-controlled-timing=number-of-repetitions=0
    signal SIG_Event_NtfICAInfo_Drvg_ADCC_DrivingFuncInfo_1: start 0, 32 bit, opaque, data-transformations=SOME_IP_Default_Transformation, data-type-policy=TRANSFORMING-I-SIGNAL, someip-transformation-i-signal-props{transformer=SOME_IP_Default_Transformer, message-type=NOTIFICATION}, transfer-property=TRIGGERED, to ICC_8155_QNX
  pdu SIGIPDU_Event_NtfIntelligentEvasionInfo_Drvg_ADCC_DrivingFuncInfo_1: has-dynamic-length=false, length=11, transmission-mode-true-timing=event-controlled-timing=number-of-repetitions=0
    signal SIG_Event_NtfIntelligentEvasionInfo_Drvg_ADCC_DrivingFuncInfo_1: start 0, 24 bit, opaque, data-transformations=SOME_IP_Default_Transformation, data-type-policy=TRANSFORMING-I-SIGNAL, someip-transformation-i-signal-props{transformer=SOME_IP_Default_Transformer, message-type=NOTIFICATION}, transfer-property=TRIGGERED, to ICC_8155_QNX
  pdu SIGIPDU_Event_NtfHNOPfunctionInfo_Drvg_ADCC_DrivingFuncInfo_1: has-dynamic-length=false, length=536, transmission-mode-true-timing=event-controlled-timing=number-of-repetitions=0
    signal SIG_Event_NtfHNOPfunctionInfo_Drvg_ADCC_DrivingFuncInfo_1: start 0, 4224 bit, opaque, data-transformations=SOME_IP_Default_Transformation, data-type-policy=TRANSFORMING-I-SIGNAL, someip-transformation-i-signal-props{transformer=SOME_IP_Default_Transformer, message-type=NOTIFICATION}, transfer-property=TRIGGERED, to ICC_8155_QNX
  pdu SIGIPDU_Event_NtfUNOPfunctionInfo_Drvg_ADCC_DrivingFuncInfo_1: has-dynamic-length=false, length=180, transmission-mode-true-timing=event-controlled-timing=number-of-repetitions=0
    signal SIG_Event_NtfUNOPfunctionInfo_Drvg_ADCC_DrivingFuncInfo_1: start 0, 1376 bit, opaque, data-transformations=SOME_IP_Default_Transformation, data-type-policy=TRANSFORMING-I-SIGNAL, someip-transformation-i-signal-props{transformer=SOME_IP_Default_Transformer, message-type=NOTIFICATION}, transfer-property=TRIGGERED, to ICC_8155_QNX
  pdu SIGIPDU_Event_NtfHodDmsInfo_Drvg_ADCC_DrivingFuncInfo_1: has-dynamic-length=false, length=12, transmission-mode-true-timing=event-controlled-timing=number-of-repetitions=0
    signal SIG_Event_NtfHodDmsInfo_Drvg_ADCC_DrivingFuncInfo_1: start 0, 32 bit, opaque, data-transformations=SOME_IP_Default_Transformation, data-type-policy=TRANSFORMING-I-SIGNAL, someip-transformation-i-signal-props{transformer=SOME_IP_Default_Transformer, message-type=NOTIFICATION}, transfer-property=TRIGGERED, to ICC_8155_QNX
  pdu SIGIPDU_Event_NtfLSSInfo_Drvg_ADCC_DrivingFuncInfo_1: has-dynamic-length=false, length=16, transmission-mode-true-timing=event-controlled-timing=number-of-repetitions=0
    signal SIG_Event_NtfLSSInfo_Drvg_ADCC_DrivingFuncInfo_1: start 0, 64 bit, opaque, data-transformations=SOME_IP_Default_Transformation, data-type-policy=TRANSFORMING-I-SIGNAL, someip-transformation-i-signal-props{transformer=SOME_IP_Default_Transformer, message-type=NOTIFICATION}, transfer-property=TRIGGERED, to ICC_8155_QNX
  pdu SIGIPDU_Event_NtfESSInfo_Drvg_ADCC_DrivingFuncInfo_1: has-dynamic-length=false, length=12, transmission-mode-true-timing=event-controlled-timing=number-of-repetitions=0
    signal SIG_Event_NtfESSInfo_Drvg_ADCC_DrivingFuncInfo_1: start 0, 32 bit, opaque, data-transformations=SOME_IP_Default_Transformation, data-type-policy=TRANSFORMING-I-SIGNAL, someip-transformation-i-signal-props{transformer=SOME_IP_Default_Transformer, message-type=NOTIFICATION}, transfer-property=TRIGGERED, to ICC_8155_QNX
  pdu SIGIPDU_Event_NtfDAIInfo_Drvg_ADCC_DrivingFuncInfo_1: has-dynamic-length=false, length=10, transmission-mode-true-timing=event-controlled-timing=number-of-repetitions=0
    signal SIG_Event_NtfDAIInfo_Drvg_ADCC_DrivingFuncInfo_1: start 0, 16 bit, opaque, data-transformations=SOME_IP_Default_Transformation, data-type-policy=TRANSFORMING-I-SIGNAL, someip-transformation-i-signal-props{transformer=SOME_IP_Default_Transformer, message-type=NOTIFICATION}, transfer-property=TRIGGERED, to ICC_8155_QNX
  pdu SIGIPDU_Event_NtfNRAInfo_Drvg_ADCC_DrivingFuncInfo_1: has-dynamic-length=false, length=524, transmission-mode-true-timing=event-controlled-timing=number-of-repetitions=0
    signal SIG_Event_NtfNRAInfo_Drvg_ADCC_DrivingFuncInfo_1: start 0, 4128 bit, opaque, data-transformations=SOME_IP_Default_Transformation, data-type-policy=TRANSFORMING-I-SIGNAL, someip-transformation-i-signal-props{transformer=SOME_IP_Default_Transformer, message-type=NOTIFICATION}, transfer-property=TRIGGERED, to ICC_8155_QNX
  pdu SIGIPDU_Event_NtfDrivingSoundInfo_Drvg_ADCC_DrivingFuncInfo_1: has-dynamic-length=false, length=39, transmission-mode-true-timing=event-controlled-timing=number-of-repetitions=0
    signal SIG_Event_NtfDrivingSoundInfo_Drvg_ADCC_DrivingFuncInfo_1: start 0, 248 bit, opaque, data-transformations=SOME_IP_Default_Transformation, data-type-policy=TRANSFORMING-I-SIGNAL, someip-transformation-i-signal-props{transformer=SOME_IP_Default_Transformer, message-type=NOTIFICATION}, transfer-property=TRIGGERED, to ICC_8155_QNX
  pdu SIGIPDU_Event_NtfMNPInfo_Drvg_ADCC_DrivingFuncInfo_1: has-dynamic-length=false, length=72, transmission-mode-true-timing=event-controlled-timing=number-of-repetitions=0
    signal SIG_Event_NtfMNPInfo_Drvg_ADCC_DrivingFuncInfo_1: start 0, 512 bit, opaque, data-transformations=SOME_IP_Default_Transformation, data-type-policy=TRANSFORMING-I-SIGNAL, someip-transformation-i-signal-props{transformer=SOME_IP_Default_Transformer, message-type=NOTIFICATION}, transfer-property=TRIGGERED, to ICC_8155_QNX
  pdu SIGIPDU_Event_NtfMNPRoutesInfo_Drvg_ADCC_DrivingFuncInfo_1: has-dynamic-length=false, length=1813104, transmission-mode-true-timing=event-controlled-timing=number-of-repetitions=0
    signal SIG_Event_NtfMNPRoutesInfo_Drvg_ADCC_DrivingFuncInfo_1: start 0, 14504768 bit, opaque, data-transformations=SOME_IP_Default_Transformation, data-type-policy=TRANSFORMING-I-SIGNAL, someip-transformation-i-signal-props{transformer=SOME_IP_Default_Transformer, message-type=NOTIFICATION}, transfer-property=TRIGGERED, to ICC_8155_QNX
  general purpose i pdu TPSIGIPDU_Event_NtfMNPRoutesInfo_Drvg_ADCC_DrivingFuncInfo_1: category=SOMEIP_SEGMENTED_IPDU, length=1400
  pdu SIGIPDU_Event_NtfIHCInfo_Drvg_ADCC_DrivingFuncInfo_1: has-dynamic-length=false, length=60, transmission-mode-true-timing=event-controlled-timing=number-of-repetitions=0
    signal SIG_Event_NtfIHCInfo_Drvg_ADCC_DrivingFuncInfo_1: start 0, 416 bit, opaque, data-transformations=SOME_IP_Default_Transformation, data-type-policy=TRANSFORMING-I-SIGNAL, someip-transformation-i-signal-props{transformer=SOME_IP_Default_Transformer, message-type=NOTIFICATION}, transfer-property=TRIGGERED, to ICC_8155_QNX
  pdu SIGIPDU_Event_NtfISLIInfo_Drvg_2_ADCC_DrivingFuncInfo_1: has-dynamic-length=false, length=69, transmission-mode-true-timing=event-controlled-timing=number-of-repetitions=0
    signal SIG_Event_NtfISLIInfo_Drvg_2_ADCC_DrivingFuncInfo_1: start 0, 488 bit, opaque, data-transformations=SOME_IP_Default_Transformation, data-type-policy=TRANSFORMING-I-SIGNAL, someip-transformation-i-signal-props{transformer=SOME_IP_Default_Transformer, message-type=NOTIFICATION}, transfer-property=TRIGGERED, to ICC_8155_QNX
  pdu SIGIPDU_Event_NtfALCInfo_Drvg_2_ADCC_DrivingFuncInfo_1: has-dynamic-length=false, length=76, transmission-mode-true-timing=event-controlled-timing=number-of-repetitions=0
    signal SIG_Event_NtfALCInfo_Drvg_2_ADCC_DrivingFuncInfo_1: start 0, 544 bit, opaque, data-transformations=SOME_IP_Default_Transformation, data-type-policy=TRANSFORMING-I-SIGNAL, someip-transformation-i-signal-props{transformer=SOME_IP_Default_Transformer, message-type=NOTIFICATION}, transfer-property=TRIGGERED, to ICC_8155_QNX
  pdu SIGIPDU_Event_NtfICAInfo_Drvg_2_ADCC_DrivingFuncInfo_1: has-dynamic-length=false, length=63, transmission-mode-true-timing=event-controlled-timing=number-of-repetitions=0
    signal SIG_Event_NtfICAInfo_Drvg_2_ADCC_DrivingFuncInfo_1: start 0, 440 bit, opaque, data-transformations=SOME_IP_Default_Transformation, data-type-policy=TRANSFORMING-I-SIGNAL, someip-transformation-i-signal-props{transformer=SOME_IP_Default_Transformer, message-type=NOTIFICATION}, transfer-property=TRIGGERED, to ICC_8155_QNX
  pdu SIGIPDU_Event_NtfLSSInfo_Drvg_2_ADCC_DrivingFuncInfo_1: has-dynamic-length=false, length=68, transmission-mode-true-timing=event-controlled-timing=number-of-repetitions=0
    signal SIG_Event_NtfLSSInfo_Drvg_2_ADCC_DrivingFuncInfo_1: start 0, 480 bit, opaque, data-transformations=SOME_IP_Default_Transformation, data-type-policy=TRANSFORMING-I-SIGNAL, someip-transformation-i-signal-props{transformer=SOME_IP_Default_Transformer, message-type=NOTIFICATION}, transfer-property=TRIGGERED, to ICC_8155_QNX
  pdu SIGIPDU_Event_NtfESSInfo_Drvg_2_ADCC_DrivingFuncInfo_1: has-dynamic-length=false, length=115, transmission-mode-true-timing=event-controlled-timing=number-of-repetitions=0
    signal SIG_Event_NtfESSInfo_Drvg_2_ADCC_DrivingFuncInfo_1: start 0, 856 bit, opaque, data-transformations=SOME_IP_Default_Transformation, data-type-policy=TRANSFORMING-I-SIGNAL, someip-transformation-i-signal-props{transformer=SOME_IP_Default_Transformer, message-type=NOTIFICATION}, transfer-property=TRIGGERED, to ICC_8155_QNX
  pdu SIGIPDU_Event_NtfTrafficSignIdentify_Drvg_ADCC_DrivingFuncInfo_1: has-dynamic-length=false, length=42, transmission-mode-true-timing=event-controlled-timing=number-of-repetitions=0
    signal SIG_Event_NtfTrafficSignIdentify_Drvg_ADCC_DrivingFuncInfo_1: start 0, 272 bit, opaque, data-transformations=SOME_IP_Default_Transformation, data-type-policy=TRANSFORMING-I-SIGNAL, someip-transformation-i-signal-props{transformer=SOME_IP_Default_Transformer, message-type=NOTIFICATION}, transfer-property=TRIGGERED, to ICC_8155_QNX
  pdu SIGIPDU_Event_NtfACCSupplementInfo_Drvg_ADCC_DrivingFuncInfo_1: has-dynamic-length=false, length=40, transmission-mode-true-timing=event-controlled-timing=number-of-repetitions=0
    signal SIG_Event_NtfACCSupplementInfo_Drvg_ADCC_DrivingFuncInfo_1: start 0, 256 bit, opaque, data-transformations=SOME_IP_Default_Transformation, data-type-policy=TRANSFORMING-I-SIGNAL, someip-transformation-i-signal-props{transformer=SOME_IP_Default_Transformer, message-type=NOTIFICATION}, transfer-property=TRIGGERED, to ICC_8155_QNX
  pdu SIGIPDU_Event_NtfHNOPSupplementInfo_Drvg_ADCC_DrivingFuncInfo_1: has-dynamic-length=false, length=16612, transmission-mode-true-timing=event-controlled-timing=number-of-repetitions=0
    signal SIG_Event_NtfHNOPSupplementInfo_Drvg_ADCC_DrivingFuncInfo_1: start 0, 132832 bit, opaque, data-transformations=SOME_IP_Default_Transformation, data-type-policy=TRANSFORMING-I-SIGNAL, someip-transformation-i-signal-props{transformer=SOME_IP_Default_Transformer, message-type=NOTIFICATION}, transfer-property=TRIGGERED, to ICC_8155_QNX
  general purpose i pdu TPSIGIPDU_Event_NtfHNOPSupplementInfo_Drvg_ADCC_DrivingFuncInfo_1: category=SOMEIP_SEGMENTED_IPDU, length=1400
  pdu SIGIPDU_Event_NtfMNPAllRoutesInfo_Drvg_ADCC_DrivingFuncInfo_1: has-dynamic-length=false, length=490584, transmission-mode-true-timing=event-controlled-timing=number-of-repetitions=0
    signal SIG_Event_NtfMNPAllRoutesInfo_Drvg_ADCC_DrivingFuncInfo_1: start 0, 3924608 bit, opaque, data-transformations=SOME_IP_Default_Transformation, data-type-policy=TRANSFORMING-I-SIGNAL, someip-transformation-i-signal-props{transformer=SOME_IP_Default_Transformer, message-type=NOTIFICATION}, transfer-property=TRIGGERED, to ICC_8155_QNX
  general purpose i pdu TPSIGIPDU_Event_NtfMNPAllRoutesInfo_Drvg_ADCC_DrivingFuncInfo_1: category=SOMEIP_SEGMENTED_IPDU, length=1400
  pdu SIGIPDU_Event_NtfMNPMemRouteInfo_Drvg_ADCC_DrivingFuncInfo_1: has-dynamic-length=false, length=24536, transmission-mode-true-timing=event-controlled-timing=number-of-repetitions=0
    signal SIG_Event_NtfMNPMemRouteInfo_Drvg_ADCC_DrivingFuncInfo_1: start 0, 196224 bit, opaque, data-transformations=SOME_IP_Default_Transformation, data-type-policy=TRANSFORMING-I-SIGNAL, someip-transformation-i-signal-props{transformer=SOME_IP_Default_Transformer, message-type=NOTIFICATION}, transfer-property=TRIGGERED, to ICC_8155_QNX
  general purpose i pdu TPSIGIPDU_Event_NtfMNPMemRouteInfo_Drvg_ADCC_DrivingFuncInfo_1: category=SOMEIP_SEGMENTED_IPDU, length=1400
  pdu SIGIPDU_Event_NtfTLRInfo_Drvg_ADCC_DrivingFuncInfo_1: has-dynamic-length=false, length=79, transmission-mode-true-timing=event-controlled-timing=number-of-repetitions=0
    signal SIG_Event_NtfTLRInfo_Drvg_ADCC_DrivingFuncInfo_1: start 0, 568 bit, opaque, data-transformations=SOME_IP_Default_Transformation, data-type-policy=TRANSFORMING-I-SIGNAL, someip-transformation-i-signal-props{transformer=SOME_IP_Default_Transformer, message-type=NOTIFICATION}, transfer-property=TRIGGERED, to ICC_8155_QNX
  pdu SIGIPDU_Event_NtfTLAInfo_Drvg_ADCC_DrivingFuncInfo_1: has-dynamic-length=false, length=41, transmission-mode-true-timing=event-controlled-timing=number-of-repetitions=0
    signal SIG_Event_NtfTLAInfo_Drvg_ADCC_DrivingFuncInfo_1: start 0, 264 bit, opaque, data-transformations=SOME_IP_Default_Transformation, data-type-policy=TRANSFORMING-I-SIGNAL, someip-transformation-i-signal-props{transformer=SOME_IP_Default_Transformer, message-type=NOTIFICATION}, transfer-property=TRIGGERED, to ICC_8155_QNX
  pdu SIGIPDU_Event_NtfMNPInfo_Drvg_2_ADCC_DrivingFuncInfo_1: has-dynamic-length=false, length=26876, transmission-mode-true-timing=event-controlled-timing=number-of-repetitions=0
    signal SIG_Event_NtfMNPInfo_Drvg_2_ADCC_DrivingFuncInfo_1: start 0, 214944 bit, opaque, data-transformations=SOME_IP_Default_Transformation, data-type-policy=TRANSFORMING-I-SIGNAL, someip-transformation-i-signal-props{transformer=SOME_IP_Default_Transformer, message-type=NOTIFICATION}, transfer-property=TRIGGERED, to ICC_8155_QNX
  general purpose i pdu TPSIGIPDU_Event_NtfMNPInfo_Drvg_2_ADCC_DrivingFuncInfo_1: category=SOMEIP_SEGMENTED_IPDU, length=1400
  pdu SIGIPDU_Event_NtfTrafficSign_Drvg_2_ADCC_DrivingFuncInfo_1: has-dynamic-length=false, length=40, transmission-mode-true-timing=event-controlled-timing=number-of-repetitions=0
    signal SIG_Event_NtfTrafficSign_Drvg_2_ADCC_DrivingFuncInfo_1: start 0, 256 bit, opaque, data-transformations=SOME_IP_Default_Transformation, data-type-policy=TRANSFORMING-I-SIGNAL, someip-transformation-i-signal-props{transformer=SOME_IP_Default_Transformer, message-type=NOTIFICATION}, transfer-property=TRIGGERED, to ICC_8155_QNX
  pdu SIGIPDU_Event_TolNtfADDrivingCardinfo_ADCC_DrivingFuncInfo_1: has-dynamic-length=false, length=200, transmission-mode-true-timing=event-controlled-timing=number-of-repetitions=0
    signal SIG_Event_TolNtfADDrivingCardinfo_ADCC_DrivingFuncInfo_1: start 0, 1536 bit, opaque, data-transformations=SOME_IP_Default_Transformation, data-type-policy=TRANSFORMING-I-SIGNAL, someip-transformation-i-signal-props{transformer=SOME_IP_Default_Transformer, message-type=NOTIFICATION}, transfer-property=TRIGGERED, to ICC_8155_QNX
  pdu SIGIPDU_Event_SglNtfADDrivingCardinfo_ADCC_DrivingFuncInfo_1: has-dynamic-length=false, length=80, transmission-mode-true-timing=event-controlled-timing=number-of-repetitions=0
    signal SIG_Event_SglNtfADDrivingCardinfo_ADCC_DrivingFuncInfo_1: start 0, 576 bit, opaque, data-transformations=SOME_IP_Default_Transformation, data-type-policy=TRANSFORMING-I-SIGNAL, someip-transformation-i-signal-props{transformer=SOME_IP_Default_Transformer, message-type=NOTIFICATION}, transfer-property=TRIGGERED, to ICC_8155_QNX
  pdu SIGIPDU_Event_NtfParkingGenaralInfo_ADCC_ParkingFuncInfo: has-dynamic-length=false, length=14, transmission-mode-true-timing=event-controlled-timing=number-of-repetitions=0
    signal SIG_Event_NtfParkingGenaralInfo_ADCC_ParkingFuncInfo: start 0, 48 bit, opaque, data-transformations=SOME_IP_Default_Transformation, data-type-policy=TRANSFORMING-I-SIGNAL, someip-transformation-i-signal-props{transformer=SOME_IP_Default_Transformer, message-type=NOTIFICATION}, transfer-property=TRIGGERED, to ICC_8155_Android
  pdu SIGIPDU_Event_NtfAPARPAInfo_ADCC_ParkingFuncInfo: has-dynamic-length=false, length=632, transmission-mode-true-timing=event-controlled-timing=number-of-repetitions=0
    signal SIG_Event_NtfAPARPAInfo_ADCC_ParkingFuncInfo: start 0, 4992 bit, opaque, data-transformations=SOME_IP_Default_Transformation, data-type-policy=TRANSFORMING-I-SIGNAL, someip-transformation-i-signal-props{transformer=SOME_IP_Default_Transformer, message-type=NOTIFICATION}, transfer-property=TRIGGERED, to ICC_8155_Android
  pdu SIGIPDU_Event_NtfAdvanceParkingInfo_ADCC_ParkingFuncInfo: has-dynamic-length=false, length=576, transmission-mode-true-timing=event-controlled-timing=number-of-repetitions=0
    signal SIG_Event_NtfAdvanceParkingInfo_ADCC_ParkingFuncInfo: start 0, 4544 bit, opaque, data-transformations=SOME_IP_Default_Transformation, data-type-policy=TRANSFORMING-I-SIGNAL, someip-transformation-i-signal-props{transformer=SOME_IP_Default_Transformer, message-type=NOTIFICATION}, transfer-property=TRIGGERED, to ICC_8155_Android
  pdu SIGIPDU_Event_NtfHPAPathDetail_ADCC_ParkingFuncInfo: has-dynamic-length=true, length=240412, transmission-mode-true-timing=event-controlled-timing=number-of-repetitions=0
    signal SIG_Event_NtfHPAPathDetail_ADCC_ParkingFuncInfo: start 0, 1923232 bit, opaque, data-transformations=SOME_IP_Default_Transformation, data-type-policy=TRANSFORMING-I-SIGNAL, someip-transformation-i-signal-props{transformer=SOME_IP_Default_Transformer, message-type=NOTIFICATION}, dynamic-length=true, transfer-property=TRIGGERED, to ICC_8155_Android
  general purpose i pdu TPSIGIPDU_Event_NtfHPAPathDetail_ADCC_ParkingFuncInfo: category=SOMEIP_SEGMENTED_IPDU, length=1400
  pdu SIGIPDU_Event_NtfHPATrainigPathInfo_ADCC_ParkingFuncInfo: has-dynamic-length=false, length=88300, transmission-mode-true-timing=event-controlled-timing=number-of-repetitions=0
    signal SIG_Event_NtfHPATrainigPathInfo_ADCC_ParkingFuncInfo: start 0, 706336 bit, opaque, data-transformations=SOME_IP_Default_Transformation, data-type-policy=TRANSFORMING-I-SIGNAL, someip-transformation-i-signal-props{transformer=SOME_IP_Default_Transformer, message-type=NOTIFICATION}, transfer-property=TRIGGERED, to ICC_8155_Android
  general purpose i pdu TPSIGIPDU_Event_NtfHPATrainigPathInfo_ADCC_ParkingFuncInfo: category=SOMEIP_SEGMENTED_IPDU, length=1400
  pdu SIGIPDU_Event_NtfVPASelfBuildMapDate_ADCC_ParkingFuncInfo: has-dynamic-length=false, length=14, transmission-mode-true-timing=event-controlled-timing=number-of-repetitions=0
    signal SIG_Event_NtfVPASelfBuildMapDate_ADCC_ParkingFuncInfo: start 0, 48 bit, opaque, data-transformations=SOME_IP_Default_Transformation, data-type-policy=TRANSFORMING-I-SIGNAL, someip-transformation-i-signal-props{transformer=SOME_IP_Default_Transformer, message-type=NOTIFICATION}, transfer-property=TRIGGERED, to ICC_8155_Android
  pdu SIGIPDU_Event_NtfMRAInfo_ADCC_ParkingFuncInfo: has-dynamic-length=false, length=540, transmission-mode-true-timing=event-controlled-timing=number-of-repetitions=0
    signal SIG_Event_NtfMRAInfo_ADCC_ParkingFuncInfo: start 0, 4256 bit, opaque, data-transformations=SOME_IP_Default_Transformation, data-type-policy=TRANSFORMING-I-SIGNAL, someip-transformation-i-signal-props{transformer=SOME_IP_Default_Transformer, message-type=NOTIFICATION}, transfer-property=TRIGGERED, to ICC_8155_Android
  pdu SIGIPDU_Event_NtfMEBInfo_ADCC_ParkingFuncInfo: has-dynamic-length=false, length=9, transmission-mode-true-timing=event-controlled-timing=number-of-repetitions=0
    signal SIG_Event_NtfMEBInfo_ADCC_ParkingFuncInfo: start 0, 8 bit, opaque, data-transformations=SOME_IP_Default_Transformation, data-type-policy=TRANSFORMING-I-SIGNAL, someip-transformation-i-signal-props{transformer=SOME_IP_Default_Transformer, message-type=NOTIFICATION}, transfer-property=TRIGGERED, to ICC_8155_Android
  pdu SIGIPDU_Event_NtfMAAInfo_ADCC_ParkingFuncInfo: has-dynamic-length=false, length=9, transmission-mode-true-timing=event-controlled-timing=number-of-repetitions=0
    signal SIG_Event_NtfMAAInfo_ADCC_ParkingFuncInfo: start 0, 8 bit, opaque, data-transformations=SOME_IP_Default_Transformation, data-type-policy=TRANSFORMING-I-SIGNAL, someip-transformation-i-signal-props{transformer=SOME_IP_Default_Transformer, message-type=NOTIFICATION}, transfer-property=TRIGGERED, to ICC_8155_Android
  pdu SIGIPDU_Event_NtfHPARepalyPathInfo_ADCC_ParkingFuncInfo: has-dynamic-length=false, length=88340, transmission-mode-true-timing=event-controlled-timing=number-of-repetitions=0
    signal SIG_Event_NtfHPARepalyPathInfo_ADCC_ParkingFuncInfo: start 0, 706656 bit, opaque, data-transformations=SOME_IP_Default_Transformation, data-type-policy=TRANSFORMING-I-SIGNAL, someip-transformation-i-signal-props{transformer=SOME_IP_Default_Transformer, message-type=NOTIFICATION}, transfer-property=TRIGGERED, to ICC_8155_Android
  general purpose i pdu TPSIGIPDU_Event_NtfHPARepalyPathInfo_ADCC_ParkingFuncInfo: category=SOMEIP_SEGMENTED_IPDU, length=1400
  pdu SIGIPDU_Event_NtfParkingGenaralInfo_2_ADCC_ParkingFuncInfo: has-dynamic-length=false, length=76, transmission-mode-true-timing=event-controlled-timing=number-of-repetitions=0
    signal SIG_Event_NtfParkingGenaralInfo_2_ADCC_ParkingFuncInfo: start 0, 544 bit, opaque, data-transformations=SOME_IP_Default_Transformation, data-type-policy=TRANSFORMING-I-SIGNAL, someip-transformation-i-signal-props{transformer=SOME_IP_Default_Transformer, message-type=NOTIFICATION}, transfer-property=TRIGGERED, to ICC_8155_Android
  pdu SIGIPDU_Event_NtfMRAInfo_2_ADCC_ParkingFuncInfo: has-dynamic-length=false, length=592, transmission-mode-true-timing=event-controlled-timing=number-of-repetitions=0
    signal SIG_Event_NtfMRAInfo_2_ADCC_ParkingFuncInfo: start 0, 4672 bit, opaque, data-transformations=SOME_IP_Default_Transformation, data-type-policy=TRANSFORMING-I-SIGNAL, someip-transformation-i-signal-props{transformer=SOME_IP_Default_Transformer, message-type=NOTIFICATION}, transfer-property=TRIGGERED, to ICC_8155_Android
  pdu SIGIPDU_Event_NtfAPARPAInfo_2_ADCC_ParkingFuncInfo: has-dynamic-length=false, length=684, transmission-mode-true-timing=event-controlled-timing=number-of-repetitions=0
    signal SIG_Event_NtfAPARPAInfo_2_ADCC_ParkingFuncInfo: start 0, 5408 bit, opaque, data-transformations=SOME_IP_Default_Transformation, data-type-policy=TRANSFORMING-I-SIGNAL, someip-transformation-i-signal-props{transformer=SOME_IP_Default_Transformer, message-type=NOTIFICATION}, transfer-property=TRIGGERED, to ICC_8155_Android
  pdu SIGIPDU_Event_NtfAdvanceParkingInfo_2_ADCC_ParkingFuncInfo: has-dynamic-length=false, length=888, transmission-mode-true-timing=event-controlled-timing=number-of-repetitions=0
    signal SIG_Event_NtfAdvanceParkingInfo_2_ADCC_ParkingFuncInfo: start 0, 7040 bit, opaque, data-transformations=SOME_IP_Default_Transformation, data-type-policy=TRANSFORMING-I-SIGNAL, someip-transformation-i-signal-props{transformer=SOME_IP_Default_Transformer, message-type=NOTIFICATION}, transfer-property=TRIGGERED, to ICC_8155_Android
  pdu SIGIPDU_Event_NtfHPAPathDetail_2_ADCC_ParkingFuncInfo: has-dynamic-length=true, length=4635296, transmission-mode-true-timing=event-controlled-timing=number-of-repetitions=0
    signal SIG_Event_NtfHPAPathDetail_2_ADCC_ParkingFuncInfo: start 0, 37082304 bit, opaque, data-transformations=SOME_IP_Default_Transformation, data-type-policy=TRANSFORMING-I-SIGNAL, someip-transformation-i-signal-props{transformer=SOME_IP_Default_Transformer, message-type=NOTIFICATION}, dynamic-length=true, transfer-property=TRIGGERED, to ICC_8155_Android
  general purpose i pdu TPSIGIPDU_Event_NtfHPAPathDetail_2_ADCC_ParkingFuncInfo: category=SOMEIP_SEGMENTED_IPDU, length=1400
  pdu SIGIPDU_Event_NtfHPATrainigPathInfo_2_ADCC_ParkingFuncInfo: has-dynamic-length=false, length=231540, transmission-mode-true-timing=event-controlled-timing=number-of-repetitions=0
    signal SIG_Event_NtfHPATrainigPathInfo_2_ADCC_ParkingFuncInfo: start 0, 1852256 bit, opaque, data-transformations=SOME_IP_Default_Transformation, data-type-policy=TRANSFORMING-I-SIGNAL, someip-transformation-i-signal-props{transformer=SOME_IP_Default_Transformer, message-type=NOTIFICATION}, transfer-property=TRIGGERED, to ICC_8155_Android
  general purpose i pdu TPSIGIPDU_Event_NtfHPATrainigPathInfo_2_ADCC_ParkingFuncInfo: category=SOMEIP_SEGMENTED_IPDU, length=1400
  pdu SIGIPDU_Event_NtfHPARepalyPathInfo_2_ADCC_ParkingFuncInfo: has-dynamic-length=false, length=378472, transmission-mode-true-timing=event-controlled-timing=number-of-repetitions=0
    signal SIG_Event_NtfHPARepalyPathInfo_2_ADCC_ParkingFuncInfo: start 0, 3027712 bit, opaque, data-transformations=SOME_IP_Default_Transformation, data-type-policy=TRANSFORMING-I-SIGNAL, someip-transformation-i-signal-props{transformer=SOME_IP_Default_Transformer, message-type=NOTIFICATION}, transfer-property=TRIGGERED, to ICC_8155_Android
  general purpose i pdu TPSIGIPDU_Event_NtfHPARepalyPathInfo_2_ADCC_ParkingFuncInfo: category=SOMEIP_SEGMENTED_IPDU, length=1400
  pdu SIGIPDU_Event_NtfVPAInfo_ADCC_ParkingFuncInfo: has-dynamic-length=false, length=2164, transmission-mode-true-timing=event-controlled-timing=number-of-repetitions=0
    signal SIG_Event_NtfVPAInfo_ADCC_ParkingFuncInfo: start 0, 17248 bit, opaque, data-transformations=SOME_IP_Default_Transformation, data-type-policy=TRANSFORMING-I-SIGNAL, someip-transformation-i-signal-props{transformer=SOME_IP_Default_Transformer, message-type=NOTIFICATION}, transfer-property=TRIGGERED, to ICC_8155_Android
  general purpose i pdu TPSIGIPDU_Event_NtfVPAInfo_ADCC_ParkingFuncInfo: category=SOMEIP_SEGMENTED_IPDU, length=1400
  pdu SIGIPDU_Event_NtfParkingHMIInfo_ADCC_ParkingFuncInfo: has-dynamic-length=false, length=11600, transmission-mode-true-timing=event-controlled-timing=number-of-repetitions=0
    signal SIG_Event_NtfParkingHMIInfo_ADCC_ParkingFuncInfo: start 0, 92736 bit, opaque, data-transformations=SOME_IP_Default_Transformation, data-type-policy=TRANSFORMING-I-SIGNAL, someip-transformation-i-signal-props{transformer=SOME_IP_Default_Transformer, message-type=NOTIFICATION}, transfer-property=TRIGGERED, to ICC_8155_Android
  general purpose i pdu TPSIGIPDU_Event_NtfParkingHMIInfo_ADCC_ParkingFuncInfo: category=SOMEIP_SEGMENTED_IPDU, length=1400
  pdu SIGIPDU_Event_NtfParkingGenaralInfo_ADCC_ParkingFuncInfo_1: has-dynamic-length=false, length=14, transmission-mode-true-timing=event-controlled-timing=number-of-repetitions=0
    signal SIG_Event_NtfParkingGenaralInfo_ADCC_ParkingFuncInfo_1: start 0, 48 bit, opaque, data-transformations=SOME_IP_Default_Transformation, data-type-policy=TRANSFORMING-I-SIGNAL, someip-transformation-i-signal-props{transformer=SOME_IP_Default_Transformer, message-type=NOTIFICATION}, transfer-property=TRIGGERED, to ICC_8155_QNX
  pdu SIGIPDU_Event_NtfAPARPAInfo_ADCC_ParkingFuncInfo_1: has-dynamic-length=false, length=632, transmission-mode-true-timing=event-controlled-timing=number-of-repetitions=0
    signal SIG_Event_NtfAPARPAInfo_ADCC_ParkingFuncInfo_1: start 0, 4992 bit, opaque, data-transformations=SOME_IP_Default_Transformation, data-type-policy=TRANSFORMING-I-SIGNAL, someip-transformation-i-signal-props{transformer=SOME_IP_Default_Transformer, message-type=NOTIFICATION}, transfer-property=TRIGGERED, to ICC_8155_QNX
  pdu SIGIPDU_Event_NtfAdvanceParkingInfo_ADCC_ParkingFuncInfo_1: has-dynamic-length=false, length=576, transmission-mode-true-timing=event-controlled-timing=number-of-repetitions=0
    signal SIG_Event_NtfAdvanceParkingInfo_ADCC_ParkingFuncInfo_1: start 0, 4544 bit, opaque, data-transformations=SOME_IP_Default_Transformation, data-type-policy=TRANSFORMING-I-SIGNAL, someip-transformation-i-signal-props{transformer=SOME_IP_Default_Transformer, message-type=NOTIFICATION}, transfer-property=TRIGGERED, to ICC_8155_QNX
  pdu SIGIPDU_Event_NtfHPAPathDetail_ADCC_ParkingFuncInfo_1: has-dynamic-length=true, length=240412, transmission-mode-true-timing=event-controlled-timing=number-of-repetitions=0
    signal SIG_Event_NtfHPAPathDetail_ADCC_ParkingFuncInfo_1: start 0, 1923232 bit, opaque, data-transformations=SOME_IP_Default_Transformation, data-type-policy=TRANSFORMING-I-SIGNAL, someip-transformation-i-signal-props{transformer=SOME_IP_Default_Transformer, message-type=NOTIFICATION}, dynamic-length=true, transfer-property=TRIGGERED, to ICC_8155_QNX
  general purpose i pdu TPSIGIPDU_Event_NtfHPAPathDetail_ADCC_ParkingFuncInfo_1: category=SOMEIP_SEGMENTED_IPDU, length=1400
  pdu SIGIPDU_Event_NtfHPATrainigPathInfo_ADCC_ParkingFuncInfo_1: has-dynamic-length=false, length=88300, transmission-mode-true-timing=event-controlled-timing=number-of-repetitions=0
    signal SIG_Event_NtfHPATrainigPathInfo_ADCC_ParkingFuncInfo_1: start 0, 706336 bit, opaque, data-transformations=SOME_IP_Default_Transformation, data-type-policy=TRANSFORMING-I-SIGNAL, someip-transformation-i-signal-props{transformer=SOME_IP_Default_Transformer, message-type=NOTIFICATION}, transfer-property=TRIGGERED, to ICC_8155_QNX
  general purpose i pdu TPSIGIPDU_Event_NtfHPATrainigPathInfo_ADCC_ParkingFuncInfo_1: category=SOMEIP_SEGMENTED_IPDU, length=1400
  pdu SIGIPDU_Event_NtfVPASelfBuildMapDate_ADCC_ParkingFuncInfo_1: has-dynamic-length=false, length=14, transmission-mode-true-timing=event-controlled-timing=number-of-repetitions=0
    signal SIG_Event_NtfVPASelfBuildMapDate_ADCC_ParkingFuncInfo_1: start 0, 48 bit, opaque, data-transformations=SOME_IP_Default_Transformation, data-type-policy=TRANSFORMING-I-SIGNAL, someip-transformation-i-signal-props{transformer=SOME_IP_Default_Transformer, message-type=NOTIFICATION}, transfer-property=TRIGGERED, to ICC_8155_QNX
  pdu SIGIPDU_Event_NtfMRAInfo_ADCC_ParkingFuncInfo_1: has-dynamic-length=false, length=540, transmission-mode-true-timing=event-controlled-timing=number-of-repetitions=0
    signal SIG_Event_NtfMRAInfo_ADCC_ParkingFuncInfo_1: start 0, 4256 bit, opaque, data-transformations=SOME_IP_Default_Transformation, data-type-policy=TRANSFORMING-I-SIGNAL, someip-transformation-i-signal-props{transformer=SOME_IP_Default_Transformer, message-type=NOTIFICATION}, transfer-property=TRIGGERED, to ICC_8155_QNX
  pdu SIGIPDU_Event_NtfMEBInfo_ADCC_ParkingFuncInfo_1: has-dynamic-length=false, length=9, transmission-mode-true-timing=event-controlled-timing=number-of-repetitions=0
    signal SIG_Event_NtfMEBInfo_ADCC_ParkingFuncInfo_1: start 0, 8 bit, opaque, data-transformations=SOME_IP_Default_Transformation, data-type-policy=TRANSFORMING-I-SIGNAL, someip-transformation-i-signal-props{transformer=SOME_IP_Default_Transformer, message-type=NOTIFICATION}, transfer-property=TRIGGERED, to ICC_8155_QNX
  pdu SIGIPDU_Event_NtfMAAInfo_ADCC_ParkingFuncInfo_1: has-dynamic-length=false, length=9, transmission-mode-true-timing=event-controlled-timing=number-of-repetitions=0
    signal SIG_Event_NtfMAAInfo_ADCC_ParkingFuncInfo_1: start 0, 8 bit, opaque, data-transformations=SOME_IP_Default_Transformation, data-type-policy=TRANSFORMING-I-SIGNAL, someip-transformation-i-signal-props{transformer=SOME_IP_Default_Transformer, message-type=NOTIFICATION}, transfer-property=TRIGGERED, to ICC_8155_QNX
  pdu SIGIPDU_Event_NtfHPARepalyPathInfo_ADCC_ParkingFuncInfo_1: has-dynamic-length=false, length=88340, transmission-mode-true-timing=event-controlled-timing=number-of-repetitions=0
    signal SIG_Event_NtfHPARepalyPathInfo_ADCC_ParkingFuncInfo_1: start 0, 706656 bit, opaque, data-transformations=SOME_IP_Default_Transformation, data-type-policy=TRANSFORMING-I-SIGNAL, someip-transformation-i-signal-props{transformer=SOME_IP_Default_Transformer, message-type=NOTIFICATION}, transfer-property=TRIGGERED, to ICC_8155_QNX
  general purpose i pdu TPSIGIPDU_Event_NtfHPARepalyPathInfo_ADCC_ParkingFuncInfo_1: category=SOMEIP_SEGMENTED_IPDU, length=1400
  pdu SIGIPDU_Event_NtfParkingGenaralInfo_2_ADCC_ParkingFuncInfo_1: has-dynamic-length=false, length=76, transmission-mode-true-timing=event-controlled-timing=number-of-repetitions=0
    signal SIG_Event_NtfParkingGenaralInfo_2_ADCC_ParkingFuncInfo_1: start 0, 544 bit, opaque, data-transformations=SOME_IP_Default_Transformation, data-type-policy=TRANSFORMING-I-SIGNAL, someip-transformation-i-signal-props{transformer=SOME_IP_Default_Transformer, message-type=NOTIFICATION}, transfer-property=TRIGGERED, to ICC_8155_QNX
  pdu SIGIPDU_Event_NtfMRAInfo_2_ADCC_ParkingFuncInfo_1: has-dynamic-length=false, length=592, transmission-mode-true-timing=event-controlled-timing=number-of-repetitions=0
    signal SIG_Event_NtfMRAInfo_2_ADCC_ParkingFuncInfo_1: start 0, 4672 bit, opaque, data-transformations=SOME_IP_Default_Transformation, data-type-policy=TRANSFORMING-I-SIGNAL, someip-transformation-i-signal-props{transformer=SOME_IP_Default_Transformer, message-type=NOTIFICATION}, transfer-property=TRIGGERED, to ICC_8155_QNX
  pdu SIGIPDU_Event_NtfAPARPAInfo_2_ADCC_ParkingFuncInfo_1: has-dynamic-length=false, length=684, transmission-mode-true-timing=event-controlled-timing=number-of-repetitions=0
    signal SIG_Event_NtfAPARPAInfo_2_ADCC_ParkingFuncInfo_1: start 0, 5408 bit, opaque, data-transformations=SOME_IP_Default_Transformation, data-type-policy=TRANSFORMING-I-SIGNAL, someip-transformation-i-signal-props{transformer=SOME_IP_Default_Transformer, message-type=NOTIFICATION}, transfer-property=TRIGGERED, to ICC_8155_QNX
  pdu SIGIPDU_Event_NtfAdvanceParkingInfo_2_ADCC_ParkingFuncInfo_1: has-dynamic-length=false, length=888, transmission-mode-true-timing=event-controlled-timing=number-of-repetitions=0
    signal SIG_Event_NtfAdvanceParkingInfo_2_ADCC_ParkingFuncInfo_1: start 0, 7040 bit, opaque, data-transformations=SOME_IP_Default_Transformation, data-type-policy=TRANSFORMING-I-SIGNAL, someip-transformation-i-signal-props{transformer=SOME_IP_Default_Transformer, message-type=NOTIFICATION}, transfer-property=TRIGGERED, to ICC_8155_QNX
  pdu SIGIPDU_Event_NtfHPAPathDetail_2_ADCC_ParkingFuncInfo_1: has-dynamic-length=true, length=4635296, transmission-mode-true-timing=event-controlled-timing=number-of-repetitions=0
    signal SIG_Event_NtfHPAPathDetail_2_ADCC_ParkingFuncInfo_1: start 0, 37082304 bit, opaque, data-transformations=SOME_IP_Default_Transformation, data-type-policy=TRANSFORMING-I-SIGNAL, someip-transformation-i-signal-props{transformer=SOME_IP_Default_Transformer, message-type=NOTIFICATION}, dynamic-length=true, transfer-property=TRIGGERED, to ICC_8155_QNX
  general purpose i pdu TPSIGIPDU_Event_NtfHPAPathDetail_2_ADCC_ParkingFuncInfo_1: category=SOMEIP_SEGMENTED_IPDU, length=1400
  pdu SIGIPDU_Event_NtfHPATrainigPathInfo_2_ADCC_ParkingFuncInfo_1: has-dynamic-length=false, length=231540, transmission-mode-true-timing=event-controlled-timing=number-of-repetitions=0
    signal SIG_Event_NtfHPATrainigPathInfo_2_ADCC_ParkingFuncInfo_1: start 0, 1852256 bit, opaque, data-transformations=SOME_IP_Default_Transformation, data-type-policy=TRANSFORMING-I-SIGNAL, someip-transformation-i-signal-props{transformer=SOME_IP_Default_Transformer, message-type=NOTIFICATION}, transfer-property=TRIGGERED, to ICC_8155_QNX
  general purpose i pdu TPSIGIPDU_Event_NtfHPATrainigPathInfo_2_ADCC_ParkingFuncInfo_1: category=SOMEIP_SEGMENTED_IPDU, length=1400
  pdu SIGIPDU_Event_NtfHPARepalyPathInfo_2_ADCC_ParkingFuncInfo_1: has-dynamic-length=false, length=378472, transmission-mode-true-timing=event-controlled-timing=number-of-repetitions=0
    signal SIG_Event_NtfHPARepalyPathInfo_2_ADCC_ParkingFuncInfo_1: start 0, 3027712 bit, opaque, data-transformations=SOME_IP_Default_Transformation, data-type-policy=TRANSFORMING-I-SIGNAL, someip-transformation-i-signal-props{transformer=SOME_IP_Default_Transformer, message-type=NOTIFICATION}, transfer-property=TRIGGERED, to ICC_8155_QNX
  general purpose i pdu TPSIGIPDU_Event_NtfHPARepalyPathInfo_2_ADCC_ParkingFuncInfo_1: category=SOMEIP_SEGMENTED_IPDU, length=1400
  pdu SIGIPDU_Event_NtfVPAInfo_ADCC_ParkingFuncInfo_1: has-dynamic-length=false, length=2164, transmission-mode-true-timing=event-controlled-timing=number-of-repetitions=0
    signal SIG_Event_NtfVPAInfo_ADCC_ParkingFuncInfo_1: start 0, 17248 bit, opaque, data-transformations=SOME_IP_Default_Transformation, data-type-policy=TRANSFORMING-I-SIGNAL, someip-transformation-i-signal-props{transformer=SOME_IP_Default_Transformer, message-type=NOTIFICATION}, transfer-property=TRIGGERED, to ICC_8155_QNX
  general purpose i pdu TPSIGIPDU_Event_NtfVPAInfo_ADCC_ParkingFuncInfo_1: category=SOMEIP_SEGMENTED_IPDU, length=1400
  pdu SIGIPDU_Event_NtfParkingHMIInfo_ADCC_ParkingFuncInfo_1: has-dynamic-length=false, length=11600, transmission-mode-true-timing=event-controlled-timing=number-of-repetitions=0
    signal SIG_Event_NtfParkingHMIInfo_ADCC_ParkingFuncInfo_1: start 0, 92736 bit, opaque, data-transformations=SOME_IP_Default_Transformation, data-type-policy=TRANSFORMING-I-SIGNAL, someip-transformation-i-signal-props{transformer=SOME_IP_Default_Transformer, message-type=NOTIFICATION}, transfer-property=TRIGGERED, to ICC_8155_QNX
  general purpose i pdu TPSIGIPDU_Event_NtfParkingHMIInfo_ADCC_ParkingFuncInfo_1: category=SOMEIP_SEGMENTED_IPDU, length=1400
  pdu SIGIPDU_Event_NtfDynamicObjectList_Prkg_ADCC_ParkingHmiEnv: has-dynamic-length=true, length=2032, transmission-mode-true-timing=event-controlled-timing=number-of-repetitions=0
    signal SIG_Event_NtfDynamicObjectList_Prkg_ADCC_ParkingHmiEnv: start 0, 16192 bit, opaque, data-transformations=SOME_IP_Default_Transformation, data-type-policy=TRANSFORMING-I-SIGNAL, someip-transformation-i-signal-props{transformer=SOME_IP_Default_Transformer, message-type=NOTIFICATION}, dynamic-length=true, transfer-property=TRIGGERED, to ICC_8155_Android
  general purpose i pdu TPSIGIPDU_Event_NtfDynamicObjectList_Prkg_ADCC_ParkingHmiEnv: category=SOMEIP_SEGMENTED_IPDU, length=1400
  pdu SIGIPDU_Event_NtfStaticObjectList_Prkg_ADCC_ParkingHmiEnv: has-dynamic-length=true, length=1696, transmission-mode-true-timing=event-controlled-timing=number-of-repetitions=0
    signal SIG_Event_NtfStaticObjectList_Prkg_ADCC_ParkingHmiEnv: start 0, 13504 bit, opaque, data-transformations=SOME_IP_Default_Transformation, data-type-policy=TRANSFORMING-I-SIGNAL, someip-transformation-i-signal-props{transformer=SOME_IP_Default_Transformer, message-type=NOTIFICATION}, dynamic-length=true, transfer-property=TRIGGERED, to ICC_8155_Android
  general purpose i pdu TPSIGIPDU_Event_NtfStaticObjectList_Prkg_ADCC_ParkingHmiEnv: category=SOMEIP_SEGMENTED_IPDU, length=1400
  pdu SIGIPDU_Event_NtfParkingSlot_Prkg_ADCC_ParkingHmiEnv: has-dynamic-length=true, length=1292, transmission-mode-true-timing=event-controlled-timing=number-of-repetitions=0
    signal SIG_Event_NtfParkingSlot_Prkg_ADCC_ParkingHmiEnv: start 0, 10272 bit, opaque, data-transformations=SOME_IP_Default_Transformation, data-type-policy=TRANSFORMING-I-SIGNAL, someip-transformation-i-signal-props{transformer=SOME_IP_Default_Transformer, message-type=NOTIFICATION}, dynamic-length=true, transfer-property=TRIGGERED, to ICC_8155_Android
  pdu SIGIPDU_Event_NtfHPAStaticObjectList_Prkg_ADCC_ParkingHmiEnv: has-dynamic-length=true, length=19216, transmission-mode-true-timing=event-controlled-timing=number-of-repetitions=0
    signal SIG_Event_NtfHPAStaticObjectList_Prkg_ADCC_ParkingHmiEnv: start 0, 153664 bit, opaque, data-transformations=SOME_IP_Default_Transformation, data-type-policy=TRANSFORMING-I-SIGNAL, someip-transformation-i-signal-props{transformer=SOME_IP_Default_Transformer, message-type=NOTIFICATION}, dynamic-length=true, transfer-property=TRIGGERED, to ICC_8155_Android
  general purpose i pdu TPSIGIPDU_Event_NtfHPAStaticObjectList_Prkg_ADCC_ParkingHmiEnv: category=SOMEIP_SEGMENTED_IPDU, length=1400
  pdu SIGIPDU_Event_NtfHPAParkingSlot_Prkg_ADCC_ParkingHmiEnv: has-dynamic-length=true, length=152012, transmission-mode-true-timing=event-controlled-timing=number-of-repetitions=0
    signal SIG_Event_NtfHPAParkingSlot_Prkg_ADCC_ParkingHmiEnv: start 0, 1216032 bit, opaque, data-transformations=SOME_IP_Default_Transformation, data-type-policy=TRANSFORMING-I-SIGNAL, someip-transformation-i-signal-props{transformer=SOME_IP_Default_Transformer, message-type=NOTIFICATION}, dynamic-length=true, transfer-property=TRIGGERED, to ICC_8155_Android
  general purpose i pdu TPSIGIPDU_Event_NtfHPAParkingSlot_Prkg_ADCC_ParkingHmiEnv: category=SOMEIP_SEGMENTED_IPDU, length=1400
  pdu SIGIPDU_Event_NtfVPASelfBuildMapInfo_ADCC_ParkingHmiEnv: has-dynamic-length=false, length=10405216, transmission-mode-true-timing=event-controlled-timing=number-of-repetitions=0
    signal SIG_Event_NtfVPASelfBuildMapInfo_ADCC_ParkingHmiEnv: start 0, 83241664 bit, opaque, data-transformations=SOME_IP_Default_Transformation, data-type-policy=TRANSFORMING-I-SIGNAL, someip-transformation-i-signal-props{transformer=SOME_IP_Default_Transformer, message-type=NOTIFICATION}, transfer-property=TRIGGERED, to ICC_8155_Android
  general purpose i pdu TPSIGIPDU_Event_NtfVPASelfBuildMapInfo_ADCC_ParkingHmiEnv: category=SOMEIP_SEGMENTED_IPDU, length=1400
  pdu SIGIPDU_Event_NtfVPAParkingLotInfo_ADCC_ParkingHmiEnv: has-dynamic-length=false, length=17212, transmission-mode-true-timing=event-controlled-timing=number-of-repetitions=0
    signal SIG_Event_NtfVPAParkingLotInfo_ADCC_ParkingHmiEnv: start 0, 137632 bit, opaque, data-transformations=SOME_IP_Default_Transformation, data-type-policy=TRANSFORMING-I-SIGNAL, someip-transformation-i-signal-props{transformer=SOME_IP_Default_Transformer, message-type=NOTIFICATION}, transfer-property=TRIGGERED, to ICC_8155_Android
  general purpose i pdu TPSIGIPDU_Event_NtfVPAParkingLotInfo_ADCC_ParkingHmiEnv: category=SOMEIP_SEGMENTED_IPDU, length=1400
  pdu SIGIPDU_Event_NtfDynamicObjectList_Prkg_2_ADCC_ParkingHmiEnv: has-dynamic-length=true, length=8416, transmission-mode-true-timing=event-controlled-timing=number-of-repetitions=0
    signal SIG_Event_NtfDynamicObjectList_Prkg_2_ADCC_ParkingHmiEnv: start 0, 67264 bit, opaque, data-transformations=SOME_IP_Default_Transformation, data-type-policy=TRANSFORMING-I-SIGNAL, someip-transformation-i-signal-props{transformer=SOME_IP_Default_Transformer, message-type=NOTIFICATION}, dynamic-length=true, transfer-property=TRIGGERED, to ICC_8155_Android
  general purpose i pdu TPSIGIPDU_Event_NtfDynamicObjectList_Prkg_2_ADCC_ParkingHmiEnv: category=SOMEIP_SEGMENTED_IPDU, length=1400
  pdu SIGIPDU_Event_NtfStaticObjectList_Prkg_2_ADCC_ParkingHmiEnv: has-dynamic-length=true, length=4816, transmission-mode-true-timing=event-controlled-timing=number-of-repetitions=0
    signal SIG_Event_NtfStaticObjectList_Prkg_2_ADCC_ParkingHmiEnv: start 0, 38464 bit, opaque, data-transformations=SOME_IP_Default_Transformation, data-type-policy=TRANSFORMING-I-SIGNAL, someip-transformation-i-signal-props{transformer=SOME_IP_Default_Transformer, message-type=NOTIFICATION}, dynamic-length=true, transfer-property=TRIGGERED, to ICC_8155_Android
  general purpose i pdu TPSIGIPDU_Event_NtfStaticObjectList_Prkg_2_ADCC_ParkingHmiEnv: category=SOMEIP_SEGMENTED_IPDU, length=1400
  pdu SIGIPDU_Event_NtfDynamicObjectList_Prkg_ADCC_ParkingHmiEnv_1: has-dynamic-length=true, length=2032, transmission-mode-true-timing=event-controlled-timing=number-of-repetitions=0
    signal SIG_Event_NtfDynamicObjectList_Prkg_ADCC_ParkingHmiEnv_1: start 0, 16192 bit, opaque, data-transformations=SOME_IP_Default_Transformation, data-type-policy=TRANSFORMING-I-SIGNAL, someip-transformation-i-signal-props{transformer=SOME_IP_Default_Transformer, message-type=NOTIFICATION}, dynamic-length=true, transfer-property=TRIGGERED, to ICC_8155_QNX
  general purpose i pdu TPSIGIPDU_Event_NtfDynamicObjectList_Prkg_ADCC_ParkingHmiEnv_1: category=SOMEIP_SEGMENTED_IPDU, length=1400
  pdu SIGIPDU_Event_NtfStaticObjectList_Prkg_ADCC_ParkingHmiEnv_1: has-dynamic-length=true, length=1696, transmission-mode-true-timing=event-controlled-timing=number-of-repetitions=0
    signal SIG_Event_NtfStaticObjectList_Prkg_ADCC_ParkingHmiEnv_1: start 0, 13504 bit, opaque, data-transformations=SOME_IP_Default_Transformation, data-type-policy=TRANSFORMING-I-SIGNAL, someip-transformation-i-signal-props{transformer=SOME_IP_Default_Transformer, message-type=NOTIFICATION}, dynamic-length=true, transfer-property=TRIGGERED, to ICC_8155_QNX
  general purpose i pdu TPSIGIPDU_Event_NtfStaticObjectList_Prkg_ADCC_ParkingHmiEnv_1: category=SOMEIP_SEGMENTED_IPDU, length=1400
  pdu SIGIPDU_Event_NtfParkingSlot_Prkg_ADCC_ParkingHmiEnv_1: has-dynamic-length=true, length=1292, transmission-mode-true-timing=event-controlled-timing=number-of-repetitions=0
    signal SIG_Event_NtfParkingSlot_Prkg_ADCC_ParkingHmiEnv_1: start 0, 10272 bit, opaque, data-transformations=SOME_IP_Default_Transformation, data-type-policy=TRANSFORMING-I-SIGNAL, someip-transformation-i-signal-props{transformer=SOME_IP_Default_Transformer, message-type=NOTIFICATION}, dynamic-length=true, transfer-property=TRIGGERED, to ICC_8155_QNX
  pdu SIGIPDU_Event_NtfHPAStaticObjectList_Prkg_ADCC_ParkingHmiEnv_1: has-dynamic-length=true, length=19216, transmission-mode-true-timing=event-controlled-timing=number-of-repetitions=0
    signal SIG_Event_NtfHPAStaticObjectList_Prkg_ADCC_ParkingHmiEnv_1: start 0, 153664 bit, opaque, data-transformations=SOME_IP_Default_Transformation, data-type-policy=TRANSFORMING-I-SIGNAL, someip-transformation-i-signal-props{transformer=SOME_IP_Default_Transformer, message-type=NOTIFICATION}, dynamic-length=true, transfer-property=TRIGGERED, to ICC_8155_QNX
  general purpose i pdu TPSIGIPDU_Event_NtfHPAStaticObjectList_Prkg_ADCC_ParkingHmiEnv_1: category=SOMEIP_SEGMENTED_IPDU, length=1400
  pdu SIGIPDU_Event_NtfHPAParkingSlot_Prkg_ADCC_ParkingHmiEnv_1: has-dynamic-length=true, length=152012, transmission-mode-true-timing=event-controlled-timing=number-of-repetitions=0
    signal SIG_Event_NtfHPAParkingSlot_Prkg_ADCC_ParkingHmiEnv_1: start 0, 1216032 bit, opaque, data-transformations=SOME_IP_Default_Transformation, data-type-policy=TRANSFORMING-I-SIGNAL, someip-transformation-i-signal-props{transformer=SOME_IP_Default_Transformer, message-type=NOTIFICATION}, dynamic-length=true, transfer-property=TRIGGERED, to ICC_8155_QNX
  general purpose i pdu TPSIGIPDU_Event_NtfHPAParkingSlot_Prkg_ADCC_ParkingHmiEnv_1: category=SOMEIP_SEGMENTED_IPDU, length=1400
  pdu SIGIPDU_Event_NtfVPASelfBuildMapInfo_ADCC_ParkingHmiEnv_1: has-dynamic-length=false, length=10405216, transmission-mode-true-timing=event-controlled-timing=number-of-repetitions=0
    signal SIG_Event_NtfVPASelfBuildMapInfo_ADCC_ParkingHmiEnv_1: start 0, 83241664 bit, opaque, data-transformations=SOME_IP_Default_Transformation, data-type-policy=TRANSFORMING-I-SIGNAL, someip-transformation-i-signal-props{transformer=SOME_IP_Default_Transformer, message-type=NOTIFICATION}, transfer-property=TRIGGERED, to ICC_8155_QNX
  general purpose i pdu TPSIGIPDU_Event_NtfVPASelfBuildMapInfo_ADCC_ParkingHmiEnv_1: category=SOMEIP_SEGMENTED_IPDU, length=1400
  pdu SIGIPDU_Event_NtfVPAParkingLotInfo_ADCC_ParkingHmiEnv_1: has-dynamic-length=false, length=17212, transmission-mode-true-timing=event-controlled-timing=number-of-repetitions=0
    signal SIG_Event_NtfVPAParkingLotInfo_ADCC_ParkingHmiEnv_1: start 0, 137632 bit, opaque, data-transformations=SOME_IP_Default_Transformation, data-type-policy=TRANSFORMING-I-SIGNAL, someip-transformation-i-signal-props{transformer=SOME_IP_Default_Transformer, message-type=NOTIFICATION}, transfer-property=TRIGGERED, to ICC_8155_QNX
  general purpose i pdu TPSIGIPDU_Event_NtfVPAParkingLotInfo_ADCC_ParkingHmiEnv_1: category=SOMEIP_SEGMENTED_IPDU, length=1400
  pdu SIGIPDU_Event_NtfDynamicObjectList_Prkg_2_ADCC_ParkingHmiEnv_1: has-dynamic-length=true, length=8416, transmission-mode-true-timing=event-controlled-timing=number-of-repetitions=0
    signal SIG_Event_NtfDynamicObjectList_Prkg_2_ADCC_ParkingHmiEnv_1: start 0, 67264 bit, opaque, data-transformations=SOME_IP_Default_Transformation, data-type-policy=TRANSFORMING-I-SIGNAL, someip-transformation-i-signal-props{transformer=SOME_IP_Default_Transformer, message-type=NOTIFICATION}, dynamic-length=true, transfer-property=TRIGGERED, to ICC_8155_QNX
  general purpose i pdu TPSIGIPDU_Event_NtfDynamicObjectList_Prkg_2_ADCC_ParkingHmiEnv_1: category=SOMEIP_SEGMENTED_IPDU, length=1400
  pdu SIGIPDU_Event_NtfStaticObjectList_Prkg_2_ADCC_ParkingHmiEnv_1: has-dynamic-length=true, length=4816, transmission-mode-true-timing=event-controlled-timing=number-of-repetitions=0
    signal SIG_Event_NtfStaticObjectList_Prkg_2_ADCC_ParkingHmiEnv_1: start 0, 38464 bit, opaque, data-transformations=SOME_IP_Default_Transformation, data-type-policy=TRANSFORMING-I-SIGNAL, someip-transformation-i-signal-props{transformer=SOME_IP_Default_Transformer, message-type=NOTIFICATION}, dynamic-length=true, transfer-property=TRIGGERED, to ICC_8155_QNX
  general purpose i pdu TPSIGIPDU_Event_NtfStaticObjectList_Prkg_2_ADCC_ParkingHmiEnv_1: category=SOMEIP_SEGMENTED_IPDU, length=1400
  pdu SIGIPDU_Event_notifyExtMMResWLnk_ADCC_AomMMSt: has-dynamic-length=false, length=64, transmission-mode-true-timing=event-controlled-timing=number-of-repetitions=0
    signal SIG_Event_notifyExtMMResWLnk_ADCC_AomMMSt: start 0, 448 bit, opaque, data-transformations=SOME_IP_Default_Transformation, data-type-policy=TRANSFORMING-I-SIGNAL, someip-transformation-i-signal-props{transformer=SOME_IP_Default_Transformer, message-type=NOTIFICATION}, transfer-property=TRIGGERED, to ICC_8155_Android
  pdu SIGIPDU_Event_HDMapInfo_ADCC_AomMMSt: has-dynamic-length=false, length=436, transmission-mode-true-timing=event-controlled-timing=number-of-repetitions=0
    signal SIG_Event_HDMapInfo_ADCC_AomMMSt: start 0, 3424 bit, opaque, data-transformations=SOME_IP_Default_Transformation, data-type-policy=TRANSFORMING-I-SIGNAL, someip-transformation-i-signal-props{transformer=SOME_IP_Default_Transformer, message-type=NOTIFICATION}, transfer-property=TRIGGERED, to ICC_8155_Android
  pdu SIGIPDU_Event_notifyExtMMResWLnk_ADCC_AomMMSt_1: has-dynamic-length=false, length=64, transmission-mode-true-timing=event-controlled-timing=number-of-repetitions=0
    signal SIG_Event_notifyExtMMResWLnk_ADCC_AomMMSt_1: start 0, 448 bit, opaque, data-transformations=SOME_IP_Default_Transformation, data-type-policy=TRANSFORMING-I-SIGNAL, someip-transformation-i-signal-props{transformer=SOME_IP_Default_Transformer, message-type=NOTIFICATION}, transfer-property=TRIGGERED, to ICC_8155_QNX
  pdu SIGIPDU_Event_HDMapInfo_ADCC_AomMMSt_1: has-dynamic-length=false, length=436, transmission-mode-true-timing=event-controlled-timing=number-of-repetitions=0
    signal SIG_Event_HDMapInfo_ADCC_AomMMSt_1: start 0, 3424 bit, opaque, data-transformations=SOME_IP_Default_Transformation, data-type-policy=TRANSFORMING-I-SIGNAL, someip-transformation-i-signal-props{transformer=SOME_IP_Default_Transformer, message-type=NOTIFICATION}, transfer-property=TRIGGERED, to ICC_8155_QNX
