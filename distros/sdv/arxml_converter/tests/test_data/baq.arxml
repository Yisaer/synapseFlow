[part 7 of 11: packages /Topology/Clusters to /TpConfig]
AUTOSAR XML (schema 00048)
package /Topology/Clusters  (continued)
  ethernet cluster EthernetCluster1  (continued)
    ethernet physical channel newChannelCommunication_VLAN62: category=WIRED  (continued)
      so-ad-config:
        17 x socket connection bundle:
          SDSCB_VLAN62_Multicast: socket-connection{client-port=SDSoAddr_VLAN62_Any, pdus=socket-connection-ipdu-identifier={header-id=4294934784, pdu-triggering=PDUTransmission_VLAN62_MulticastRx}}, server-port=SDSoAddr_VLAN62_Multicast
          SDSCB_VLAN62_ICC_8155_Android: socket-connection{client-port=SDSoAddr_VLAN62_Any, pdus=[{header-id=4294934784, pdu-triggering=PDUTransmission_VLAN62_Tx_ICC_8155_Android}, {header-id=4294934784, pdu-triggering=PDUTransmission_VLAN62_UnicastRx_ICC_8155_Android}]}, server-port=SDSoAddr_VLAN62_ICC_8155_Android
          SCB_VLAN62_ICC_8155_Android_UDP_30500: server-port=SoAddr_VLAN62_ICC_8155_Android_UDP_30500
            bundled-connections:
              {client-port=SoAddr_VLAN62_ADCC_UDP_30501, pdus=[{header-id=2845081601, pdu-triggering=PDUTrigger_Event_NtfParkingFuncModReq_eHMI_ParkingUI, routing-group=SoAdRG_eHMI_ParkingUI_Eventgroup_VLAN62_eHMI_ParkingUI}, {header-id=2845081602, pdu-triggering=PDUTrigger_Event_NtfApaRpaFcnOperating_eHMI_ParkingUI, routing-group=SoAdRG_eHMI_ParkingUI_Eventgroup_VLAN62_eHMI_ParkingUI}, {header-id=2845081603, pdu-triggering=PDUTrigger_Event_NtfHpaFcnOperating_eHMI_ParkingUI, routing-group=SoAdRG_eHMI_ParkingUI_Eventgroup_VLAN62_eHMI_ParkingUI}, {header-id=2845081605, pdu-triggering=PDUTrigger_Event_NtfMraFcnOperating_eHMI_ParkingUI, routing-group=SoAdRG_eHMI_ParkingUI_Eventgroup_VLAN62_eHMI_ParkingUI}, {header-id=2845081606, pdu-triggering=PDUTrigger_Event_NtfSVSStatus_eHMI_ParkingUI, routing-group=SoAdRG_eHMI_ParkingUI_Eventgroup_VLAN62_eHMI_ParkingUI}, {header-id=2845081607, pdu-triggering=PDUTrigger_Event_NtfApaRpaFcnOperating_2_eHMI_ParkingUI, routing-group=SoAdRG_eHMI_ParkingUI_Eventgroup_VLAN62_eHMI_ParkingUI}, {header-id=2845081608, pdu-triggering=PDUTrigger_Event_NtfHpaFcnOperating_2_eHMI_ParkingUI, routing-group=SoAdRG_eHMI_ParkingUI_Eventgroup_VLAN62_eHMI_ParkingUI}, {header-id=2845147137, pdu-triggering=PDUTrigger_Event_NtfADASSettingInfo_eHMI_ADASSetting, routing-group=SoAdRG_eHMI_ADASSetting_Eventgroup_VLAN62_eHMI_ADASSetting}, {header-id=2845147138, pdu-triggering=PDUTrigger_Event_NtfADASSettingInfo_2_eHMI_ADASSetting, routing-group=SoAdRG_eHMI_ADASSetting_Eventgroup_VLAN62_eHMI_ADASSetting}, {header-id=2845147139, pdu-triggering=PDUTrigger_Event_NtfADASSettingInfo_3_eHMI_ADASSetting, routing-group=SoAdRG_eHMI_ADASSetting_Eventgroup_VLAN62_eHMI_ADASSetting}, {header-id=2885976065, pdu-triggering=PDUTrigger_Event_notifyADCC_Command_ICC_Aom, routing-group=SoAdRG_ICC_Aom_Eventgroup_VLAN62_ICC_Aom}, {header-id=2886107137, pdu-triggering=TPPDUTrigger_Event_NtfSDmapInfo_ICC_SDmapInfo, routing-group=SoAdRG_ICC_SDmapInfo_EventGroup_VLAN62_ICC_SDmapInfo}, {header-id=2886107138, pdu-triggering=PDUTrigger_Event_notifyNOA_SDMapPosInfo_ICC_SDmapInfo, routing-group=SoAdRG_ICC_SDmapInfo_EventGroup_VLAN62_ICC_SDmapInfo}, {header-id=2886107139, pdu-triggering=PDUTrigger_Event_notifyNOA_SDMapStubInfo_ICC_SDmapInfo, routing-group=SoAdRG_ICC_SDmapInfo_EventGroup_VLAN62_ICC_SDmapInfo}, {header-id=2886107140, pdu-triggering=PDUTrigger_Event_notifyNOA_SDMapSegmentInfo_ICC_SDmapInfo, routing-group=SoAdRG_ICC_SDmapInfo_EventGroup_VLAN62_ICC_SDmapInfo}, {header-id=2886107141, pdu-triggering=PDUTrigger_Event_notifyNOA_SDMapShortInfo_ICC_SDmapInfo, routing-group=SoAdRG_ICC_SDmapInfo_EventGroup_VLAN62_ICC_SDmapInfo}, {header-id=2886107142, pdu-triggering=PDUTrigger_Event_notifyNOA_SDMapLongInfo_ICC_SDmapInfo, routing-group=SoAdRG_ICC_SDmapInfo_EventGroup_VLAN62_ICC_SDmapInfo}, {header-id=2886107143, pdu-triggering=PDUTrigger_Event_notifyNOA_SDMapMetaInfo_ICC_SDmapInfo, routing-group=SoAdRG_ICC_SDmapInfo_EventGroup_VLAN62_ICC_SDmapInfo}, {header-id=2886107144, pdu-triggering=PDUTrigger_Event_NtfSDmapInfo_international_ICC_SDmapInfo, routing-group=SoAdRG_ICC_SDmapInfo_EventGroup_VLAN62_ICC_SDmapInfo}, {header-id=2886107145, pdu-triggering=PDUTrigger_Event_NtfSDmapLaneInfo_ICC_SDmapInfo, routing-group=SoAdRG_ICC_SDmapInfo_EventGroup_VLAN62_ICC_SDmapInfo}, {header-id=2886500356, pdu-triggering=PDUTrigger_Event_NtfSDmapCruiseFacilityInfo_ICC_SDmapInfo_2, routing-group=SoAdRG_ICC_SDmapInfo_2_EventGroup_VLAN62_ICC_SDmapInfo_2}, {header-id=2886500362, pdu-triggering=PDUTrigger_Event_notifySDmapLaneInfo_ICC_SDmapInfo_2, routing-group=SoAdRG_ICC_SDmapInfo_2_EventGroup_VLAN62_ICC_SDmapInfo_2}, {header-id=2886500363, pdu-triggering=PDUTrigger_Event_NtfSDmapMixForkInfo_ICC_SDmapInfo_2, routing-group=SoAdRG_ICC_SDmapInfo_2_EventGroup_VLAN62_ICC_SDmapInfo_2}, {header-id=2886500364, pdu-triggering=PDUTrigger_Event_NtfSDmapMyLocationInfo_ICC_SDmapInfo_2, routing-group=SoAdRG_ICC_SDmapInfo_2_EventGroup_VLAN62_ICC_SDmapInfo_2}, {header-id=2886500365, pdu-triggering=PDUTrigger_Event_NtfSDmapNaviStatusInfo_ICC_SDmapInfo_2, routing-group=SoAdRG_ICC_SDmapInfo_2_EventGroup_VLAN62_ICC_SDmapInfo_2}, {header-id=2886500366, pdu-triggering=PDUTrigger_Event_NtfSDmapSoundInfo_ICC_SDmapInfo_2, routing-group=SoAdRG_ICC_SDmapInfo_2_EventGroup_VLAN62_ICC_SDmapInfo_2}, {header-id=2886500367, pdu-triggering=PDUTrigger_Event_NtfSDmapRouteOption_ICC_SDmapInfo_2, routing-group=SoAdRG_ICC_SDmapInfo_2_EventGroup_VLAN62_ICC_SDmapInfo_2}, {header-id=2886500368, pdu-triggering=PDUTrigger_Event_NtfSDmapCruiseInfo_ICC_SDmapInfo_2, routing-group=SoAdRG_ICC_SDmapInfo_2_EventGroup_VLAN62_ICC_SDmapInfo_2}, {header-id=2886500369, pdu-triggering=PDUTrigger_Event_NtfSDmapNaviRoadInfo_ICC_SDmapInfo_2, routing-group=SoAdRG_ICC_SDmapInfo_2_EventGroup_VLAN62_ICC_SDmapInfo_2}, {header-id=2886500371, pdu-triggering=PDUTrigger_Event_NtfSDmapTollGateInfo_ICC_SDmapInfo_2, routing-group=SoAdRG_ICC_SDmapInfo_2_EventGroup_VLAN62_ICC_SDmapInfo_2}, {header-id=2886500372, pdu-triggering=PDUTrigger_Event_NtfSDmapServiceAreaInfo_ICC_SDmapInfo_2, routing-group=SoAdRG_ICC_SDmapInfo_2_EventGroup_VLAN62_ICC_SDmapInfo_2}, {header-id=2886500373, pdu-triggering=PDUTrigger_Event_NtfSDmapTunnelInfo_ICC_SDmapInfo_2, routing-group=SoAdRG_ICC_SDmapInfo_2_EventGroup_VLAN62_ICC_SDmapInfo_2}, {header-id=2886500374, pdu-triggering=PDUTrigger_Event_NtfSDmapRampInfo_ICC_SDmapInfo_2, routing-group=SoAdRG_ICC_SDmapInfo_2_EventGroup_VLAN62_ICC_SDmapInfo_2}, {header-id=2886500375, pdu-triggering=PDUTrigger_Event_NtfSDmapFacilityInfo_ICC_SDmapInfo_2, routing-group=SoAdRG_ICC_SDmapInfo_2_EventGroup_VLAN62_ICC_SDmapInfo_2}, {header-id=2886500376, pdu-triggering=PDUTrigger_Event_NtfSDmapLocMatchInfo_ICC_SDmapInfo_2, routing-group=SoAdRG_ICC_SDmapInfo_2_EventGroup_VLAN62_ICC_SDmapInfo_2}, {header-id=2886500377, pdu-triggering=TPPDUTrigger_Event_notifySDmapTollGateLaneInfo_ICC_SDmapInfo_2, routing-group=SoAdRG_ICC_SDmapInfo_2_EventGroup_VLAN62_ICC_SDmapInfo_2}, {header-id=2886500378, pdu-triggering=PDUTrigger_Event_notifySDmapNavArriveAim_ICC_SDmapInfo_2, routing-group=SoAdRG_ICC_SDmapInfo_2_EventGroup_VLAN62_ICC_SDmapInfo_2}]}
              {client-port=SoAddr_VLAN62_FCM_UDP_30501, pdus=[{header-id=2845147137, pdu-triggering=PDUTrigger_Event_NtfADASSettingInfo_eHMI_ADASSetting_1, routing-group=SoAdRG_eHMI_ADASSetting_Eventgroup_VLAN62_eHMI_ADASSetting}, {header-id=2845147138, pdu-triggering=PDUTrigger_Event_NtfADASSettingInfo_2_eHMI_ADASSetting_1, routing-group=SoAdRG_eHMI_ADASSetting_Eventgroup_VLAN62_eHMI_ADASSetting}, {header-id=2845147139, pdu-triggering=PDUTrigger_Event_NtfADASSettingInfo_3_eHMI_ADASSetting_1, routing-group=SoAdRG_eHMI_ADASSetting_Eventgroup_VLAN62_eHMI_ADASSetting}, {header-id=2886107137, pdu-triggering=TPPDUTrigger_Event_NtfSDmapInfo_ICC_SDmapInfo_1, routing-group=SoAdRG_ICC_SDmapInfo_EventGroup_VLAN62_ICC_SDmapInfo}, {header-id=2886107138, pdu-triggering=PDUTrigger_Event_notifyNOA_SDMapPosInfo_ICC_SDmapInfo_1, routing-group=SoAdRG_ICC_SDmapInfo_EventGroup_VLAN62_ICC_SDmapInfo}, {header-id=2886107139, pdu-triggering=PDUTrigger_Event_notifyNOA_SDMapStubInfo_ICC_SDmapInfo_1, routing-group=SoAdRG_ICC_SDmapInfo_EventGroup_VLAN62_ICC_SDmapInfo}, {header-id=2886107140, pdu-triggering=PDUTrigger_Event_notifyNOA_SDMapSegmentInfo_ICC_SDmapInfo_1, routing-group=SoAdRG_ICC_SDmapInfo_EventGroup_VLAN62_ICC_SDmapInfo}, {header-id=2886107141, pdu-triggering=PDUTrigger_Event_notifyNOA_SDMapShortInfo_ICC_SDmapInfo_1, routing-group=SoAdRG_ICC_SDmapInfo_EventGroup_VLAN62_ICC_SDmapInfo}, {header-id=2886107142, pdu-triggering=PDUTrigger_Event_notifyNOA_SDMapLongInfo_ICC_SDmapInfo_1, routing-group=SoAdRG_ICC_SDmapInfo_EventGroup_VLAN62_ICC_SDmapInfo}, {header-id=2886107143, pdu-triggering=PDUTrigger_Event_notifyNOA_SDMapMetaInfo_ICC_SDmapInfo_1, routing-group=SoAdRG_ICC_SDmapInfo_EventGroup_VLAN62_ICC_SDmapInfo}, {header-id=2886107144, pdu-triggering=PDUTrigger_Event_NtfSDmapInfo_international_ICC_SDmapInfo_1, routing-group=SoAdRG_ICC_SDmapInfo_EventGroup_VLAN62_ICC_SDmapInfo}, {header-id=2886107145, pdu-triggering=PDUTrigger_Event_NtfSDmapLaneInfo_ICC_SDmapInfo_1, routing-group=SoAdRG_ICC_SDmapInfo_EventGroup_VLAN62_ICC_SDmapInfo}, {header-id=2886500356, pdu-triggering=PDUTrigger_Event_NtfSDmapCruiseFacilityInfo_ICC_SDmapInfo_2_1, routing-group=SoAdRG_ICC_SDmapInfo_2_EventGroup_VLAN62_ICC_SDmapInfo_2}, {header-id=2886500362, pdu-triggering=PDUTrigger_Event_notifySDmapLaneInfo_ICC_SDmapInfo_2_1, routing-group=SoAdRG_ICC_SDmapInfo_2_EventGroup_VLAN62_ICC_SDmapInfo_2}, {header-id=2886500363, pdu-triggering=PDUTrigger_Event_NtfSDmapMixForkInfo_ICC_SDmapInfo_2_1, routing-group=SoAdRG_ICC_SDmapInfo_2_EventGroup_VLAN62_ICC_SDmapInfo_2}, {header-id=2886500364, pdu-triggering=PDUTrigger_Event_NtfSDmapMyLocationInfo_ICC_SDmapInfo_2_1, routing-group=SoAdRG_ICC_SDmapInfo_2_EventGroup_VLAN62_ICC_SDmapInfo_2}, {header-id=2886500365, pdu-triggering=PDUTrigger_Event_NtfSDmapNaviStatusInfo_ICC_SDmapInfo_2_1, routing-group=SoAdRG_ICC_SDmapInfo_2_EventGroup_VLAN62_ICC_SDmapInfo_2}, {header-id=2886500366, pdu-triggering=PDUTrigger_Event_NtfSDmapSoundInfo_ICC_SDmapInfo_2_1, routing-group=SoAdRG_ICC_SDmapInfo_2_EventGroup_VLAN62_ICC_SDmapInfo_2}, {header-id=2886500367, pdu-triggering=PDUTrigger_Event_NtfSDmapRouteOption_ICC_SDmapInfo_2_1, routing-group=SoAdRG_ICC_SDmapInfo_2_EventGroup_VLAN62_ICC_SDmapInfo_2}, {header-id=2886500368, pdu-triggering=PDUTrigger_Event_NtfSDmapCruiseInfo_ICC_SDmapInfo_2_1, routing-group=SoAdRG_ICC_SDmapInfo_2_EventGroup_VLAN62_ICC_SDmapInfo_2}, {header-id=2886500369, pdu-triggering=PDUTrigger_Event_NtfSDmapNaviRoadInfo_ICC_SDmapInfo_2_1, routing-group=SoAdRG_ICC_SDmapInfo_2_EventGroup_VLAN62_ICC_SDmapInfo_2}, {header-id=2886500371, pdu-triggering=PDUTrigger_Event_NtfSDmapTollGateInfo_ICC_SDmapInfo_2_1, routing-group=SoAdRG_ICC_SDmapInfo_2_EventGroup_VLAN62_ICC_SDmapInfo_2}, {header-id=2886500372, pdu-triggering=PDUTrigger_Event_NtfSDmapServiceAreaInfo_ICC_SDmapInfo_2_1, routing-group=SoAdRG_ICC_SDmapInfo_2_EventGroup_VLAN62_ICC_SDmapInfo_2}, {header-id=2886500373, pdu-triggering=PDUTrigger_Event_NtfSDmapTunnelInfo_ICC_SDmapInfo_2_1, routing-group=SoAdRG_ICC_SDmapInfo_2_EventGroup_VLAN62_ICC_SDmapInfo_2}, {header-id=2886500374, pdu-triggering=PDUTrigger_Event_NtfSDmapRampInfo_ICC_SDmapInfo_2_1, routing-group=SoAdRG_ICC_SDmapInfo_2_EventGroup_VLAN62_ICC_SDmapInfo_2}, {header-id=2886500375, pdu-triggering=PDUTrigger_Event_NtfSDmapFacilityInfo_ICC_SDmapInfo_2_1, routing-group=SoAdRG_ICC_SDmapInfo_2_EventGroup_VLAN62_ICC_SDmapInfo_2}, {header-id=2886500376, pdu-triggering=PDUTrigger_Event_NtfSDmapLocMatchInfo_ICC_SDmapInfo_2_1, routing-group=SoAdRG_ICC_SDmapInfo_2_EventGroup_VLAN62_ICC_SDmapInfo_2}, {header-id=2886500377, pdu-triggering=TPPDUTrigger_Event_notifySDmapTollGateLaneInfo_ICC_SDmapInfo_2_1, routing-group=SoAdRG_ICC_SDmapInfo_2_EventGroup_VLAN62_ICC_SDmapInfo_2}, {header-id=2886500378, pdu-triggering=PDUTrigger_Event_notifySDmapNavArriveAim_ICC_SDmapInfo_2_1, routing-group=SoAdRG_ICC_SDmapInfo_2_EventGroup_VLAN62_ICC_SDmapInfo_2}, {header-id=2886696961, pdu-triggering=PDUTrigger_Event_notifyUnixTimestamp_IVI_UnixTimestamp, routing-group=SoAdRG_UnixTimestamp_Eventgroup_VLAN62_IVI_UnixTimestamp}]}
              {client-port=SoAddr_VLAN62_TBOX_UDP_30501, pdus=socket-connection-ipdu-identifier={header-id=2886041603, pdu-triggering=PDUTrigger_Event_notifyEcallMdoeFed_ICC_Android_OutService, routing-group=SoAdRG_ICC_Android_OutService_EventGroup_VLAN62_ICC_Android_OutService}}
          SCB_VLAN62_ICC_8155_Android_TCP_30500: server-port=SoAddr_VLAN62_ICC_8155_Android_TCP_30500
            bundled-connections:
              {client-port=SoAddr_VLAN62_ADCC_TCP_30501, pdus=[{header-id=2845081604, pdu-triggering=TPPDUTrigger_Event_NtfVpaFcnOperating_eHMI_ParkingUI, routing-group=SoAdRG_eHMI_ParkingUI_Eventgroup_VLAN62_eHMI_ParkingUI}, {header-id=2885943297, pdu-triggering=PDUTrigger_RR_GetRenderDBInfo_call_Cis_ADCC_ICC_Aom, routing-group=SoAdRG_ICC_Aom_VLAN62}, {header-id=2885943297, pdu-triggering=PDUTrigger_RR_GetRenderDBInfo_return_Cis_ADCC_ICC_Aom, routing-group=SoAdRG_ICC_Aom_VLAN62}, {header-id=2886500353, pdu-triggering=TPPDUTrigger_Event_NtfSDmapRouteInfo_ICC_SDmapInfo_2, routing-group=SoAdRG_ICC_SDmapInfo_2_EventGroup_VLAN62_ICC_SDmapInfo_2}, {header-id=2886500354, pdu-triggering=TPPDUTrigger_Event_NtfSDmapTBTNaviInfo_ICC_SDmapInfo_2, routing-group=SoAdRG_ICC_SDmapInfo_2_EventGroup_VLAN62_ICC_SDmapInfo_2}, {header-id=2886500355, pdu-triggering=TPPDUTrigger_Event_NtfSDmapNaviCameraInfo_ICC_SDmapInfo_2, routing-group=SoAdRG_ICC_SDmapInfo_2_EventGroup_VLAN62_ICC_SDmapInfo_2}, {header-id=2886500357, pdu-triggering=TPPDUTrigger_Event_NtfSDmapTrafficLightCDInfo_ICC_SDmapInfo_2, routing-group=SoAdRG_ICC_SDmapInfo_2_EventGroup_VLAN62_ICC_SDmapInfo_2}, {header-id=2886500358, pdu-triggering=TPPDUTrigger_Event_NtfSDmapNaviIntCamDynInfo_ICC_SDmapInfo_2, routing-group=SoAdRG_ICC_SDmapInfo_2_EventGroup_VLAN62_ICC_SDmapInfo_2}, {header-id=2886500359, pdu-triggering=TPPDUTrigger_Event_NtfSDmapNaviWeatherInfo_ICC_SDmapInfo_2, routing-group=SoAdRG_ICC_SDmapInfo_2_EventGroup_VLAN62_ICC_SDmapInfo_2}, {header-id=2886500360, pdu-triggering=TPPDUTrigger_Event_NtfSDmapNaviCongestionInfo_ICC_SDmapInfo_2, routing-group=SoAdRG_ICC_SDmapInfo_2_EventGroup_VLAN62_ICC_SDmapInfo_2}, {header-id=2886500361, pdu-triggering=TPPDUTrigger_Event_NtfSDmapNaviGreenWaveCarSpd_ICC_SDmapInfo_2, routing-group=SoAdRG_ICC_SDmapInfo_2_EventGroup_VLAN62_ICC_SDmapInfo_2}, {header-id=2886500370, pdu-triggering=TPPDUTrigger_Event_NtfSDmapAheadLaneInfo_ICC_SDmapInfo_2, routing-group=SoAdRG_ICC_SDmapInfo_2_EventGroup_VLAN62_ICC_SDmapInfo_2}]}
              {client-port=SoAddr_VLAN62_FCM_TCP_30501, pdus=[{header-id=2845802497, pdu-triggering=PDUTrigger_Event_notifyDVRRequest_eHMI_DVRSet, routing-group=SoAdRG_eHMI_DVRSet_EventGroup_VLAN62_eHMI_DVRSet}, {header-id=2886500353, pdu-triggering=TPPDUTrigger_Event_NtfSDmapRouteInfo_ICC_SDmapInfo_2_1, routing-group=SoAdRG_ICC_SDmapInfo_2_EventGroup_VLAN62_ICC_SDmapInfo_2}, {header-id=2886500354, pdu-triggering=TPPDUTrigger_Event_NtfSDmapTBTNaviInfo_ICC_SDmapInfo_2_1, routing-group=SoAdRG_ICC_SDmapInfo_2_EventGroup_VLAN62_ICC_SDmapInfo_2}, {header-id=2886500355, pdu-triggering=TPPDUTrigger_Event_NtfSDmapNaviCameraInfo_ICC_SDmapInfo_2_1, routing-group=SoAdRG_ICC_SDmapInfo_2_EventGroup_VLAN62_ICC_SDmapInfo_2}, {header-id=2886500357, pdu-triggering=TPPDUTrigger_Event_NtfSDmapTrafficLightCDInfo_ICC_SDmapInfo_2_1, routing-group=SoAdRG_ICC_SDmapInfo_2_EventGroup_VLAN62_ICC_SDmapInfo_2}, {header-id=2886500358, pdu-triggering=TPPDUTrigger_Event_NtfSDmapNaviIntCamDynInfo_ICC_SDmapInfo_2_1, routing-group=SoAdRG_ICC_SDmapInfo_2_EventGroup_VLAN62_ICC_SDmapInfo_2}, {header-id=2886500359, pdu-triggering=TPPDUTrigger_Event_NtfSDmapNaviWeatherInfo_ICC_SDmapInfo_2_1, routing-group=SoAdRG_ICC_SDmapInfo_2_EventGroup_VLAN62_ICC_SDmapInfo_2}, {header-id=2886500360, pdu-triggering=TPPDUTrigger_Event_NtfSDmapNaviCongestionInfo_ICC_SDmapInfo_2_1, routing-group=SoAdRG_ICC_SDmapInfo_2_EventGroup_VLAN62_ICC_SDmapInfo_2}, {header-id=2886500361, pdu-triggering=TPPDUTrigger_Event_NtfSDmapNaviGreenWaveCarSpd_ICC_SDmapInfo_2_1, routing-group=SoAdRG_ICC_SDmapInfo_2_EventGroup_VLAN62_ICC_SDmapInfo_2}, {header-id=2886500370, pdu-triggering=TPPDUTrigger_Event_NtfSDmapAheadLaneInfo_ICC_SDmapInfo_2_1, routing-group=SoAdRG_ICC_SDmapInfo_2_EventGroup_VLAN62_ICC_SDmapInfo_2}]}
          SDSCB_VLAN62_ADCC: socket-connection{client-port=SDSoAddr_VLAN62_Any, pdus=[{header-id=4294934784, pdu-triggering=PDUTransmission_VLAN62_Tx_ADCC}, {header-id=4294934784, pdu-triggering=PDUTransmission_VLAN62_UnicastRx_ADCC}]}, server-port=SDSoAddr_VLAN62_ADCC
          SDSCB_VLAN62_FCM: socket-connection{client-port=SDSoAddr_VLAN62_Any, pdus=[{header-id=4294934784, pdu-triggering=PDUTransmission_VLAN62_Tx_FCM}, {header-id=4294934784, pdu-triggering=PDUTransmission_VLAN62_UnicastRx_FCM}]}, server-port=SDSoAddr_VLAN62_FCM
          SDSCB_VLAN62_TBOX: socket-connection{client-port=SDSoAddr_VLAN62_Any, pdus=[{header-id=4294934784, pdu-triggering=PDUTransmission_VLAN62_Tx_TBOX}, {header-id=4294934784, pdu-triggering=PDUTransmission_VLAN62_UnicastRx_TBOX}]}, server-port=SDSoAddr_VLAN62_TBOX
          SCB_VLAN62_TBOX_UDP_30500: server-port=SoAddr_VLAN62_TBOX_UDP_30500
            bundled-connections:
              {client-port=SoAddr_VLAN62_ICC_8155_Android_UDP_30501, pdus=[{header-id=2852290561, pdu-triggering=PDUTrigger_Event_notifyTimeManagement_TBOX_TimeManagement, routing-group=SoAdRG_TBOX_TimeManagement_EventGroup_VLAN62_TBOX_TimeManagement}, {header-id=2852716545, pdu-triggering=PDUTrigger_RR_get5GSwtSts_Fb_call_Cis_ICC_8155_Android_TBOX_ResSwtSts, routing-group=SoAdRG_TBOX_ResSwtSts_VLAN62}, {header-id=2852716545, pdu-triggering=PDUTrigger_RR_get5GSwtSts_Fb_return_Cis_ICC_8155_Android_TBOX_ResSwtSts, routing-group=SoAdRG_TBOX_ResSwtSts_VLAN62}, {header-id=2852716546, pdu-triggering=PDUTrigger_RR_getV2XSwtSts_Fb_call_Cis_ICC_8155_Android_TBOX_ResSwtSts, routing-group=SoAdRG_TBOX_ResSwtSts_VLAN62}, {header-id=2852716546, pdu-triggering=PDUTrigger_RR_getV2XSwtSts_Fb_return_Cis_ICC_8155_Android_TBOX_ResSwtSts, routing-group=SoAdRG_TBOX_ResSwtSts_VLAN62}, {header-id=2852716547, pdu-triggering=PDUTrigger_RR_getDownLogSwtSts_Fb_call_Cis_ICC_8155_Android_TBOX_ResSwtSts, routing-group=SoAdRG_TBOX_ResSwtSts_VLAN62}, {header-id=2852716547, pdu-triggering=PDUTrigger_RR_getDownLogSwtSts_Fb_return_Cis_ICC_8155_Android_TBOX_ResSwtSts, routing-group=SoAdRG_TBOX_ResSwtSts_VLAN62}, {header-id=2852716548, pdu-triggering=PDUTrigger_RR_getUSBUpdateSwtSts_Fb_call_Cis_ICC_8155_Android_TBOX_ResSwtSts, routing-group=SoAdRG_TBOX_ResSwtSts_VLAN62}, {header-id=2852716548, pdu-triggering=PDUTrigger_RR_getUSBUpdateSwtSts_Fb_return_Cis_ICC_8155_Android_TBOX_ResSwtSts, routing-group=SoAdRG_TBOX_ResSwtSts_VLAN62}, {header-id=2852716549, pdu-triggering=PDUTrigger_RR_getResumeFactorySet_Fb_call_Cis_ICC_8155_Android_TBOX_ResSwtSts, routing-group=SoAdRG_TBOX_ResSwtSts_VLAN62}, {header-id=2852716549, pdu-triggering=PDUTrigger_RR_getResumeFactorySet_Fb_return_Cis_ICC_8155_Android_TBOX_ResSwtSts, routing-group=SoAdRG_TBOX_ResSwtSts_VLAN62}, {header-id=2852716550, pdu-triggering=PDUTrigger_RR_set5GSwtSts_call_Cis_ICC_8155_Android_TBOX_ResSwtSts, routing-group=SoAdRG_TBOX_ResSwtSts_VLAN62}, {header-id=2852716550, pdu-triggering=PDUTrigger_RR_set5GSwtSts_return_Cis_ICC_8155_Android_TBOX_ResSwtSts, routing-group=SoAdRG_TBOX_ResSwtSts_VLAN62}, {header-id=2852716551, pdu-triggering=PDUTrigger_RR_setV2XSwtSts_call_Cis_ICC_8155_Android_TBOX_ResSwtSts, routing-group=SoAdRG_TBOX_ResSwtSts_VLAN62}, {header-id=2852716551, pdu-triggering=PDUTrigger_RR_setV2XSwtSts_return_Cis_ICC_8155_Android_TBOX_ResSwtSts, routing-group=SoAdRG_TBOX_ResSwtSts_VLAN62}, {header-id=2852716552, pdu-triggering=PDUTrigger_RR_setDownLogSwtSts_call_Cis_ICC_8155_Android_TBOX_ResSwtSts, routing-group=SoAdRG_TBOX_ResSwtSts_VLAN62}, {header-id=2852716552, pdu-triggering=PDUTrigger_RR_setDownLogSwtSts_return_Cis_ICC_8155_Android_TBOX_ResSwtSts, routing-group=SoAdRG_TBOX_ResSwtSts_VLAN62}, {header-id=2852716553, pdu-triggering=PDUTrigger_RR_setUSBUpdateSwtSts_call_Cis_ICC_8155_Android_TBOX_ResSwtSts, routing-group=SoAdRG_TBOX_ResSwtSts_VLAN62}, {header-id=2852716553, pdu-triggering=PDUTrigger_RR_setUSBUpdateSwtSts_return_Cis_ICC_8155_Android_TBOX_ResSwtSts, routing-group=SoAdRG_TBOX_ResSwtSts_VLAN62}, {header-id=2852716554, pdu-triggering=PDUTrigger_RR_setResumeFactorySet_call_Cis_ICC_8155_Android_TBOX_ResSwtSts, routing-group=SoAdRG_TBOX_ResSwtSts_VLAN62}, {header-id=2852716554, pdu-triggering=PDUTrigger_RR_setResumeFactorySet_return_Cis_ICC_8155_Android_TBOX_ResSwtSts, routing-group=SoAdRG_TBOX_ResSwtSts_VLAN62}, {header-id=2852814849, pdu-triggering=PDUTrigger_Event_Event_NetworkStatus_TBOX_SystemInfo_2, routing-group=SoAdRG_TBOXSystemInfo_EventGroup_VLAN62_TBOX_SystemInfo}, {header-id=2852814850, pdu-triggering=PDUTrigger_Event_Event_VehicleDiagStatus_TBOX_SystemInfo_2, routing-group=SoAdRG_TBOXSystemInfo_EventGroup_VLAN62_TBOX_SystemInfo}, {header-id=2852782081, pdu-triggering=PDUTrigger_RR_RR_TBoxVersionInfo_call_Cis_ICC_8155_Android_TBOX_SystemInfo, routing-group=SoAdRG_TBOX_SystemInfo_VLAN62}, {header-id=2852782081, pdu-triggering=PDUTrigger_RR_RR_TBoxVersionInfo_return_Cis_ICC_8155_Android_TBOX_SystemInfo, routing-group=SoAdRG_TBOX_SystemInfo_VLAN62}, {header-id=2852782082, pdu-triggering=PDUTrigger_RR_RR_BleModuleInfo_call_Cis_ICC_8155_Android_TBOX_SystemInfo, routing-group=SoAdRG_TBOX_SystemInfo_VLAN62}, {header-id=2852782082, pdu-triggering=PDUTrigger_RR_RR_BleModuleInfo_return_Cis_ICC_8155_Android_TBOX_SystemInfo, routing-group=SoAdRG_TBOX_SystemInfo_VLAN62}, {header-id=2852782083, pdu-triggering=PDUTrigger_RR_RR_VIN_call_Cis_ICC_8155_Android_TBOX_SystemInfo, routing-group=SoAdRG_TBOX_SystemInfo_VLAN62}, {header-id=2852782083, pdu-triggering=PDUTrigger_RR_RR_VIN_return_Cis_ICC_8155_Android_TBOX_SystemInfo, routing-group=SoAdRG_TBOX_SystemInfo_VLAN62}, {header-id=2852782084, pdu-triggering=PDUTrigger_RR_RR_SIMCardinfo_call_Cis_ICC_8155_Android_TBOX_SystemInfo, routing-group=SoAdRG_TBOX_SystemInfo_VLAN62}, {header-id=2852782084, pdu-triggering=PDUTrigger_RR_RR_SIMCardinfo_return_Cis_ICC_8155_Android_TBOX_SystemInfo, routing-group=SoAdRG_TBOX_SystemInfo_VLAN62}, {header-id=2852782085, pdu-triggering=PDUTrigger_RR_RR_IMEIInfo_call_Cis_ICC_8155_Android_TBOX_SystemInfo, routing-group=SoAdRG_TBOX_SystemInfo_VLAN62}, {header-id=2852782085, pdu-triggering=PDUTrigger_RR_RR_IMEIInfo_return_Cis_ICC_8155_Android_TBOX_SystemInfo, routing-group=SoAdRG_TBOX_SystemInfo_VLAN62}, {header-id=2852782086, pdu-triggering=PDUTrigger_RR_RR_CallNumberList_call_Cis_ICC_8155_Android_TBOX_SystemInfo, routing-group=SoAdRG_TBOX_SystemInfo_VLAN62}, {header-id=2852782086, pdu-triggering=PDUTrigger_RR_RR_CallNumberList_return_Cis_ICC_8155_Android_TBOX_SystemInfo, routing-group=SoAdRG_TBOX_SystemInfo_VLAN62}, {header-id=2852782087, pdu-triggering=PDUTrigger_RR_RR_WorkModel_call_Cis_ICC_8155_Android_TBOX_SystemInfo, routing-group=SoAdRG_TBOX_SystemInfo_VLAN62}, {header-id=2852782087, pdu-triggering=PDUTrigger_RR_RR_WorkModel_return_Cis_ICC_8155_Android_TBOX_SystemInfo, routing-group=SoAdRG_TBOX_SystemInfo_VLAN62}, {header-id=2852782088, pdu-triggering=PDUTrigger_RR_RR_CertificateIssuedMark_call_Cis_ICC_8155_Android_TBOX_SystemInfo, routing-group=SoAdRG_TBOX_SystemInfo_VLAN62}, {header-id=2852782088, pdu-triggering=PDUTrigger_RR_RR_CertificateIssuedMark_return_Cis_ICC_8155_Android_TBOX_SystemInfo, routing-group=SoAdRG_TBOX_SystemInfo_VLAN62}, {header-id=2852782089, pdu-triggering=PDUTrigger_RR_RR_SetCallNumber_call_Cis_ICC_8155_Android_TBOX_SystemInfo, routing-group=SoAdRG_TBOX_SystemInfo_VLAN62}, {header-id=2852782089, pdu-triggering=PDUTrigger_RR_RR_SetCallNumber_return_Cis_ICC_8155_Android_TBOX_SystemInfo, routing-group=SoAdRG_TBOX_SystemInfo_VLAN62}, {header-id=2852782090, pdu-triggering=PDUTrigger_RR_RR_Cellinfo_call_Cis_ICC_8155_Android_TBOX_SystemInfo, routing-group=SoAdRG_TBOX_SystemInfo_VLAN62}, {header-id=2852782090, pdu-triggering=PDUTrigger_RR_RR_Cellinfo_return_Cis_ICC_8155_Android_TBOX_SystemInfo, routing-group=SoAdRG_TBOX_SystemInfo_VLAN62}, {header-id=2852782091, pdu-triggering=PDUTrigger_RR_RR_VehicleDiag_call_Cis_ICC_8155_Android_TBOX_SystemInfo, routing-group=SoAdRG_TBOX_SystemInfo_VLAN62}, {header-id=2852782091, pdu-triggering=PDUTrigger_RR_RR_VehicleDiag_return_Cis_ICC_8155_Android_TBOX_SystemInfo, routing-group=SoAdRG_TBOX_SystemInfo_VLAN62}, {header-id=2852782092, pdu-triggering=PDUTrigger_RR_RR_CurrenMonthTalkTime_call_Cis_ICC_8155_Android_TBOX_SystemInfo, routing-group=SoAdRG_TBOX_SystemInfo_VLAN62}, {header-id=2852782092, pdu-triggering=PDUTrigger_RR_RR_CurrenMonthTalkTime_return_Cis_ICC_8155_Android_TBOX_SystemInfo, routing-group=SoAdRG_TBOX_SystemInfo_VLAN62}, {header-id=2852782093, pdu-triggering=PDUTrigger_RR_RR_TSPConnectionState_call_Cis_ICC_8155_Android_TBOX_SystemInfo, routing-group=SoAdRG_TBOX_SystemInfo_VLAN62}, {header-id=2852782093, pdu-triggering=PDUTrigger_RR_RR_TSPConnectionState_return_Cis_ICC_8155_Android_TBOX_SystemInfo, routing-group=SoAdRG_TBOX_SystemInfo_VLAN62}, {header-id=2852782094, pdu-triggering=PDUTrigger_RR_RR_MicState_call_Cis_ICC_8155_Android_TBOX_SystemInfo, routing-group=SoAdRG_TBOX_SystemInfo_VLAN62}, {header-id=2852782094, pdu-triggering=PDUTrigger_RR_RR_MicState_return_Cis_ICC_8155_Android_TBOX_SystemInfo, routing-group=SoAdRG_TBOX_SystemInfo_VLAN62}, {header-id=2852782095, pdu-triggering=PDUTrigger_RR_RR_ECUVersion_call_Cis_ICC_8155_Android_TBOX_SystemInfo, routing-group=SoAdRG_TBOX_SystemInfo_VLAN62}, {header-id=2852782095, pdu-triggering=PDUTrigger_RR_RR_ECUVersion_return_Cis_ICC_8155_Android_TBOX_SystemInfo, routing-group=SoAdRG_TBOX_SystemInfo_VLAN62}, {header-id=2852782096, pdu-triggering=PDUTrigger_RR_RR_CanConfig_call_Cis_ICC_8155_Android_TBOX_SystemInfo, routing-group=SoAdRG_TBOX_SystemInfo_VLAN62}, {header-id=2852782096, pdu-triggering=PDUTrigger_RR_RR_CanConfig_return_Cis_ICC_8155_Android_TBOX_SystemInfo, routing-group=SoAdRG_TBOX_SystemInfo_VLAN62}, {header-id=2852782097, pdu-triggering=PDUTrigger_RR_RR_KL15State_call_Cis_ICC_8155_Android_TBOX_SystemInfo, routing-group=SoAdRG_TBOX_SystemInfo_VLAN62}, {header-id=2852782097, pdu-triggering=PDUTrigger_RR_RR_KL15State_return_Cis_ICC_8155_Android_TBOX_SystemInfo, routing-group=SoAdRG_TBOX_SystemInfo_VLAN62}, {header-id=2852782098, pdu-triggering=PDUTrigger_RR_RR_SPKState_call_Cis_ICC_8155_Android_TBOX_SystemInfo, routing-group=SoAdRG_TBOX_SystemInfo_VLAN62}, {header-id=2852782098, pdu-triggering=PDUTrigger_RR_RR_SPKState_return_Cis_ICC_8155_Android_TBOX_SystemInfo, routing-group=SoAdRG_TBOX_SystemInfo_VLAN62}, {header-id=2852782099, pdu-triggering=PDUTrigger_RR_RR_AntState_call_Cis_ICC_8155_Android_TBOX_SystemInfo, routing-group=SoAdRG_TBOX_SystemInfo_VLAN62}, {header-id=2852782099, pdu-triggering=PDUTrigger_RR_RR_AntState_return_Cis_ICC_8155_Android_TBOX_SystemInfo, routing-group=SoAdRG_TBOX_SystemInfo_VLAN62}, {header-id=2852880385, pdu-triggering=PDUTrigger_Event_Event_UploadBEICALLSts_TBOX_BEICALL, routing-group=SoAdRG_BEICALL_EventGroup_VLAN62_TBOX_BEICALL}, {header-id=2852880386, pdu-triggering=PDUTrigger_Event_notifyEcallMdoe_TBOX_BEICALL, routing-group=SoAdRG_BEICALL_EventGroup_VLAN62_TBOX_BEICALL}, {header-id=2852847617, pdu-triggering=PDUTrigger_RR_RR_BEICALL_call_Cis_ICC_8155_Android_TBOX_BEICALL, routing-group=SoAdRG_TBOX_BEICALL_VLAN62}, {header-id=2852847617, pdu-triggering=PDUTrigger_RR_RR_BEICALL_return_Cis_ICC_8155_Android_TBOX_BEICALL, routing-group=SoAdRG_TBOX_BEICALL_VLAN62}, {header-id=2852945921, pdu-triggering=PDUTrigger_Event_Event_UsbUpdateSta_TBOX_USBUpdate, routing-group=SoAdRG_USBUpdate_EventGroup_VLAN62_TBOX_USBUpdate}, {header-id=2852913153, pdu-triggering=PDUTrigger_RR_RR_UpdatePrepare_call_Cis_ICC_8155_Android_TBOX_USBUpdate, routing-group=SoAdRG_TBOX_USBUpdate_VLAN62}, {header-id=2852913153, pdu-triggering=PDUTrigger_RR_RR_UpdatePrepare_return_Cis_ICC_8155_Android_TBOX_USBUpdate, routing-group=SoAdRG_TBOX_USBUpdate_VLAN62}, {header-id=2852913154, pdu-triggering=PDUTrigger_RR_RR_UpdateFTPSts_call_Cis_ICC_8155_Android_TBOX_USBUpdate, routing-group=SoAdRG_TBOX_USBUpdate_VLAN62}, {header-id=2852913154, pdu-triggering=PDUTrigger_RR_RR_UpdateFTPSts_return_Cis_ICC_8155_Android_TBOX_USBUpdate, routing-group=SoAdRG_TBOX_USBUpdate_VLAN62}, {header-id=2852913155, pdu-triggering=PDUTrigger_RR_RR_UsbUpdateStart_call_Cis_ICC_8155_Android_TBOX_USBUpdate, routing-group=SoAdRG_TBOX_USBUpdate_VLAN62}, {header-id=2852913155, pdu-triggering=PDUTrigger_RR_RR_UsbUpdateStart_return_Cis_ICC_8155_Android_TBOX_USBUpdate, routing-group=SoAdRG_TBOX_USBUpdate_VLAN62}, {header-id=2852913156, pdu-triggering=PDUTrigger_FF_FF_UpdateCompleted_Cis_ICC_8155_Android_TBOX_USBUpdate, routing-group=SoAdRG_TBOX_USBUpdate_VLAN62}, {header-id=2852978689, pdu-triggering=PDUTrigger_RR_RR_logPrepare_call_Cis_ICC_8155_Android_TBOX_USBTBOXlog, routing-group=SoAdRG_TBOX_USBTBOXlog_VLAN62}, {header-id=2852978689, pdu-triggering=PDUTrigger_RR_RR_logPrepare_return_Cis_ICC_8155_Android_TBOX_USBTBOXlog, routing-group=SoAdRG_TBOX_USBTBOXlog_VLAN62}, {header-id=2852978690, pdu-triggering=PDUTrigger_RR_RR_LogFTPSts_call_Cis_ICC_8155_Android_TBOX_USBTBOXlog, routing-group=SoAdRG_TBOX_USBTBOXlog_VLAN62}, {header-id=2852978690, pdu-triggering=PDUTrigger_RR_RR_LogFTPSts_return_Cis_ICC_8155_Android_TBOX_USBTBOXlog, routing-group=SoAdRG_TBOX_USBTBOXlog_VLAN62}, {header-id=2853044225, pdu-triggering=PDUTrigger_RR_RR_DMCGNSSType_call_Cis_ICC_8155_Android_TBOX_GNSSInfo, routing-group=SoAdRG_TBOX_GNSSInfo_VLAN62}, {header-id=2853044225, pdu-triggering=PDUTrigger_RR_RR_DMCGNSSType_return_Cis_ICC_8155_Android_TBOX_GNSSInfo, routing-group=SoAdRG_TBOX_GNSSInfo_VLAN62}]}
              {client-port=SoAddr_VLAN62_ADCC_UDP_30501, pdus=[{header-id=2852814849, pdu-triggering=PDUTrigger_Event_Event_NetworkStatus_TBOX_SystemInfo, routing-group=SoAdRG_TBOXSystemInfo_EventGroup_VLAN62_TBOX_SystemInfo}, {header-id=2852814850, pdu-triggering=PDUTrigger_Event_Event_VehicleDiagStatus_TBOX_SystemInfo, routing-group=SoAdRG_TBOXSystemInfo_EventGroup_VLAN62_TBOX_SystemInfo}, {header-id=2852782081, pdu-triggering=PDUTrigger_RR_RR_TBoxVersionInfo_call_Cis_ADCC_TBOX_SystemInfo, routing-group=SoAdRG_TBOX_SystemInfo_VLAN62}, {header-id=2852782081, pdu-triggering=PDUTrigger_RR_RR_TBoxVersionInfo_return_Cis_ADCC_TBOX_SystemInfo, routing-group=SoAdRG_TBOX_SystemInfo_VLAN62}, {header-id=2852782082, pdu-triggering=PDUTrigger_RR_RR_BleModuleInfo_call_Cis_ADCC_TBOX_SystemInfo, routing-group=SoAdRG_TBOX_SystemInfo_VLAN62}, {header-id=2852782082, pdu-triggering=PDUTrigger_RR_RR_BleModuleInfo_return_Cis_ADCC_TBOX_SystemInfo, routing-group=SoAdRG_TBOX_SystemInfo_VLAN62}, {header-id=2852782083, pdu-triggering=PDUTrigger_RR_RR_VIN_call_Cis_ADCC_TBOX_SystemInfo, routing-group=SoAdRG_TBOX_SystemInfo_VLAN62}, {header-id=2852782083, pdu-triggering=PDUTrigger_RR_RR_VIN_return_Cis_ADCC_TBOX_SystemInfo, routing-group=SoAdRG_TBOX_SystemInfo_VLAN62}, {header-id=2852782084, pdu-triggering=PDUTrigger_RR_RR_SIMCardinfo_call_Cis_ADCC_TBOX_SystemInfo, routing-group=SoAdRG_TBOX_SystemInfo_VLAN62}, {header-id=2852782084, pdu-triggering=PDUTrigger_RR_RR_SIMCardinfo_return_Cis_ADCC_TBOX_SystemInfo, routing-group=SoAdRG_TBOX_SystemInfo_VLAN62}, {header-id=2852782085, pdu-triggering=PDUTrigger_RR_RR_IMEIInfo_call_Cis_ADCC_TBOX_SystemInfo, routing-group=SoAdRG_TBOX_SystemInfo_VLAN62}, {header-id=2852782085, pdu-triggering=PDUTrigger_RR_RR_IMEIInfo_return_Cis_ADCC_TBOX_SystemInfo, routing-group=SoAdRG_TBOX_SystemInfo_VLAN62}, {header-id=2852782086, pdu-triggering=PDUTrigger_RR_RR_CallNumberList_call_Cis_ADCC_TBOX_SystemInfo, routing-group=SoAdRG_TBOX_SystemInfo_VLAN62}, {header-id=2852782086, pdu-triggering=PDUTrigger_RR_RR_CallNumberList_return_Cis_ADCC_TBOX_SystemInfo, routing-group=SoAdRG_TBOX_SystemInfo_VLAN62}, {header-id=2852782087, pdu-triggering=PDUTrigger_RR_RR_WorkModel_call_Cis_ADCC_TBOX_SystemInfo, routing-group=SoAdRG_TBOX_SystemInfo_VLAN62}, {header-id=2852782087, pdu-triggering=PDUTrigger_RR_RR_WorkModel_return_Cis_ADCC_TBOX_SystemInfo, routing-group=SoAdRG_TBOX_SystemInfo_VLAN62}, {header-id=2852782088, pdu-triggering=PDUTrigger_RR_RR_CertificateIssuedMark_call_Cis_ADCC_TBOX_SystemInfo, routing-group=SoAdRG_TBOX_SystemInfo_VLAN62}, {header-id=2852782088, pdu-triggering=PDUTrigger_RR_RR_CertificateIssuedMark_return_Cis_ADCC_TBOX_SystemInfo, routing-group=SoAdRG_TBOX_SystemInfo_VLAN62}, {header-id=2852782089, pdu-triggering=PDUTrigger_RR_RR_SetCallNumber_call_Cis_ADCC_TBOX_SystemInfo, routing-group=SoAdRG_TBOX_SystemInfo_VLAN62}, {header-id=2852782089, pdu-triggering=PDUTrigger_RR_RR_SetCallNumber_return_Cis_ADCC_TBOX_SystemInfo, routing-group=SoAdRG_TBOX_SystemInfo_VLAN62}, {header-id=2852782090, pdu-triggering=PDUTrigger_RR_RR_Cellinfo_call_Cis_ADCC_TBOX_SystemInfo, routing-group=SoAdRG_TBOX_SystemInfo_VLAN62}, {header-id=2852782090, pdu-triggering=PDUTrigger_RR_RR_Cellinfo_return_Cis_ADCC_TBOX_SystemInfo, routing-group=SoAdRG_TBOX_SystemInfo_VLAN62}, {header-id=2852782091, pdu-triggering=PDUTrigger_RR_RR_VehicleDiag_call_Cis_ADCC_TBOX_SystemInfo, routing-group=SoAdRG_TBOX_SystemInfo_VLAN62}, {header-id=2852782091, pdu-triggering=PDUTrigger_RR_RR_VehicleDiag_return_Cis_ADCC_TBOX_SystemInfo, routing-group=SoAdRG_TBOX_SystemInfo_VLAN62}, {header-id=2852782092, pdu-triggering=PDUTrigger_RR_RR_CurrenMonthTalkTime_call_Cis_ADCC_TBOX_SystemInfo, routing-group=SoAdRG_TBOX_SystemInfo_VLAN62}, {header-id=2852782092, pdu-triggering=PDUTrigger_RR_RR_CurrenMonthTalkTime_return_Cis_ADCC_TBOX_SystemInfo, routing-group=SoAdRG_TBOX_SystemInfo_VLAN62}, {header-id=2852782093, pdu-triggering=PDUTrigger_RR_RR_TSPConnectionState_call_Cis_ADCC_TBOX_SystemInfo, routing-group=SoAdRG_TBOX_SystemInfo_VLAN62}, {header-id=2852782093, pdu-triggering=PDUTrigger_RR_RR_TSPConnectionState_return_Cis_ADCC_TBOX_SystemInfo, routing-group=SoAdRG_TBOX_SystemInfo_VLAN62}, {header-id=2852782094, pdu-triggering=PDUTrigger_RR_RR_MicState_call_Cis_ADCC_TBOX_SystemInfo, routing-group=SoAdRG_TBOX_SystemInfo_VLAN62}, {header-id=2852782094, pdu-triggering=PDUTrigger_RR_RR_MicState_return_Cis_ADCC_TBOX_SystemInfo, routing-group=SoAdRG_TBOX_SystemInfo_VLAN62}, {header-id=2852782095, pdu-triggering=PDUTrigger_RR_RR_ECUVersion_call_Cis_ADCC_TBOX_SystemInfo, routing-group=SoAdRG_TBOX_SystemInfo_VLAN62}, {header-id=2852782095, pdu-triggering=PDUTrigger_RR_RR_ECUVersion_return_Cis_ADCC_TBOX_SystemInfo, routing-group=SoAdRG_TBOX_SystemInfo_VLAN62}, {header-id=2852782096, pdu-triggering=PDUTrigger_RR_RR_CanConfig_call_Cis_ADCC_TBOX_SystemInfo, routing-group=SoAdRG_TBOX_SystemInfo_VLAN62}, {header-id=2852782096, pdu-triggering=PDUTrigger_RR_RR_CanConfig_return_Cis_ADCC_TBOX_SystemInfo, routing-group=SoAdRG_TBOX_SystemInfo_VLAN62}, {header-id=2852782097, pdu-triggering=PDUTrigger_RR_RR_KL15State_call_Cis_ADCC_TBOX_SystemInfo, routing-group=SoAdRG_TBOX_SystemInfo_VLAN62}, {header-id=2852782097, pdu-triggering=PDUTrigger_RR_RR_KL15State_return_Cis_ADCC_TBOX_SystemInfo, routing-group=SoAdRG_TBOX_SystemInfo_VLAN62}, {header-id=2852782098, pdu-triggering=PDUTrigger_RR_RR_SPKState_call_Cis_ADCC_TBOX_SystemInfo, routing-group=SoAdRG_TBOX_SystemInfo_VLAN62}, {header-id=2852782098, pdu-triggering=PDUTrigger_RR_RR_SPKState_return_Cis_ADCC_TBOX_SystemInfo, routing-group=SoAdRG_TBOX_SystemInfo_VLAN62}, {header-id=2852782099, pdu-triggering=PDUTrigger_RR_RR_AntState_call_Cis_ADCC_TBOX_SystemInfo, routing-group=SoAdRG_TBOX_SystemInfo_VLAN62}, {header-id=2852782099, pdu-triggering=PDUTrigger_RR_RR_AntState_return_Cis_ADCC_TBOX_SystemInfo, routing-group=SoAdRG_TBOX_SystemInfo_VLAN62}, {header-id=2853044225, pdu-triggering=PDUTrigger_RR_RR_DMCGNSSType_call_Cis_ADCC_TBOX_GNSSInfo, routing-group=SoAdRG_TBOX_GNSSInfo_VLAN62}, {header-id=2853044225, pdu-triggering=PDUTrigger_RR_RR_DMCGNSSType_return_Cis_ADCC_TBOX_GNSSInfo, routing-group=SoAdRG_TBOX_GNSSInfo_VLAN62}]}
              {client-port=SoAddr_VLAN62_LCM_UDP_30501, pdus=[{header-id=2852814849, pdu-triggering=PDUTrigger_Event_Event_NetworkStatus_TBOX_SystemInfo_1, routing-group=SoAdRG_TBOXSystemInfo_EventGroup_VLAN62_TBOX_SystemInfo}, {header-id=2852814850, pdu-triggering=PDUTrigger_Event_Event_VehicleDiagStatus_TBOX_SystemInfo_1, routing-group=SoAdRG_TBOXSystemInfo_EventGroup_VLAN62_TBOX_SystemInfo}, {header-id=2852782081, pdu-triggering=PDUTrigger_RR_RR_TBoxVersionInfo_call_Cis_LCM_TBOX_SystemInfo, routing-group=SoAdRG_TBOX_SystemInfo_VLAN62}, {header-id=2852782081, pdu-triggering=PDUTrigger_RR_RR_TBoxVersionInfo_return_Cis_LCM_TBOX_SystemInfo, routing-group=SoAdRG_TBOX_SystemInfo_VLAN62}, {header-id=2852782082, pdu-triggering=PDUTrigger_RR_RR_BleModuleInfo_call_Cis_LCM_TBOX_SystemInfo, routing-group=SoAdRG_TBOX_SystemInfo_VLAN62}, {header-id=2852782082, pdu-triggering=PDUTrigger_RR_RR_BleModuleInfo_return_Cis_LCM_TBOX_SystemInfo, routing-group=SoAdRG_TBOX_SystemInfo_VLAN62}, {header-id=2852782083, pdu-triggering=PDUTrigger_RR_RR_VIN_call_Cis_LCM_TBOX_SystemInfo, routing-group=SoAdRG_TBOX_SystemInfo_VLAN62}, {header-id=2852782083, pdu-triggering=PDUTrigger_RR_RR_VIN_return_Cis_LCM_TBOX_SystemInfo, routing-group=SoAdRG_TBOX_SystemInfo_VLAN62}, {header-id=2852782084, pdu-triggering=PDUTrigger_RR_RR_SIMCardinfo_call_Cis_LCM_TBOX_SystemInfo, routing-group=SoAdRG_TBOX_SystemInfo_VLAN62}, {header-id=2852782084, pdu-triggering=PDUTrigger_RR_RR_SIMCardinfo_return_Cis_LCM_TBOX_SystemInfo, routing-group=SoAdRG_TBOX_SystemInfo_VLAN62}, {header-id=2852782085, pdu-triggering=PDUTrigger_RR_RR_IMEIInfo_call_Cis_LCM_TBOX_SystemInfo, routing-group=SoAdRG_TBOX_SystemInfo_VLAN62}, {header-id=2852782085, pdu-triggering=PDUTrigger_RR_RR_IMEIInfo_return_Cis_LCM_TBOX_SystemInfo, routing-group=SoAdRG_TBOX_SystemInfo_VLAN62}, {header-id=2852782086, pdu-triggering=PDUTrigger_RR_RR_CallNumberList_call_Cis_LCM_TBOX_SystemInfo, routing-group=SoAdRG_TBOX_SystemInfo_VLAN62}, {header-id=2852782086, pdu-triggering=PDUTrigger_RR_RR_CallNumberList_return_Cis_LCM_TBOX_SystemInfo, routing-group=SoAdRG_TBOX_SystemInfo_VLAN62}, {header-id=2852782087, pdu-triggering=PDUTrigger_RR_RR_WorkModel_call_Cis_LCM_TBOX_SystemInfo, routing-group=SoAdRG_TBOX_SystemInfo_VLAN62}, {header-id=2852782087, pdu-triggering=PDUTrigger_RR_RR_WorkModel_return_Cis_LCM_TBOX_SystemInfo, routing-group=SoAdRG_TBOX_SystemInfo_VLAN62}, {header-id=2852782088, pdu-triggering=PDUTrigger_RR_RR_CertificateIssuedMark_call_Cis_LCM_TBOX_SystemInfo, routing-group=SoAdRG_TBOX_SystemInfo_VLAN62}, {header-id=2852782088, pdu-triggering=PDUTrigger_RR_RR_CertificateIssuedMark_return_Cis_LCM_TBOX_SystemInfo, routing-group=SoAdRG_TBOX_SystemInfo_VLAN62}, {header-id=2852782089, pdu-triggering=PDUTrigger_RR_RR_SetCallNumber_call_Cis_LCM_TBOX_SystemInfo, routing-group=SoAdRG_TBOX_SystemInfo_VLAN62}, {header-id=2852782089, pdu-triggering=PDUTrigger_RR_RR_SetCallNumber_return_Cis_LCM_TBOX_SystemInfo, routing-group=SoAdRG_TBOX_SystemInfo_VLAN62}, {header-id=2852782090, pdu-triggering=PDUTrigger_RR_RR_Cellinfo_call_Cis_LCM_TBOX_SystemInfo, routing-group=SoAdRG_TBOX_SystemInfo_VLAN62}, {header-id=2852782090, pdu-triggering=PDUTrigger_RR_RR_Cellinfo_return_Cis_LCM_TBOX_SystemInfo, routing-group=SoAdRG_TBOX_SystemInfo_VLAN62}, {header-id=2852782091, pdu-triggering=PDUTrigger_RR_RR_VehicleDiag_call_Cis_LCM_TBOX_SystemInfo, routing-group=SoAdRG_TBOX_SystemInfo_VLAN62}, {header-id=2852782091, pdu-triggering=PDUTrigger_RR_RR_VehicleDiag_return_Cis_LCM_TBOX_SystemInfo, routing-group=SoAdRG_TBOX_SystemInfo_VLAN62}, {header-id=2852782092, pdu-triggering=PDUTrigger_RR_RR_CurrenMonthTalkTime_call_Cis_LCM_TBOX_SystemInfo, routing-group=SoAdRG_TBOX_SystemInfo_VLAN62}, {header-id=2852782092, pdu-triggering=PDUTrigger_RR_RR_CurrenMonthTalkTime_return_Cis_LCM_TBOX_SystemInfo, routing-group=SoAdRG_TBOX_SystemInfo_VLAN62}, {header-id=2852782093, pdu-triggering=PDUTrigger_RR_RR_TSPConnectionState_call_Cis_LCM_TBOX_SystemInfo, routing-group=SoAdRG_TBOX_SystemInfo_VLAN62}, {header-id=2852782093, pdu-triggering=PDUTrigger_RR_RR_TSPConnectionState_return_Cis_LCM_TBOX_SystemInfo, routing-group=SoAdRG_TBOX_SystemInfo_VLAN62}, {header-id=2852782094, pdu-triggering=PDUTrigger_RR_RR_MicState_call_Cis_LCM_TBOX_SystemInfo, routing-group=SoAdRG_TBOX_SystemInfo_VLAN62}, {header-id=2852782094, pdu-triggering=PDUTrigger_RR_RR_MicState_return_Cis_LCM_TBOX_SystemInfo, routing-group=SoAdRG_TBOX_SystemInfo_VLAN62}, {header-id=2852782095, pdu-triggering=PDUTrigger_RR_RR_ECUVersion_call_Cis_LCM_TBOX_SystemInfo, routing-group=SoAdRG_TBOX_SystemInfo_VLAN62}, {header-id=2852782095, pdu-triggering=PDUTrigger_RR_RR_ECUVersion_return_Cis_LCM_TBOX_SystemInfo, routing-group=SoAdRG_TBOX_SystemInfo_VLAN62}, {header-id=2852782096, pdu-triggering=PDUTrigger_RR_RR_CanConfig_call_Cis_LCM_TBOX_SystemInfo, routing-group=SoAdRG_TBOX_SystemInfo_VLAN62}, {header-id=2852782096, pdu-triggering=PDUTrigger_RR_RR_CanConfig_return_Cis_LCM_TBOX_SystemInfo, routing-group=SoAdRG_TBOX_SystemInfo_VLAN62}, {header-id=2852782097, pdu-triggering=PDUTrigger_RR_RR_KL15State_call_Cis_LCM_TBOX_SystemInfo, routing-group=SoAdRG_TBOX_SystemInfo_VLAN62}, {header-id=2852782097, pdu-triggering=PDUTrigger_RR_RR_KL15State_return_Cis_LCM_TBOX_SystemInfo, routing-group=SoAdRG_TBOX_SystemInfo_VLAN62}, {header-id=2852782098, pdu-triggering=PDUTrigger_RR_RR_SPKState_call_Cis_LCM_TBOX_SystemInfo, routing-group=SoAdRG_TBOX_SystemInfo_VLAN62}, {header-id=2852782098, pdu-triggering=PDUTrigger_RR_RR_SPKState_return_Cis_LCM_TBOX_SystemInfo, routing-group=SoAdRG_TBOX_SystemInfo_VLAN62}, {header-id=2852782099, pdu-triggering=PDUTrigger_RR_RR_AntState_call_Cis_LCM_TBOX_SystemInfo, routing-group=SoAdRG_TBOX_SystemInfo_VLAN62}, {header-id=2852782099, pdu-triggering=PDUTrigger_RR_RR_AntState_return_Cis_LCM_TBOX_SystemInfo, routing-group=SoAdRG_TBOX_SystemInfo_VLAN62}]}
          SCB_VLAN62_TBOX_TCP_30500: server-port=SoAddr_VLAN62_TBOX_TCP_30500
            bundled-connections:
              {client-port=SoAddr_VLAN62_ICC_8155_Android_TCP_30501, pdus=[{header-id=2852749313, pdu-triggering=PDUTrigger_Event_notify5GSwtSts_Fb_TBOX_ResSwtSts, routing-group=SoAdRG_TBOX_ResSwtSts_EventGroup_VLAN62_TBOX_ResSwtSts}, {header-id=2852749314, pdu-triggering=PDUTrigger_Event_notifyV2XSwtSts_Fb_TBOX_ResSwtSts, routing-group=SoAdRG_TBOX_ResSwtSts_EventGroup_VLAN62_TBOX_ResSwtSts}, {header-id=2852749315, pdu-triggering=PDUTrigger_Event_notifyDownLogSwtSts_Fb_TBOX_ResSwtSts, routing-group=SoAdRG_TBOX_ResSwtSts_EventGroup_VLAN62_TBOX_ResSwtSts}, {header-id=2852749316, pdu-triggering=PDUTrigger_Event_notifyUSBUpdateSwtSts_Fb_TBOX_ResSwtSts, routing-group=SoAdRG_TBOX_ResSwtSts_EventGroup_VLAN62_TBOX_ResSwtSts}, {header-id=2852749317, pdu-triggering=PDUTrigger_Event_notifyResumeFactorySet_Fb_TBOX_ResSwtSts, routing-group=SoAdRG_TBOX_ResSwtSts_EventGroup_VLAN62_TBOX_ResSwtSts}, {header-id=2853076993, pdu-triggering=TPPDUTrigger_Event_Event_GNSSInfo1_TBOX_GNSSInfo, routing-group=SoAdRG_GNSSInfo_EventGroup_VLAN62_TBOX_GNSSInfo}]}
              {client-port=SoAddr_VLAN62_ADCC_TCP_30501, pdus=socket-connection-ipdu-identifier={header-id=2853076993, pdu-triggering=TPPDUTrigger_Event_Event_GNSSInfo1_TBOX_GNSSInfo_1, routing-group=SoAdRG_GNSSInfo_EventGroup_VLAN62_TBOX_GNSSInfo}}
          SDSCB_VLAN62_LCM: socket-connection{client-port=SDSoAddr_VLAN62_Any, pdus=[{header-id=4294934784, pdu-triggering=PDUTransmission_VLAN62_Tx_LCM}, {header-id=4294934784, pdu-triggering=PDUTransmission_VLAN62_UnicastRx_LCM}]}, server-port=SDSoAddr_VLAN62_LCM
          SCB_VLAN62_ADCC_UDP_30500: server-port=SoAddr_VLAN62_ADCC_UDP_30500
            bundled-connections:
              {client-port=SoAddr_VLAN62_ICC_8155_Android_UDP_30501, pdus=[{header-id=2868936705, pdu-triggering=TPPDUTrigger_Event_NtfDynamicObjectList_Drvg_ADCC_DrivingHmiEnv, routing-group=SoAdRG_ADCC_DrivingHmiEnv_Eventgroup_VLAN62_ADCC_DrivingHmiEnv}, {header-id=2868936706, pdu-triggering=TPPDUTrigger_Event_NtfStaticObjectList_Drvg_ADCC_DrivingHmiEnv, routing-group=SoAdRG_ADCC_DrivingHmiEnv_Eventgroup_VLAN62_ADCC_DrivingHmiEnv}, {header-id=2868936707, pdu-triggering=PDUTrigger_Event_NtfLaneLineListt_Drvg_ADCC_DrivingHmiEnv, routing-group=SoAdRG_ADCC_DrivingHmiEnv_Eventgroup_VLAN62_ADCC_DrivingHmiEnv}, {header-id=2868936708, pdu-triggering=PDUTrigger_Event_NtfEgoFusionPose_Drvg_ADCC_DrivingHmiEnv, routing-group=SoAdRG_ADCC_DrivingHmiEnv_Eventgroup_VLAN62_ADCC_DrivingHmiEnv}, {header-id=2868936709, pdu-triggering=PDUTrigger_Event_NtfRoadMarkerList_ADCC_DrivingHmiEnv, routing-group=SoAdRG_ADCC_DrivingHmiEnv_Eventgroup_VLAN62_ADCC_DrivingHmiEnv}, {header-id=2868936710, pdu-triggering=TPPDUTrigger_Event_NtfLaneLineListt_Drvg_2_ADCC_DrivingHmiEnv, routing-group=SoAdRG_ADCC_DrivingHmiEnv_Eventgroup_VLAN62_ADCC_DrivingHmiEnv}, {header-id=2868936711, pdu-triggering=PDUTrigger_Event_NtfEgoPose_ADCC_DrivingHmiEnv, routing-group=SoAdRG_ADCC_DrivingHmiEnv_Eventgroup_VLAN62_ADCC_DrivingHmiEnv}, {header-id=2868936713, pdu-triggering=PDUTrigger_Event_NtfRoadMarkerListSupplement_ADCC_DrivingHmiEnv, routing-group=SoAdRG_ADCC_DrivingHmiEnv_Eventgroup_VLAN62_ADCC_DrivingHmiEnv}, {header-id=2868936714, pdu-triggering=PDUTrigger_Event_NtfTrafficLightList_Drvg_ADCC_DrivingHmiEnv, routing-group=SoAdRG_ADCC_DrivingHmiEnv_Eventgroup_VLAN62_ADCC_DrivingHmiEnv}, {header-id=2868936715, pdu-triggering=TPPDUTrigger_Event_NtfFreeSpaceList_Drvg_ADCC_DrivingHmiEnv, routing-group=SoAdRG_ADCC_DrivingHmiEnv_Eventgroup_VLAN62_ADCC_DrivingHmiEnv}, {header-id=2868936716, pdu-triggering=TPPDUTrigger_Event_Ntf3DTrafficSignList_Drvg_ADCC_DrivingHmiEnv, routing-group=SoAdRG_ADCC_DrivingHmiEnv_Eventgroup_VLAN62_ADCC_DrivingHmiEnv}, {header-id=2868936717, pdu-triggering=TPPDUTrigger_Event_NtfDynamicObjectList_Drvg_2_ADCC_DrivingHmiEnv, routing-group=SoAdRG_ADCC_DrivingHmiEnv_Eventgroup_VLAN62_ADCC_DrivingHmiEnv}, {header-id=2868936718, pdu-triggering=TPPDUTrigger_Event_NtfStaticObjectList_Drvg_2_ADCC_DrivingHmiEnv, routing-group=SoAdRG_ADCC_DrivingHmiEnv_Eventgroup_VLAN62_ADCC_DrivingHmiEnv}, {header-id=2868936719, pdu-triggering=PDUTrigger_Event_NtfRoadMarkerList_2_ADCC_DrivingHmiEnv, routing-group=SoAdRG_ADCC_DrivingHmiEnv_Eventgroup_VLAN62_ADCC_DrivingHmiEnv}, {header-id=2868936720, pdu-triggering=TPPDUTrigger_Event_NtfRoadSurfaceMes_ADCC_DrivingHmiEnv, routing-group=SoAdRG_ADCC_DrivingHmiEnv_Eventgroup_VLAN62_ADCC_DrivingHmiEnv}, {header-id=2869002241, pdu-triggering=PDUTrigger_Event_NtfSensorSt_ADCC_SensorInfo, routing-group=SoAdRG_ADCC_SensorInfo_Eventgroup_VLAN62_ADCC_SensorInfo}, {header-id=2869002242, pdu-triggering=PDUTrigger_Event_CamStreamStResp_ADCC_SensorInfo, routing-group=SoAdRG_ADCC_SensorInfo_Eventgroup_VLAN62_ADCC_SensorInfo}, {header-id=2868969473, pdu-triggering=PDUTrigger_RR_getAvmCamIntrinsics_call_Cis_ICC_8155_Android_ADCC_SensorInfo, routing-group=SoAdRG_ADCC_SensorInfo_VLAN62}, {header-id=2868969473, pdu-triggering=PDUTrigger_RR_getAvmCamIntrinsics_return_Cis_ICC_8155_Android_ADCC_SensorInfo, routing-group=SoAdRG_ADCC_SensorInfo_VLAN62}, {header-id=2868969474, pdu-triggering=PDUTrigger_RR_getAvmCamCalPrms_call_Cis_ICC_8155_Android_ADCC_SensorInfo, routing-group=SoAdRG_ADCC_SensorInfo_VLAN62}, {header-id=2868969474, pdu-triggering=PDUTrigger_RR_getAvmCamCalPrms_return_Cis_ICC_8155_Android_ADCC_SensorInfo, routing-group=SoAdRG_ADCC_SensorInfo_VLAN62}, {header-id=2868969475, pdu-triggering=PDUTrigger_FF_CamStreamSwtReq_Cis_ICC_8155_Android_ADCC_SensorInfo, routing-group=SoAdRG_ADCC_SensorInfo_VLAN62}, {header-id=2868969476, pdu-triggering=PDUTrigger_RR_RR_ADASVersInfo_call_Cis_ICC_8155_Android_ADCC_SensorInfo, routing-group=SoAdRG_ADCC_SensorInfo_VLAN62}, {header-id=2868969476, pdu-triggering=PDUTrigger_RR_RR_ADASVersInfo_return_Cis_ICC_8155_Android_ADCC_SensorInfo, routing-group=SoAdRG_ADCC_SensorInfo_VLAN62}, {header-id=2869067777, pdu-triggering=PDUTrigger_Event_NtfTrafficSign_Drvg_ADCC_DrivingFuncInfo, routing-group=SoAdRG_ADCC_DrivingFuncInfo_Eventgroup_VLAN62_ADCC_DrivingFuncInfo}, {header-id=2869067778, pdu-triggering=PDUTrigger_Event_NtfISLIInfo_Drvg_ADCC_DrivingFuncInfo, routing-group=SoAdRG_ADCC_DrivingFuncInfo_Eventgroup_VLAN62_ADCC_DrivingFuncInfo}, {header-id=2869067779, pdu-triggering=PDUTrigger_Event_NtfACCInfo_Drvg_ADCC_DrivingFuncInfo, routing-group=SoAdRG_ADCC_DrivingFuncInfo_Eventgroup_VLAN62_ADCC_DrivingFuncInfo}, {header-id=2869067780, pdu-triggering=PDUTrigger_Event_NtfALCInfo_Drvg_ADCC_DrivingFuncInfo, routing-group=SoAdRG_ADCC_DrivingFuncInfo_Eventgroup_VLAN62_ADCC_DrivingFuncInfo}, {header-id=2869067781, pdu-triggering=PDUTrigger_Event_NtfICAInfo_Drvg_ADCC_DrivingFuncInfo, routing-group=SoAdRG_ADCC_DrivingFuncInfo_Eventgroup_VLAN62_ADCC_DrivingFuncInfo}, {header-id=2869067782, pdu-triggering=PDUTrigger_Event_NtfIntelligentEvasionInfo_Drvg_ADCC_DrivingFuncInfo, routing-group=SoAdRG_ADCC_DrivingFuncInfo_Eventgroup_VLAN62_ADCC_DrivingFuncInfo}, {header-id=2869067783, pdu-triggering=PDUTrigger_Event_NtfHNOPfunctionInfo_Drvg_ADCC_DrivingFuncInfo, routing-group=SoAdRG_ADCC_DrivingFuncInfo_Eventgroup_VLAN62_ADCC_DrivingFuncInfo}, {header-id=2869067784, pdu-triggering=PDUTrigger_Event_NtfUNOPfunctionInfo_Drvg_ADCC_DrivingFuncInfo, routing-group=SoAdRG_ADCC_DrivingFuncInfo_Eventgroup_VLAN62_ADCC_DrivingFuncInfo}, {header-id=2869067785, pdu-triggering=PDUTrigger_Event_NtfHodDmsInfo_Drvg_ADCC_DrivingFuncInfo, routing-group=SoAdRG_ADCC_DrivingFuncInfo_Eventgroup_VLAN62_ADCC_DrivingFuncInfo}, {header-id=2869067786, pdu-triggering=PDUTrigger_Event_NtfLSSInfo_Drvg_ADCC_DrivingFuncInfo, routing-group=SoAdRG_ADCC_DrivingFuncInfo_Eventgroup_VLAN62_ADCC_DrivingFuncInfo}, {header-id=2869067787, pdu-triggering=PDUTrigger_Event_NtfESSInfo_Drvg_ADCC_DrivingFuncInfo, routing-group=SoAdRG_ADCC_DrivingFuncInfo_Eventgroup_VLAN62_ADCC_DrivingFuncInfo}, {header-id=2869067788, pdu-triggering=PDUTrigger_Event_NtfDAIInfo_Drvg_ADCC_DrivingFuncInfo, routing-group=SoAdRG_ADCC_DrivingFuncInfo_Eventgroup_VLAN62_ADCC_DrivingFuncInfo}, {header-id=2869067789, pdu-triggering=PDUTrigger_Event_NtfNRAInfo_Drvg_ADCC_DrivingFuncInfo, routing-group=SoAdRG_ADCC_DrivingFuncInfo_Eventgroup_VLAN62_ADCC_DrivingFuncInfo}, {header-id=2869067790, pdu-triggering=PDUTrigger_Event_NtfDrivingSoundInfo_Drvg_ADCC_DrivingFuncInfo, routing-group=SoAdRG_ADCC_DrivingFuncInfo_Eventgroup_VLAN62_ADCC_DrivingFuncInfo}, {header-id=2869067791, pdu-triggering=PDUTrigger_Event_NtfMNPInfo_Drvg_ADCC_DrivingFuncInfo, routing-group=SoAdRG_ADCC_DrivingFuncInfo_Eventgroup_VLAN62_ADCC_DrivingFuncInfo}, {header-id=2869067793, pdu-triggering=PDUTrigger_Event_NtfIHCInfo_Drvg_ADCC_DrivingFuncInfo, routing-group=SoAdRG_ADCC_DrivingFuncInfo_Eventgroup_VLAN62_ADCC_DrivingFuncInfo}, {header-id=2869067794, pdu-triggering=PDUTrigger_Event_NtfISLIInfo_Drvg_2_ADCC_DrivingFuncInfo, routing-group=SoAdRG_ADCC_DrivingFuncInfo_Eventgroup_VLAN62_ADCC_DrivingFuncInfo}, {header-id=2869067795, pdu-triggering=PDUTrigger_Event_NtfALCInfo_Drvg_2_ADCC_DrivingFuncInfo, routing-group=SoAdRG_ADCC_DrivingFuncInfo_Eventgroup_VLAN62_ADCC_DrivingFuncInfo}, {header-id=2869067796, pdu-triggering=PDUTrigger_Event_NtfICAInfo_Drvg_2_ADCC_DrivingFuncInfo, routing-group=SoAdRG_ADCC_DrivingFuncInfo_Eventgroup_VLAN62_ADCC_DrivingFuncInfo}, {header-id=2869067797, pdu-triggering=PDUTrigger_Event_NtfLSSInfo_Drvg_2_ADCC_DrivingFuncInfo, routing-group=SoAdRG_ADCC_DrivingFuncInfo_Eventgroup_VLAN62_ADCC_DrivingFuncInfo}, {header-id=2869067798, pdu-triggering=PDUTrigger_Event_NtfESSInfo_Drvg_2_ADCC_DrivingFuncInfo, routing-group=SoAdRG_ADCC_DrivingFuncInfo_Eventgroup_VLAN62_ADCC_DrivingFuncInfo}, {header-id=2869067799, pdu-triggering=PDUTrigger_Event_NtfTrafficSignIdentify_Drvg_ADCC_DrivingFuncInfo, routing-group=SoAdRG_ADCC_DrivingFuncInfo_Eventgroup_VLAN62_ADCC_DrivingFuncInfo}, {header-id=2869067800, pdu-triggering=PDUTrigger_Event_NtfACCSupplementInfo_Drvg_ADCC_DrivingFuncInfo, routing-group=SoAdRG_ADCC_DrivingFuncInfo_Eventgroup_VLAN62_ADCC_DrivingFuncInfo}, {header-id=2869067801, pdu-triggering=TPPDUTrigger_Event_NtfHNOPSupplementInfo_Drvg_ADCC_DrivingFuncInfo, routing-group=SoAdRG_ADCC_DrivingFuncInfo_Eventgroup_VLAN62_ADCC_DrivingFuncInfo}, {header-id=2869067804, pdu-triggering=PDUTrigger_Event_NtfTLRInfo_Drvg_ADCC_DrivingFuncInfo, routing-group=SoAdRG_ADCC_DrivingFuncInfo_Eventgroup_VLAN62_ADCC_DrivingFuncInfo}, {header-id=2869067805, pdu-triggering=PDUTrigger_Event_NtfTLAInfo_Drvg_ADCC_DrivingFuncInfo, routing-group=SoAdRG_ADCC_DrivingFuncInfo_Eventgroup_VLAN62_ADCC_DrivingFuncInfo}, {header-id=2869067806, pdu-triggering=TPPDUTrigger_Event_NtfMNPInfo_Drvg_2_ADCC_DrivingFuncInfo, routing-group=SoAdRG_ADCC_DrivingFuncInfo_Eventgroup_VLAN62_ADCC_DrivingFuncInfo}, {header-id=2869067808, pdu-triggering=PDUTrigger_Event_NtfTrafficSign_Drvg_2_ADCC_DrivingFuncInfo, routing-group=SoAdRG_ADCC_DrivingFuncInfo_Eventgroup_VLAN62_ADCC_DrivingFuncInfo}, {header-id=2869067809, pdu-triggering=PDUTrigger_Event_TolNtfADDrivingCardinfo_ADCC_DrivingFuncInfo, routing-group=SoAdRG_ADCC_DrivingFuncInfo_Eventgroup_VLAN62_ADCC_DrivingFuncInfo}, {header-id=2869067810, pdu-triggering=PDUTrigger_Event_SglNtfADDrivingCardinfo_ADCC_DrivingFuncInfo, routing-group=SoAdRG_ADCC_DrivingFuncInfo_Eventgroup_VLAN62_ADCC_DrivingFuncInfo}, {header-id=2869133313, pdu-triggering=PDUTrigger_Event_NtfParkingGenaralInfo_ADCC_ParkingFuncInfo, routing-group=SoAdRG_ADAS_ParkingFuncInfo_Eventgroup_VLAN62_ADCC_ParkingFuncInfo}, {header-id=2869133314, pdu-triggering=PDUTrigger_Event_NtfAPARPAInfo_ADCC_ParkingFuncInfo, routing-group=SoAdRG_ADAS_ParkingFuncInfo_Eventgroup_VLAN62_ADCC_ParkingFuncInfo}, {header-id=2869133315, pdu-triggering=PDUTrigger_Event_NtfAdvanceParkingInfo_ADCC_ParkingFuncInfo, routing-group=SoAdRG_ADAS_ParkingFuncInfo_Eventgroup_VLAN62_ADCC_ParkingFuncInfo}, {header-id=2869133319, pdu-triggering=PDUTrigger_Event_NtfMRAInfo_ADCC_ParkingFuncInfo, routing-group=SoAdRG_ADAS_ParkingFuncInfo_Eventgroup_VLAN62_ADCC_ParkingFuncInfo}, {header-id=2869133320, pdu-triggering=PDUTrigger_Event_NtfMEBInfo_ADCC_ParkingFuncInfo, routing-group=SoAdRG_ADAS_ParkingFuncInfo_Eventgroup_VLAN62_ADCC_ParkingFuncInfo}, {header-id=2869133321, pdu-triggering=PDUTrigger_Event_NtfMAAInfo_ADCC_ParkingFuncInfo, routing-group=SoAdRG_ADAS_ParkingFuncInfo_Eventgroup_VLAN62_ADCC_ParkingFuncInfo}, {header-id=2869133323, pdu-triggering=PDUTrigger_Event_NtfParkingGenaralInfo_2_ADCC_ParkingFuncInfo, routing-group=SoAdRG_ADAS_ParkingFuncInfo_Eventgroup_VLAN62_ADCC_ParkingFuncInfo}, {header-id=2869133324, pdu-triggering=PDUTrigger_Event_NtfMRAInfo_2_ADCC_ParkingFuncInfo, routing-group=SoAdRG_ADAS_ParkingFuncInfo_Eventgroup_VLAN62_ADCC_ParkingFuncInfo}, {header-id=2869133325, pdu-triggering=PDUTrigger_Event_NtfAPARPAInfo_2_ADCC_ParkingFuncInfo, routing-group=SoAdRG_ADAS_ParkingFuncInfo_Eventgroup_VLAN62_ADCC_ParkingFuncInfo}, {header-id=2869133326, pdu-triggering=PDUTrigger_Event_NtfAdvanceParkingInfo_2_ADCC_ParkingFuncInfo, routing-group=SoAdRG_ADAS_ParkingFuncInfo_Eventgroup_VLAN62_ADCC_ParkingFuncInfo}, {header-id=2869198849, pdu-triggering=TPPDUTrigger_Event_NtfDynamicObjectList_Prkg_ADCC_ParkingHmiEnv, routing-group=SoAdRG_ADCC_ParkingHmiEnv_Eventgroup_VLAN62_ADCC_ParkingHmiEnv}, {header-id=2869198850, pdu-triggering=TPPDUTrigger_Event_NtfStaticObjectList_Prkg_ADCC_ParkingHmiEnv, routing-group=SoAdRG_ADCC_ParkingHmiEnv_Eventgroup_VLAN62_ADCC_ParkingHmiEnv}, {header-id=2869198851, pdu-triggering=PDUTrigger_Event_NtfParkingSlot_Prkg_ADCC_ParkingHmiEnv, routing-group=SoAdRG_ADCC_ParkingHmiEnv_Eventgroup_VLAN62_ADCC_ParkingHmiEnv}, {header-id=2869198852, pdu-triggering=TPPDUTrigger_Event_NtfHPAStaticObjectList_Prkg_ADCC_ParkingHmiEnv, routing-group=SoAdRG_ADCC_ParkingHmiEnv_Eventgroup_VLAN62_ADCC_ParkingHmiEnv}, {header-id=2869198853, pdu-triggering=TPPDUTrigger_Event_NtfHPAParkingSlot_Prkg_ADCC_ParkingHmiEnv, routing-group=SoAdRG_ADCC_ParkingHmiEnv_Eventgroup_VLAN62_ADCC_ParkingHmiEnv}, {header-id=2869198856, pdu-triggering=TPPDUTrigger_Event_NtfDynamicObjectList_Prkg_2_ADCC_ParkingHmiEnv, routing-group=SoAdRG_ADCC_ParkingHmiEnv_Eventgroup_VLAN62_ADCC_ParkingHmiEnv}, {header-id=2869198857, pdu-triggering=TPPDUTrigger_Event_NtfStaticObjectList_Prkg_2_ADCC_ParkingHmiEnv, routing-group=SoAdRG_ADCC_ParkingHmiEnv_Eventgroup_VLAN62_ADCC_ParkingHmiEnv}, {header-id=2869592065, pdu-triggering=PDUTrigger_Event_NtfActiveSafetyFcnInfo_Act_ADCC_ActiveSafetyInfo, routing-group=SoAdRG_ADCC_ActiveSafetyInfo_Eventgroup_VLAN62_ADCC_ActiveSafetyInfo}, {header-id=2869592066, pdu-triggering=PDUTrigger_Event_NtfAEBTargetObjInfo_Act_ADCC_ActiveSafetyInfo, routing-group=SoAdRG_ADCC_ActiveSafetyInfo_Eventgroup_VLAN62_ADCC_ActiveSafetyInfo}, {header-id=2869592067, pdu-triggering=PDUTrigger_Event_NtfActiveSafetyFcnInfo_Act_2_ADCC_ActiveSafetyInfo, routing-group=SoAdRG_ADCC_ActiveSafetyInfo_Eventgroup_VLAN62_ADCC_ActiveSafetyInfo}, {header-id=2869592068, pdu-triggering=PDUTrigger_Event_NtfAEBTargetObjInfo_Act_2_ADCC_ActiveSafetyInfo, routing-group=SoAdRG_ADCC_ActiveSafetyInfo_Eventgroup_VLAN62_ADCC_ActiveSafetyInfo}, {header-id=2869592069, pdu-triggering=PDUTrigger_Event_NtfAEBTargetObjInfo_Act_3_ADCC_ActiveSafetyInfo, routing-group=SoAdRG_ADCC_ActiveSafetyInfo_Eventgroup_VLAN62_ADCC_ActiveSafetyInfo}, {header-id=2869624833, pdu-triggering=PDUTrigger_RR_GetUUIDCodeResponse_UUID_call_Cis_ICC_8155_Android_ADCC_UUID, routing-group=SoAdRG_ADCC_UUID_VLAN62}, {header-id=2869624833, pdu-triggering=PDUTrigger_RR_GetUUIDCodeResponse_UUID_return_Cis_ICC_8155_Android_ADCC_UUID, routing-group=SoAdRG_ADCC_UUID_VLAN62}, {header-id=2869723137, pdu-triggering=PDUTrigger_Event_notifyDVRSts_ADCC_ADCC_DVRSts, routing-group=SoAdRG_ADCC_DVRSts_Eventgroup_VLAN62_ADCC_DVRSts}, {header-id=2869723138, pdu-triggering=PDUTrigger_Event_notifyDVRcameraSts_ADCC_ADCC_DVRSts, routing-group=SoAdRG_ADCC_DVRSts_Eventgroup_VLAN62_ADCC_DVRSts}, {header-id=2869723139, pdu-triggering=PDUTrigger_Event_notifyCameraInterParm_ADCC_ADCC_DVRSts, routing-group=SoAdRG_ADCC_DVRSts_Eventgroup_VLAN62_ADCC_DVRSts}, {header-id=2869690369, pdu-triggering=PDUTrigger_RR_getCameraInterParm_ADCC_call_Cis_ICC_8155_Android_ADCC_DVRSts, routing-group=SoAdRG_ADCC_DVRSts_VLAN62}, {header-id=2869690369, pdu-triggering=PDUTrigger_RR_getCameraInterParm_ADCC_return_Cis_ICC_8155_Android_ADCC_DVRSts, routing-group=SoAdRG_ADCC_DVRSts_VLAN62}, {header-id=2869755905, pdu-triggering=PDUTrigger_RR_RR_ADASGNSSType_call_Cis_ICC_8155_Android_ADAS_GNSSInfo, routing-group=SoAdRG_ADAS_GNSSInfo_VLAN62}, {header-id=2869755905, pdu-triggering=PDUTrigger_RR_RR_ADASGNSSType_return_Cis_ICC_8155_Android_ADAS_GNSSInfo, routing-group=SoAdRG_ADAS_GNSSInfo_VLAN62}]}
              {client-port=SoAddr_VLAN62_ICC_8155_QNX_UDP_30501, pdus=[{header-id=2868936705, pdu-triggering=TPPDUTrigger_Event_NtfDynamicObjectList_Drvg_ADCC_DrivingHmiEnv_1, routing-group=SoAdRG_ADCC_DrivingHmiEnv_Eventgroup_VLAN62_ADCC_DrivingHmiEnv}, {header-id=2868936706, pdu-triggering=TPPDUTrigger_Event_NtfStaticObjectList_Drvg_ADCC_DrivingHmiEnv_1, routing-group=SoAdRG_ADCC_DrivingHmiEnv_Eventgroup_VLAN62_ADCC_DrivingHmiEnv}, {header-id=2868936707, pdu-triggering=PDUTrigger_Event_NtfLaneLineListt_Drvg_ADCC_DrivingHmiEnv_1, routing-group=SoAdRG_ADCC_DrivingHmiEnv_Eventgroup_VLAN62_ADCC_DrivingHmiEnv}, {header-id=2868936708, pdu-triggering=PDUTrigger_Event_NtfEgoFusionPose_Drvg_ADCC_DrivingHmiEnv_1, routing-group=SoAdRG_ADCC_DrivingHmiEnv_Eventgroup_VLAN62_ADCC_DrivingHmiEnv}, {header-id=2868936709, pdu-triggering=PDUTrigger_Event_NtfRoadMarkerList_ADCC_DrivingHmiEnv_1, routing-group=SoAdRG_ADCC_DrivingHmiEnv_Eventgroup_VLAN62_ADCC_DrivingHmiEnv}, {header-id=2868936710, pdu-triggering=TPPDUTrigger_Event_NtfLaneLineListt_Drvg_2_ADCC_DrivingHmiEnv_1, routing-group=SoAdRG_ADCC_DrivingHmiEnv_Eventgroup_VLAN62_ADCC_DrivingHmiEnv}, {header-id=2868936711, pdu-triggering=PDUTrigger_Event_NtfEgoPose_ADCC_DrivingHmiEnv_1, routing-group=SoAdRG_ADCC_DrivingHmiEnv_Eventgroup_VLAN62_ADCC_DrivingHmiEnv}, {header-id=2868936713, pdu-triggering=PDUTrigger_Event_NtfRoadMarkerListSupplement_ADCC_DrivingHmiEnv_1, routing-group=SoAdRG_ADCC_DrivingHmiEnv_Eventgroup_VLAN62_ADCC_DrivingHmiEnv}, {header-id=2868936714, pdu-triggering=PDUTrigger_Event_NtfTrafficLightList_Drvg_ADCC_DrivingHmiEnv_1, routing-group=SoAdRG_ADCC_DrivingHmiEnv_Eventgroup_VLAN62_ADCC_DrivingHmiEnv}, {header-id=2868936715, pdu-triggering=TPPDUTrigger_Event_NtfFreeSpaceList_Drvg_ADCC_DrivingHmiEnv_1, routing-group=SoAdRG_ADCC_DrivingHmiEnv_Eventgroup_VLAN62_ADCC_DrivingHmiEnv}, {header-id=2868936716, pdu-triggering=TPPDUTrigger_Event_Ntf3DTrafficSignList_Drvg_ADCC_DrivingHmiEnv_1, routing-group=SoAdRG_ADCC_DrivingHmiEnv_Eventgroup_VLAN62_ADCC_DrivingHmiEnv}, {header-id=2868936717, pdu-triggering=TPPDUTrigger_Event_NtfDynamicObjectList_Drvg_2_ADCC_DrivingHmiEnv_1, routing-group=SoAdRG_ADCC_DrivingHmiEnv_Eventgroup_VLAN62_ADCC_DrivingHmiEnv}, {header-id=2868936718, pdu-triggering=TPPDUTrigger_Event_NtfStaticObjectList_Drvg_2_ADCC_DrivingHmiEnv_1, routing-group=SoAdRG_ADCC_DrivingHmiEnv_Eventgroup_VLAN62_ADCC_DrivingHmiEnv}, {header-id=2868936719, pdu-triggering=PDUTrigger_Event_NtfRoadMarkerList_2_ADCC_DrivingHmiEnv_1, routing-group=SoAdRG_ADCC_DrivingHmiEnv_Eventgroup_VLAN62_ADCC_DrivingHmiEnv}, {header-id=2868936720, pdu-triggering=TPPDUTrigger_Event_NtfRoadSurfaceMes_ADCC_DrivingHmiEnv_1, routing-group=SoAdRG_ADCC_DrivingHmiEnv_Eventgroup_VLAN62_ADCC_DrivingHmiEnv}, {header-id=2869002241, pdu-triggering=PDUTrigger_Event_NtfSensorSt_ADCC_SensorInfo_1, routing-group=SoAdRG_ADCC_SensorInfo_Eventgroup_VLAN62_ADCC_SensorInfo}, {header-id=2869002242, pdu-triggering=PDUTrigger_Event_CamStreamStResp_ADCC_SensorInfo_1, routing-group=SoAdRG_ADCC_SensorInfo_Eventgroup_VLAN62_ADCC_SensorInfo}, {header-id=2868969473, pdu-triggering=PDUTrigger_RR_getAvmCamIntrinsics_call_Cis_ICC_8155_QNX_ADCC_SensorInfo, routing-group=SoAdRG_ADCC_SensorInfo_VLAN62}, {header-id=2868969473, pdu-triggering=PDUTrigger_RR_getAvmCamIntrinsics_return_Cis_ICC_8155_QNX_ADCC_SensorInfo, routing-group=SoAdRG_ADCC_SensorInfo_VLAN62}, {header-id=2868969474, pdu-triggering=PDUTrigger_RR_getAvmCamCalPrms_call_Cis_ICC_8155_QNX_ADCC_SensorInfo, routing-group=SoAdRG_ADCC_SensorInfo_VLAN62}, {header-id=2868969474, pdu-triggering=PDUTrigger_RR_getAvmCamCalPrms_return_Cis_ICC_8155_QNX_ADCC_SensorInfo, routing-group=SoAdRG_ADCC_SensorInfo_VLAN62}, {header-id=2868969475, pdu-triggering=PDUTrigger_FF_CamStreamSwtReq_Cis_ICC_8155_QNX_ADCC_SensorInfo, routing-group=SoAdRG_ADCC_SensorInfo_VLAN62}, {header-id=2868969476, pdu-triggering=PDUTrigger_RR_RR_ADASVersInfo_call_Cis_ICC_8155_QNX_ADCC_SensorInfo, routing-group=SoAdRG_ADCC_SensorInfo_VLAN62}, {header-id=2868969476, pdu-triggering=PDUTrigger_RR_RR_ADASVersInfo_return_Cis_ICC_8155_QNX_ADCC_SensorInfo, routing-group=SoAdRG_ADCC_SensorInfo_VLAN62}, {header-id=2869067777, pdu-triggering=PDUTrigger_Event_NtfTrafficSign_Drvg_ADCC_DrivingFuncInfo_1, routing-group=SoAdRG_ADCC_DrivingFuncInfo_Eventgroup_VLAN62_ADCC_DrivingFuncInfo}, {header-id=2869067778, pdu-triggering=PDUTrigger_Event_NtfISLIInfo_Drvg_ADCC_DrivingFuncInfo_1, routing-group=SoAdRG_ADCC_DrivingFuncInfo_Eventgroup_VLAN62_ADCC_DrivingFuncInfo}, {header-id=2869067779, pdu-triggering=PDUTrigger_Event_NtfACCInfo_Drvg_ADCC_DrivingFuncInfo_1, routing-group=SoAdRG_ADCC_DrivingFuncInfo_Eventgroup_VLAN62_ADCC_DrivingFuncInfo}, {header-id=2869067780, pdu-triggering=PDUTrigger_Event_NtfALCInfo_Drvg_ADCC_DrivingFuncInfo_1, routing-group=SoAdRG_ADCC_DrivingFuncInfo_Eventgroup_VLAN62_ADCC_DrivingFuncInfo}, {header-id=2869067781, pdu-triggering=PDUTrigger_Event_NtfICAInfo_Drvg_ADCC_DrivingFuncInfo_1, routing-group=SoAdRG_ADCC_DrivingFuncInfo_Eventgroup_VLAN62_ADCC_DrivingFuncInfo}, {header-id=2869067782, pdu-triggering=PDUTrigger_Event_NtfIntelligentEvasionInfo_Drvg_ADCC_DrivingFuncInfo_1, routing-group=SoAdRG_ADCC_DrivingFuncInfo_Eventgroup_VLAN62_ADCC_DrivingFuncInfo}, {header-id=2869067783, pdu-triggering=PDUTrigger_Event_NtfHNOPfunctionInfo_Drvg_ADCC_DrivingFuncInfo_1, routing-group=SoAdRG_ADCC_DrivingFuncInfo_Eventgroup_VLAN62_ADCC_DrivingFuncInfo}, {header-id=2869067784, pdu-triggering=PDUTrigger_Event_NtfUNOPfunctionInfo_Drvg_ADCC_DrivingFuncInfo_1, routing-group=SoAdRG_ADCC_DrivingFuncInfo_Eventgroup_VLAN62_ADCC_DrivingFuncInfo}, {header-id=2869067785, pdu-triggering=PDUTrigger_Event_NtfHodDmsInfo_Drvg_ADCC_DrivingFuncInfo_1, routing-group=SoAdRG_ADCC_DrivingFuncInfo_Eventgroup_VLAN62_ADCC_DrivingFuncInfo}, {header-id=2869067786, pdu-triggering=PDUTrigger_Event_NtfLSSInfo_Drvg_ADCC_DrivingFuncInfo_1, routing-group=SoAdRG_ADCC_DrivingFuncInfo_Eventgroup_VLAN62_ADCC_DrivingFuncInfo}, {header-id=2869067787, pdu-triggering=PDUTrigger_Event_NtfESSInfo_Drvg_ADCC_DrivingFuncInfo_1, routing-group=SoAdRG_ADCC_DrivingFuncInfo_Eventgroup_VLAN62_ADCC_DrivingFuncInfo}, {header-id=2869067788, pdu-triggering=PDUTrigger_Event_NtfDAIInfo_Drvg_ADCC_DrivingFuncInfo_1, routing-group=SoAdRG_ADCC_DrivingFuncInfo_Eventgroup_VLAN62_ADCC_DrivingFuncInfo}, {header-id=2869067789, pdu-triggering=PDUTrigger_Event_NtfNRAInfo_Drvg_ADCC_DrivingFuncInfo_1, routing-group=SoAdRG_ADCC_DrivingFuncInfo_Eventgroup_VLAN62_ADCC_DrivingFuncInfo}, {header-id=2869067790, pdu-triggering=PDUTrigger_Event_NtfDrivingSoundInfo_Drvg_ADCC_DrivingFuncInfo_1, routing-group=SoAdRG_ADCC_DrivingFuncInfo_Eventgroup_VLAN62_ADCC_DrivingFuncInfo}, {header-id=2869067791, pdu-triggering=PDUTrigger_Event_NtfMNPInfo_Drvg_ADCC_DrivingFuncInfo_1, routing-group=SoAdRG_ADCC_DrivingFuncInfo_Eventgroup_VLAN62_ADCC_DrivingFuncInfo}, {header-id=2869067793, pdu-triggering=PDUTrigger_Event_NtfIHCInfo_Drvg_ADCC_DrivingFuncInfo_1, routing-group=SoAdRG_ADCC_DrivingFuncInfo_Eventgroup_VLAN62_ADCC_DrivingFuncInfo}, {header-id=2869067794, pdu-triggering=PDUTrigger_Event_NtfISLIInfo_Drvg_2_ADCC_DrivingFuncInfo_1, routing-group=SoAdRG_ADCC_DrivingFuncInfo_Eventgroup_VLAN62_ADCC_DrivingFuncInfo}, {header-id=2869067795, pdu-triggering=PDUTrigger_Event_NtfALCInfo_Drvg_2_ADCC_DrivingFuncInfo_1, routing-group=SoAdRG_ADCC_DrivingFuncInfo_Eventgroup_VLAN62_ADCC_DrivingFuncInfo}, {header-id=2869067796, pdu-triggering=PDUTrigger_Event_NtfICAInfo_Drvg_2_ADCC_DrivingFuncInfo_1, routing-group=SoAdRG_ADCC_DrivingFuncInfo_Eventgroup_VLAN62_ADCC_DrivingFuncInfo}, {header-id=2869067797, pdu-triggering=PDUTrigger_Event_NtfLSSInfo_Drvg_2_ADCC_DrivingFuncInfo_1, routing-group=SoAdRG_ADCC_DrivingFuncInfo_Eventgroup_VLAN62_ADCC_DrivingFuncInfo}, {header-id=2869067798, pdu-triggering=PDUTrigger_Event_NtfESSInfo_Drvg_2_ADCC_DrivingFuncInfo_1, routing-group=SoAdRG_ADCC_DrivingFuncInfo_Eventgroup_VLAN62_ADCC_DrivingFuncInfo}, {header-id=2869067799, pdu-triggering=PDUTrigger_Event_NtfTrafficSignIdentify_Drvg_ADCC_DrivingFuncInfo_1, routing-group=SoAdRG_ADCC_DrivingFuncInfo_Eventgroup_VLAN62_ADCC_DrivingFuncInfo}, {header-id=2869067800, pdu-triggering=PDUTrigger_Event_NtfACCSupplementInfo_Drvg_ADCC_DrivingFuncInfo_1, routing-group=SoAdRG_ADCC_DrivingFuncInfo_Eventgroup_VLAN62_ADCC_DrivingFuncInfo}, {header-id=2869067801, pdu-triggering=TPPDUTrigger_Event_NtfHNOPSupplementInfo_Drvg_ADCC_DrivingFuncInfo_1, routing-group=SoAdRG_ADCC_DrivingFuncInfo_Eventgroup_VLAN62_ADCC_DrivingFuncInfo}, {header-id=2869067804, pdu-triggering=PDUTrigger_Event_NtfTLRInfo_Drvg_ADCC_DrivingFuncInfo_1, routing-group=SoAdRG_ADCC_DrivingFuncInfo_Eventgroup_VLAN62_ADCC_DrivingFuncInfo}, {header-id=2869067805, pdu-triggering=PDUTrigger_Event_NtfTLAInfo_Drvg_ADCC_DrivingFuncInfo_1, routing-group=SoAdRG_ADCC_DrivingFuncInfo_Eventgroup_VLAN62_ADCC_DrivingFuncInfo}, {header-id=2869067806, pdu-triggering=TPPDUTrigger_Event_NtfMNPInfo_Drvg_2_ADCC_DrivingFuncInfo_1, routing-group=SoAdRG_ADCC_DrivingFuncInfo_Eventgroup_VLAN62_ADCC_DrivingFuncInfo}, {header-id=2869067808, pdu-triggering=PDUTrigger_Event_NtfTrafficSign_Drvg_2_ADCC_DrivingFuncInfo_1, routing-group=SoAdRG_ADCC_DrivingFuncInfo_Eventgroup_VLAN62_ADCC_DrivingFuncInfo}, {header-id=2869067809, pdu-triggering=PDUTrigger_Event_TolNtfADDrivingCardinfo_ADCC_DrivingFuncInfo_1, routing-group=SoAdRG_ADCC_DrivingFuncInfo_Eventgroup_VLAN62_ADCC_DrivingFuncInfo}, {header-id=2869067810, pdu-triggering=PDUTrigger_Event_SglNtfADDrivingCardinfo_ADCC_DrivingFuncInfo_1, routing-group=SoAdRG_ADCC_DrivingFuncInfo_Eventgroup_VLAN62_ADCC_DrivingFuncInfo}, {header-id=2869133313, pdu-triggering=PDUTrigger_Event_NtfParkingGenaralInfo_ADCC_ParkingFuncInfo_1, routing-group=SoAdRG_ADAS_ParkingFuncInfo_Eventgroup_VLAN62_ADCC_ParkingFuncInfo}, {header-id=2869133314, pdu-triggering=PDUTrigger_Event_NtfAPARPAInfo_ADCC_ParkingFuncInfo_1, routing-group=SoAdRG_ADAS_ParkingFuncInfo_Eventgroup_VLAN62_ADCC_ParkingFuncInfo}, {header-id=2869133315, pdu-triggering=PDUTrigger_Event_NtfAdvanceParkingInfo_ADCC_ParkingFuncInfo_1, routing-group=SoAdRG_ADAS_ParkingFuncInfo_Eventgroup_VLAN62_ADCC_ParkingFuncInfo}, {header-id=2869133319, pdu-triggering=PDUTrigger_Event_NtfMRAInfo_ADCC_ParkingFuncInfo_1, routing-group=SoAdRG_ADAS_ParkingFuncInfo_Eventgroup_VLAN62_ADCC_ParkingFuncInfo}, {header-id=2869133320, pdu-triggering=PDUTrigger_Event_NtfMEBInfo_ADCC_ParkingFuncInfo_1, routing-group=SoAdRG_ADAS_ParkingFuncInfo_Eventgroup_VLAN62_ADCC_ParkingFuncInfo}, {header-id=2869133321, pdu-triggering=PDUTrigger_Event_NtfMAAInfo_ADCC_ParkingFuncInfo_1, routing-group=SoAdRG_ADAS_ParkingFuncInfo_Eventgroup_VLAN62_ADCC_ParkingFuncInfo}, {header-id=2869133323, pdu-triggering=PDUTrigger_Event_NtfParkingGenaralInfo_2_ADCC_ParkingFuncInfo_1, routing-group=SoAdRG_ADAS_ParkingFuncInfo_Eventgroup_VLAN62_ADCC_ParkingFuncInfo}, {header-id=2869133324, pdu-triggering=PDUTrigger_Event_NtfMRAInfo_2_ADCC_ParkingFuncInfo_1, routing-group=SoAdRG_ADAS_ParkingFuncInfo_Eventgroup_VLAN62_ADCC_ParkingFuncInfo}, {header-id=2869133325, pdu-triggering=PDUTrigger_Event_NtfAPARPAInfo_2_ADCC_ParkingFuncInfo_1, routing-group=SoAdRG_ADAS_ParkingFuncInfo_Eventgroup_VLAN62_ADCC_ParkingFuncInfo}, {header-id=2869133326, pdu-triggering=PDUTrigger_Event_NtfAdvanceParkingInfo_2_ADCC_ParkingFuncInfo_1, routing-group=SoAdRG_ADAS_ParkingFuncInfo_Eventgroup_VLAN62_ADCC_ParkingFuncInfo}, {header-id=2869198849, pdu-triggering=TPPDUTrigger_Event_NtfDynamicObjectList_Prkg_ADCC_ParkingHmiEnv_1, routing-group=SoAdRG_ADCC_ParkingHmiEnv_Eventgroup_VLAN62_ADCC_ParkingHmiEnv}, {header-id=2869198850, pdu-triggering=TPPDUTrigger_Event_NtfStaticObjectList_Prkg_ADCC_ParkingHmiEnv_1, routing-group=SoAdRG_ADCC_ParkingHmiEnv_Eventgroup_VLAN62_ADCC_ParkingHmiEnv}, {header-id=2869198851, pdu-triggering=PDUTrigger_Event_NtfParkingSlot_Prkg_ADCC_ParkingHmiEnv_1, routing-group=SoAdRG_ADCC_ParkingHmiEnv_Eventgroup_VLAN62_ADCC_ParkingHmiEnv}, {header-id=2869198852, pdu-triggering=TPPDUTrigger_Event_NtfHPAStaticObjectList_Prkg_ADCC_ParkingHmiEnv_1, routing-group=SoAdRG_ADCC_ParkingHmiEnv_Eventgroup_VLAN62_ADCC_ParkingHmiEnv}, {header-id=2869198853, pdu-triggering=TPPDUTrigger_Event_NtfHPAParkingSlot_Prkg_ADCC_ParkingHmiEnv_1, routing-group=SoAdRG_ADCC_ParkingHmiEnv_Eventgroup_VLAN62_ADCC_ParkingHmiEnv}, {header-id=2869198856, pdu-triggering=TPPDUTrigger_Event_NtfDynamicObjectList_Prkg_2_ADCC_ParkingHmiEnv_1, routing-group=SoAdRG_ADCC_ParkingHmiEnv_Eventgroup_VLAN62_ADCC_ParkingHmiEnv}, {header-id=2869198857, pdu-triggering=TPPDUTrigger_Event_NtfStaticObjectList_Prkg_2_ADCC_ParkingHmiEnv_1, routing-group=SoAdRG_ADCC_ParkingHmiEnv_Eventgroup_VLAN62_ADCC_ParkingHmiEnv}, {header-id=2869592065, pdu-triggering=PDUTrigger_Event_NtfActiveSafetyFcnInfo_Act_ADCC_ActiveSafetyInfo_1, routing-group=SoAdRG_ADCC_ActiveSafetyInfo_Eventgroup_VLAN62_ADCC_ActiveSafetyInfo}, {header-id=2869592066, pdu-triggering=PDUTrigger_Event_NtfAEBTargetObjInfo_Act_ADCC_ActiveSafetyInfo_1, routing-group=SoAdRG_ADCC_ActiveSafetyInfo_Eventgroup_VLAN62_ADCC_ActiveSafetyInfo}, {header-id=2869592067, pdu-triggering=PDUTrigger_Event_NtfActiveSafetyFcnInfo_Act_2_ADCC_ActiveSafetyInfo_1, routing-group=SoAdRG_ADCC_ActiveSafetyInfo_Eventgroup_VLAN62_ADCC_ActiveSafetyInfo}, {header-id=2869592068, pdu-triggering=PDUTrigger_Event_NtfAEBTargetObjInfo_Act_2_ADCC_ActiveSafetyInfo_1, routing-group=SoAdRG_ADCC_ActiveSafetyInfo_Eventgroup_VLAN62_ADCC_ActiveSafetyInfo}, {header-id=2869592069, pdu-triggering=PDUTrigger_Event_NtfAEBTargetObjInfo_Act_3_ADCC_ActiveSafetyInfo_1, routing-group=SoAdRG_ADCC_ActiveSafetyInfo_Eventgroup_VLAN62_ADCC_ActiveSafetyInfo}, {header-id=2869723137, pdu-triggering=PDUTrigger_Event_notifyDVRSts_ADCC_ADCC_DVRSts_1, routing-group=SoAdRG_ADCC_DVRSts_Eventgroup_VLAN62_ADCC_DVRSts}, {header-id=2869723138, pdu-triggering=PDUTrigger_Event_notifyDVRcameraSts_ADCC_ADCC_DVRSts_1, routing-group=SoAdRG_ADCC_DVRSts_Eventgroup_VLAN62_ADCC_DVRSts}, {header-id=2869723139, pdu-triggering=PDUTrigger_Event_notifyCameraInterParm_ADCC_ADCC_DVRSts_1, routing-group=SoAdRG_ADCC_DVRSts_Eventgroup_VLAN62_ADCC_DVRSts}, {header-id=2869690369, pdu-triggering=PDUTrigger_RR_getCameraInterParm_ADCC_call_Cis_ICC_8155_QNX_ADCC_DVRSts, routing-group=SoAdRG_ADCC_DVRSts_VLAN62}, {header-id=2869690369, pdu-triggering=PDUTrigger_RR_getCameraInterParm_ADCC_return_Cis_ICC_8155_QNX_ADCC_DVRSts, routing-group=SoAdRG_ADCC_DVRSts_VLAN62}, {header-id=2869755905, pdu-triggering=PDUTrigger_RR_RR_ADASGNSSType_call_Cis_ICC_8155_QNX_ADAS_GNSSInfo, routing-group=SoAdRG_ADAS_GNSSInfo_VLAN62}, {header-id=2869755905, pdu-triggering=PDUTrigger_RR_RR_ADASGNSSType_return_Cis_ICC_8155_QNX_ADAS_GNSSInfo, routing-group=SoAdRG_ADAS_GNSSInfo_VLAN62}]}
              {client-port=SoAddr_VLAN62_TBOX_UDP_30501, pdus=[{header-id=2869624833, pdu-triggering=PDUTrigger_RR_GetUUIDCodeResponse_UUID_call_Cis_TBOX_ADCC_UUID, routing-group=SoAdRG_ADCC_UUID_VLAN62}, {header-id=2869624833, pdu-triggering=PDUTrigger_RR_GetUUIDCodeResponse_UUID_return_Cis_TBOX_ADCC_UUID, routing-group=SoAdRG_ADCC_UUID_VLAN62}]}
              {client-port=SoAddr_VLAN62_LCM_UDP_30501, pdus=[{header-id=2869624833, pdu-triggering=PDUTrigger_RR_GetUUIDCodeResponse_UUID_call_Cis_LCM_ADCC_UUID, routing-group=SoAdRG_ADCC_UUID_VLAN62}, {header-id=2869624833, pdu-triggering=PDUTrigger_RR_GetUUIDCodeResponse_UUID_return_Cis_LCM_ADCC_UUID, routing-group=SoAdRG_ADCC_UUID_VLAN62}]}
          SCB_VLAN62_ADCC_TCP_30500: server-port=SoAddr_VLAN62_ADCC_TCP_30500
            bundled-connections:
              {client-port=SoAddr_VLAN62_ICC_8155_Android_TCP_30501, pdus=[{header-id=2868936712, pdu-triggering=TPPDUTrigger_Event_NtfFusionMapData_ADCC_DrivingHmiEnv, routing-group=SoAdRG_ADCC_DrivingHmiEnv_Eventgroup_VLAN62_ADCC_DrivingHmiEnv}, {header-id=2869067792, pdu-triggering=TPPDUTrigger_Event_NtfMNPRoutesInfo_Drvg_ADCC_DrivingFuncInfo, routing-group=SoAdRG_ADCC_DrivingFuncInfo_Eventgroup_VLAN62_ADCC_DrivingFuncInfo}, {header-id=2869067802, pdu-triggering=TPPDUTrigger_Event_NtfMNPAllRoutesInfo_Drvg_ADCC_DrivingFuncInfo, routing-group=SoAdRG_ADCC_DrivingFuncInfo_Eventgroup_VLAN62_ADCC_DrivingFuncInfo}, {header-id=2869067803, pdu-triggering=TPPDUTrigger_Event_NtfMNPMemRouteInfo_Drvg_ADCC_DrivingFuncInfo, routing-group=SoAdRG_ADCC_DrivingFuncInfo_Eventgroup_VLAN62_ADCC_DrivingFuncInfo}, {header-id=2869133316, pdu-triggering=TPPDUTrigger_Event_NtfHPAPathDetail_ADCC_ParkingFuncInfo, routing-group=SoAdRG_ADAS_ParkingFuncInfo_Eventgroup_VLAN62_ADCC_ParkingFuncInfo}, {header-id=2869133317, pdu-triggering=TPPDUTrigger_Event_NtfHPATrainigPathInfo_ADCC_ParkingFuncInfo, routing-group=SoAdRG_ADAS_ParkingFuncInfo_Eventgroup_VLAN62_ADCC_ParkingFuncInfo}, {header-id=2869133318, pdu-triggering=PDUTrigger_Event_NtfVPASelfBuildMapDate_ADCC_ParkingFuncInfo, routing-group=SoAdRG_ADAS_ParkingFuncInfo_Eventgroup_VLAN62_ADCC_ParkingFuncInfo}, {header-id=2869133322, pdu-triggering=TPPDUTrigger_Event_NtfHPARepalyPathInfo_ADCC_ParkingFuncInfo, routing-group=SoAdRG_ADAS_ParkingFuncInfo_Eventgroup_VLAN62_ADCC_ParkingFuncInfo}, {header-id=2869133327, pdu-triggering=TPPDUTrigger_Event_NtfHPAPathDetail_2_ADCC_ParkingFuncInfo, routing-group=SoAdRG_ADAS_ParkingFuncInfo_Eventgroup_VLAN62_ADCC_ParkingFuncInfo}, {header-id=2869133328, pdu-triggering=TPPDUTrigger_Event_NtfHPATrainigPathInfo_2_ADCC_ParkingFuncInfo, routing-group=SoAdRG_ADAS_ParkingFuncInfo_Eventgroup_VLAN62_ADCC_ParkingFuncInfo}, {header-id=2869133329, pdu-triggering=TPPDUTrigger_Event_NtfHPARepalyPathInfo_2_ADCC_ParkingFuncInfo, routing-group=SoAdRG_ADAS_ParkingFuncInfo_Eventgroup_VLAN62_ADCC_ParkingFuncInfo}, {header-id=2869133330, pdu-triggering=TPPDUTrigger_Event_NtfVPAInfo_ADCC_ParkingFuncInfo, routing-group=SoAdRG_ADAS_ParkingFuncInfo_Eventgroup_VLAN62_ADCC_ParkingFuncInfo}, {header-id=2869133331, pdu-triggering=TPPDUTrigger_Event_NtfParkingHMIInfo_ADCC_ParkingFuncInfo, routing-group=SoAdRG_ADAS_ParkingFuncInfo_Eventgroup_VLAN62_ADCC_ParkingFuncInfo}, {header-id=2869198854, pdu-triggering=TPPDUTrigger_Event_NtfVPASelfBuildMapInfo_ADCC_ParkingHmiEnv, routing-group=SoAdRG_ADCC_ParkingHmiEnv_Eventgroup_VLAN62_ADCC_ParkingHmiEnv}, {header-id=2869198855, pdu-triggering=TPPDUTrigger_Event_NtfVPAParkingLotInfo_ADCC_ParkingHmiEnv, routing-group=SoAdRG_ADCC_ParkingHmiEnv_Eventgroup_VLAN62_ADCC_ParkingHmiEnv}, {header-id=2869264385, pdu-triggering=PDUTrigger_Event_notifyExtMMResWLnk_ADCC_AomMMSt, routing-group=SoAdRG_ADCC_AomMMSt_Eventgroup_VLAN62_ADCC_AomMMSt}, {header-id=2869264386, pdu-triggering=PDUTrigger_Event_HDMapInfo_ADCC_AomMMSt, routing-group=SoAdRG_ADCC_AomMMSt_Eventgroup_VLAN62_ADCC_AomMMSt}, {header-id=2869297153, pdu-triggering=PDUTrigger_RR_GetPackageData_call_Cis_ICC_8155_Android_ADCC_AomDB, routing-group=SoAdRG_ADCC_AomDB_VLAN62}, {header-id=2869297153, pdu-triggering=TPPDUTrigger_RR_GetPackageData_return_Cis_ICC_8155_Android_ADCC_AomDB, routing-group=SoAdRG_ADCC_AomDB_VLAN62}, {header-id=2869395457, pdu-triggering=TPPDUTrigger_Event_notifyRtMatchRes_ADCC_RtMM, routing-group=SoAdRG_ADCC_RtMM_Eventgroup_VLAN62_ADCC_RtMM}, {header-id=2869788673, pdu-triggering=TPPDUTrigger_Event_notifyGNSSInfo_ADAS_GNSSInfo, routing-group=SoAdRG_ADAS_GNSSInfo_Eventgroup_VLAN62_ADAS_GNSSInfo}]}
              {client-port=SoAddr_VLAN62_ICC_8155_QNX_TCP_30501, pdus=[{header-id=2868936712, pdu-triggering=TPPDUTrigger_Event_NtfFusionMapData_ADCC_DrivingHmiEnv_1, routing-group=SoAdRG_ADCC_DrivingHmiEnv_Eventgroup_VLAN62_ADCC_DrivingHmiEnv}, {header-id=2869067792, pdu-triggering=TPPDUTrigger_Event_NtfMNPRoutesInfo_Drvg_ADCC_DrivingFuncInfo_1, routing-group=SoAdRG_ADCC_DrivingFuncInfo_Eventgroup_VLAN62_ADCC_DrivingFuncInfo}, {header-id=2869067802, pdu-triggering=TPPDUTrigger_Event_NtfMNPAllRoutesInfo_Drvg_ADCC_DrivingFuncInfo_1, routing-group=SoAdRG_ADCC_DrivingFuncInfo_Eventgroup_VLAN62_ADCC_DrivingFuncInfo}, {header-id=2869067803, pdu-triggering=TPPDUTrigger_Event_NtfMNPMemRouteInfo_Drvg_ADCC_DrivingFuncInfo_1, routing-group=SoAdRG_ADCC_DrivingFuncInfo_Eventgroup_VLAN62_ADCC_DrivingFuncInfo}, {header-id=2869133316, pdu-triggering=TPPDUTrigger_Event_NtfHPAPathDetail_ADCC_ParkingFuncInfo_1, routing-group=SoAdRG_ADAS_ParkingFuncInfo_Eventgroup_VLAN62_ADCC_ParkingFuncInfo}, {header-id=2869133317, pdu-triggering=TPPDUTrigger_Event_NtfHPATrainigPathInfo_ADCC_ParkingFuncInfo_1, routing-group=SoAdRG_ADAS_ParkingFuncInfo_Eventgroup_VLAN62_ADCC_ParkingFuncInfo}, {header-id=2869133318, pdu-triggering=PDUTrigger_Event_NtfVPASelfBuildMapDate_ADCC_ParkingFuncInfo_1, routing-group=SoAdRG_ADAS_ParkingFuncInfo_Eventgroup_VLAN62_ADCC_ParkingFuncInfo}, {header-id=2869133322, pdu-triggering=TPPDUTrigger_Event_NtfHPARepalyPathInfo_ADCC_ParkingFuncInfo_1, routing-group=SoAdRG_ADAS_ParkingFuncInfo_Eventgroup_VLAN62_ADCC_ParkingFuncInfo}, {header-id=2869133327, pdu-triggering=TPPDUTrigger_Event_NtfHPAPathDetail_2_ADCC_ParkingFuncInfo_1, routing-group=SoAdRG_ADAS_ParkingFuncInfo_Eventgroup_VLAN62_ADCC_ParkingFuncInfo}, {header-id=2869133328, pdu-triggering=TPPDUTrigger_Event_NtfHPATrainigPathInfo_2_ADCC_ParkingFuncInfo_1, routing-group=SoAdRG_ADAS_ParkingFuncInfo_Eventgroup_VLAN62_ADCC_ParkingFuncInfo}, {header-id=2869133329, pdu-triggering=TPPDUTrigger_Event_NtfHPARepalyPathInfo_2_ADCC_ParkingFuncInfo_1, routing-group=SoAdRG_ADAS_ParkingFuncInfo_Eventgroup_VLAN62_ADCC_ParkingFuncInfo}, {header-id=2869133330, pdu-triggering=TPPDUTrigger_Event_NtfVPAInfo_ADCC_ParkingFuncInfo_1, routing-group=SoAdRG_ADAS_ParkingFuncInfo_Eventgroup_VLAN62_ADCC_ParkingFuncInfo}, {header-id=2869133331, pdu-triggering=TPPDUTrigger_Event_NtfParkingHMIInfo_ADCC_ParkingFuncInfo_1, routing-group=SoAdRG_ADAS_ParkingFuncInfo_Eventgroup_VLAN62_ADCC_ParkingFuncInfo}, {header-id=2869198854, pdu-triggering=TPPDUTrigger_Event_NtfVPASelfBuildMapInfo_ADCC_ParkingHmiEnv_1, routing-group=SoAdRG_ADCC_ParkingHmiEnv_Eventgroup_VLAN62_ADCC_ParkingHmiEnv}, {header-id=2869198855, pdu-triggering=TPPDUTrigger_Event_NtfVPAParkingLotInfo_ADCC_ParkingHmiEnv_1, routing-group=SoAdRG_ADCC_ParkingHmiEnv_Eventgroup_VLAN62_ADCC_ParkingHmiEnv}, {header-id=2869264385, pdu-triggering=PDUTrigger_Event_notifyExtMMResWLnk_ADCC_AomMMSt_1, routing-group=SoAdRG_ADCC_AomMMSt_Eventgroup_VLAN62_ADCC_AomMMSt}, {header-id=2869264386, pdu-triggering=PDUTrigger_Event_HDMapInfo_ADCC_AomMMSt_1, routing-group=SoAdRG_ADCC_AomMMSt_Eventgroup_VLAN62_ADCC_AomMMSt}, {header-id=2869297153, pdu-triggering=PDUTrigger_RR_GetPackageData_call_Cis_ICC_8155_QNX_ADCC_AomDB, routing-group=SoAdRG_ADCC_AomDB_VLAN62}, {header-id=2869297153, pdu-triggering=TPPDUTrigger_RR_GetPackageData_return_Cis_ICC_8155_QNX_ADCC_AomDB, routing-group=SoAdRG_ADCC_AomDB_VLAN62}, {header-id=2869395457, pdu-triggering=TPPDUTrigger_Event_notifyRtMatchRes_ADCC_RtMM_1, routing-group=SoAdRG_ADCC_RtMM_Eventgroup_VLAN62_ADCC_RtMM}, {header-id=2869788673, pdu-triggering=TPPDUTrigger_Event_notifyGNSSInfo_ADAS_GNSSInfo_1, routing-group=SoAdRG_ADAS_GNSSInfo_Eventgroup_VLAN62_ADAS_GNSSInfo}]}
          SDSCB_VLAN62_ICC_8155_QNX: socket-connection{client-port=SDSoAddr_VLAN62_Any, pdus=[{header-id=4294934784, pdu-triggering=PDUTransmission_VLAN62_Tx_ICC_8155_QNX}, {header-id=4294934784, pdu-triggering=PDUTransmission_VLAN62_UnicastRx_ICC_8155_QNX}]}, server-port=SDSoAddr_VLAN62_ICC_8155_QNX
          SCB_VLAN62_FCM_UDP_30500: server-port=SoAddr_VLAN62_FCM_UDP_30500
            bundled-connections:
              {client-port=SoAddr_VLAN62_ICC_8155_QNX_UDP_30501, pdus=[{header-id=2869985281, pdu-triggering=TPPDUTrigger_Event_NtfDynamicObjectList_FCM_DrivingHmiEnv, routing-group=SoAdRG_FCM_DrivingHmiEnv_Eventgroup_VLAN62_FCM_DrivingHmiEnv}, {header-id=2869985282, pdu-triggering=TPPDUTrigger_Event_NtfStaticObjectList_FCM_DrivingHmiEnv, routing-group=SoAdRG_FCM_DrivingHmiEnv_Eventgroup_VLAN62_FCM_DrivingHmiEnv}, {header-id=2869985283, pdu-triggering=PDUTrigger_Event_NtfLaneLineList_FCM_DrivingHmiEnv, routing-group=SoAdRG_FCM_DrivingHmiEnv_Eventgroup_VLAN62_FCM_DrivingHmiEnv}, {header-id=2869985285, pdu-triggering=PDUTrigger_Event_NtfEgoFusionPose_FCM_DrivingHmiEnv, routing-group=SoAdRG_FCM_DrivingHmiEnv_Eventgroup_VLAN62_FCM_DrivingHmiEnv}, {header-id=2869985286, pdu-triggering=TPPDUTrigger_Event_NtfDynamicObjectList_2_FCM_DrivingHmiEnv, routing-group=SoAdRG_FCM_DrivingHmiEnv_Eventgroup_VLAN62_FCM_DrivingHmiEnv}, {header-id=2869985287, pdu-triggering=TPPDUTrigger_Event_NtfStaticObjectList_2_FCM_DrivingHmiEnv, routing-group=SoAdRG_FCM_DrivingHmiEnv_Eventgroup_VLAN62_FCM_DrivingHmiEnv}, {header-id=2870050817, pdu-triggering=PDUTrigger_Event_NtfActiveSafetyFcnInfo_FCM_ActiveSafetyInfo_1, routing-group=SoAdRG_FCM_ActiveSafetyInfo_Eventgroup_VLAN62_FCM_ActiveSafetyInfo}, {header-id=2870050818, pdu-triggering=PDUTrigger_Event_NtfAEBTargetObjInfo_FCM_ActiveSafetyInfo_1, routing-group=SoAdRG_FCM_ActiveSafetyInfo_Eventgroup_VLAN62_FCM_ActiveSafetyInfo}, {header-id=2870050819, pdu-triggering=PDUTrigger_Event_NtfActiveSafetyFcnInfo_2_FCM_ActiveSafetyInfo_1, routing-group=SoAdRG_FCM_ActiveSafetyInfo_Eventgroup_VLAN62_FCM_ActiveSafetyInfo}, {header-id=2870050820, pdu-triggering=PDUTrigger_Event_NtfAEBTargetObjInfo_2_FCM_ActiveSafetyInfo_1, routing-group=SoAdRG_FCM_ActiveSafetyInfo_Eventgroup_VLAN62_FCM_ActiveSafetyInfo}, {header-id=2870116353, pdu-triggering=PDUTrigger_Event_NtfTrafficSign_FCM_DrivingFuncInfo_1, routing-group=SoAdRG_FCM_DrivingFuncInfo_Eventgroup_VLAN62_FCM_DrivingFuncInfo}, {header-id=2870116354, pdu-triggering=PDUTrigger_Event_NtfISLIinfo_FCM_DrivingFuncInfo_1, routing-group=SoAdRG_FCM_DrivingFuncInfo_Eventgroup_VLAN62_FCM_DrivingFuncInfo}, {header-id=2870116355, pdu-triggering=PDUTrigger_Event_NtfACCinfo_FCM_DrivingFuncInfo_1, routing-group=SoAdRG_FCM_DrivingFuncInfo_Eventgroup_VLAN62_FCM_DrivingFuncInfo}, {header-id=2870116356, pdu-triggering=PDUTrigger_Event_NtfICAInfo_FCM_DrivingFuncInfo_1, routing-group=SoAdRG_FCM_DrivingFuncInfo_Eventgroup_VLAN62_FCM_DrivingFuncInfo}, {header-id=2870116357, pdu-triggering=PDUTrigger_Event_NtfIntelligentEvasionInfo_FCM_DrivingFuncInfo_1, routing-group=SoAdRG_FCM_DrivingFuncInfo_Eventgroup_VLAN62_FCM_DrivingFuncInfo}, {header-id=2870116358, pdu-triggering=PDUTrigger_Event_NtfHodDmsInfo_FCM_DrivingFuncInfo_1, routing-group=SoAdRG_FCM_DrivingFuncInfo_Eventgroup_VLAN62_FCM_DrivingFuncInfo}, {header-id=2870116359, pdu-triggering=PDUTrigger_Event_NtfLSSInfo_FCM_DrivingFuncInfo_1, routing-group=SoAdRG_FCM_DrivingFuncInfo_Eventgroup_VLAN62_FCM_DrivingFuncInfo}, {header-id=2870116360, pdu-triggering=PDUTrigger_Event_NtfESSInfo_FCM_DrivingFuncInfo_1, routing-group=SoAdRG_FCM_DrivingFuncInfo_Eventgroup_VLAN62_FCM_DrivingFuncInfo}, {header-id=2870116361, pdu-triggering=PDUTrigger_Event_NtfDAIInfo_FCM_DrivingFuncInfo_1, routing-group=SoAdRG_FCM_DrivingFuncInfo_Eventgroup_VLAN62_FCM_DrivingFuncInfo}, {header-id=2870116362, pdu-triggering=PDUTrigger_Event_NtfISLIinfo_2_FCM_DrivingFuncInfo_1, routing-group=SoAdRG_FCM_DrivingFuncInfo_Eventgroup_VLAN62_FCM_DrivingFuncInfo}, {header-id=2870116363, pdu-triggering=PDUTrigger_Event_NtfLSSInfo_2_FCM_DrivingFuncInfo_1, routing-group=SoAdRG_FCM_DrivingFuncInfo_Eventgroup_VLAN62_FCM_DrivingFuncInfo}, {header-id=2870116364, pdu-triggering=PDUTrigger_Event_NtfDrivingSoundInfo_FCM_DrivingFuncInfo_1, routing-group=SoAdRG_FCM_DrivingFuncInfo_Eventgroup_VLAN62_FCM_DrivingFuncInfo}, {header-id=2870116365, pdu-triggering=PDUTrigger_Event_NtfIHCInfo_FCM_DrivingFuncInfo_1, routing-group=SoAdRG_FCM_DrivingFuncInfo_Eventgroup_VLAN62_FCM_DrivingFuncInfo}, {header-id=2870116366, pdu-triggering=PDUTrigger_Event_NtfHNOPfunctionInfo_FCM_DrivingFuncInfo_1, routing-group=SoAdRG_FCM_DrivingFuncInfo_Eventgroup_VLAN62_FCM_DrivingFuncInfo}, {header-id=2870181889, pdu-triggering=PDUTrigger_Event_notifyDVRSts_FCM_DVRSts_1, routing-group=SoAdRG_FCM_DVRSts_Eventgroup_VLAN62_FCM_DVRSts}, {header-id=2870181890, pdu-triggering=PDUTrigger_Event_notifyDVRcameraSts_FCM_DVRSts_1, routing-group=SoAdRG_FCM_DVRSts_Eventgroup_VLAN62_FCM_DVRSts}, {header-id=2870181891, pdu-triggering=PDUTrigger_Event_notifyCameraInterParm_FCM_DVRSts_1, routing-group=SoAdRG_FCM_DVRSts_Eventgroup_VLAN62_FCM_DVRSts}, {header-id=2870149121, pdu-triggering=PDUTrigger_RR_getCameraInterParm_call_Cis_ICC_8155_QNX_FCM_DVRSts, routing-group=SoAdRG_FCM_DVRSts_VLAN62}, {header-id=2870149121, pdu-triggering=PDUTrigger_RR_getCameraInterParm_return_Cis_ICC_8155_QNX_FCM_DVRSts, routing-group=SoAdRG_FCM_DVRSts_VLAN62}, {header-id=2870378497, pdu-triggering=PDUTrigger_Event_NtfSensorSt_FCM_FCM_SensorInfo_1, routing-group=SoAdRG_FCM_SensorInfo_Eventgroup_VLAN62_FCM_SensorInfo}]}
              {client-port=SoAddr_VLAN62_ICC_8155_Android_UDP_30501, pdus=[{header-id=2869985281, pdu-triggering=TPPDUTrigger_Event_NtfDynamicObjectList_FCM_DrivingHmiEnv_1, routing-group=SoAdRG_FCM_DrivingHmiEnv_Eventgroup_VLAN62_FCM_DrivingHmiEnv}, {header-id=2869985282, pdu-triggering=TPPDUTrigger_Event_NtfStaticObjectList_FCM_DrivingHmiEnv_1, routing-group=SoAdRG_FCM_DrivingHmiEnv_Eventgroup_VLAN62_FCM_DrivingHmiEnv}, {header-id=2869985283, pdu-triggering=PDUTrigger_Event_NtfLaneLineList_FCM_DrivingHmiEnv_1, routing-group=SoAdRG_FCM_DrivingHmiEnv_Eventgroup_VLAN62_FCM_DrivingHmiEnv}, {header-id=2869985285, pdu-triggering=PDUTrigger_Event_NtfEgoFusionPose_FCM_DrivingHmiEnv_1, routing-group=SoAdRG_FCM_DrivingHmiEnv_Eventgroup_VLAN62_FCM_DrivingHmiEnv}, {header-id=2869985286, pdu-triggering=TPPDUTrigger_Event_NtfDynamicObjectList_2_FCM_DrivingHmiEnv_1, routing-group=SoAdRG_FCM_DrivingHmiEnv_Eventgroup_VLAN62_FCM_DrivingHmiEnv}, {header-id=2869985287, pdu-triggering=TPPDUTrigger_Event_NtfStaticObjectList_2_FCM_DrivingHmiEnv_1, routing-group=SoAdRG_FCM_DrivingHmiEnv_Eventgroup_VLAN62_FCM_DrivingHmiEnv}, {header-id=2870050817, pdu-triggering=PDUTrigger_Event_NtfActiveSafetyFcnInfo_FCM_ActiveSafetyInfo, routing-group=SoAdRG_FCM_ActiveSafetyInfo_Eventgroup_VLAN62_FCM_ActiveSafetyInfo}, {header-id=2870050818, pdu-triggering=PDUTrigger_Event_NtfAEBTargetObjInfo_FCM_ActiveSafetyInfo, routing-group=SoAdRG_FCM_ActiveSafetyInfo_Eventgroup_VLAN62_FCM_ActiveSafetyInfo}, {header-id=2870050819, pdu-triggering=PDUTrigger_Event_NtfActiveSafetyFcnInfo_2_FCM_ActiveSafetyInfo, routing-group=SoAdRG_FCM_ActiveSafetyInfo_Eventgroup_VLAN62_FCM_ActiveSafetyInfo}, {header-id=2870050820, pdu-triggering=PDUTrigger_Event_NtfAEBTargetObjInfo_2_FCM_ActiveSafetyInfo, routing-group=SoAdRG_FCM_ActiveSafetyInfo_Eventgroup_VLAN62_FCM_ActiveSafetyInfo}, {header-id=2870116353, pdu-triggering=PDUTrigger_Event_NtfTrafficSign_FCM_DrivingFuncInfo, routing-group=SoAdRG_FCM_DrivingFuncInfo_Eventgroup_VLAN62_FCM_DrivingFuncInfo}, {header-id=2870116354, pdu-triggering=PDUTrigger_Event_NtfISLIinfo_FCM_DrivingFuncInfo, routing-group=SoAdRG_FCM_DrivingFuncInfo_Eventgroup_VLAN62_FCM_DrivingFuncInfo}, {header-id=2870116355, pdu-triggering=PDUTrigger_Event_NtfACCinfo_FCM_DrivingFuncInfo, routing-group=SoAdRG_FCM_DrivingFuncInfo_Eventgroup_VLAN62_FCM_DrivingFuncInfo}, {header-id=2870116356, pdu-triggering=PDUTrigger_Event_NtfICAInfo_FCM_DrivingFuncInfo, routing-group=SoAdRG_FCM_DrivingFuncInfo_Eventgroup_VLAN62_FCM_DrivingFuncInfo}, {header-id=2870116357, pdu-triggering=PDUTrigger_Event_NtfIntelligentEvasionInfo_FCM_DrivingFuncInfo, routing-group=SoAdRG_FCM_DrivingFuncInfo_Eventgroup_VLAN62_FCM_DrivingFuncInfo}, {header-id=2870116358, pdu-triggering=PDUTrigger_Event_NtfHodDmsInfo_FCM_DrivingFuncInfo, routing-group=SoAdRG_FCM_DrivingFuncInfo_Eventgroup_VLAN62_FCM_DrivingFuncInfo}, {header-id=2870116359, pdu-triggering=PDUTrigger_Event_NtfLSSInfo_FCM_DrivingFuncInfo, routing-group=SoAdRG_FCM_DrivingFuncInfo_Eventgroup_VLAN62_FCM_DrivingFuncInfo}, {header-id=2870116360, pdu-triggering=PDUTrigger_Event_NtfESSInfo_FCM_DrivingFuncInfo, routing-group=SoAdRG_FCM_DrivingFuncInfo_Eventgroup_VLAN62_FCM_DrivingFuncInfo}, {header-id=2870116361, pdu-triggering=PDUTrigger_Event_NtfDAIInfo_FCM_DrivingFuncInfo, routing-group=SoAdRG_FCM_DrivingFuncInfo_Eventgroup_VLAN62_FCM_DrivingFuncInfo}, {header-id=2870116362, pdu-triggering=PDUTrigger_Event_NtfISLIinfo_2_FCM_DrivingFuncInfo, routing-group=SoAdRG_FCM_DrivingFuncInfo_Eventgroup_VLAN62_FCM_DrivingFuncInfo}, {header-id=2870116363, pdu-triggering=PDUTrigger_Event_NtfLSSInfo_2_FCM_DrivingFuncInfo, routing-group=SoAdRG_FCM_DrivingFuncInfo_Eventgroup_VLAN62_FCM_DrivingFuncInfo}, {header-id=2870116364, pdu-triggering=PDUTrigger_Event_NtfDrivingSoundInfo_FCM_DrivingFuncInfo, routing-group=SoAdRG_FCM_DrivingFuncInfo_Eventgroup_VLAN62_FCM_DrivingFuncInfo}, {header-id=2870116365, pdu-triggering=PDUTrigger_Event_NtfIHCInfo_FCM_DrivingFuncInfo, routing-group=SoAdRG_FCM_DrivingFuncInfo_Eventgroup_VLAN62_FCM_DrivingFuncInfo}, {header-id=2870116366, pdu-triggering=PDUTrigger_Event_NtfHNOPfunctionInfo_FCM_DrivingFuncInfo, routing-group=SoAdRG_FCM_DrivingFuncInfo_Eventgroup_VLAN62_FCM_DrivingFuncInfo}, {header-id=2870181889, pdu-triggering=PDUTrigger_Event_notifyDVRSts_FCM_DVRSts, routing-group=SoAdRG_FCM_DVRSts_Eventgroup_VLAN62_FCM_DVRSts}, {header-id=2870181890, pdu-triggering=PDUTrigger_Event_notifyDVRcameraSts_FCM_DVRSts, routing-group=SoAdRG_FCM_DVRSts_Eventgroup_VLAN62_FCM_DVRSts}, {header-id=2870181891, pdu-triggering=PDUTrigger_Event_notifyCameraInterParm_FCM_DVRSts, routing-group=SoAdRG_FCM_DVRSts_Eventgroup_VLAN62_FCM_DVRSts}, {header-id=2870149121, pdu-triggering=PDUTrigger_RR_getCameraInterParm_call_Cis_ICC_8155_Android_FCM_DVRSts, routing-group=SoAdRG_FCM_DVRSts_VLAN62}, {header-id=2870149121, pdu-triggering=PDUTrigger_RR_getCameraInterParm_return_Cis_ICC_8155_Android_FCM_DVRSts, routing-group=SoAdRG_FCM_DVRSts_VLAN62}, {header-id=2870280193, pdu-triggering=PDUTrigger_RR_GetUUIDCodeResponse_call_Cis_ICC_8155_Android_FCM_UUID, routing-group=SoAdRG_FCM_UUID_VLAN62}, {header-id=2870280193, pdu-triggering=PDUTrigger_RR_GetUUIDCodeResponse_return_Cis_ICC_8155_Android_FCM_UUID, routing-group=SoAdRG_FCM_UUID_VLAN62}, {header-id=2870378497, pdu-triggering=PDUTrigger_Event_NtfSensorSt_FCM_FCM_SensorInfo, routing-group=SoAdRG_FCM_SensorInfo_Eventgroup_VLAN62_FCM_SensorInfo}, {header-id=2870444033, pdu-triggering=PDUTrigger_Event_notifyData_ID_ADAS_DataInLoop, routing-group=SoAdRG_DataInLoop_Eventgroup_VLAN62_ADAS_DataInLoop}, {header-id=2870444034, pdu-triggering=PDUTrigger_Event_notifyDataInLoop_1_ADAS_DataInLoop, routing-group=SoAdRG_DataInLoop_Eventgroup_VLAN62_ADAS_DataInLoop}, {header-id=2870444035, pdu-triggering=PDUTrigger_Event_notifyDataInLoop_2_ADAS_DataInLoop, routing-group=SoAdRG_DataInLoop_Eventgroup_VLAN62_ADAS_DataInLoop}, {header-id=2870444036, pdu-triggering=PDUTrigger_Event_notifyDataInLoop_3_ADAS_DataInLoop, routing-group=SoAdRG_DataInLoop_Eventgroup_VLAN62_ADAS_DataInLoop}, {header-id=2870444037, pdu-triggering=PDUTrigger_Event_notifyDataInLoop_ADAS_DataInLoop, routing-group=SoAdRG_DataInLoop_Eventgroup_VLAN62_ADAS_DataInLoop}]}
              {client-port=SoAddr_VLAN62_TBOX_UDP_30501, pdus=[{header-id=2870280193, pdu-triggering=PDUTrigger_RR_GetUUIDCodeResponse_call_Cis_TBOX_FCM_UUID, routing-group=SoAdRG_FCM_UUID_VLAN62}, {header-id=2870280193, pdu-triggering=PDUTrigger_RR_GetUUIDCodeResponse_return_Cis_TBOX_FCM_UUID, routing-group=SoAdRG_FCM_UUID_VLAN62}]}
              {client-port=SoAddr_VLAN62_ADCC_UDP_30501, pdus=[{header-id=2870280193, pdu-triggering=PDUTrigger_RR_GetUUIDCodeResponse_call_Cis_ADCC_FCM_UUID, routing-group=SoAdRG_FCM_UUID_VLAN62}, {header-id=2870280193, pdu-triggering=PDUTrigger_RR_GetUUIDCodeResponse_return_Cis_ADCC_FCM_UUID, routing-group=SoAdRG_FCM_UUID_VLAN62}]}
              {client-port=SoAddr_VLAN62_LCM_UDP_30501, pdus=[{header-id=2870280193, pdu-triggering=PDUTrigger_RR_GetUUIDCodeResponse_call_Cis_LCM_FCM_UUID, routing-group=SoAdRG_FCM_UUID_VLAN62}, {header-id=2870280193, pdu-triggering=PDUTrigger_RR_GetUUIDCodeResponse_return_Cis_LCM_FCM_UUID, routing-group=SoAdRG_FCM_UUID_VLAN62}]}
          SCB_VLAN62_FCM_TCP_30500: server-port=SoAddr_VLAN62_FCM_TCP_30500
            bundled-connections:
              {client-port=SoAddr_VLAN62_ICC_8155_QNX_TCP_30501, pdus=socket-connection-ipdu-identifier={header-id=2869985284, pdu-triggering=TPPDUTrigger_Event_NtfLaneLineList_2_FCM_DrivingHmiEnv, routing-group=SoAdRG_FCM_DrivingHmiEnv_Eventgroup_VLAN62_FCM_DrivingHmiEnv}}
              {client-port=SoAddr_VLAN62_ICC_8155_Android_TCP_30501, pdus=socket-connection-ipdu-identifier={header-id=2869985284, pdu-triggering=TPPDUTrigger_Event_NtfLaneLineList_2_FCM_DrivingHmiEnv_1, routing-group=SoAdRG_FCM_DrivingHmiEnv_Eventgroup_VLAN62_FCM_DrivingHmiEnv}}
          SCB_VLAN62_LCM_UDP_30500: server-port=SoAddr_VLAN62_LCM_UDP_30500
            bundled-connections:
              {client-port=SoAddr_VLAN62_ICC_8155_QNX_UDP_30501, pdus=socket-connection-ipdu-identifier={header-id=2871033857, pdu-triggering=PDUTrigger_Event_NtfIMUInfo_LCM_ICC_Data, routing-group=SoAdRG_LCM_ICC_Data_Eventgroup_VLAN62_LCM_ICC_Data}}
              {client-port=SoAddr_VLAN62_ADCC_UDP_30501, pdus=socket-connection-ipdu-identifier={header-id=2871164929, pdu-triggering=PDUTrigger_Event_NtfGRawInfo_LCM_ADCC_RawData, routing-group=SoAdRG_LCM_ADCC_RawData_Eventgroup_VLAN62_LCM_ADCC_RawData}}
          SCB_VLAN62_ICC_8155_QNX_UDP_30500: socket-connection{client-port=SoAddr_VLAN62_ADCC_UDP_30501, pdus=[{header-id=2886631425, pdu-triggering=PDUTrigger_Event_Event_NetworkStatus_ICC_TBOX_SystemInfo_ICC, routing-group=SoAdRG_TBOXSystemInfo_EventGroup_VLAN62_TBOX_SystemInfo_ICC}, {header-id=2886598660, pdu-triggering=PDUTrigger_RR_RR_SIMCardinfo_ICC_call_Cis_ADCC_TBOX_SystemInfo_ICC, routing-group=SoAdRG_TBOX_SystemInfo_ICC_VLAN62}, {header-id=2886598660, pdu-triggering=PDUTrigger_RR_RR_SIMCardinfo_ICC_return_Cis_ADCC_TBOX_SystemInfo_ICC, routing-group=SoAdRG_TBOX_SystemInfo_ICC_VLAN62}, {header-id=2886598669, pdu-triggering=PDUTrigger_RR_RR_TSPConnectionState_ICC_call_Cis_ADCC_TBOX_SystemInfo_ICC, routing-group=SoAdRG_TBOX_SystemInfo_ICC_VLAN62}, {header-id=2886598669, pdu-triggering=PDUTrigger_RR_RR_TSPConnectionState_ICC_return_Cis_ADCC_TBOX_SystemInfo_ICC, routing-group=SoAdRG_TBOX_SystemInfo_ICC_VLAN62}, {header-id=2886598673, pdu-triggering=PDUTrigger_RR_RR_KL15State_ICC_call_Cis_ADCC_TBOX_SystemInfo_ICC, routing-group=SoAdRG_TBOX_SystemInfo_ICC_VLAN62}, {header-id=2886598673, pdu-triggering=PDUTrigger_RR_RR_KL15State_ICC_return_Cis_ADCC_TBOX_SystemInfo_ICC, routing-group=SoAdRG_TBOX_SystemInfo_ICC_VLAN62}]}, server-port=SoAddr_VLAN62_ICC_8155_QNX_UDP_30500
        28 x socket address:
          SDSoAddr_VLAN62_Any
            application endpoint SDAEP_VLAN62_Any: network-endpoint=NetworkEndpoint_VLAN62_Any, tp-configuration=udp-tp=udp-tp-port=port-number=30490
          SDSoAddr_VLAN62_Multicast: multicast-connector=[LianJieDian_ICC_8155_Android_SwitchEEI_In_VLAN62, LianJieDian_ADCC_SwitchEEI_In_VLAN62, LianJieDian_FCM_SwitchEEI_In_VLAN62, LianJieDian_TBOX_SwitchEEI_In_VLAN62, LianJieDian_LCM_SwitchEEI_In_VLAN62, LianJieDian_ICC_8155_QNX_SwitchEEI_In_VLAN62]
            application endpoint SDAEP_VLAN62_Multicast: network-endpoint=NetworkEndpoint_VLAN62_Multicast, tp-configuration=udp-tp=udp-tp-port=port-number=30490
          SDSoAddr_VLAN62_ICC_8155_Android: connector=LianJieDian_ICC_8155_Android_SwitchEEI_In_VLAN62
            application endpoint SDAEP_VLAN62_ICC_8155_Android: network-endpoint=LianJieDian_ICC_8155_Android_SwitchNEP, tp-configuration=udp-tp=udp-tp-port=port-number=30490
          SoAddr_VLAN62_ICC_8155_Android_UDP_30500: connector=LianJieDian_ICC_8155_Android_SwitchEEI_In_VLAN62
            application endpoint AEP_VLAN62_ICC_8155_Android_UDP_30500: network-endpoint=LianJieDian_ICC_8155_Android_SwitchNEP, tp-configuration=udp-tp=udp-tp-port=port-number=30500
              7 x provided service instance, all with instance-identifier=1, sd-server-config={initial-offer-behavior={initial-delay-max-value=0.1, initial-delay-min-value=0.0, initial-repetitions-base-delay=0.03, initial-repetitions-max=3}, offer-cyclic-delay=1.0, request-response-delay={max-value=0.0, min-value=0.0}, server-service-major-version=1, server-service-minor-version=1, ttl=3}:
                PSI_eHMI_ParkingUI_1_VLAN62_ICC_8155_Android: routing-group=SoAdRG_eHMI_ParkingUI_VLAN62, service-identifier=43412
                  event handler EH_eHMI_ParkingUI_Eventgroup_VLAN62_ICC_8155_Android: consumed-event-group=CSI_eHMI_ParkingUI_VLAN62_ADCC/CEG_eHMI_ParkingUI_Eventgroup_VLAN62_ADCC, routing-group=SoAdRG_eHMI_ParkingUI_Eventgroup_VLAN62_eHMI_ParkingUI, sd-server-config=ttl=16777215
                PSI_eHMI_ADASSetting_1_VLAN62_ICC_8155_Android: routing-group=SoAdRG_eHMI_ADASSetting_VLAN62, service-identifier=43413
                  event handler EH_eHMI_ADASSetting_Eventgroup_VLAN62_ICC_8155_Android: consumed-event-group=[CEG_eHMI_ADASSetting_Eventgroup_VLAN62_ADCC, CEG_eHMI_ADASSetting_Eventgroup_VLAN62_FCM], routing-group=SoAdRG_eHMI_ADASSetting_Eventgroup_VLAN62_eHMI_ADASSetting, sd-server-config=ttl=16777215
                PSI_ICC_Android_OutService_1_VLAN62_ICC_8155_Android: routing-group=SoAdRG_ICC_Android_OutService_VLAN62, service-identifier=44037
                  event handler EH_ICC_Android_OutService_EventGroup_VLAN62_ICC_8155_Android: consumed-event-group=CEG_ICC_Android_OutService_EventGroup_VLAN62_TBOX, routing-group=SoAdRG_ICC_Android_OutService_EventGroup_VLAN62_ICC_Android_OutService, sd-server-config=ttl=16777215
                PSI_ICC_Aom_1_VLAN62_ICC_8155_Android: routing-group=SoAdRG_ICC_Aom_VLAN62, service-identifier=44036
                  event handler EH_ICC_Aom_Eventgroup_VLAN62_ICC_8155_Android: consumed-event-group=CSI_ICC_Aom_VLAN62_ADCC/CEG_ICC_Aom_Eventgroup_VLAN62_ADCC, routing-group=SoAdRG_ICC_Aom_Eventgroup_VLAN62_ICC_Aom, sd-server-config=ttl=16777215
                PSI_ICC_SDmapInfo_1_VLAN62_ICC_8155_Android: routing-group=SoAdRG_ICC_SDmapInfo_VLAN62, service-identifier=44038
                  event handler EH_ICC_SDmapInfo_EventGroup_VLAN62_ICC_8155_Android: consumed-event-group=[CEG_ICC_SDmapInfo_EventGroup_VLAN62_ADCC, CEG_ICC_SDmapInfo_EventGroup_VLAN62_FCM], routing-group=SoAdRG_ICC_SDmapInfo_EventGroup_VLAN62_ICC_SDmapInfo, sd-server-config=ttl=16777215
                PSI_ICC_SDmapInfo_2_1_VLAN62_ICC_8155_Android: routing-group=SoAdRG_ICC_SDmapInfo_2_VLAN62, service-identifier=44044
                  event handler EH_ICC_SDmapInfo_2_EventGroup_VLAN62_ICC_8155_Android: consumed-event-group=[CSI_ICC_SDmapInfo_2_VLAN62_ADCC/CEG_ICC_SDmapInfo_2_EventGroup_VLAN62_ADCC, CSI_ICC_SDmapInfo_2_VLAN62_FCM/CEG_ICC_SDmapInfo_2_EventGroup_VLAN62_FCM], routing-group=SoAdRG_ICC_SDmapInfo_2_EventGroup_VLAN62_ICC_SDmapInfo_2, sd-server-config=ttl=16777215
                PSI_IVI_UnixTimestamp_1_VLAN62_ICC_8155_Android: routing-group=SoAdRG_IVI_UnixTimestamp_VLAN62, service-identifier=44047
                  event handler EH_UnixTimestamp_Eventgroup_VLAN62_ICC_8155_Android: consumed-event-group=CEG_UnixTimestamp_Eventgroup_VLAN62_FCM, routing-group=SoAdRG_UnixTimestamp_Eventgroup_VLAN62_IVI_UnixTimestamp, sd-server-config=ttl=16777215
          SoAddr_VLAN62_ICC_8155_Android_TCP_30500: connector=LianJieDian_ICC_8155_Android_SwitchEEI_In_VLAN62
            application endpoint AEP_VLAN62_ICC_8155_Android_TCP_30500: network-endpoint=LianJieDian_ICC_8155_Android_SwitchNEP, tp-configuration=tcp-tp=tcp-tp-port=port-number=30500
              4 x provided service instance, all with instance-identifier=1, sd-server-config={initial-offer-behavior={initial-delay-max-value=0.1, initial-delay-min-value=0.0, initial-repetitions-base-delay=0.03, initial-repetitions-max=3}, offer-cyclic-delay=1.0, request-response-delay={max-value=0.0, min-value=0.0}, server-service-major-version=1, server-service-minor-version=1, ttl=3}:
                PSI_eHMI_ParkingUI_1_VLAN62_ICC_8155_Android: routing-group=SoAdRG_eHMI_ParkingUI_VLAN62, service-identifier=43412
                  event handler EH_eHMI_ParkingUI_Eventgroup_VLAN62_ICC_8155_Android_1: consumed-event-group=CSI_eHMI_ParkingUI_VLAN62_ADCC/CEG_eHMI_ParkingUI_Eventgroup_VLAN62_ADCC, routing-group=SoAdRG_eHMI_ParkingUI_Eventgroup_VLAN62_eHMI_ParkingUI, sd-server-config=ttl=16777215
                PSI_eHMI_DVRSet_1_VLAN62_ICC_8155_Android: routing-group=SoAdRG_eHMI_DVRSet_VLAN62, service-identifier=43423
                  event handler EH_eHMI_DVRSet_EventGroup_VLAN62_ICC_8155_Android: consumed-event-group=CEG_eHMI_DVRSet_EventGroup_VLAN62_FCM, routing-group=SoAdRG_eHMI_DVRSet_EventGroup_VLAN62_eHMI_DVRSet, sd-server-config=ttl=16777215
                PSI_ICC_Aom_1_VLAN62_ICC_8155_Android: routing-group=SoAdRG_ICC_Aom_VLAN62, service-identifier=44036
                  event handler EH_ICC_Aom_Eventgroup_VLAN62_ICC_8155_Android_1: consumed-event-group=CSI_ICC_Aom_VLAN62_ADCC/CEG_ICC_Aom_Eventgroup_VLAN62_ADCC, routing-group=SoAdRG_ICC_Aom_Eventgroup_VLAN62_ICC_Aom, sd-server-config=ttl=16777215
                PSI_ICC_SDmapInfo_2_1_VLAN62_ICC_8155_Android: routing-group=SoAdRG_ICC_SDmapInfo_2_VLAN62, service-identifier=44044
                  event handler EH_ICC_SDmapInfo_2_EventGroup_VLAN62_ICC_8155_Android_1: consumed-event-group=[CSI_ICC_SDmapInfo_2_VLAN62_ADCC/CEG_ICC_SDmapInfo_2_EventGroup_VLAN62_ADCC, CSI_ICC_SDmapInfo_2_VLAN62_FCM/CEG_ICC_SDmapInfo_2_EventGroup_VLAN62_FCM], routing-group=SoAdRG_ICC_SDmapInfo_2_EventGroup_VLAN62_ICC_SDmapInfo_2, sd-server-config=ttl=16777215
          SDSoAddr_VLAN62_ADCC: connector=LianJieDian_ADCC_SwitchEEI_In_VLAN62
            application endpoint SDAEP_VLAN62_ADCC: network-endpoint=LianJieDian_ADCC_SwitchNEP, tp-configuration=udp-tp=udp-tp-port=port-number=30490
          SoAddr_VLAN62_ADCC_UDP_30501: connector=LianJieDian_ADCC_SwitchEEI_In_VLAN62
            application endpoint AEP_VLAN62_ADCC_UDP_30501: network-endpoint=LianJieDian_ADCC_SwitchNEP, tp-configuration=udp-tp=udp-tp-port=port-number=30501
              10 x consumed service instance, all with sd-client-config={client-service-major-version=1, client-service-minor-version=1, initial-find-behavior={initial-delay-max-value=0.1, initial-delay-min-value=0.0, initial-repetitions-base-delay=0.03, initial-repetitions-max=3}, request-response-delay={max-value=0.0, min-value=0.0}, ttl=3}:
                CSI_eHMI_ParkingUI_VLAN62_ADCC: routing-group=SoAdRG_eHMI_ParkingUI_VLAN62, provided-service-instance=AEP_VLAN62_ICC_8155_Android_UDP_30500/PSI_eHMI_ParkingUI_1_VLAN62_ICC_8155_Android
                  consumed event group CEG_eHMI_ParkingUI_Eventgroup_VLAN62_ADCC: event-group-identifier=1, routing-group=SoAdRG_eHMI_ParkingUI_Eventgroup_VLAN62_eHMI_ParkingUI, sd-client-config=ttl=16777215
                CSI_eHMI_ADASSetting_VLAN62_ADCC: routing-group=SoAdRG_eHMI_ADASSetting_VLAN62, provided-service-instance=PSI_eHMI_ADASSetting_1_VLAN62_ICC_8155_Android
                  consumed event group CEG_eHMI_ADASSetting_Eventgroup_VLAN62_ADCC: event-group-identifier=1, routing-group=SoAdRG_eHMI_ADASSetting_Eventgroup_VLAN62_eHMI_ADASSetting, sd-client-config=ttl=16777215
                CSI_TBOX_SystemInfo_VLAN62_ADCC: routing-group=SoAdRG_TBOX_SystemInfo_VLAN62, provided-service-instance=PSI_TBOX_SystemInfo_1_VLAN62_TBOX
                  consumed event group CEG_TBOXSystemInfo_EventGroup_VLAN62_ADCC: event-group-identifier=1, routing-group=SoAdRG_TBOXSystemInfo_EventGroup_VLAN62_TBOX_SystemInfo, sd-client-config=ttl=16777215
                CSI_TBOX_GNSSInfo_VLAN62_ADCC: routing-group=SoAdRG_TBOX_GNSSInfo_VLAN62, provided-service-instance=AEP_VLAN62_TBOX_UDP_30500/PSI_TBOX_GNSSInfo_1_VLAN62_TBOX
                  consumed event group CEG_GNSSInfo_EventGroup_VLAN62_ADCC: event-group-identifier=1, routing-group=SoAdRG_GNSSInfo_EventGroup_VLAN62_TBOX_GNSSInfo, sd-client-config=ttl=16777215
                CSI_ICC_Aom_VLAN62_ADCC: routing-group=SoAdRG_ICC_Aom_VLAN62, provided-service-instance=AEP_VLAN62_ICC_8155_Android_UDP_30500/PSI_ICC_Aom_1_VLAN62_ICC_8155_Android
                  consumed event group CEG_ICC_Aom_Eventgroup_VLAN62_ADCC: event-group-identifier=1, routing-group=SoAdRG_ICC_Aom_Eventgroup_VLAN62_ICC_Aom, sd-client-config=ttl=16777215
                CSI_ICC_SDmapInfo_VLAN62_ADCC: routing-group=SoAdRG_ICC_SDmapInfo_VLAN62, provided-service-instance=PSI_ICC_SDmapInfo_1_VLAN62_ICC_8155_Android
                  consumed event group CEG_ICC_SDmapInfo_EventGroup_VLAN62_ADCC: event-group-identifier=1, routing-group=SoAdRG_ICC_SDmapInfo_EventGroup_VLAN62_ICC_SDmapInfo, sd-client-config=ttl=16777215
                CSI_ICC_SDmapInfo_2_VLAN62_ADCC: routing-group=SoAdRG_ICC_SDmapInfo_2_VLAN62, provided-service-instance=AEP_VLAN62_ICC_8155_Android_UDP_30500/PSI_ICC_SDmapInfo_2_1_VLAN62_ICC_8155_Android
                  consumed event group CEG_ICC_SDmapInfo_2_EventGroup_VLAN62_ADCC: event-group-identifier=1, routing-group=SoAdRG_ICC_SDmapInfo_2_EventGroup_VLAN62_ICC_SDmapInfo_2, sd-client-config=ttl=16777215
                CSI_FCM_UUID_VLAN62_ADCC: routing-group=SoAdRG_FCM_UUID_VLAN62, provided-service-instance=PSI_FCM_UUID_1_VLAN62_FCM
                CSI_LCM_ADCC_RawData_VLAN62_ADCC: routing-group=SoAdRG_LCM_ADCC_RawData_VLAN62, provided-service-instance=PSI_LCM_ADCC_RawData_1_VLAN62_LCM
                  consumed event group CEG_LCM_ADCC_RawData_Eventgroup_VLAN62_ADCC: event-group-identifier=1, routing-group=SoAdRG_LCM_ADCC_RawData_Eventgroup_VLAN62_LCM_ADCC_RawData, sd-client-config=ttl=16777215
                CSI_TBOX_SystemInfo_ICC_VLAN62_ADCC: routing-group=SoAdRG_TBOX_SystemInfo_ICC_VLAN62, provided-service-instance=PSI_TBOX_SystemInfo_ICC_1_VLAN62_ICC_8155_QNX
                  consumed event group CEG_TBOXSystemInfo_EventGroup_VLAN62_ADCC: event-group-identifier=1, routing-group=SoAdRG_TBOXSystemInfo_EventGroup_VLAN62_TBOX_SystemInfo_ICC, sd-client-config=ttl=16777215
          SoAddr_VLAN62_ADCC_TCP_30501: connector=LianJieDian_ADCC_SwitchEEI_In_VLAN62
            application endpoint AEP_VLAN62_ADCC_TCP_30501: network-endpoint=LianJieDian_ADCC_SwitchNEP, tp-configuration=tcp-tp=tcp-tp-port=port-number=30501
              4 x consumed service instance, all with sd-client-config={client-service-major-version=1, client-service-minor-version=1, initial-find-behavior={initial-delay-max-value=0.1, initial-delay-min-value=0.0, initial-repetitions-base-delay=0.03, initial-repetitions-max=3}, request-response-delay={max-value=0.0, min-value=0.0}, ttl=3}:
                CSI_eHMI_ParkingUI_VLAN62_ADCC: routing-group=SoAdRG_eHMI_ParkingUI_VLAN62, provided-service-instance=AEP_VLAN62_ICC_8155_Android_TCP_30500/PSI_eHMI_ParkingUI_1_VLAN62_ICC_8155_Android
                  consumed event group CEG_eHMI_ParkingUI_Eventgroup_VLAN62_ADCC: event-group-identifier=1, routing-group=SoAdRG_eHMI_ParkingUI_Eventgroup_VLAN62_eHMI_ParkingUI, sd-client-config=ttl=16777215
                CSI_TBOX_GNSSInfo_VLAN62_ADCC: routing-group=SoAdRG_TBOX_GNSSInfo_VLAN62, provided-service-instance=AEP_VLAN62_TBOX_TCP_30500/PSI_TBOX_GNSSInfo_1_VLAN62_TBOX
                  consumed event group CEG_GNSSInfo_EventGroup_VLAN62_ADCC: event-group-identifier=1, routing-group=SoAdRG_GNSSInfo_EventGroup_VLAN62_TBOX_GNSSInfo, sd-client-config=ttl=16777215
                CSI_ICC_Aom_VLAN62_ADCC: routing-group=SoAdRG_ICC_Aom_VLAN62, provided-service-instance=AEP_VLAN62_ICC_8155_Android_TCP_30500/PSI_ICC_Aom_1_VLAN62_ICC_8155_Android
                  consumed event group CEG_ICC_Aom_Eventgroup_VLAN62_ADCC: event-group-identifier=1, routing-group=SoAdRG_ICC_Aom_Eventgroup_VLAN62_ICC_Aom, sd-client-config=ttl=16777215
                CSI_ICC_SDmapInfo_2_VLAN62_ADCC: routing-group=SoAdRG_ICC_SDmapInfo_2_VLAN62, provided-service-instance=AEP_VLAN62_ICC_8155_Android_TCP_30500/PSI_ICC_SDmapInfo_2_1_VLAN62_ICC_8155_Android
                  consumed event group CEG_ICC_SDmapInfo_2_EventGroup_VLAN62_ADCC: event-group-identifier=1, routing-group=SoAdRG_ICC_SDmapInfo_2_EventGroup_VLAN62_ICC_SDmapInfo_2, sd-client-config=ttl=16777215
          SDSoAddr_VLAN62_FCM: connector=LianJieDian_FCM_SwitchEEI_In_VLAN62
            application endpoint SDAEP_VLAN62_FCM: network-endpoint=LianJieDian_FCM_SwitchNEP, tp-configuration=udp-tp=udp-tp-port=port-number=30490
          SoAddr_VLAN62_FCM_UDP_30501: connector=LianJieDian_FCM_SwitchEEI_In_VLAN62
            application endpoint AEP_VLAN62_FCM_UDP_30501: network-endpoint=LianJieDian_FCM_SwitchNEP, tp-configuration=udp-tp=udp-tp-port=port-number=30501
              4 x consumed service instance, all with sd-client-config={client-service-major-version=1, client-service-minor-version=1, initial-find-behavior={initial-delay-max-value=0.1, initial-delay-min-value=0.0, initial-repetitions-base-delay=0.03, initial-repetitions-max=3}, request-response-delay={max-value=0.0, min-value=0.0}, ttl=3}:
                CSI_eHMI_ADASSetting_VLAN62_FCM: routing-group=SoAdRG_eHMI_ADASSetting_VLAN62, provided-service-instance=PSI_eHMI_ADASSetting_1_VLAN62_ICC_8155_Android
                  consumed event group CEG_eHMI_ADASSetting_Eventgroup_VLAN62_FCM: event-group-identifier=1, routing-group=SoAdRG_eHMI_ADASSetting_Eventgroup_VLAN62_eHMI_ADASSetting, sd-client-config=ttl=16777215
                CSI_ICC_SDmapInfo_VLAN62_FCM: routing-group=SoAdRG_ICC_SDmapInfo_VLAN62, provided-service-instance=PSI_ICC_SDmapInfo_1_VLAN62_ICC_8155_Android
                  consumed event group CEG_ICC_SDmapInfo_EventGroup_VLAN62_FCM: event-group-identifier=1, routing-group=SoAdRG_ICC_SDmapInfo_EventGroup_VLAN62_ICC_SDmapInfo, sd-client-config=ttl=16777215
                CSI_ICC_SDmapInfo_2_VLAN62_FCM: routing-group=SoAdRG_ICC_SDmapInfo_2_VLAN62, provided-service-instance=AEP_VLAN62_ICC_8155_Android_UDP_30500/PSI_ICC_SDmapInfo_2_1_VLAN62_ICC_8155_Android
                  consumed event group CEG_ICC_SDmapInfo_2_EventGroup_VLAN62_FCM: event-group-identifier=1, routing-group=SoAdRG_ICC_SDmapInfo_2_EventGroup_VLAN62_ICC_SDmapInfo_2, sd-client-config=ttl=16777215
                CSI_IVI_UnixTimestamp_VLAN62_FCM: routing-group=SoAdRG_IVI_UnixTimestamp_VLAN62, provided-service-instance=PSI_IVI_UnixTimestamp_1_VLAN62_ICC_8155_Android
                  consumed event group CEG_UnixTimestamp_Eventgroup_VLAN62_FCM: event-group-identifier=1, routing-group=SoAdRG_UnixTimestamp_Eventgroup_VLAN62_IVI_UnixTimestamp, sd-client-config=ttl=16777215
          SoAddr_VLAN62_FCM_TCP_30501: connector=LianJieDian_FCM_SwitchEEI_In_VLAN62
            application endpoint AEP_VLAN62_FCM_TCP_30501: network-endpoint=LianJieDian_FCM_SwitchNEP, tp-configuration=tcp-tp=tcp-tp-port=port-number=30501
              consumed service instance CSI_eHMI_DVRSet_VLAN62_FCM: routing-group=SoAdRG_eHMI_DVRSet_VLAN62, provided-service-instance=PSI_eHMI_DVRSet_1_VLAN62_ICC_8155_Android, sd-client-config={client-service-major-version=1, client-service-minor-version=1, initial-find-behavior={initial-delay-max-value=0.1, initial-delay-min-value=0.0, initial-repetitions-base-delay=0.03, initial-repetitions-max=3}, request-response-delay={max-value=0.0, min-value=0.0}, ttl=3}
                consumed event group CEG_eHMI_DVRSet_EventGroup_VLAN62_FCM: event-group-identifier=1, routing-group=SoAdRG_eHMI_DVRSet_EventGroup_VLAN62_eHMI_DVRSet, sd-client-config=ttl=16777215
              consumed service instance CSI_ICC_SDmapInfo_2_VLAN62_FCM:
                routing-group=SoAdRG_ICC_SDmapInfo_2_VLAN62
                provided-service-instance=AEP_VLAN62_ICC_8155_Android_TCP_30500/PSI_ICC_SDmapInfo_2_1_VLAN62_ICC_8155_Android
                sd-client-config={client-service-major-version=1, client-service-minor-version=1, initial-find-behavior={initial-delay-max-value=0.1, initial-delay-min-value=0.0, initial-repetitions-base-delay=0.03, initial-repetitions-max=3}, request-response-delay={max-value=0.0, min-value=0.0}, ttl=3}
                consumed event group CEG_ICC_SDmapInfo_2_EventGroup_VLAN62_FCM: event-group-identifier=1, routing-group=SoAdRG_ICC_SDmapInfo_2_EventGroup_VLAN62_ICC_SDmapInfo_2, sd-client-config=ttl=16777215
          SDSoAddr_VLAN62_TBOX: connector=LianJieDian_TBOX_SwitchEEI_In_VLAN62
            application endpoint SDAEP_VLAN62_TBOX: network-endpoint=LianJieDian_TBOX_SwitchNEP, tp-configuration=udp-tp=udp-tp-port=port-number=30490
          SoAddr_VLAN62_TBOX_UDP_30500: connector=LianJieDian_TBOX_SwitchEEI_In_VLAN62
            application endpoint AEP_VLAN62_TBOX_UDP_30500: network-endpoint=LianJieDian_TBOX_SwitchNEP, tp-configuration=udp-tp=udp-tp-port=port-number=30500
              7 x provided service instance, all with instance-identifier=1, sd-server-config={initial-offer-behavior={initial-delay-max-value=0.1, initial-delay-min-value=0.0, initial-repetitions-base-delay=0.03, initial-repetitions-max=3}, offer-cyclic-delay=1.0, request-response-delay={max-value=0.0, min-value=0.0}, server-service-major-version=1, server-service-minor-version=1, ttl=3}:
                PSI_TBOX_TimeManagement_1_VLAN62_TBOX: routing-group=SoAdRG_TBOX_TimeManagement_VLAN62, service-identifier=43522
                  event handler EH_TBOX_TimeManagement_EventGroup_VLAN62_TBOX: consumed-event-group=CEG_TBOX_TimeManagement_EventGroup_VLAN62_ICC_8155_Android, routing-group=SoAdRG_TBOX_TimeManagement_EventGroup_VLAN62_TBOX_TimeManagement, sd-server-config=ttl=16777215
                PSI_TBOX_ResSwtSts_1_VLAN62_TBOX: routing-group=SoAdRG_TBOX_ResSwtSts_VLAN62, service-identifier=43529
                  event handler EH_TBOX_ResSwtSts_EventGroup_VLAN62_TBOX: consumed-event-group=CSI_TBOX_ResSwtSts_VLAN62_ICC_8155_Android/CEG_TBOX_ResSwtSts_EventGroup_VLAN62_ICC_8155_Android, routing-group=SoAdRG_TBOX_ResSwtSts_EventGroup_VLAN62_TBOX_ResSwtSts, sd-server-config=ttl=16777215
                PSI_TBOX_SystemInfo_1_VLAN62_TBOX: routing-group=SoAdRG_TBOX_SystemInfo_VLAN62, service-identifier=43530
                  event handler EH_TBOXSystemInfo_EventGroup_VLAN62_TBOX: consumed-event-group=[CSI_TBOX_SystemInfo_VLAN62_ADCC/CEG_TBOXSystemInfo_EventGroup_VLAN62_ADCC, CEG_TBOXSystemInfo_EventGroup_VLAN62_LCM, CEG_TBOXSystemInfo_EventGroup_VLAN62_ICC_8155_Android], routing-group=SoAdRG_TBOXSystemInfo_EventGroup_VLAN62_TBOX_SystemInfo, sd-server-config=ttl=16777215
                PSI_TBOX_BEICALL_1_VLAN62_TBOX: routing-group=SoAdRG_TBOX_BEICALL_VLAN62, service-identifier=43531
                  event handler EH_BEICALL_EventGroup_VLAN62_TBOX: consumed-event-group=CEG_BEICALL_EventGroup_VLAN62_ICC_8155_Android, routing-group=SoAdRG_BEICALL_EventGroup_VLAN62_TBOX_BEICALL, sd-server-config=ttl=16777215
                PSI_TBOX_USBUpdate_1_VLAN62_TBOX: routing-group=SoAdRG_TBOX_USBUpdate_VLAN62, service-identifier=43532
                  event handler EH_USBUpdate_EventGroup_VLAN62_TBOX: consumed-event-group=CEG_USBUpdate_EventGroup_VLAN62_ICC_8155_Android, routing-group=SoAdRG_USBUpdate_EventGroup_VLAN62_TBOX_USBUpdate, sd-server-config=ttl=16777215
                PSI_TBOX_USBTBOXlog_1_VLAN62_TBOX: routing-group=SoAdRG_TBOX_USBTBOXlog_VLAN62, service-identifier=43533
                PSI_TBOX_GNSSInfo_1_VLAN62_TBOX: routing-group=SoAdRG_TBOX_GNSSInfo_VLAN62, service-identifier=43534
                  event handler EH_GNSSInfo_EventGroup_VLAN62_TBOX: consumed-event-group=[CSI_TBOX_GNSSInfo_VLAN62_ICC_8155_Android/CEG_GNSSInfo_EventGroup_VLAN62_ICC_8155_Android, CSI_TBOX_GNSSInfo_VLAN62_ADCC/CEG_GNSSInfo_EventGroup_VLAN62_ADCC], routing-group=SoAdRG_GNSSInfo_EventGroup_VLAN62_TBOX_GNSSInfo, sd-server-config=ttl=16777215
          SoAddr_VLAN62_ICC_8155_Android_UDP_30501: connector=LianJieDian_ICC_8155_Android_SwitchEEI_In_VLAN62
            application endpoint AEP_VLAN62_ICC_8155_Android_UDP_30501: network-endpoint=LianJieDian_ICC_8155_Android_SwitchNEP, tp-configuration=udp-tp=udp-tp-port=port-number=30501
              23 x consumed service instance, all with sd-client-config={client-service-major-version=1, client-service-minor-version=1, initial-find-behavior={initial-delay-max-value=0.1, initial-delay-min-value=0.0, initial-repetitions-base-delay=0.03, initial-repetitions-max=3}, request-response-delay={max-value=0.0, min-value=0.0}, ttl=3}:
                CSI_TBOX_TimeManagement_VLAN62_ICC_8155_Android: routing-group=SoAdRG_TBOX_TimeManagement_VLAN62, provided-service-instance=PSI_TBOX_TimeManagement_1_VLAN62_TBOX
                  consumed event group CEG_TBOX_TimeManagement_EventGroup_VLAN62_ICC_8155_Android: event-group-identifier=1, routing-group=SoAdRG_TBOX_TimeManagement_EventGroup_VLAN62_TBOX_TimeManagement, sd-client-config=ttl=16777215
                CSI_TBOX_ResSwtSts_VLAN62_ICC_8155_Android: routing-group=SoAdRG_TBOX_ResSwtSts_VLAN62, provided-service-instance=AEP_VLAN62_TBOX_UDP_30500/PSI_TBOX_ResSwtSts_1_VLAN62_TBOX
                  consumed event group CEG_TBOX_ResSwtSts_EventGroup_VLAN62_ICC_8155_Android: event-group-identifier=1, routing-group=SoAdRG_TBOX_ResSwtSts_EventGroup_VLAN62_TBOX_ResSwtSts, sd-client-config=ttl=16777215
                CSI_TBOX_SystemInfo_VLAN62_ICC_8155_Android: routing-group=SoAdRG_TBOX_SystemInfo_VLAN62, provided-service-instance=PSI_TBOX_SystemInfo_1_VLAN62_TBOX
                  consumed event group CEG_TBOXSystemInfo_EventGroup_VLAN62_ICC_8155_Android: event-group-identifier=1, routing-group=SoAdRG_TBOXSystemInfo_EventGroup_VLAN62_TBOX_SystemInfo, sd-client-config=ttl=16777215
                CSI_TBOX_BEICALL_VLAN62_ICC_8155_Android: routing-group=SoAdRG_TBOX_BEICALL_VLAN62, provided-service-instance=PSI_TBOX_BEICALL_1_VLAN62_TBOX
                  consumed event group CEG_BEICALL_EventGroup_VLAN62_ICC_8155_Android: event-group-identifier=1, routing-group=SoAdRG_BEICALL_EventGroup_VLAN62_TBOX_BEICALL, sd-client-config=ttl=16777215
                CSI_TBOX_USBUpdate_VLAN62_ICC_8155_Android: routing-group=SoAdRG_TBOX_USBUpdate_VLAN62, provided-service-instance=PSI_TBOX_USBUpdate_1_VLAN62_TBOX
                  consumed event group CEG_USBUpdate_EventGroup_VLAN62_ICC_8155_Android: event-group-identifier=1, routing-group=SoAdRG_USBUpdate_EventGroup_VLAN62_TBOX_USBUpdate, sd-client-config=ttl=16777215
                CSI_TBOX_USBTBOXlog_VLAN62_ICC_8155_Android: routing-group=SoAdRG_TBOX_USBTBOXlog_VLAN62, provided-service-instance=PSI_TBOX_USBTBOXlog_1_VLAN62_TBOX
                CSI_TBOX_GNSSInfo_VLAN62_ICC_8155_Android: routing-group=SoAdRG_TBOX_GNSSInfo_VLAN62, provided-service-instance=AEP_VLAN62_TBOX_UDP_30500/PSI_TBOX_GNSSInfo_1_VLAN62_TBOX
                  consumed event group CEG_GNSSInfo_EventGroup_VLAN62_ICC_8155_Android: event-group-identifier=1, routing-group=SoAdRG_GNSSInfo_EventGroup_VLAN62_TBOX_GNSSInfo, sd-client-config=ttl=16777215
                CSI_ADCC_DrivingHmiEnv_VLAN62_ICC_8155_Android: routing-group=SoAdRG_ADCC_DrivingHmiEnv_VLAN62, provided-service-instance=AEP_VLAN62_ADCC_UDP_30500/PSI_ADCC_DrivingHmiEnv_1_VLAN62_ADCC
                  consumed event group CEG_ADCC_DrivingHmiEnv_Eventgroup_VLAN62_ICC_8155_Android: event-group-identifier=1, routing-group=SoAdRG_ADCC_DrivingHmiEnv_Eventgroup_VLAN62_ADCC_DrivingHmiEnv, sd-client-config=ttl=16777215
                CSI_ADCC_SensorInfo_VLAN62_ICC_8155_Android: routing-group=SoAdRG_ADCC_SensorInfo_VLAN62, provided-service-instance=PSI_ADCC_SensorInfo_1_VLAN62_ADCC
                  consumed event group CEG_ADCC_SensorInfo_Eventgroup_VLAN62_ICC_8155_Android: event-group-identifier=1, routing-group=SoAdRG_ADCC_SensorInfo_Eventgroup_VLAN62_ADCC_SensorInfo, sd-client-config=ttl=16777215
                CSI_ADCC_DrivingFuncInfo_VLAN62_ICC_8155_Android: routing-group=SoAdRG_ADCC_DrivingFuncInfo_VLAN62, provided-service-instance=AEP_VLAN62_ADCC_UDP_30500/PSI_ADCC_DrivingFuncInfo_1_VLAN62_ADCC
                  consumed event group CEG_ADCC_DrivingFuncInfo_Eventgroup_VLAN62_ICC_8155_Android: event-group-identifier=1, routing-group=SoAdRG_ADCC_DrivingFuncInfo_Eventgroup_VLAN62_ADCC_DrivingFuncInfo, sd-client-config=ttl=16777215
                CSI_ADCC_ParkingFuncInfo_VLAN62_ICC_8155_Android: routing-group=SoAdRG_ADCC_ParkingFuncInfo_VLAN62, provided-service-instance=AEP_VLAN62_ADCC_UDP_30500/PSI_ADCC_ParkingFuncInfo_1_VLAN62_ADCC
                  consumed event group CEG_ADAS_ParkingFuncInfo_Eventgroup_VLAN62_ICC_8155_Android: event-group-identifier=1, routing-group=SoAdRG_ADAS_ParkingFuncInfo_Eventgroup_VLAN62_ADCC_ParkingFuncInfo, sd-client-config=ttl=16777215
                CSI_ADCC_ParkingHmiEnv_VLAN62_ICC_8155_Android: routing-group=SoAdRG_ADCC_ParkingHmiEnv_VLAN62, provided-service-instance=AEP_VLAN62_ADCC_UDP_30500/PSI_ADCC_ParkingHmiEnv_1_VLAN62_ADCC
                  consumed event group CEG_ADCC_ParkingHmiEnv_Eventgroup_VLAN62_ICC_8155_Android: event-group-identifier=1, routing-group=SoAdRG_ADCC_ParkingHmiEnv_Eventgroup_VLAN62_ADCC_ParkingHmiEnv, sd-client-config=ttl=16777215
                CSI_FCM_DrivingHmiEnv_VLAN62_ICC_8155_Android: routing-group=SoAdRG_FCM_DrivingHmiEnv_VLAN62, provided-service-instance=AEP_VLAN62_FCM_UDP_30500/PSI_FCM_DrivingHmiEnv_1_VLAN62_FCM
                  consumed event group CEG_FCM_DrivingHmiEnv_Eventgroup_VLAN62_ICC_8155_Android: event-group-identifier=1, routing-group=SoAdRG_FCM_DrivingHmiEnv_Eventgroup_VLAN62_FCM_DrivingHmiEnv, sd-client-config=ttl=16777215
                CSI_FCM_ActiveSafetyInfo_VLAN62_ICC_8155_Android: routing-group=SoAdRG_FCM_ActiveSafetyInfo_VLAN62, provided-service-instance=PSI_FCM_ActiveSafetyInfo_1_VLAN62_FCM
                  consumed event group CEG_FCM_ActiveSafetyInfo_Eventgroup_VLAN62_ICC_8155_Android: event-group-identifier=1, routing-group=SoAdRG_FCM_ActiveSafetyInfo_Eventgroup_VLAN62_FCM_ActiveSafetyInfo, sd-client-config=ttl=16777215
                CSI_FCM_DrivingFuncInfo_VLAN62_ICC_8155_Android: routing-group=SoAdRG_FCM_DrivingFuncInfo_VLAN62, provided-service-instance=PSI_FCM_DrivingFuncInfo_1_VLAN62_FCM
                  consumed event group CEG_FCM_DrivingFuncInfo_Eventgroup_VLAN62_ICC_8155_Android: event-group-identifier=1, routing-group=SoAdRG_FCM_DrivingFuncInfo_Eventgroup_VLAN62_FCM_DrivingFuncInfo, sd-client-config=ttl=16777215
                CSI_FCM_DVRSts_VLAN62_ICC_8155_Android: routing-group=SoAdRG_FCM_DVRSts_VLAN62, provided-service-instance=PSI_FCM_DVRSts_1_VLAN62_FCM
                  consumed event group CEG_FCM_DVRSts_Eventgroup_VLAN62_ICC_8155_Android: event-group-identifier=1, routing-group=SoAdRG_FCM_DVRSts_Eventgroup_VLAN62_FCM_DVRSts, sd-client-config=ttl=16777215
                CSI_FCM_UUID_VLAN62_ICC_8155_Android: routing-group=SoAdRG_FCM_UUID_VLAN62, provided-service-instance=PSI_FCM_UUID_1_VLAN62_FCM
                CSI_ADCC_ActiveSafetyInfo_VLAN62_ICC_8155_Android: routing-group=SoAdRG_ADCC_ActiveSafetyInfo_VLAN62, provided-service-instance=PSI_ADCC_ActiveSafetyInfo_1_VLAN62_ADCC
                  consumed event group CEG_ADCC_ActiveSafetyInfo_Eventgroup_VLAN62_ICC_8155_Android: event-group-identifier=1, routing-group=SoAdRG_ADCC_ActiveSafetyInfo_Eventgroup_VLAN62_ADCC_ActiveSafetyInfo, sd-client-config=ttl=16777215
                CSI_ADCC_UUID_VLAN62_ICC_8155_Android: routing-group=SoAdRG_ADCC_UUID_VLAN62, provided-service-instance=PSI_ADCC_UUID_1_VLAN62_ADCC
                CSI_FCM_SensorInfo_VLAN62_ICC_8155_Android: routing-group=SoAdRG_FCM_SensorInfo_VLAN62, provided-service-instance=PSI_FCM_SensorInfo_1_VLAN62_FCM
                  consumed event group CEG_FCM_SensorInfo_Eventgroup_VLAN62_ICC_8155_Android: event-group-identifier=1, routing-group=SoAdRG_FCM_SensorInfo_Eventgroup_VLAN62_FCM_SensorInfo, sd-client-config=ttl=16777215
                CSI_ADCC_DVRSts_VLAN62_ICC_8155_Android: routing-group=SoAdRG_ADCC_DVRSts_VLAN62, provided-service-instance=PSI_ADCC_DVRSts_1_VLAN62_ADCC
                  consumed event group CEG_ADCC_DVRSts_Eventgroup_VLAN62_ICC_8155_Android: event-group-identifier=1, routing-group=SoAdRG_ADCC_DVRSts_Eventgroup_VLAN62_ADCC_DVRSts, sd-client-config=ttl=16777215
                CSI_ADAS_DataInLoop_VLAN62_ICC_8155_Android: routing-group=SoAdRG_ADAS_DataInLoop_VLAN62, provided-service-instance=PSI_ADAS_DataInLoop_1_VLAN62_FCM
                  consumed event group CEG_DataInLoop_Eventgroup_VLAN62_ICC_8155_Android: event-group-identifier=1, routing-group=SoAdRG_DataInLoop_Eventgroup_VLAN62_ADAS_DataInLoop, sd-client-config=ttl=16777215
                CSI_ADAS_GNSSInfo_VLAN62_ICC_8155_Android: routing-group=SoAdRG_ADAS_GNSSInfo_VLAN62, provided-service-instance=AEP_VLAN62_ADCC_UDP_30500/PSI_ADAS_GNSSInfo_1_VLAN62_ADCC
                  consumed event group CEG_ADAS_GNSSInfo_Eventgroup_VLAN62_ICC_8155_Android: event-group-identifier=1, routing-group=SoAdRG_ADAS_GNSSInfo_Eventgroup_VLAN62_ADAS_GNSSInfo, sd-client-config=ttl=16777215
          SoAddr_VLAN62_TBOX_TCP_30500: connector=LianJieDian_TBOX_SwitchEEI_In_VLAN62
            application endpoint AEP_VLAN62_TBOX_TCP_30500: network-endpoint=LianJieDian_TBOX_SwitchNEP, tp-configuration=tcp-tp=tcp-tp-port=port-number=30500
              provided service instance PSI_TBOX_ResSwtSts_1_VLAN62_TBOX:
                routing-group=SoAdRG_TBOX_ResSwtSts_VLAN62
                instance-identifier=1
                sd-server-config={initial-offer-behavior={initial-delay-max-value=0.1, initial-delay-min-value=0.0, initial-repetitions-base-delay=0.03, initial-repetitions-max=3}, offer-cyclic-delay=1.0, request-response-delay={max-value=0.0, min-value=0.0}, server-service-major-version=1, server-service-minor-version=1, ttl=3}
                service-identifier=43529
                event handler EH_TBOX_ResSwtSts_EventGroup_VLAN62_TBOX_1: consumed-event-group=CSI_TBOX_ResSwtSts_VLAN62_ICC_8155_Android/CEG_TBOX_ResSwtSts_EventGroup_VLAN62_ICC_8155_Android, routing-group=SoAdRG_TBOX_ResSwtSts_EventGroup_VLAN62_TBOX_ResSwtSts, sd-server-config=ttl=16777215
              provided service instance PSI_TBOX_GNSSInfo_1_VLAN62_TBOX: routing-group=SoAdRG_TBOX_GNSSInfo_VLAN62, instance-identifier=1, sd-server-config={initial-offer-behavior={initial-delay-max-value=0.1, initial-delay-min-value=0.0, initial-repetitions-base-delay=0.03, initial-repetitions-max=3}, offer-cyclic-delay=1.0, request-response-delay={max-value=0.0, min-value=0.0}, server-service-major-version=1, server-service-minor-version=1, ttl=3}, service-identifier=43534
                event handler EH_GNSSInfo_EventGroup_VLAN62_TBOX_1: consumed-event-group=[CSI_TBOX_GNSSInfo_VLAN62_ICC_8155_Android/CEG_GNSSInfo_EventGroup_VLAN62_ICC_8155_Android, CSI_TBOX_GNSSInfo_VLAN62_ADCC/CEG_GNSSInfo_EventGroup_VLAN62_ADCC], routing-group=SoAdRG_GNSSInfo_EventGroup_VLAN62_TBOX_GNSSInfo, sd-server-config=ttl=16777215
          SoAddr_VLAN62_ICC_8155_Android_TCP_30501: connector=LianJieDian_ICC_8155_Android_SwitchEEI_In_VLAN62
            application endpoint AEP_VLAN62_ICC_8155_Android_TCP_30501: network-endpoint=LianJieDian_ICC_8155_Android_SwitchNEP, tp-configuration=tcp-tp=tcp-tp-port=port-number=30501
              11 x consumed service instance, all with sd-client-config={client-service-major-version=1, client-service-minor-version=1, initial-find-behavior={initial-delay-max-value=0.1, initial-delay-min-value=0.0, initial-repetitions-base-delay=0.03, initial-repetitions-max=3}, request-response-delay={max-value=0.0, min-value=0.0}, ttl=3}:
                CSI_TBOX_ResSwtSts_VLAN62_ICC_8155_Android: routing-group=SoAdRG_TBOX_ResSwtSts_VLAN62, provided-service-instance=AEP_VLAN62_TBOX_TCP_30500/PSI_TBOX_ResSwtSts_1_VLAN62_TBOX
                  consumed event group CEG_TBOX_ResSwtSts_EventGroup_VLAN62_ICC_8155_Android: event-group-identifier=1, routing-group=SoAdRG_TBOX_ResSwtSts_EventGroup_VLAN62_TBOX_ResSwtSts, sd-client-config=ttl=16777215
                CSI_TBOX_GNSSInfo_VLAN62_ICC_8155_Android: routing-group=SoAdRG_TBOX_GNSSInfo_VLAN62, provided-service-instance=AEP_VLAN62_TBOX_TCP_30500/PSI_TBOX_GNSSInfo_1_VLAN62_TBOX
                  consumed event group CEG_GNSSInfo_EventGroup_VLAN62_ICC_8155_Android: event-group-identifier=1, routing-group=SoAdRG_GNSSInfo_EventGroup_VLAN62_TBOX_GNSSInfo, sd-client-config=ttl=16777215
                CSI_ADCC_DrivingHmiEnv_VLAN62_ICC_8155_Android: routing-group=SoAdRG_ADCC_DrivingHmiEnv_VLAN62, provided-service-instance=AEP_VLAN62_ADCC_TCP_30500/PSI_ADCC_DrivingHmiEnv_1_VLAN62_ADCC
                  consumed event group CEG_ADCC_DrivingHmiEnv_Eventgroup_VLAN62_ICC_8155_Android: event-group-identifier=1, routing-group=SoAdRG_ADCC_DrivingHmiEnv_Eventgroup_VLAN62_ADCC_DrivingHmiEnv, sd-client-config=ttl=16777215
                CSI_ADCC_DrivingFuncInfo_VLAN62_ICC_8155_Android: routing-group=SoAdRG_ADCC_DrivingFuncInfo_VLAN62, provided-service-instance=AEP_VLAN62_ADCC_TCP_30500/PSI_ADCC_DrivingFuncInfo_1_VLAN62_ADCC
                  consumed event group CEG_ADCC_DrivingFuncInfo_Eventgroup_VLAN62_ICC_8155_Android: event-group-identifier=1, routing-group=SoAdRG_ADCC_DrivingFuncInfo_Eventgroup_VLAN62_ADCC_DrivingFuncInfo, sd-client-config=ttl=16777215
                CSI_ADCC_ParkingFuncInfo_VLAN62_ICC_8155_Android: routing-group=SoAdRG_ADCC_ParkingFuncInfo_VLAN62, provided-service-instance=AEP_VLAN62_ADCC_TCP_30500/PSI_ADCC_ParkingFuncInfo_1_VLAN62_ADCC
                  consumed event group CEG_ADAS_ParkingFuncInfo_Eventgroup_VLAN62_ICC_8155_Android: event-group-identifier=1, routing-group=SoAdRG_ADAS_ParkingFuncInfo_Eventgroup_VLAN62_ADCC_ParkingFuncInfo, sd-client-config=ttl=16777215
                CSI_ADCC_ParkingHmiEnv_VLAN62_ICC_8155_Android: routing-group=SoAdRG_ADCC_ParkingHmiEnv_VLAN62, provided-service-instance=AEP_VLAN62_ADCC_TCP_30500/PSI_ADCC_ParkingHmiEnv_1_VLAN62_ADCC
                  consumed event group CEG_ADCC_ParkingHmiEnv_Eventgroup_VLAN62_ICC_8155_Android: event-group-identifier=1, routing-group=SoAdRG_ADCC_ParkingHmiEnv_Eventgroup_VLAN62_ADCC_ParkingHmiEnv, sd-client-config=ttl=16777215
                CSI_ADCC_AomMMSt_VLAN62_ICC_8155_Android: routing-group=SoAdRG_ADCC_AomMMSt_VLAN62, provided-service-instance=PSI_ADCC_AomMMSt_1_VLAN62_ADCC
                  consumed event group CEG_ADCC_AomMMSt_Eventgroup_VLAN62_ICC_8155_Android: event-group-identifier=1, routing-group=SoAdRG_ADCC_AomMMSt_Eventgroup_VLAN62_ADCC_AomMMSt, sd-client-config=ttl=16777215
                CSI_ADCC_AomDB_VLAN62_ICC_8155_Android: routing-group=SoAdRG_ADCC_AomDB_VLAN62, provided-service-instance=PSI_ADCC_AomDB_1_VLAN62_ADCC
                CSI_ADCC_RtMM_VLAN62_ICC_8155_Android: routing-group=SoAdRG_ADCC_RtMM_VLAN62, provided-service-instance=PSI_ADCC_RtMM_1_VLAN62_ADCC
                  consumed event group CEG_ADCC_RtMM_Eventgroup_VLAN62_ICC_8155_Android: event-group-identifier=1, routing-group=SoAdRG_ADCC_RtMM_Eventgroup_VLAN62_ADCC_RtMM, sd-client-config=ttl=16777215
                CSI_FCM_DrivingHmiEnv_VLAN62_ICC_8155_Android: routing-group=SoAdRG_FCM_DrivingHmiEnv_VLAN62, provided-service-instance=AEP_VLAN62_FCM_TCP_30500/PSI_FCM_DrivingHmiEnv_1_VLAN62_FCM
                  consumed event group CEG_FCM_DrivingHmiEnv_Eventgroup_VLAN62_ICC_8155_Android: event-group-identifier=1, routing-group=SoAdRG_FCM_DrivingHmiEnv_Eventgroup_VLAN62_FCM_DrivingHmiEnv, sd-client-config=ttl=16777215
                CSI_ADAS_GNSSInfo_VLAN62_ICC_8155_Android: routing-group=SoAdRG_ADAS_GNSSInfo_VLAN62, provided-service-instance=AEP_VLAN62_ADCC_TCP_30500/PSI_ADAS_GNSSInfo_1_VLAN62_ADCC
                  consumed event group CEG_ADAS_GNSSInfo_Eventgroup_VLAN62_ICC_8155_Android: event-group-identifier=1, routing-group=SoAdRG_ADAS_GNSSInfo_Eventgroup_VLAN62_ADAS_GNSSInfo, sd-client-config=ttl=16777215
          SDSoAddr_VLAN62_LCM: connector=LianJieDian_LCM_SwitchEEI_In_VLAN62
            application endpoint SDAEP_VLAN62_LCM: network-endpoint=LianJieDian_LCM_SwitchNEP, tp-configuration=udp-tp=udp-tp-port=port-number=30490
          SoAddr_VLAN62_LCM_UDP_30501: connector=LianJieDian_LCM_SwitchEEI_In_VLAN62
            application endpoint AEP_VLAN62_LCM_UDP_30501: network-endpoint=LianJieDian_LCM_SwitchNEP, tp-configuration=udp-tp=udp-tp-port=port-number=30501
              consumed service instance CSI_TBOX_SystemInfo_VLAN62_LCM: routing-group=SoAdRG_TBOX_SystemInfo_VLAN62, provided-service-instance=PSI_TBOX_SystemInfo_1_VLAN62_TBOX, sd-client-config={client-service-major-version=1, client-service-minor-version=1, initial-find-behavior={initial-delay-max-value=0.1, initial-delay-min-value=0.0, initial-repetitions-base-delay=0.03, initial-repetitions-max=3}, request-response-delay={max-value=0.0, min-value=0.0}, ttl=3}
                consumed event group CEG_TBOXSystemInfo_EventGroup_VLAN62_LCM: event-group-identifier=1, routing-group=SoAdRG_TBOXSystemInfo_EventGroup_VLAN62_TBOX_SystemInfo, sd-client-config=ttl=16777215
              consumed service instance CSI_FCM_UUID_VLAN62_LCM: routing-group=SoAdRG_FCM_UUID_VLAN62, provided-service-instance=PSI_FCM_UUID_1_VLAN62_FCM, sd-client-config={client-service-major-version=1, client-service-minor-version=1, initial-find-behavior={initial-delay-max-value=0.1, initial-delay-min-value=0.0, initial-repetitions-base-delay=0.03, initial-repetitions-max=3}, request-response-delay={max-value=0.0, min-value=0.0}, ttl=3}
              consumed service instance CSI_ADCC_UUID_VLAN62_LCM: routing-group=SoAdRG_ADCC_UUID_VLAN62, provided-service-instance=PSI_ADCC_UUID_1_VLAN62_ADCC, sd-client-config={client-service-major-version=1, client-service-minor-version=1, initial-find-behavior={initial-delay-max-value=0.1, initial-delay-min-value=0.0, initial-repetitions-base-delay=0.03, initial-repetitions-max=3}, request-response-delay={max-value=0.0, min-value=0.0}, ttl=3}
          SoAddr_VLAN62_TBOX_UDP_30501: connector=LianJieDian_TBOX_SwitchEEI_In_VLAN62
            application endpoint AEP_VLAN62_TBOX_UDP_30501: network-endpoint=LianJieDian_TBOX_SwitchNEP, tp-configuration=udp-tp=udp-tp-port=port-number=30501
              consumed service instance CSI_ICC_Android_OutService_VLAN62_TBOX:
                routing-group=SoAdRG_ICC_Android_OutService_VLAN62
                provided-service-instance=PSI_ICC_Android_OutService_1_VLAN62_ICC_8155_Android
                sd-client-config={client-service-major-version=1, client-service-minor-version=1, initial-find-behavior={initial-delay-max-value=0.1, initial-delay-min-value=0.0, initial-repetitions-base-delay=0.03, initial-repetitions-max=3}, request-response-delay={max-value=0.0, min-value=0.0}, ttl=3}
                consumed event group CEG_ICC_Android_OutService_EventGroup_VLAN62_TBOX: event-group-identifier=1, routing-group=SoAdRG_ICC_Android_OutService_EventGroup_VLAN62_ICC_Android_OutService, sd-client-config=ttl=16777215
              consumed service instance CSI_FCM_UUID_VLAN62_TBOX: routing-group=SoAdRG_FCM_UUID_VLAN62, provided-service-instance=PSI_FCM_UUID_1_VLAN62_FCM, sd-client-config={client-service-major-version=1, client-service-minor-version=1, initial-find-behavior={initial-delay-max-value=0.1, initial-delay-min-value=0.0, initial-repetitions-base-delay=0.03, initial-repetitions-max=3}, request-response-delay={max-value=0.0, min-value=0.0}, ttl=3}
              consumed service instance CSI_ADCC_UUID_VLAN62_TBOX: routing-group=SoAdRG_ADCC_UUID_VLAN62, provided-service-instance=PSI_ADCC_UUID_1_VLAN62_ADCC, sd-client-config={client-service-major-version=1, client-service-minor-version=1, initial-find-behavior={initial-delay-max-value=0.1, initial-delay-min-value=0.0, initial-repetitions-base-delay=0.03, initial-repetitions-max=3}, request-response-delay={max-value=0.0, min-value=0.0}, ttl=3}
          SoAddr_VLAN62_ADCC_UDP_30500: connector=LianJieDian_ADCC_SwitchEEI_In_VLAN62
            application endpoint AEP_VLAN62_ADCC_UDP_30500: network-endpoint=LianJieDian_ADCC_SwitchNEP, tp-configuration=udp-tp=udp-tp-port=port-number=30500
              9 x provided service instance, all with instance-identifier=1, sd-server-config={initial-offer-behavior={initial-delay-max-value=0.1, initial-delay-min-value=0.0, initial-repetitions-base-delay=0.03, initial-repetitions-max=3}, offer-cyclic-delay=1.0, request-response-delay={max-value=0.0, min-value=0.0}, server-service-major-version=1, server-service-minor-version=1, ttl=3}:
                PSI_ADCC_DrivingHmiEnv_1_VLAN62_ADCC: routing-group=SoAdRG_ADCC_DrivingHmiEnv_VLAN62, service-identifier=43776
                  event handler EH_ADCC_DrivingHmiEnv_Eventgroup_VLAN62_ADCC: consumed-event-group=[CSI_ADCC_DrivingHmiEnv_VLAN62_ICC_8155_Android/CEG_ADCC_DrivingHmiEnv_Eventgroup_VLAN62_ICC_8155_Android, CSI_ADCC_DrivingHmiEnv_VLAN62_ICC_8155_QNX/CEG_ADCC_DrivingHmiEnv_Eventgroup_VLAN62_ICC_8155_QNX], routing-group=SoAdRG_ADCC_DrivingHmiEnv_Eventgroup_VLAN62_ADCC_DrivingHmiEnv, sd-server-config=ttl=16777215
                PSI_ADCC_SensorInfo_1_VLAN62_ADCC: routing-group=SoAdRG_ADCC_SensorInfo_VLAN62, service-identifier=43777
                  event handler EH_ADCC_SensorInfo_Eventgroup_VLAN62_ADCC: consumed-event-group=[CEG_ADCC_SensorInfo_Eventgroup_VLAN62_ICC_8155_Android, CEG_ADCC_SensorInfo_Eventgroup_VLAN62_ICC_8155_QNX], routing-group=SoAdRG_ADCC_SensorInfo_Eventgroup_VLAN62_ADCC_SensorInfo, sd-server-config=ttl=16777215
                PSI_ADCC_DrivingFuncInfo_1_VLAN62_ADCC: routing-group=SoAdRG_ADCC_DrivingFuncInfo_VLAN62, service-identifier=43778
                  event handler EH_ADCC_DrivingFuncInfo_Eventgroup_VLAN62_ADCC: consumed-event-group=[CSI_ADCC_DrivingFuncInfo_VLAN62_ICC_8155_Android/CEG_ADCC_DrivingFuncInfo_Eventgroup_VLAN62_ICC_8155_Android, CSI_ADCC_DrivingFuncInfo_VLAN62_ICC_8155_QNX/CEG_ADCC_DrivingFuncInfo_Eventgroup_VLAN62_ICC_8155_QNX], routing-group=SoAdRG_ADCC_DrivingFuncInfo_Eventgroup_VLAN62_ADCC_DrivingFuncInfo, sd-server-config=ttl=16777215
                PSI_ADCC_ParkingFuncInfo_1_VLAN62_ADCC: routing-group=SoAdRG_ADCC_ParkingFuncInfo_VLAN62, service-identifier=43779
                  event handler EH_ADAS_ParkingFuncInfo_Eventgroup_VLAN62_ADCC: consumed-event-group=[CSI_ADCC_ParkingFuncInfo_VLAN62_ICC_8155_Android/CEG_ADAS_ParkingFuncInfo_Eventgroup_VLAN62_ICC_8155_Android, CSI_ADCC_ParkingFuncInfo_VLAN62_ICC_8155_QNX/CEG_ADAS_ParkingFuncInfo_Eventgroup_VLAN62_ICC_8155_QNX], routing-group=SoAdRG_ADAS_ParkingFuncInfo_Eventgroup_VLAN62_ADCC_ParkingFuncInfo, sd-server-config=ttl=16777215
                PSI_ADCC_ParkingHmiEnv_1_VLAN62_ADCC: routing-group=SoAdRG_ADCC_ParkingHmiEnv_VLAN62, service-identifier=43780
                  event handler EH_ADCC_ParkingHmiEnv_Eventgroup_VLAN62_ADCC: consumed-event-group=[CSI_ADCC_ParkingHmiEnv_VLAN62_ICC_8155_Android/CEG_ADCC_ParkingHmiEnv_Eventgroup_VLAN62_ICC_8155_Android, CSI_ADCC_ParkingHmiEnv_VLAN62_ICC_8155_QNX/CEG_ADCC_ParkingHmiEnv_Eventgroup_VLAN62_ICC_8155_QNX], routing-group=SoAdRG_ADCC_ParkingHmiEnv_Eventgroup_VLAN62_ADCC_ParkingHmiEnv, sd-server-config=ttl=16777215
                PSI_ADCC_ActiveSafetyInfo_1_VLAN62_ADCC: routing-group=SoAdRG_ADCC_ActiveSafetyInfo_VLAN62, service-identifier=43786
                  event handler EH_ADCC_ActiveSafetyInfo_Eventgroup_VLAN62_ADCC: consumed-event-group=[CEG_ADCC_ActiveSafetyInfo_Eventgroup_VLAN62_ICC_8155_Android, CEG_ADCC_ActiveSafetyInfo_Eventgroup_VLAN62_ICC_8155_QNX], routing-group=SoAdRG_ADCC_ActiveSafetyInfo_Eventgroup_VLAN62_ADCC_ActiveSafetyInfo, sd-server-config=ttl=16777215
                PSI_ADCC_UUID_1_VLAN62_ADCC: routing-group=SoAdRG_ADCC_UUID_VLAN62, service-identifier=43787
                PSI_ADCC_DVRSts_1_VLAN62_ADCC: routing-group=SoAdRG_ADCC_DVRSts_VLAN62, service-identifier=43788
                  event handler EH_ADCC_DVRSts_Eventgroup_VLAN62_ADCC: consumed-event-group=[CEG_ADCC_DVRSts_Eventgroup_VLAN62_ICC_8155_Android, CEG_ADCC_DVRSts_Eventgroup_VLAN62_ICC_8155_QNX], routing-group=SoAdRG_ADCC_DVRSts_Eventgroup_VLAN62_ADCC_DVRSts, sd-server-config=ttl=16777215
                PSI_ADAS_GNSSInfo_1_VLAN62_ADCC: routing-group=SoAdRG_ADAS_GNSSInfo_VLAN62, service-identifier=43789
                  event handler EH_ADAS_GNSSInfo_Eventgroup_VLAN62_ADCC: consumed-event-group=[CSI_ADAS_GNSSInfo_VLAN62_ICC_8155_Android/CEG_ADAS_GNSSInfo_Eventgroup_VLAN62_ICC_8155_Android, CSI_ADAS_GNSSInfo_VLAN62_ICC_8155_QNX/CEG_ADAS_GNSSInfo_Eventgroup_VLAN62_ICC_8155_QNX], routing-group=SoAdRG_ADAS_GNSSInfo_Eventgroup_VLAN62_ADAS_GNSSInfo, sd-server-config=ttl=16777215
          SoAddr_VLAN62_ADCC_TCP_30500: connector=LianJieDian_ADCC_SwitchEEI_In_VLAN62
            application endpoint AEP_VLAN62_ADCC_TCP_30500: network-endpoint=LianJieDian_ADCC_SwitchNEP, tp-configuration=tcp-tp=tcp-tp-port=port-number=30500
              8 x provided service instance, all with instance-identifier=1, sd-server-config={initial-offer-behavior={initial-delay-max-value=0.1, initial-delay-min-value=0.0, initial-repetitions-base-delay=0.03, initial-repetitions-max=3}, offer-cyclic-delay=1.0, request-response-delay={max-value=0.0, min-value=0.0}, server-service-major-version=1, server-service-minor-version=1, ttl=3}:
                PSI_ADCC_DrivingHmiEnv_1_VLAN62_ADCC: routing-group=SoAdRG_ADCC_DrivingHmiEnv_VLAN62, service-identifier=43776
                  event handler EH_ADCC_DrivingHmiEnv_Eventgroup_VLAN62_ADCC_1: consumed-event-group=[CSI_ADCC_DrivingHmiEnv_VLAN62_ICC_8155_Android/CEG_ADCC_DrivingHmiEnv_Eventgroup_VLAN62_ICC_8155_Android, CSI_ADCC_DrivingHmiEnv_VLAN62_ICC_8155_QNX/CEG_ADCC_DrivingHmiEnv_Eventgroup_VLAN62_ICC_8155_QNX], routing-group=SoAdRG_ADCC_DrivingHmiEnv_Eventgroup_VLAN62_ADCC_DrivingHmiEnv, sd-server-config=ttl=16777215
                PSI_ADCC_DrivingFuncInfo_1_VLAN62_ADCC: routing-group=SoAdRG_ADCC_DrivingFuncInfo_VLAN62, service-identifier=43778
                  event handler EH_ADCC_DrivingFuncInfo_Eventgroup_VLAN62_ADCC_1: consumed-event-group=[CSI_ADCC_DrivingFuncInfo_VLAN62_ICC_8155_Android/CEG_ADCC_DrivingFuncInfo_Eventgroup_VLAN62_ICC_8155_Android, CSI_ADCC_DrivingFuncInfo_VLAN62_ICC_8155_QNX/CEG_ADCC_DrivingFuncInfo_Eventgroup_VLAN62_ICC_8155_QNX], routing-group=SoAdRG_ADCC_DrivingFuncInfo_Eventgroup_VLAN62_ADCC_DrivingFuncInfo, sd-server-config=ttl=16777215
                PSI_ADCC_ParkingFuncInfo_1_VLAN62_ADCC: routing-group=SoAdRG_ADCC_ParkingFuncInfo_VLAN62, service-identifier=43779
                  event handler EH_ADAS_ParkingFuncInfo_Eventgroup_VLAN62_ADCC_1: consumed-event-group=[CSI_ADCC_ParkingFuncInfo_VLAN62_ICC_8155_Android/CEG_ADAS_ParkingFuncInfo_Eventgroup_VLAN62_ICC_8155_Android, CSI_ADCC_ParkingFuncInfo_VLAN62_ICC_8155_QNX/CEG_ADAS_ParkingFuncInfo_Eventgroup_VLAN62_ICC_8155_QNX], routing-group=SoAdRG_ADAS_ParkingFuncInfo_Eventgroup_VLAN62_ADCC_ParkingFuncInfo, sd-server-config=ttl=16777215
                PSI_ADCC_ParkingHmiEnv_1_VLAN62_ADCC: routing-group=SoAdRG_ADCC_ParkingHmiEnv_VLAN62, service-identifier=43780
                  event handler EH_ADCC_ParkingHmiEnv_Eventgroup_VLAN62_ADCC_1: consumed-event-group=[CSI_ADCC_ParkingHmiEnv_VLAN62_ICC_8155_Android/CEG_ADCC_ParkingHmiEnv_Eventgroup_VLAN62_ICC_8155_Android, CSI_ADCC_ParkingHmiEnv_VLAN62_ICC_8155_QNX/CEG_ADCC_ParkingHmiEnv_Eventgroup_VLAN62_ICC_8155_QNX], routing-group=SoAdRG_ADCC_ParkingHmiEnv_Eventgroup_VLAN62_ADCC_ParkingHmiEnv, sd-server-config=ttl=16777215
                PSI_ADCC_AomMMSt_1_VLAN62_ADCC: routing-group=SoAdRG_ADCC_AomMMSt_VLAN62, service-identifier=43781
                  event handler EH_ADCC_AomMMSt_Eventgroup_VLAN62_ADCC: consumed-event-group=[CEG_ADCC_AomMMSt_Eventgroup_VLAN62_ICC_8155_Android, CEG_ADCC_AomMMSt_Eventgroup_VLAN62_ICC_8155_QNX], routing-group=SoAdRG_ADCC_AomMMSt_Eventgroup_VLAN62_ADCC_AomMMSt, sd-server-config=ttl=16777215
                PSI_ADCC_AomDB_1_VLAN62_ADCC: routing-group=SoAdRG_ADCC_AomDB_VLAN62, service-identifier=43782
                PSI_ADCC_RtMM_1_VLAN62_ADCC: routing-group=SoAdRG_ADCC_RtMM_VLAN62, service-identifier=43783
                  event handler EH_ADCC_RtMM_Eventgroup_VLAN62_ADCC: consumed-event-group=[CEG_ADCC_RtMM_Eventgroup_VLAN62_ICC_8155_Android, CEG_ADCC_RtMM_Eventgroup_VLAN62_ICC_8155_QNX], routing-group=SoAdRG_ADCC_RtMM_Eventgroup_VLAN62_ADCC_RtMM, sd-server-config=ttl=16777215
                PSI_ADAS_GNSSInfo_1_VLAN62_ADCC: routing-group=SoAdRG_ADAS_GNSSInfo_VLAN62, service-identifier=43789
                  event handler EH_ADAS_GNSSInfo_Eventgroup_VLAN62_ADCC_1: consumed-event-group=[CSI_ADAS_GNSSInfo_VLAN62_ICC_8155_Android/CEG_ADAS_GNSSInfo_Eventgroup_VLAN62_ICC_8155_Android, CSI_ADAS_GNSSInfo_VLAN62_ICC_8155_QNX/CEG_ADAS_GNSSInfo_Eventgroup_VLAN62_ICC_8155_QNX], routing-group=SoAdRG_ADAS_GNSSInfo_Eventgroup_VLAN62_ADAS_GNSSInfo, sd-server-config=ttl=16777215
          SDSoAddr_VLAN62_ICC_8155_QNX: connector=LianJieDian_ICC_8155_QNX_SwitchEEI_In_VLAN62
            application endpoint SDAEP_VLAN62_ICC_8155_QNX: network-endpoint=LianJieDian_ICC_8155_QNX_SwitchNEP, tp-configuration=udp-tp=udp-tp-port=port-number=30490
          SoAddr_VLAN62_ICC_8155_QNX_UDP_30501: connector=LianJieDian_ICC_8155_QNX_SwitchEEI_In_VLAN62
            application endpoint AEP_VLAN62_ICC_8155_QNX_UDP_30501: network-endpoint=LianJieDian_ICC_8155_QNX_SwitchNEP, tp-configuration=udp-tp=udp-tp-port=port-number=30501
              14 x consumed service instance, all with sd-client-config={client-service-major-version=1, client-service-minor-version=1, initial-find-behavior={initial-delay-max-value=0.1, initial-delay-min-value=0.0, initial-repetitions-base-delay=0.03, initial-repetitions-max=3}, request-response-delay={max-value=0.0, min-value=0.0}, ttl=3}:
                CSI_ADCC_DrivingHmiEnv_VLAN62_ICC_8155_QNX: routing-group=SoAdRG_ADCC_DrivingHmiEnv_VLAN62, provided-service-instance=AEP_VLAN62_ADCC_UDP_30500/PSI_ADCC_DrivingHmiEnv_1_VLAN62_ADCC
                  consumed event group CEG_ADCC_DrivingHmiEnv_Eventgroup_VLAN62_ICC_8155_QNX: event-group-identifier=1, routing-group=SoAdRG_ADCC_DrivingHmiEnv_Eventgroup_VLAN62_ADCC_DrivingHmiEnv, sd-client-config=ttl=16777215
                CSI_ADCC_SensorInfo_VLAN62_ICC_8155_QNX: routing-group=SoAdRG_ADCC_SensorInfo_VLAN62, provided-service-instance=PSI_ADCC_SensorInfo_1_VLAN62_ADCC
                  consumed event group CEG_ADCC_SensorInfo_Eventgroup_VLAN62_ICC_8155_QNX: event-group-identifier=1, routing-group=SoAdRG_ADCC_SensorInfo_Eventgroup_VLAN62_ADCC_SensorInfo, sd-client-config=ttl=16777215
                CSI_ADCC_DrivingFuncInfo_VLAN62_ICC_8155_QNX: routing-group=SoAdRG_ADCC_DrivingFuncInfo_VLAN62, provided-service-instance=AEP_VLAN62_ADCC_UDP_30500/PSI_ADCC_DrivingFuncInfo_1_VLAN62_ADCC
                  consumed event group CEG_ADCC_DrivingFuncInfo_Eventgroup_VLAN62_ICC_8155_QNX: event-group-identifier=1, routing-group=SoAdRG_ADCC_DrivingFuncInfo_Eventgroup_VLAN62_ADCC_DrivingFuncInfo, sd-client-config=ttl=16777215
                CSI_ADCC_ParkingFuncInfo_VLAN62_ICC_8155_QNX: routing-group=SoAdRG_ADCC_ParkingFuncInfo_VLAN62, provided-service-instance=AEP_VLAN62_ADCC_UDP_30500/PSI_ADCC_ParkingFuncInfo_1_VLAN62_ADCC
                  consumed event group CEG_ADAS_ParkingFuncInfo_Eventgroup_VLAN62_ICC_8155_QNX: event-group-identifier=1, routing-group=SoAdRG_ADAS_ParkingFuncInfo_Eventgroup_VLAN62_ADCC_ParkingFuncInfo, sd-client-config=ttl=16777215
                CSI_ADCC_ParkingHmiEnv_VLAN62_ICC_8155_QNX: routing-group=SoAdRG_ADCC_ParkingHmiEnv_VLAN62, provided-service-instance=AEP_VLAN62_ADCC_UDP_30500/PSI_ADCC_ParkingHmiEnv_1_VLAN62_ADCC
                  consumed event group CEG_ADCC_ParkingHmiEnv_Eventgroup_VLAN62_ICC_8155_QNX: event-group-identifier=1, routing-group=SoAdRG_ADCC_ParkingHmiEnv_Eventgroup_VLAN62_ADCC_ParkingHmiEnv, sd-client-config=ttl=16777215
                CSI_FCM_DrivingHmiEnv_VLAN62_ICC_8155_QNX: routing-group=SoAdRG_FCM_DrivingHmiEnv_VLAN62, provided-service-instance=AEP_VLAN62_FCM_UDP_30500/PSI_FCM_DrivingHmiEnv_1_VLAN62_FCM
                  consumed event group CEG_FCM_DrivingHmiEnv_Eventgroup_VLAN62_ICC_8155_QNX: event-group-identifier=1, routing-group=SoAdRG_FCM_DrivingHmiEnv_Eventgroup_VLAN62_FCM_DrivingHmiEnv, sd-client-config=ttl=16777215
                CSI_FCM_ActiveSafetyInfo_VLAN62_ICC_8155_QNX: routing-group=SoAdRG_FCM_ActiveSafetyInfo_VLAN62, provided-service-instance=PSI_FCM_ActiveSafetyInfo_1_VLAN62_FCM
                  consumed event group CEG_FCM_ActiveSafetyInfo_Eventgroup_VLAN62_ICC_8155_QNX: event-group-identifier=1, routing-group=SoAdRG_FCM_ActiveSafetyInfo_Eventgroup_VLAN62_FCM_ActiveSafetyInfo, sd-client-config=ttl=16777215
                CSI_FCM_DrivingFuncInfo_VLAN62_ICC_8155_QNX: routing-group=SoAdRG_FCM_DrivingFuncInfo_VLAN62, provided-service-instance=PSI_FCM_DrivingFuncInfo_1_VLAN62_FCM
                  consumed event group CEG_FCM_DrivingFuncInfo_Eventgroup_VLAN62_ICC_8155_QNX: event-group-identifier=1, routing-group=SoAdRG_FCM_DrivingFuncInfo_Eventgroup_VLAN62_FCM_DrivingFuncInfo, sd-client-config=ttl=16777215
                CSI_FCM_DVRSts_VLAN62_ICC_8155_QNX: routing-group=SoAdRG_FCM_DVRSts_VLAN62, provided-service-instance=PSI_FCM_DVRSts_1_VLAN62_FCM
                  consumed event group CEG_FCM_DVRSts_Eventgroup_VLAN62_ICC_8155_QNX: event-group-identifier=1, routing-group=SoAdRG_FCM_DVRSts_Eventgroup_VLAN62_FCM_DVRSts, sd-client-config=ttl=16777215
                CSI_LCM_ICC_Data_VLAN62_ICC_8155_QNX: routing-group=SoAdRG_LCM_ICC_Data_VLAN62, provided-service-instance=PSI_LCM_ICC_Data_1_VLAN62_LCM
                  consumed event group CEG_LCM_ICC_Data_Eventgroup_VLAN62_ICC_8155_QNX: event-group-identifier=1, routing-group=SoAdRG_LCM_ICC_Data_Eventgroup_VLAN62_LCM_ICC_Data, sd-client-config=ttl=16777215
                CSI_ADCC_ActiveSafetyInfo_VLAN62_ICC_8155_QNX: routing-group=SoAdRG_ADCC_ActiveSafetyInfo_VLAN62, provided-service-instance=PSI_ADCC_ActiveSafetyInfo_1_VLAN62_ADCC
                  consumed event group CEG_ADCC_ActiveSafetyInfo_Eventgroup_VLAN62_ICC_8155_QNX: event-group-identifier=1, routing-group=SoAdRG_ADCC_ActiveSafetyInfo_Eventgroup_VLAN62_ADCC_ActiveSafetyInfo, sd-client-config=ttl=16777215
                CSI_FCM_SensorInfo_VLAN62_ICC_8155_QNX: routing-group=SoAdRG_FCM_SensorInfo_VLAN62, provided-service-instance=PSI_FCM_SensorInfo_1_VLAN62_FCM
                  consumed event group CEG_FCM_SensorInfo_Eventgroup_VLAN62_ICC_8155_QNX: event-group-identifier=1, routing-group=SoAdRG_FCM_SensorInfo_Eventgroup_VLAN62_FCM_SensorInfo, sd-client-config=ttl=16777215
                CSI_ADCC_DVRSts_VLAN62_ICC_8155_QNX: routing-group=SoAdRG_ADCC_DVRSts_VLAN62, provided-service-instance=PSI_ADCC_DVRSts_1_VLAN62_ADCC
                  consumed event group CEG_ADCC_DVRSts_Eventgroup_VLAN62_ICC_8155_QNX: event-group-identifier=1, routing-group=SoAdRG_ADCC_DVRSts_Eventgroup_VLAN62_ADCC_DVRSts, sd-client-config=ttl=16777215
                CSI_ADAS_GNSSInfo_VLAN62_ICC_8155_QNX: routing-group=SoAdRG_ADAS_GNSSInfo_VLAN62, provided-service-instance=AEP_VLAN62_ADCC_UDP_30500/PSI_ADAS_GNSSInfo_1_VLAN62_ADCC
                  consumed event group CEG_ADAS_GNSSInfo_Eventgroup_VLAN62_ICC_8155_QNX: event-group-identifier=1, routing-group=SoAdRG_ADAS_GNSSInfo_Eventgroup_VLAN62_ADAS_GNSSInfo, sd-client-config=ttl=16777215
          SoAddr_VLAN62_ICC_8155_QNX_TCP_30501: connector=LianJieDian_ICC_8155_QNX_SwitchEEI_In_VLAN62
            application endpoint AEP_VLAN62_ICC_8155_QNX_TCP_30501: network-endpoint=LianJieDian_ICC_8155_QNX_SwitchNEP, tp-configuration=tcp-tp=tcp-tp-port=port-number=30501
              9 x consumed service instance, all with sd-client-config={client-service-major-version=1, client-service-minor-version=1, initial-find-behavior={initial-delay-max-value=0.1, initial-delay-min-value=0.0, initial-repetitions-base-delay=0.03, initial-repetitions-max=3}, request-response-delay={max-value=0.0, min-value=0.0}, ttl=3}:
                CSI_ADCC_DrivingHmiEnv_VLAN62_ICC_8155_QNX: routing-group=SoAdRG_ADCC_DrivingHmiEnv_VLAN62, provided-service-instance=AEP_VLAN62_ADCC_TCP_30500/PSI_ADCC_DrivingHmiEnv_1_VLAN62_ADCC
                  consumed event group CEG_ADCC_DrivingHmiEnv_Eventgroup_VLAN62_ICC_8155_QNX: event-group-identifier=1, routing-group=SoAdRG_ADCC_DrivingHmiEnv_Eventgroup_VLAN62_ADCC_DrivingHmiEnv, sd-client-config=ttl=16777215
                CSI_ADCC_DrivingFuncInfo_VLAN62_ICC_8155_QNX: routing-group=SoAdRG_ADCC_DrivingFuncInfo_VLAN62, provided-service-instance=AEP_VLAN62_ADCC_TCP_30500/PSI_ADCC_DrivingFuncInfo_1_VLAN62_ADCC
                  consumed event group CEG_ADCC_DrivingFuncInfo_Eventgroup_VLAN62_ICC_8155_QNX: event-group-identifier=1, routing-group=SoAdRG_ADCC_DrivingFuncInfo_Eventgroup_VLAN62_ADCC_DrivingFuncInfo, sd-client-config=ttl=16777215
                CSI_ADCC_ParkingFuncInfo_VLAN62_ICC_8155_QNX: routing-group=SoAdRG_ADCC_ParkingFuncInfo_VLAN62, provided-service-instance=AEP_VLAN62_ADCC_TCP_30500/PSI_ADCC_ParkingFuncInfo_1_VLAN62_ADCC
                  consumed event group CEG_ADAS_ParkingFuncInfo_Eventgroup_VLAN62_ICC_8155_QNX: event-group-identifier=1, routing-group=SoAdRG_ADAS_ParkingFuncInfo_Eventgroup_VLAN62_ADCC_ParkingFuncInfo, sd-client-config=ttl=16777215
                CSI_ADCC_ParkingHmiEnv_VLAN62_ICC_8155_QNX: routing-group=SoAdRG_ADCC_ParkingHmiEnv_VLAN62, provided-service-instance=AEP_VLAN62_ADCC_TCP_30500/PSI_ADCC_ParkingHmiEnv_1_VLAN62_ADCC
                  consumed event group CEG_ADCC_ParkingHmiEnv_Eventgroup_VLAN62_ICC_8155_QNX: event-group-identifier=1, routing-group=SoAdRG_ADCC_ParkingHmiEnv_Eventgroup_VLAN62_ADCC_ParkingHmiEnv, sd-client-config=ttl=16777215
                CSI_ADCC_AomMMSt_VLAN62_ICC_8155_QNX: routing-group=SoAdRG_ADCC_AomMMSt_VLAN62, provided-service-instance=PSI_ADCC_AomMMSt_1_VLAN62_ADCC
                  consumed event group CEG_ADCC_AomMMSt_Eventgroup_VLAN62_ICC_8155_QNX: event-group-identifier=1, routing-group=SoAdRG_ADCC_AomMMSt_Eventgroup_VLAN62_ADCC_AomMMSt, sd-client-config=ttl=16777215
                CSI_ADCC_AomDB_VLAN62_ICC_8155_QNX: routing-group=SoAdRG_ADCC_AomDB_VLAN62, provided-service-instance=PSI_ADCC_AomDB_1_VLAN62_ADCC
                CSI_ADCC_RtMM_VLAN62_ICC_8155_QNX: routing-group=SoAdRG_ADCC_RtMM_VLAN62, provided-service-instance=PSI_ADCC_RtMM_1_VLAN62_ADCC
                  consumed event group CEG_ADCC_RtMM_Eventgroup_VLAN62_ICC_8155_QNX: event-group-identifier=1, routing-group=SoAdRG_ADCC_RtMM_Eventgroup_VLAN62_ADCC_RtMM, sd-client-config=ttl=16777215
                CSI_FCM_DrivingHmiEnv_VLAN62_ICC_8155_QNX: routing-group=SoAdRG_FCM_DrivingHmiEnv_VLAN62, provided-service-instance=AEP_VLAN62_FCM_TCP_30500/PSI_FCM_DrivingHmiEnv_1_VLAN62_FCM
                  consumed event group CEG_FCM_DrivingHmiEnv_Eventgroup_VLAN62_ICC_8155_QNX: event-group-identifier=1, routing-group=SoAdRG_FCM_DrivingHmiEnv_Eventgroup_VLAN62_FCM_DrivingHmiEnv, sd-client-config=ttl=16777215
                CSI_ADAS_GNSSInfo_VLAN62_ICC_8155_QNX: routing-group=SoAdRG_ADAS_GNSSInfo_VLAN62, provided-service-instance=AEP_VLAN62_ADCC_TCP_30500/PSI_ADAS_GNSSInfo_1_VLAN62_ADCC
                  consumed event group CEG_ADAS_GNSSInfo_Eventgroup_VLAN62_ICC_8155_QNX: event-group-identifier=1, routing-group=SoAdRG_ADAS_GNSSInfo_Eventgroup_VLAN62_ADAS_GNSSInfo, sd-client-config=ttl=16777215
          SoAddr_VLAN62_FCM_UDP_30500: connector=LianJieDian_FCM_SwitchEEI_In_VLAN62
            application endpoint AEP_VLAN62_FCM_UDP_30500: network-endpoint=LianJieDian_FCM_SwitchNEP, tp-configuration=udp-tp=udp-tp-port=port-number=30500
              7 x provided service instance, all with instance-identifier=1, sd-server-config={initial-offer-behavior={initial-delay-max-value=0.1, initial-delay-min-value=0.0, initial-repetitions-base-delay=0.03, initial-repetitions-max=3}, offer-cyclic-delay=1.0, request-response-delay={max-value=0.0, min-value=0.0}, server-service-major-version=1, server-service-minor-version=1, ttl=3}:
                PSI_FCM_DrivingHmiEnv_1_VLAN62_FCM: routing-group=SoAdRG_FCM_DrivingHmiEnv_VLAN62, service-identifier=43792
                  event handler EH_FCM_DrivingHmiEnv_Eventgroup_VLAN62_FCM: consumed-event-group=[CSI_FCM_DrivingHmiEnv_VLAN62_ICC_8155_QNX/CEG_FCM_DrivingHmiEnv_Eventgroup_VLAN62_ICC_8155_QNX, CSI_FCM_DrivingHmiEnv_VLAN62_ICC_8155_Android/CEG_FCM_DrivingHmiEnv_Eventgroup_VLAN62_ICC_8155_Android], routing-group=SoAdRG_FCM_DrivingHmiEnv_Eventgroup_VLAN62_FCM_DrivingHmiEnv, sd-server-config=ttl=16777215
                PSI_FCM_ActiveSafetyInfo_1_VLAN62_FCM: routing-group=SoAdRG_FCM_ActiveSafetyInfo_VLAN62, service-identifier=43793
                  event handler EH_FCM_ActiveSafetyInfo_Eventgroup_VLAN62_FCM: consumed-event-group=[CEG_FCM_ActiveSafetyInfo_Eventgroup_VLAN62_ICC_8155_Android, CEG_FCM_ActiveSafetyInfo_Eventgroup_VLAN62_ICC_8155_QNX], routing-group=SoAdRG_FCM_ActiveSafetyInfo_Eventgroup_VLAN62_FCM_ActiveSafetyInfo, sd-server-config=ttl=16777215
                PSI_FCM_DrivingFuncInfo_1_VLAN62_FCM: routing-group=SoAdRG_FCM_DrivingFuncInfo_VLAN62, service-identifier=43794
                  event handler EH_FCM_DrivingFuncInfo_Eventgroup_VLAN62_FCM: consumed-event-group=[CEG_FCM_DrivingFuncInfo_Eventgroup_VLAN62_ICC_8155_Android, CEG_FCM_DrivingFuncInfo_Eventgroup_VLAN62_ICC_8155_QNX], routing-group=SoAdRG_FCM_DrivingFuncInfo_Eventgroup_VLAN62_FCM_DrivingFuncInfo, sd-server-config=ttl=16777215
                PSI_FCM_DVRSts_1_VLAN62_FCM: routing-group=SoAdRG_FCM_DVRSts_VLAN62, service-identifier=43795
                  event handler EH_FCM_DVRSts_Eventgroup_VLAN62_FCM: consumed-event-group=[CEG_FCM_DVRSts_Eventgroup_VLAN62_ICC_8155_Android, CEG_FCM_DVRSts_Eventgroup_VLAN62_ICC_8155_QNX], routing-group=SoAdRG_FCM_DVRSts_Eventgroup_VLAN62_FCM_DVRSts, sd-server-config=ttl=16777215
                PSI_FCM_UUID_1_VLAN62_FCM: routing-group=SoAdRG_FCM_UUID_VLAN62, service-identifier=43797
                PSI_FCM_SensorInfo_1_VLAN62_FCM: routing-group=SoAdRG_FCM_SensorInfo_VLAN62, service-identifier=43798
                  event handler EH_FCM_SensorInfo_Eventgroup_VLAN62_FCM: consumed-event-group=[CEG_FCM_SensorInfo_Eventgroup_VLAN62_ICC_8155_Android, CEG_FCM_SensorInfo_Eventgroup_VLAN62_ICC_8155_QNX], routing-group=SoAdRG_FCM_SensorInfo_Eventgroup_VLAN62_FCM_SensorInfo, sd-server-config=ttl=16777215
                PSI_ADAS_DataInLoop_1_VLAN62_FCM: routing-group=SoAdRG_ADAS_DataInLoop_VLAN62, service-identifier=43799
                  event handler EH_DataInLoop_Eventgroup_VLAN62_FCM: consumed-event-group=CEG_DataInLoop_Eventgroup_VLAN62_ICC_8155_Android, routing-group=SoAdRG_DataInLoop_Eventgroup_VLAN62_ADAS_DataInLoop, sd-server-config=ttl=16777215
          SoAddr_VLAN62_FCM_TCP_30500: connector=LianJieDian_FCM_SwitchEEI_In_VLAN62
            application endpoint AEP_VLAN62_FCM_TCP_30500: network-endpoint=LianJieDian_FCM_SwitchNEP, tp-configuration=tcp-tp=tcp-tp-port=port-number=30500
              provided service instance PSI_FCM_DrivingHmiEnv_1_VLAN62_FCM:
                routing-group=SoAdRG_FCM_DrivingHmiEnv_VLAN62
                instance-identifier=1
                sd-server-config={initial-offer-behavior={initial-delay-max-value=0.1, initial-delay-min-value=0.0, initial-repetitions-base-delay=0.03, initial-repetitions-max=3}, offer-cyclic-delay=1.0, request-response-delay={max-value=0.0, min-value=0.0}, server-service-major-version=1, server-service-minor-version=1, ttl=3}
                service-identifier=43792
                event handler EH_FCM_DrivingHmiEnv_Eventgroup_VLAN62_FCM_1: consumed-event-group=[CSI_FCM_DrivingHmiEnv_VLAN62_ICC_8155_QNX/CEG_FCM_DrivingHmiEnv_Eventgroup_VLAN62_ICC_8155_QNX, CSI_FCM_DrivingHmiEnv_VLAN62_ICC_8155_Android/CEG_FCM_DrivingHmiEnv_Eventgroup_VLAN62_ICC_8155_Android], routing-group=SoAdRG_FCM_DrivingHmiEnv_Eventgroup_VLAN62_FCM_DrivingHmiEnv, sd-server-config=ttl=16777215
          SoAddr_VLAN62_LCM_UDP_30500: connector=LianJieDian_LCM_SwitchEEI_In_VLAN62
            application endpoint AEP_VLAN62_LCM_UDP_30500: network-endpoint=LianJieDian_LCM_SwitchNEP, tp-configuration=udp-tp=udp-tp-port=port-number=30500
              provided service instance PSI_LCM_ICC_Data_1_VLAN62_LCM: routing-group=SoAdRG_LCM_ICC_Data_VLAN62, instance-identifier=1, sd-server-config={initial-offer-behavior={initial-delay-max-value=0.1, initial-delay-min-value=0.0, initial-repetitions-base-delay=0.03, initial-repetitions-max=3}, offer-cyclic-delay=1.0, request-response-delay={max-value=0.0, min-value=0.0}, server-service-major-version=1, server-service-minor-version=1, ttl=3}, service-identifier=43808
                event handler EH_LCM_ICC_Data_Eventgroup_VLAN62_LCM: consumed-event-group=CEG_LCM_ICC_Data_Eventgroup_VLAN62_ICC_8155_QNX, routing-group=SoAdRG_LCM_ICC_Data_Eventgroup_VLAN62_LCM_ICC_Data, sd-server-config=ttl=16777215
              provided service instance PSI_LCM_ADCC_RawData_1_VLAN62_LCM:
                routing-group=SoAdRG_LCM_ADCC_RawData_VLAN62
                instance-identifier=1
                sd-server-config={initial-offer-behavior={initial-delay-max-value=0.1, initial-delay-min-value=0.0, initial-repetitions-base-delay=0.03, initial-repetitions-max=3}, offer-cyclic-delay=1.0, request-response-delay={max-value=0.0, min-value=0.0}, server-service-major-version=1, server-service-minor-version=1, ttl=3}
                service-identifier=43810
                event handler EH_LCM_ADCC_RawData_Eventgroup_VLAN62_LCM: consumed-event-group=CEG_LCM_ADCC_RawData_Eventgroup_VLAN62_ADCC, routing-group=SoAdRG_LCM_ADCC_RawData_Eventgroup_VLAN62_LCM_ADCC_RawData, sd-server-config=ttl=16777215
          SoAddr_VLAN62_ICC_8155_QNX_UDP_30500: connector=LianJieDian_ICC_8155_QNX_SwitchEEI_In_VLAN62
            application endpoint AEP_VLAN62_ICC_8155_QNX_UDP_30500: network-endpoint=LianJieDian_ICC_8155_QNX_SwitchNEP, tp-configuration=udp-tp=udp-tp-port=port-number=30500
              provided service instance PSI_TBOX_SystemInfo_ICC_1_VLAN62_ICC_8155_QNX:
                routing-group=SoAdRG_TBOX_SystemInfo_ICC_VLAN62
                instance-identifier=1
                sd-server-config={initial-offer-behavior={initial-delay-max-value=0.1, initial-delay-min-value=0.0, initial-repetitions-base-delay=0.03, initial-repetitions-max=3}, offer-cyclic-delay=1.0, request-response-delay={max-value=0.0, min-value=0.0}, server-service-major-version=1, server-service-minor-version=1, ttl=3}
                service-identifier=44046
                event handler EH_TBOXSystemInfo_EventGroup_VLAN62_ICC_8155_QNX: consumed-event-group=CSI_TBOX_SystemInfo_ICC_VLAN62_ADCC/CEG_TBOXSystemInfo_EventGroup_VLAN62_ADCC, routing-group=SoAdRG_TBOXSystemInfo_EventGroup_VLAN62_TBOX_SystemInfo_ICC, sd-server-config=ttl=16777215
      vlan VLAN62: vlan-identifier=62
    coupling-port-connections:
      first-port=LianJieDian_ICC_8155_Android_Switch, second-port=LianJieDian_Switch_ICC_8155_Android
      first-port=LianJieDian_ADCC_Switch, second-port=LianJieDian_Switch_ADCC
      first-port=LianJieDian_FCM_Switch, second-port=LianJieDian_Switch_FCM
      first-port=LianJieDian_TBOX_Switch, second-port=LianJieDian_Switch_TBOX
      first-port=LianJieDian_LCM_Switch, second-port=LianJieDian_Switch_LCM
      first-port=LianJieDian_ICC_8155_QNX_Switch, second-port=LianJieDian_Switch_ICC_8155_QNX
package /Topology/HardwareComponents
  coupling element CouplingElement1: communication-cluster=EthernetCluster1, coupling-type=SWITCH
    6 x coupling port, all with physical-layer-type=BROAD-R-REACH, vlan-membership{send-activity=SENT-TAGGED, vlan=newChannelCommunication_VLAN62}:
      LianJieDian_Switch_ICC_8155_Android
      LianJieDian_Switch_ADCC
      LianJieDian_Switch_FCM
      LianJieDian_Switch_TBOX
      LianJieDian_Switch_LCM
      LianJieDian_Switch_ICC_8155_QNX
  6 x ecu instance, all with category=WIRED, sleep-mode-supported=false, wake-up-over-bus-supported=false:
    ICC_8155_Android
      ethernet communication controller EthernetControllerConfiguration_ICC_8155_Android: category=WIRED, mac-unicast-address=02:51:52:00:00:1F
        coupling port LianJieDian_ICC_8155_Android_Switch: connection-negotiation-behavior=AUTO, physical-layer-type=BROAD-R-REACH, vlan-membership{default-priority=6, vlan=newChannelCommunication_VLAN62}
      ethernet communication connector LianJieDian_ICC_8155_Android_SwitchEEI_In_VLAN62: category=WIRED, comm-controller=EthernetControllerConfiguration_ICC_8155_Android, network-endpoint=[LianJieDian_ICC_8155_Android_SwitchNEP, NetworkEndpoint_VLAN62_Multicast]
    ADCC
      ethernet communication controller EthernetControllerConfiguration_ADCC: category=WIRED, mac-unicast-address=02:51:52:00:00:0B
        coupling port LianJieDian_ADCC_Switch: connection-negotiation-behavior=AUTO, physical-layer-type=BROAD-R-REACH, vlan-membership{default-priority=6, vlan=newChannelCommunication_VLAN62}
      ethernet communication connector LianJieDian_ADCC_SwitchEEI_In_VLAN62: category=WIRED, comm-controller=EthernetControllerConfiguration_ADCC, network-endpoint=[LianJieDian_ADCC_SwitchNEP, NetworkEndpoint_VLAN62_Multicast]
    FCM
      ethernet communication controller EthernetControllerConfiguration_FCM: category=WIRED, mac-unicast-address=02:51:52:00:00:0F
        coupling port LianJieDian_FCM_Switch: connection-negotiation-behavior=AUTO, physical-layer-type=BROAD-R-REACH, vlan-membership{default-priority=6, vlan=newChannelCommunication_VLAN62}
      ethernet communication connector LianJieDian_FCM_SwitchEEI_In_VLAN62: category=WIRED, comm-controller=EthernetControllerConfiguration_FCM, network-endpoint=[LianJieDian_FCM_SwitchNEP, NetworkEndpoint_VLAN62_Multicast]
    TBOX
      ethernet communication controller EthernetControllerConfiguration_TBOX: category=WIRED, mac-unicast-address=02:51:52:00:00:01
        coupling port LianJieDian_TBOX_Switch: connection-negotiation-behavior=AUTO, physical-layer-type=BROAD-R-REACH, vlan-membership{default-priority=6, vlan=newChannelCommunication_VLAN62}
      ethernet communication connector LianJieDian_TBOX_SwitchEEI_In_VLAN62: category=WIRED, comm-controller=EthernetControllerConfiguration_TBOX, network-endpoint=[LianJieDian_TBOX_SwitchNEP, NetworkEndpoint_VLAN62_Multicast]
    LCM
      ethernet communication controller EthernetControllerConfiguration_LCM: category=WIRED, mac-unicast-address=02:51:52:00:00:0E
        coupling port LianJieDian_LCM_Switch: connection-negotiation-behavior=AUTO, physical-layer-type=BROAD-R-REACH, vlan-membership{default-priority=6, vlan=newChannelCommunication_VLAN62}
      ethernet communication connector LianJieDian_LCM_SwitchEEI_In_VLAN62: category=WIRED, comm-controller=EthernetControllerConfiguration_LCM, network-endpoint=[LianJieDian_LCM_SwitchNEP, NetworkEndpoint_VLAN62_Multicast]
    ICC_8155_QNX
      ethernet communication controller EthernetControllerConfiguration_ICC_8155_QNX: category=WIRED, mac-unicast-address=02:51:52:00:00:20
        coupling port LianJieDian_ICC_8155_QNX_Switch: connection-negotiation-behavior=AUTO, physical-layer-type=BROAD-R-REACH, vlan-membership{default-priority=6, vlan=newChannelCommunication_VLAN62}
      ethernet communication connector LianJieDian_ICC_8155_QNX_SwitchEEI_In_VLAN62: category=WIRED, comm-controller=EthernetControllerConfiguration_ICC_8155_QNX, network-endpoint=[LianJieDian_ICC_8155_QNX_SwitchNEP, NetworkEndpoint_VLAN62_Multicast]
package /TpConfig
  someip tp config SOME_IP_TP_1: communication-cluster=EthernetCluster1
    12 x someip tp channel, all with separation-time=0.01:
      eHMI_ParkingUI_SOME_IP_TP_Channel
      TBOX_GNSSInfo_SOME_IP_TP_Channel
      ICC_SDmapInfo_SOME_IP_TP_Channel
      ICC_SDmapInfo_2_SOME_IP_TP_Channel
      ADCC_DrivingHmiEnv_SOME_IP_TP_Channel
      ADCC_DrivingFuncInfo_SOME_IP_TP_Channel
      ADCC_ParkingFuncInfo_SOME_IP_TP_Channel
      ADCC_ParkingHmiEnv_SOME_IP_TP_Channel
      ADCC_AomDB_SOME_IP_TP_Channel
      ADCC_RtMM_SOME_IP_TP_Channel
      FCM_DrivingHmiEnv_SOME_IP_TP_Channel
      ADAS_GNSSInfo_SOME_IP_TP_Channel
    tp-connections:
      tp-channel=eHMI_ParkingUI_SOME_IP_TP_Channel, tp-sdu=PDUTrigger_Event_NtfVpaFcnOperating_eHMI_ParkingUI, transport-pdu=TPPDUTrigger_Event_NtfVpaFcnOperating_eHMI_ParkingUI
      tp-channel=TBOX_GNSSInfo_SOME_IP_TP_Channel, tp-sdu=PDUTrigger_Event_Event_GNSSInfo1_TBOX_GNSSInfo, transport-pdu=TPPDUTrigger_Event_Event_GNSSInfo1_TBOX_GNSSInfo
      tp-channel=TBOX_GNSSInfo_SOME_IP_TP_Channel, tp-sdu=PDUTrigger_Event_Event_GNSSInfo1_TBOX_GNSSInfo_1, transport-pdu=TPPDUTrigger_Event_Event_GNSSInfo1_TBOX_GNSSInfo_1
      tp-channel=ICC_SDmapInfo_SOME_IP_TP_Channel, tp-sdu=PDUTrigger_Event_NtfSDmapInfo_ICC_SDmapInfo, transport-pdu=TPPDUTrigger_Event_NtfSDmapInfo_ICC_SDmapInfo
      tp-channel=ICC_SDmapInfo_SOME_IP_TP_Channel, tp-sdu=PDUTrigger_Event_NtfSDmapInfo_ICC_SDmapInfo_1, transport-pdu=TPPDUTrigger_Event_NtfSDmapInfo_ICC_SDmapInfo_1
      tp-channel=ICC_SDmapInfo_2_SOME_IP_TP_Channel, tp-sdu=PDUTrigger_Event_NtfSDmapRouteInfo_ICC_SDmapInfo_2, transport-pdu=TPPDUTrigger_Event_NtfSDmapRouteInfo_ICC_SDmapInfo_2
      tp-channel=ICC_SDmapInfo_2_SOME_IP_TP_Channel, tp-sdu=PDUTrigger_Event_NtfSDmapTBTNaviInfo_ICC_SDmapInfo_2, transport-pdu=TPPDUTrigger_Event_NtfSDmapTBTNaviInfo_ICC_SDmapInfo_2
      tp-channel=ICC_SDmapInfo_2_SOME_IP_TP_Channel, tp-sdu=PDUTrigger_Event_NtfSDmapNaviCameraInfo_ICC_SDmapInfo_2, transport-pdu=TPPDUTrigger_Event_NtfSDmapNaviCameraInfo_ICC_SDmapInfo_2
      tp-channel=ICC_SDmapInfo_2_SOME_IP_TP_Channel, tp-sdu=PDUTrigger_Event_NtfSDmapTrafficLightCDInfo_ICC_SDmapInfo_2, transport-pdu=TPPDUTrigger_Event_NtfSDmapTrafficLightCDInfo_ICC_SDmapInfo_2
      tp-channel=ICC_SDmapInfo_2_SOME_IP_TP_Channel, tp-sdu=PDUTrigger_Event_NtfSDmapNaviIntCamDynInfo_ICC_SDmapInfo_2, transport-pdu=TPPDUTrigger_Event_NtfSDmapNaviIntCamDynInfo_ICC_SDmapInfo_2
      tp-channel=ICC_SDmapInfo_2_SOME_IP_TP_Channel, tp-sdu=PDUTrigger_Event_NtfSDmapNaviWeatherInfo_ICC_SDmapInfo_2, transport-pdu=TPPDUTrigger_Event_NtfSDmapNaviWeatherInfo_ICC_SDmapInfo_2
      tp-channel=ICC_SDmapInfo_2_SOME_IP_TP_Channel, tp-sdu=PDUTrigger_Event_NtfSDmapNaviCongestionInfo_ICC_SDmapInfo_2, transport-pdu=TPPDUTrigger_Event_NtfSDmapNaviCongestionInfo_ICC_SDmapInfo_2
      tp-channel=ICC_SDmapInfo_2_SOME_IP_TP_Channel, tp-sdu=PDUTrigger_Event_NtfSDmapNaviGreenWaveCarSpd_ICC_SDmapInfo_2, transport-pdu=TPPDUTrigger_Event_NtfSDmapNaviGreenWaveCarSpd_ICC_SDmapInfo_2
      tp-channel=ICC_SDmapInfo_2_SOME_IP_TP_Channel, tp-sdu=PDUTrigger_Event_NtfSDmapAheadLaneInfo_ICC_SDmapInfo_2, transport-pdu=TPPDUTrigger_Event_NtfSDmapAheadLaneInfo_ICC_SDmapInfo_2
      tp-channel=ICC_SDmapInfo_2_SOME_IP_TP_Channel, tp-sdu=PDUTrigger_Event_notifySDmapTollGateLaneInfo_ICC_SDmapInfo_2, transport-pdu=TPPDUTrigger_Event_notifySDmapTollGateLaneInfo_ICC_SDmapInfo_2
      tp-channel=ICC_SDmapInfo_2_SOME_IP_TP_Channel, tp-sdu=PDUTrigger_Event_NtfSDmapRouteInfo_ICC_SDmapInfo_2_1, transport-pdu=TPPDUTrigger_Event_NtfSDmapRouteInfo_ICC_SDmapInfo_2_1
      tp-channel=ICC_SDmapInfo_2_SOME_IP_TP_Channel, tp-sdu=PDUTrigger_Event_NtfSDmapTBTNaviInfo_ICC_SDmapInfo_2_1, transport-pdu=TPPDUTrigger_Event_NtfSDmapTBTNaviInfo_ICC_SDmapInfo_2_1
      tp-channel=ICC_SDmapInfo_2_SOME_IP_TP_Channel, tp-sdu=PDUTrigger_Event_NtfSDmapNaviCameraInfo_ICC_SDmapInfo_2_1, transport-pdu=TPPDUTrigger_Event_NtfSDmapNaviCameraInfo_ICC_SDmapInfo_2_1
      tp-channel=ICC_SDmapInfo_2_SOME_IP_TP_Channel, tp-sdu=PDUTrigger_Event_NtfSDmapTrafficLightCDInfo_ICC_SDmapInfo_2_1, transport-pdu=TPPDUTrigger_Event_NtfSDmapTrafficLightCDInfo_ICC_SDmapInfo_2_1
      tp-channel=ICC_SDmapInfo_2_SOME_IP_TP_Channel, tp-sdu=PDUTrigger_Event_NtfSDmapNaviIntCamDynInfo_ICC_SDmapInfo_2_1, transport-pdu=TPPDUTrigger_Event_NtfSDmapNaviIntCamDynInfo_ICC_SDmapInfo_2_1
      tp-channel=ICC_SDmapInfo_2_SOME_IP_TP_Channel, tp-sdu=PDUTrigger_Event_NtfSDmapNaviWeatherInfo_ICC_SDmapInfo_2_1, transport-pdu=TPPDUTrigger_Event_NtfSDmapNaviWeatherInfo_ICC_SDmapInfo_2_1
      tp-channel=ICC_SDmapInfo_2_SOME_IP_TP_Channel, tp-sdu=PDUTrigger_Event_NtfSDmapNaviCongestionInfo_ICC_SDmapInfo_2_1, transport-pdu=TPPDUTrigger_Event_NtfSDmapNaviCongestionInfo_ICC_SDmapInfo_2_1
      tp-channel=ICC_SDmapInfo_2_SOME_IP_TP_Channel, tp-sdu=PDUTrigger_Event_NtfSDmapNaviGreenWaveCarSpd_ICC_SDmapInfo_2_1, transport-pdu=TPPDUTrigger_Event_NtfSDmapNaviGreenWaveCarSpd_ICC_SDmapInfo_2_1
      tp-channel=ICC_SDmapInfo_2_SOME_IP_TP_Channel, tp-sdu=PDUTrigger_Event_NtfSDmapAheadLaneInfo_ICC_SDmapInfo_2_1, transport-pdu=TPPDUTrigger_Event_NtfSDmapAheadLaneInfo_ICC_SDmapInfo_2_1
      tp-channel=ICC_SDmapInfo_2_SOME_IP_TP_Channel, tp-sdu=PDUTrigger_Event_notifySDmapTollGateLaneInfo_ICC_SDmapInfo_2_1, transport-pdu=TPPDUTrigger_Event_notifySDmapTollGateLaneInfo_ICC_SDmapInfo_2_1
      tp-channel=ADCC_DrivingHmiEnv_SOME_IP_TP_Channel, tp-sdu=PDUTrigger_Event_NtfDynamicObjectList_Drvg_ADCC_DrivingHmiEnv, transport-pdu=TPPDUTrigger_Event_NtfDynamicObjectList_Drvg_ADCC_DrivingHmiEnv
      tp-channel=ADCC_DrivingHmiEnv_SOME_IP_TP_Channel, tp-sdu=PDUTrigger_Event_NtfStaticObjectList_Drvg_ADCC_DrivingHmiEnv, transport-pdu=TPPDUTrigger_Event_NtfStaticObjectList_Drvg_ADCC_DrivingHmiEnv
      tp-channel=ADCC_DrivingHmiEnv_SOME_IP_TP_Channel, tp-sdu=PDUTrigger_Event_NtfLaneLineListt_Drvg_2_ADCC_DrivingHmiEnv, transport-pdu=TPPDUTrigger_Event_NtfLaneLineListt_Drvg_2_ADCC_DrivingHmiEnv
      tp-channel=ADCC_DrivingHmiEnv_SOME_IP_TP_Channel, tp-sdu=PDUTrigger_Event_NtfFusionMapData_ADCC_DrivingHmiEnv, transport-pdu=TPPDUTrigger_Event_NtfFusionMapData_ADCC_DrivingHmiEnv
      tp-channel=ADCC_DrivingHmiEnv_SOME_IP_TP_Channel, tp-sdu=PDUTrigger_Event_NtfFreeSpaceList_Drvg_ADCC_DrivingHmiEnv, transport-pdu=TPPDUTrigger_Event_NtfFreeSpaceList_Drvg_ADCC_DrivingHmiEnv
      tp-channel=ADCC_DrivingHmiEnv_SOME_IP_TP_Channel, tp-sdu=PDUTrigger_Event_Ntf3DTrafficSignList_Drvg_ADCC_DrivingHmiEnv, transport-pdu=TPPDUTrigger_Event_Ntf3DTrafficSignList_Drvg_ADCC_DrivingHmiEnv
      tp-channel=ADCC_DrivingHmiEnv_SOME_IP_TP_Channel, tp-sdu=PDUTrigger_Event_NtfDynamicObjectList_Drvg_2_ADCC_DrivingHmiEnv, transport-pdu=TPPDUTrigger_Event_NtfDynamicObjectList_Drvg_2_ADCC_DrivingHmiEnv
      tp-channel=ADCC_DrivingHmiEnv_SOME_IP_TP_Channel, tp-sdu=PDUTrigger_Event_NtfStaticObjectList_Drvg_2_ADCC_DrivingHmiEnv, transport-pdu=TPPDUTrigger_Event_NtfStaticObjectList_Drvg_2_ADCC_DrivingHmiEnv
      tp-channel=ADCC_DrivingHmiEnv_SOME_IP_TP_Channel, tp-sdu=PDUTrigger_Event_NtfRoadSurfaceMes_ADCC_DrivingHmiEnv, transport-pdu=TPPDUTrigger_Event_NtfRoadSurfaceMes_ADCC_DrivingHmiEnv
      tp-channel=ADCC_DrivingHmiEnv_SOME_IP_TP_Channel, tp-sdu=PDUTrigger_Event_NtfDynamicObjectList_Drvg_ADCC_DrivingHmiEnv_1, transport-pdu=TPPDUTrigger_Event_NtfDynamicObjectList_Drvg_ADCC_DrivingHmiEnv_1
      tp-channel=ADCC_DrivingHmiEnv_SOME_IP_TP_Channel, tp-sdu=PDUTrigger_Event_NtfStaticObjectList_Drvg_ADCC_DrivingHmiEnv_1, transport-pdu=TPPDUTrigger_Event_NtfStaticObjectList_Drvg_ADCC_DrivingHmiEnv_1
      tp-channel=ADCC_DrivingHmiEnv_SOME_IP_TP_Channel, tp-sdu=PDUTrigger_Event_NtfLaneLineListt_Drvg_2_ADCC_DrivingHmiEnv_1, transport-pdu=TPPDUTrigger_Event_NtfLaneLineListt_Drvg_2_ADCC_DrivingHmiEnv_1
      tp-channel=ADCC_DrivingHmiEnv_SOME_IP_TP_Channel, tp-sdu=PDUTrigger_Event_NtfFusionMapData_ADCC_DrivingHmiEnv_1, transport-pdu=TPPDUTrigger_Event_NtfFusionMapData_ADCC_DrivingHmiEnv_1
      tp-channel=ADCC_DrivingHmiEnv_SOME_IP_TP_Channel, tp-sdu=PDUTrigger_Event_NtfFreeSpaceList_Drvg_ADCC_DrivingHmiEnv_1, transport-pdu=TPPDUTrigger_Event_NtfFreeSpaceList_Drvg_ADCC_DrivingHmiEnv_1
      tp-channel=ADCC_DrivingHmiEnv_SOME_IP_TP_Channel, tp-sdu=PDUTrigger_Event_Ntf3DTrafficSignList_Drvg_ADCC_DrivingHmiEnv_1, transport-pdu=TPPDUTrigger_Event_Ntf3DTrafficSignList_Drvg_ADCC_DrivingHmiEnv_1
      tp-channel=ADCC_DrivingHmiEnv_SOME_IP_TP_Channel, tp-sdu=PDUTrigger_Event_NtfDynamicObjectList_Drvg_2_ADCC_DrivingHmiEnv_1, transport-pdu=TPPDUTrigger_Event_NtfDynamicObjectList_Drvg_2_ADCC_DrivingHmiEnv_1
      tp-channel=ADCC_DrivingHmiEnv_SOME_IP_TP_Channel, tp-sdu=PDUTrigger_Event_NtfStaticObjectList_Drvg_2_ADCC_DrivingHmiEnv_1, transport-pdu=TPPDUTrigger_Event_NtfStaticObjectList_Drvg_2_ADCC_DrivingHmiEnv_1
      tp-channel=ADCC_DrivingHmiEnv_SOME_IP_TP_Channel, tp-sdu=PDUTrigger_Event_NtfRoadSurfaceMes_ADCC_DrivingHmiEnv_1, transport-pdu=TPPDUTrigger_Event_NtfRoadSurfaceMes_ADCC_DrivingHmiEnv_1
      tp-channel=ADCC_DrivingFuncInfo_SOME_IP_TP_Channel, tp-sdu=PDUTrigger_Event_NtfMNPRoutesInfo_Drvg_ADCC_DrivingFuncInfo, transport-pdu=TPPDUTrigger_Event_NtfMNPRoutesInfo_Drvg_ADCC_DrivingFuncInfo
      tp-channel=ADCC_DrivingFuncInfo_SOME_IP_TP_Channel, tp-sdu=PDUTrigger_Event_NtfHNOPSupplementInfo_Drvg_ADCC_DrivingFuncInfo, transport-pdu=TPPDUTrigger_Event_NtfHNOPSupplementInfo_Drvg_ADCC_DrivingFuncInfo
      tp-channel=ADCC_DrivingFuncInfo_SOME_IP_TP_Channel, tp-sdu=PDUTrigger_Event_NtfMNPAllRoutesInfo_Drvg_ADCC_DrivingFuncInfo, transport-pdu=TPPDUTrigger_Event_NtfMNPAllRoutesInfo_Drvg_ADCC_DrivingFuncInfo
      tp-channel=ADCC_DrivingFuncInfo_SOME_IP_TP_Channel, tp-sdu=PDUTrigger_Event_NtfMNPMemRouteInfo_Drvg_ADCC_DrivingFuncInfo, transport-pdu=TPPDUTrigger_Event_NtfMNPMemRouteInfo_Drvg_ADCC_DrivingFuncInfo
      tp-channel=ADCC_DrivingFuncInfo_SOME_IP_TP_Channel, tp-sdu=PDUTrigger_Event_NtfMNPInfo_Drvg_2_ADCC_DrivingFuncInfo, transport-pdu=TPPDUTrigger_Event_NtfMNPInfo_Drvg_2_ADCC_DrivingFuncInfo
      tp-channel=ADCC_DrivingFuncInfo_SOME_IP_TP_Channel, tp-sdu=PDUTrigger_Event_NtfMNPRoutesInfo_Drvg_ADCC_DrivingFuncInfo_1, transport-pdu=TPPDUTrigger_Event_NtfMNPRoutesInfo_Drvg_ADCC_DrivingFuncInfo_1
      tp-channel=ADCC_DrivingFuncInfo_SOME_IP_TP_Channel, tp-sdu=PDUTrigger_Event_NtfHNOPSupplementInfo_Drvg_ADCC_DrivingFuncInfo_1, transport-pdu=TPPDUTrigger_Event_NtfHNOPSupplementInfo_Drvg_ADCC_DrivingFuncInfo_1
      tp-channel=ADCC_DrivingFuncInfo_SOME_IP_TP_Channel, tp-sdu=PDUTrigger_Event_NtfMNPAllRoutesInfo_Drvg_ADCC_DrivingFuncInfo_1, transport-pdu=TPPDUTrigger_Event_NtfMNPAllRoutesInfo_Drvg_ADCC_DrivingFuncInfo_1
      tp-channel=ADCC_DrivingFuncInfo_SOME_IP_TP_Channel, tp-sdu=PDUTrigger_Event_NtfMNPMemRouteInfo_Drvg_ADCC_DrivingFuncInfo_1, transport-pdu=TPPDUTrigger_Event_NtfMNPMemRouteInfo_Drvg_ADCC_DrivingFuncInfo_1
      tp-channel=ADCC_DrivingFuncInfo_SOME_IP_TP_Channel, tp-sdu=PDUTrigger_Event_NtfMNPInfo_Drvg_2_ADCC_DrivingFuncInfo_1, transport-pdu=TPPDUTrigger_Event_NtfMNPInfo_Drvg_2_ADCC_DrivingFuncInfo_1
      tp-channel=ADCC_ParkingFuncInfo_SOME_IP_TP_Channel, tp-sdu=PDUTrigger_Event_NtfHPAPathDetail_ADCC_ParkingFuncInfo, transport-pdu=TPPDUTrigger_Event_NtfHPAPathDetail_ADCC_ParkingFuncInfo
      tp-channel=ADCC_ParkingFuncInfo_SOME_IP_TP_Channel, tp-sdu=PDUTrigger_Event_NtfHPATrainigPathInfo_ADCC_ParkingFuncInfo, transport-pdu=TPPDUTrigger_Event_NtfHPATrainigPathInfo_ADCC_ParkingFuncInfo
      tp-channel=ADCC_ParkingFuncInfo_SOME_IP_TP_Channel, tp-sdu=PDUTrigger_Event_NtfHPARepalyPathInfo_ADCC_ParkingFuncInfo, transport-pdu=TPPDUTrigger_Event_NtfHPARepalyPathInfo_ADCC_ParkingFuncInfo
      tp-channel=ADCC_ParkingFuncInfo_SOME_IP_TP_Channel, tp-sdu=PDUTrigger_Event_NtfHPAPathDetail_2_ADCC_ParkingFuncInfo, transport-pdu=TPPDUTrigger_Event_NtfHPAPathDetail_2_ADCC_ParkingFuncInfo
      tp-channel=ADCC_ParkingFuncInfo_SOME_IP_TP_Channel, tp-sdu=PDUTrigger_Event_NtfHPATrainigPathInfo_2_ADCC_ParkingFuncInfo, transport-pdu=TPPDUTrigger_Event_NtfHPATrainigPathInfo_2_ADCC_ParkingFuncInfo
      tp-channel=ADCC_ParkingFuncInfo_SOME_IP_TP_Channel, tp-sdu=PDUTrigger_Event_NtfHPARepalyPathInfo_2_ADCC_ParkingFuncInfo, transport-pdu=TPPDUTrigger_Event_NtfHPARepalyPathInfo_2_ADCC_ParkingFuncInfo
      tp-channel=ADCC_ParkingFuncInfo_SOME_IP_TP_Channel, tp-sdu=PDUTrigger_Event_NtfVPAInfo_ADCC_ParkingFuncInfo, transport-pdu=TPPDUTrigger_Event_NtfVPAInfo_ADCC_ParkingFuncInfo
      tp-channel=ADCC_ParkingFuncInfo_SOME_IP_TP_Channel, tp-sdu=PDUTrigger_Event_NtfParkingHMIInfo_ADCC_ParkingFuncInfo, transport-pdu=TPPDUTrigger_Event_NtfParkingHMIInfo_ADCC_ParkingFuncInfo
      tp-channel=ADCC_ParkingFuncInfo_SOME_IP_TP_Channel, tp-sdu=PDUTrigger_Event_NtfHPAPathDetail_ADCC_ParkingFuncInfo_1, transport-pdu=TPPDUTrigger_Event_NtfHPAPathDetail_ADCC_ParkingFuncInfo_1
      tp-channel=ADCC_ParkingFuncInfo_SOME_IP_TP_Channel, tp-sdu=PDUTrigger_Event_NtfHPATrainigPathInfo_ADCC_ParkingFuncInfo_1, transport-pdu=TPPDUTrigger_Event_NtfHPATrainigPathInfo_ADCC_ParkingFuncInfo_1
      tp-channel=ADCC_ParkingFuncInfo_SOME_IP_TP_Channel, tp-sdu=PDUTrigger_Event_NtfHPARepalyPathInfo_ADCC_ParkingFuncInfo_1, transport-pdu=TPPDUTrigger_Event_NtfHPARepalyPathInfo_ADCC_ParkingFuncInfo_1
      tp-channel=ADCC_ParkingFuncInfo_SOME_IP_TP_Channel, tp-sdu=PDUTrigger_Event_NtfHPAPathDetail_2_ADCC_ParkingFuncInfo_1, transport-pdu=TPPDUTrigger_Event_NtfHPAPathDetail_2_ADCC_ParkingFuncInfo_1
      tp-channel=ADCC_ParkingFuncInfo_SOME_IP_TP_Channel, tp-sdu=PDUTrigger_Event_NtfHPATrainigPathInfo_2_ADCC_ParkingFuncInfo_1, transport-pdu=TPPDUTrigger_Event_NtfHPATrainigPathInfo_2_ADCC_ParkingFuncInfo_1
      tp-channel=ADCC_ParkingFuncInfo_SOME_IP_TP_Channel, tp-sdu=PDUTrigger_Event_NtfHPARepalyPathInfo_2_ADCC_ParkingFuncInfo_1, transport-pdu=TPPDUTrigger_Event_NtfHPARepalyPathInfo_2_ADCC_ParkingFuncInfo_1
      tp-channel=ADCC_ParkingFuncInfo_SOME_IP_TP_Channel, tp-sdu=PDUTrigger_Event_NtfVPAInfo_ADCC_ParkingFuncInfo_1, transport-pdu=TPPDUTrigger_Event_NtfVPAInfo_ADCC_ParkingFuncInfo_1
      tp-channel=ADCC_ParkingFuncInfo_SOME_IP_TP_Channel, tp-sdu=PDUTrigger_Event_NtfParkingHMIInfo_ADCC_ParkingFuncInfo_1, transport-pdu=TPPDUTrigger_Event_NtfParkingHMIInfo_ADCC_ParkingFuncInfo_1
      tp-channel=ADCC_ParkingHmiEnv_SOME_IP_TP_Channel, tp-sdu=PDUTrigger_Event_NtfDynamicObjectList_Prkg_ADCC_ParkingHmiEnv, transport-pdu=TPPDUTrigger_Event_NtfDynamicObjectList_Prkg_ADCC_ParkingHmiEnv
      tp-channel=ADCC_ParkingHmiEnv_SOME_IP_TP_Channel, tp-sdu=PDUTrigger_Event_NtfStaticObjectList_Prkg_ADCC_ParkingHmiEnv, transport-pdu=TPPDUTrigger_Event_NtfStaticObjectList_Prkg_ADCC_ParkingHmiEnv
      tp-channel=ADCC_ParkingHmiEnv_SOME_IP_TP_Channel, tp-sdu=PDUTrigger_Event_NtfHPAStaticObjectList_Prkg_ADCC_ParkingHmiEnv, transport-pdu=TPPDUTrigger_Event_NtfHPAStaticObjectList_Prkg_ADCC_ParkingHmiEnv
      tp-channel=ADCC_ParkingHmiEnv_SOME_IP_TP_Channel, tp-sdu=PDUTrigger_Event_NtfHPAParkingSlot_Prkg_ADCC_ParkingHmiEnv, transport-pdu=TPPDUTrigger_Event_NtfHPAParkingSlot_Prkg_ADCC_ParkingHmiEnv
      tp-channel=ADCC_ParkingHmiEnv_SOME_IP_TP_Channel, tp-sdu=PDUTrigger_Event_NtfVPASelfBuildMapInfo_ADCC_ParkingHmiEnv, transport-pdu=TPPDUTrigger_Event_NtfVPASelfBuildMapInfo_ADCC_ParkingHmiEnv
      tp-channel=ADCC_ParkingHmiEnv_SOME_IP_TP_Channel, tp-sdu=PDUTrigger_Event_NtfVPAParkingLotInfo_ADCC_ParkingHmiEnv, transport-pdu=TPPDUTrigger_Event_NtfVPAParkingLotInfo_ADCC_ParkingHmiEnv
      tp-channel=ADCC_ParkingHmiEnv_SOME_IP_TP_Channel, tp-sdu=PDUTrigger_Event_NtfDynamicObjectList_Prkg_2_ADCC_ParkingHmiEnv, transport-pdu=TPPDUTrigger_Event_NtfDynamicObjectList_Prkg_2_ADCC_ParkingHmiEnv
      tp-channel=ADCC_ParkingHmiEnv_SOME_IP_TP_Channel, tp-sdu=PDUTrigger_Event_NtfStaticObjectList_Prkg_2_ADCC_ParkingHmiEnv, transport-pdu=TPPDUTrigger_Event_NtfStaticObjectList_Prkg_2_ADCC_ParkingHmiEnv
      tp-channel=ADCC_ParkingHmiEnv_SOME_IP_TP_Channel, tp-sdu=PDUTrigger_Event_NtfDynamicObjectList_Prkg_ADCC_ParkingHmiEnv_1, transport-pdu=TPPDUTrigger_Event_NtfDynamicObjectList_Prkg_ADCC_ParkingHmiEnv_1
      tp-channel=ADCC_ParkingHmiEnv_SOME_IP_TP_Channel, tp-sdu=PDUTrigger_Event_NtfStaticObjectList_Prkg_ADCC_ParkingHmiEnv_1, transport-pdu=TPPDUTrigger_Event_NtfStaticObjectList_Prkg_ADCC_ParkingHmiEnv_1
      tp-channel=ADCC_ParkingHmiEnv_SOME_IP_TP_Channel, tp-sdu=PDUTrigger_Event_NtfHPAStaticObjectList_Prkg_ADCC_ParkingHmiEnv_1, transport-pdu=TPPDUTrigger_Event_NtfHPAStaticObjectList_Prkg_ADCC_ParkingHmiEnv_1
      tp-channel=ADCC_ParkingHmiEnv_SOME_IP_TP_Channel, tp-sdu=PDUTrigger_Event_NtfHPAParkingSlot_Prkg_ADCC_ParkingHmiEnv_1, transport-pdu=TPPDUTrigger_Event_NtfHPAParkingSlot_Prkg_ADCC_ParkingHmiEnv_1
      tp-channel=ADCC_ParkingHmiEnv_SOME_IP_TP_Channel, tp-sdu=PDUTrigger_Event_NtfVPASelfBuildMapInfo_ADCC_ParkingHmiEnv_1, transport-pdu=TPPDUTrigger_Event_NtfVPASelfBuildMapInfo_ADCC_ParkingHmiEnv_1
      tp-channel=ADCC_ParkingHmiEnv_SOME_IP_TP_Channel, tp-sdu=PDUTrigger_Event_NtfVPAParkingLotInfo_ADCC_ParkingHmiEnv_1, transport-pdu=TPPDUTrigger_Event_NtfVPAParkingLotInfo_ADCC_ParkingHmiEnv_1
      tp-channel=ADCC_ParkingHmiEnv_SOME_IP_TP_Channel, tp-sdu=PDUTrigger_Event_NtfDynamicObjectList_Prkg_2_ADCC_ParkingHmiEnv_1, transport-pdu=TPPDUTrigger_Event_NtfDynamicObjectList_Prkg_2_ADCC_ParkingHmiEnv_1
      tp-channel=ADCC_ParkingHmiEnv_SOME_IP_TP_Channel, tp-sdu=PDUTrigger_Event_NtfStaticObjectList_Prkg_2_ADCC_ParkingHmiEnv_1, transport-pdu=TPPDUTrigger_Event_NtfStaticObjectList_Prkg_2_ADCC_ParkingHmiEnv_1
      tp-channel=ADCC_AomDB_SOME_IP_TP_Channel, tp-sdu=PDUTrigger_RR_GetPackageData_return_Cis_ICC_8155_Android_ADCC_AomDB, transport-pdu=TPPDUTrigger_RR_GetPackageData_return_Cis_ICC_8155_Android_ADCC_AomDB
      tp-channel=ADCC_AomDB_SOME_IP_TP_Channel, tp-sdu=PDUTrigger_RR_GetPackageData_return_Cis_ICC_8155_QNX_ADCC_AomDB, transport-pdu=TPPDUTrigger_RR_GetPackageData_return_Cis_ICC_8155_QNX_ADCC_AomDB
      tp-channel=ADCC_RtMM_SOME_IP_TP_Channel, tp-sdu=PDUTrigger_Event_notifyRtMatchRes_ADCC_RtMM, transport-pdu=TPPDUTrigger_Event_notifyRtMatchRes_ADCC_RtMM
      tp-channel=ADCC_RtMM_SOME_IP_TP_Channel, tp-sdu=PDUTrigger_Event_notifyRtMatchRes_ADCC_RtMM_1, transport-pdu=TPPDUTrigger_Event_notifyRtMatchRes_ADCC_RtMM_1
      tp-channel=FCM_DrivingHmiEnv_SOME_IP_TP_Channel, tp-sdu=PDUTrigger_Event_NtfDynamicObjectList_FCM_DrivingHmiEnv, transport-pdu=TPPDUTrigger_Event_NtfDynamicObjectList_FCM_DrivingHmiEnv
      tp-channel=FCM_DrivingHmiEnv_SOME_IP_TP_Channel, tp-sdu=PDUTrigger_Event_NtfStaticObjectList_FCM_DrivingHmiEnv, transport-pdu=TPPDUTrigger_Event_NtfStaticObjectList_FCM_DrivingHmiEnv
      tp-channel=FCM_DrivingHmiEnv_SOME_IP_TP_Channel, tp-sdu=PDUTrigger_Event_NtfLaneLineList_2_FCM_DrivingHmiEnv, transport-pdu=TPPDUTrigger_Event_NtfLaneLineList_2_FCM_DrivingHmiEnv
      tp-channel=FCM_DrivingHmiEnv_SOME_IP_TP_Channel, tp-sdu=PDUTrigger_Event_NtfDynamicObjectList_2_FCM_DrivingHmiEnv, transport-pdu=TPPDUTrigger_Event_NtfDynamicObjectList_2_FCM_DrivingHmiEnv
      tp-channel=FCM_DrivingHmiEnv_SOME_IP_TP_Channel, tp-sdu=PDUTrigger_Event_NtfStaticObjectList_2_FCM_DrivingHmiEnv, transport-pdu=TPPDUTrigger_Event_NtfStaticObjectList_2_FCM_DrivingHmiEnv
      tp-channel=FCM_DrivingHmiEnv_SOME_IP_TP_Channel, tp-sdu=PDUTrigger_Event_NtfDynamicObjectList_FCM_DrivingHmiEnv_1, transport-pdu=TPPDUTrigger_Event_NtfDynamicObjectList_FCM_DrivingHmiEnv_1
      tp-channel=FCM_DrivingHmiEnv_SOME_IP_TP_Channel, tp-sdu=PDUTrigger_Event_NtfStaticObjectList_FCM_DrivingHmiEnv_1, transport-pdu=TPPDUTrigger_Event_NtfStaticObjectList_FCM_DrivingHmiEnv_1
      tp-channel=FCM_DrivingHmiEnv_SOME_IP_TP_Channel, tp-sdu=PDUTrigger_Event_NtfLaneLineList_2_FCM_DrivingHmiEnv_1, transport-pdu=TPPDUTrigger_Event_NtfLaneLineList_2_FCM_DrivingHmiEnv_1
      tp-channel=FCM_DrivingHmiEnv_SOME_IP_TP_Channel, tp-sdu=PDUTrigger_Event_NtfDynamicObjectList_2_FCM_DrivingHmiEnv_1, transport-pdu=TPPDUTrigger_Event_NtfDynamicObjectList_2_FCM_DrivingHmiEnv_1
      tp-channel=FCM_DrivingHmiEnv_SOME_IP_TP_Channel, tp-sdu=PDUTrigger_Event_NtfStaticObjectList_2_FCM_DrivingHmiEnv_1, transport-pdu=TPPDUTrigger_Event_NtfStaticObjectList_2_FCM_DrivingHmiEnv_1
      tp-channel=ADAS_GNSSInfo_SOME_IP_TP_Channel, tp-sdu=PDUTrigger_Event_notifyGNSSInfo_ADAS_GNSSInfo, transport-pdu=TPPDUTrigger_Event_notifyGNSSInfo_ADAS_GNSSInfo
      tp-channel=ADAS_GNSSInfo_SOME_IP_TP_Channel, tp-sdu=PDUTrigger_Event_notifyGNSSInfo_ADAS_GNSSInfo_1, transport-pdu=TPPDUTrigger_Event_notifyGNSSInfo_ADAS_GNSSInfo_1
