[part 4 of 11: packages /SoftwareTypes/Interfaces to /System]
AUTOSAR XML (schema 00048)
package /SoftwareTypes/Interfaces
  13 x sender receiver interface:
    eHMI_ParkingUI_NtfParkingFuncModReq
      data DataElement_NtfParkingFuncModReq: type=ADT_ICC_enum_ParkingFuncModReq
    eHMI_ParkingUI_NtfApaRpaFcnOperating
      data DataElement_NtfApaRpaFcnOperating: type=ADT_ICC_strt_ApaRpaFcnOperating
    eHMI_ParkingUI_NtfHpaFcnOperating
      data DataElement_NtfHpaFcnOperating: type=ADT_ICC_strt_HpaFcnOperating
    eHMI_ParkingUI_NtfVpaFcnOperating
      data DataElement_NtfVpaFcnOperating: type=ADT_ICC_strt_VpaFcnOperating
    eHMI_ParkingUI_NtfMraFcnOperating
      data DataElement_NtfMraFcnOperating: type=ADT_ICC_enum_MRAOperationId
    eHMI_ParkingUI_NtfSVSStatus
      data DataElement_NtfSVSStatus: type=ADT_ADAS_enum_SVSSts
    eHMI_ParkingUI_NtfApaRpaFcnOperating_2
      data DataElement_NtfApaRpaFcnOperating_2: type=ADT_ICC_strt_ApaRpaFcnOperating_2
    eHMI_ParkingUI_NtfHpaFcnOperating_2
      data DataElement_NtfHpaFcnOperating_2: type=ADT_ICC_strt_HpaFcnOperating_2
    eHMI_ADASSetting_NtfADASSettingInfo
      data DataElement_NtfADASSettingInfo: type=ADT_ICC_Strt_ADASSettingInfo
    eHMI_ADASSetting_NtfADASSettingInfo_2
      data DataElement_NtfADASSettingInfo_2: type=ADT_ICC_Strt_ADASSettingInfo_2
    eHMI_ADASSetting_NtfADASSettingInfo_3
      data DataElement_NtfADASSettingInfo_3: type=ADT_ICC_Strt_ADASSettingInfo_3
    eHMI_DVRSet_notifyDVRRequest
      data DataElement_notifyDVRRequest: type=ADT_DVRRequest
    TBOX_TimeManagement_notifyTimeManagement
      data DataElement_notifyTimeManagement: type=ADT_TimeManagement
  client server interface TBOX_ResSwtSts
    10 x operation:
      RROper_get5GSwtSts_Fb
        arg RROperationArgument_get5GSwtSts_Fb_Out_0: type=ADT_SwtSts, direction=OUT
      RROper_getV2XSwtSts_Fb
        arg RROperationArgument_getV2XSwtSts_Fb_Out_0: type=ADT_SwtSts, direction=OUT
      RROper_getDownLogSwtSts_Fb
        arg RROperationArgument_getDownLogSwtSts_Fb_Out_0: type=ADT_SwtSts, direction=OUT
      RROper_getUSBUpdateSwtSts_Fb
        arg RROperationArgument_getUSBUpdateSwtSts_Fb_Out_0: type=ADT_SwtSts, direction=OUT
      RROper_getResumeFactorySet_Fb
        arg RROperationArgument_getResumeFactorySet_Fb_Out_0: type=ADT_ResumeFactorySet, direction=OUT
      RROper_set5GSwtSts
        arg RROperationArgument_set5GSwtSts_In_0: type=ADT_SwtSts, direction=IN
        arg RROperationArgument_set5GSwtSts_Out_0: type=ADT_TBOX_ReturnCode, direction=OUT
      RROper_setV2XSwtSts
        arg RROperationArgument_setV2XSwtSts_In_0: type=ADT_SwtSts, direction=IN
        arg RROperationArgument_setV2XSwtSts_Out_0: type=ADT_TBOX_ReturnCode, direction=OUT
      RROper_setDownLogSwtSts
        arg RROperationArgument_setDownLogSwtSts_In_0: type=ADT_SwtSts, direction=IN
        arg RROperationArgument_setDownLogSwtSts_Out_0: type=ADT_TBOX_ReturnCode, direction=OUT
      RROper_setUSBUpdateSwtSts
        arg RROperationArgument_setUSBUpdateSwtSts_In_0: type=ADT_SwtSts, direction=IN
        arg RROperationArgument_setUSBUpdateSwtSts_Out_0: type=ADT_TBOX_ReturnCode, direction=OUT
      RROper_setResumeFactorySet
        arg RROperationArgument_setResumeFactorySet_In_0: type=ADT_ResumeFactorySet, direction=IN
        arg RROperationArgument_setResumeFactorySet_Out_0: type=ADT_TBOX_ReturnCode, direction=OUT
  5 x sender receiver interface:
    TBOX_ResSwtSts_notify5GSwtSts_Fb
      data DataElement_notify5GSwtSts_Fb: type=ADT_SwtSts
    TBOX_ResSwtSts_notifyV2XSwtSts_Fb
      data DataElement_notifyV2XSwtSts_Fb: type=ADT_SwtSts
    TBOX_ResSwtSts_notifyDownLogSwtSts_Fb
      data DataElement_notifyDownLogSwtSts_Fb: type=ADT_SwtSts
    TBOX_ResSwtSts_notifyUSBUpdateSwtSts_Fb
      data DataElement_notifyUSBUpdateSwtSts_Fb: type=ADT_SwtSts
    TBOX_ResSwtSts_notifyResumeFactorySet_Fb
      data DataElement_notifyResumeFactorySet_Fb: type=ADT_ResumeFactorySet
  client server interface TBOX_SystemInfo
    19 x operation:
      RROper_RR_TBoxVersionInfo
        arg RROperationArgument_RR_TBoxVersionInfo_Out_0: type=ADT_Struct_TBOXVersionInfo, direction=OUT
      RROper_RR_BleModuleInfo
        arg RROperationArgument_RR_BleModuleInfo_Out_0: type=ADT_Struct_BleModuleInfo, direction=OUT
      RROper_RR_VIN
        arg RROperationArgument_RR_VIN_Out_0: type=ADT_StrVar_VIN, direction=OUT
      RROper_RR_SIMCardinfo
        arg RROperationArgument_RR_SIMCardinfo_Out_0: type=ADT_Struct_SIMCardinfo, direction=OUT
      RROper_RR_IMEIInfo
        arg RROperationArgument_RR_IMEIInfo_Out_0: type=ADT_StrVar_IMEIInfo, direction=OUT
      RROper_RR_CallNumberList
        arg RROperationArgument_RR_CallNumberList_Out_0: type=ADT_Array_CallNumberList, direction=OUT
      RROper_RR_WorkModel
        arg RROperationArgument_RR_WorkModel_Out_0: type=ADT_Enum_WorkModel, direction=OUT
      RROper_RR_CertificateIssuedMark
        arg RROperationArgument_RR_CertificateIssuedMark_Out_0: type=ADT_Struct_CertificateIssuedMark, direction=OUT
      RROper_RR_SetCallNumber
        arg RROperationArgument_RR_SetCallNumber_In_0: type=ADT_Struct_SetCallNumber1, direction=IN
        arg RROperationArgument_RR_SetCallNumber_Out_0: type=ADT_Struct_SetCallNumber2, direction=OUT
      RROper_RR_Cellinfo
        arg RROperationArgument_RR_Cellinfo_Out_0: type=ADT_Struct_Cellinfo, direction=OUT
      RROper_RR_VehicleDiag
        arg RROperationArgument_RR_VehicleDiag_Out_0: type=ADT_Enum_VehicleDiag, direction=OUT
      RROper_RR_CurrenMonthTalkTime
        arg RROperationArgument_RR_CurrenMonthTalkTime_Out_0: type=ADT_Struct_CurrenMonthTalkTime, direction=OUT
      RROper_RR_TSPConnectionState
        arg RROperationArgument_RR_TSPConnectionState_Out_0: type=ADT_Enum_TSPConnectionState, direction=OUT
      RROper_RR_MicState
        arg RROperationArgument_RR_MicState_Out_0: type=ADT_Enum_MicState, direction=OUT
      RROper_RR_ECUVersion
        arg RROperationArgument_RR_ECUVersion_Out_0: type=ADT_Struct_ECUVersion, direction=OUT
      RROper_RR_CanConfig
        arg RROperationArgument_RR_CanConfig_Out_0: type=ADT_StrVar_CanConfig, direction=OUT
      RROper_RR_KL15State
        arg RROperationArgument_RR_KL15State_Out_0: type=ADT_Enum_KL15State, direction=OUT
      RROper_RR_SPKState
        arg RROperationArgument_RR_SPKState_Out_0: type=ADT_Enum_SPKState, direction=OUT
      RROper_RR_AntState
        arg RROperationArgument_RR_AntState_Out_0: type=ADT_Enum_AntState, direction=OUT
  sender receiver interface TBOX_SystemInfo_Event_NetworkStatus
    data DataElement_Event_NetworkStatus: type=ADT_Struct_NetworkStatus
  sender receiver interface TBOX_SystemInfo_Event_VehicleDiagStatus
    data DataElement_Event_VehicleDiagStatus: type=ADT_Struct_VehicleDiagStatus
  client server interface TBOX_BEICALL
    operation RROper_RR_BEICALL
      arg RROperationArgument_RR_BEICALL_In_0: type=ADT_Struct_BEICALL, direction=IN
      arg RROperationArgument_RR_BEICALL_Out_0: type=ADT_Enum_BEICALL, direction=OUT
  sender receiver interface TBOX_BEICALL_Event_UploadBEICALLSts
    data DataElement_Event_UploadBEICALLSts: type=ADT_Struct_UploadBEICALLSts
  sender receiver interface TBOX_BEICALL_notifyEcallMdoe
    data DataElement_notifyEcallMdoe: type=ADT_EcallMode
  client server interface TBOX_USBUpdate
    operation RROper_RR_UpdatePrepare
      arg RROperationArgument_RR_UpdatePrepare_Out_0: type=ADT_Enum_UpdatePrepare, direction=OUT
    operation RROper_RR_UpdateFTPSts
      arg RROperationArgument_RR_UpdateFTPSts_In_0: type=ADT_Enum_UpdateFTPSts, direction=IN
      arg RROperationArgument_RR_UpdateFTPSts_Out_0: type=ADT_Struct_UpdateFTPSts, direction=OUT
    operation RROper_RR_UsbUpdateStart
      arg RROperationArgument_RR_UsbUpdateStart_Out_0: type=ADT_Enum_UsbUpdateStart, direction=OUT
  sender receiver interface TBOX_USBUpdate_Event_UsbUpdateSta
    data DataElement_Event_UsbUpdateSta: type=ADT_Struct_UsbUpdateSta
  sender receiver interface TBOX_USBUpdate_FF_UpdateCompleted
    data DataElement_FF_UpdateCompleted: type=ADT_Enum_UpdateCompleted
  client server interface TBOX_USBTBOXlog
    operation RROper_RR_logPrepare
      arg RROperationArgument_RR_logPrepare_Out_0: type=ADT_Struct_LogPrepare, direction=OUT
    operation RROper_RR_LogFTPSts
      arg RROperationArgument_RR_LogFTPSts_In_0: type=ADT_Enum_LogFTPSts, direction=IN
      arg RROperationArgument_RR_LogFTPSts_Out_0: type=ADT_Struct_LogFTPSts, direction=OUT
  client server interface TBOX_GNSSInfo
    operation RROper_RR_DMCGNSSType
      arg RROperationArgument_RR_DMCGNSSType_In_0: type=ADT_Enum_GNSSType1, direction=IN
      arg RROperationArgument_RR_DMCGNSSType_Out_0: type=ADT_Enum_GNSSType2, direction=OUT
  sender receiver interface TBOX_GNSSInfo_Event_GNSSInfo1
    data DataElement_Event_GNSSInfo1: type=ADT_Struct_GNSSInfo
  sender receiver interface ICC_Android_OutService_notifyEcallMdoeFed
    data DataElement_notifyEcallMdoeFed: type=ADT_EcallModeFed
  client server interface ICC_Aom
    operation RROper_GetRenderDBInfo
      arg RROperationArgument_GetRenderDBInfo_In_0: type=ADT_Array_DataType, direction=IN
      arg RROperationArgument_GetRenderDBInfo_Out_0: type=ADT_Array_RenderData, direction=OUT
  52 x sender receiver interface:
    ICC_Aom_notifyADCC_Command
      data DataElement_notifyADCC_Command: type=ADT_Enum_AomCommand
    ICC_SDmapInfo_NtfSDmapInfo
      data DataElement_NtfSDmapInfo: type=ADT_ADAS_strt_SDmapInfo
    ICC_SDmapInfo_notifyNOA_SDMapPosInfo
      data DataElement_notifyNOA_SDMapPosInfo: type=ADT_Struct_NOA_SDMapPosInfo
    ICC_SDmapInfo_notifyNOA_SDMapStubInfo
      data DataElement_notifyNOA_SDMapStubInfo: type=ADT_Struct_NOA_SDMapStubInfo
    ICC_SDmapInfo_notifyNOA_SDMapSegmentInfo
      data DataElement_notifyNOA_SDMapSegmentInfo: type=ADT_Struct_NOA_SDMapSegmentInfo
    ICC_SDmapInfo_notifyNOA_SDMapShortInfo
      data DataElement_notifyNOA_SDMapShortInfo: type=ADT_Struct_NOA_SDMapShortInfo
    ICC_SDmapInfo_notifyNOA_SDMapLongInfo
      data DataElement_notifyNOA_SDMapLongInfo: type=ADT_Struct_NOA_SDMapLongInfo
    ICC_SDmapInfo_notifyNOA_SDMapMetaInfo
      data DataElement_notifyNOA_SDMapMetaInfo: type=ADT_Struct_NOA_SDMapMetaInfo
    ICC_SDmapInfo_NtfSDmapInfo_international
      data DataElement_NtfSDmapInfo_international: type=ADT_ADAS_strt_SDmapInfo_international
    ICC_SDmapInfo_NtfSDmapLaneInfo
      data DataElement_NtfSDmapLaneInfo: type=ADT_ICC_strt_SDmapLaneInfo
    ICC_SDmapInfo_2_NtfSDmapRouteInfo
      data DataElement_NtfSDmapRouteInfo: type=ADT_ICC_string_RouteInfo
    ICC_SDmapInfo_2_NtfSDmapTBTNaviInfo
      data DataElement_NtfSDmapTBTNaviInfo: type=ADT_ICC_strt_NaviInfo
    ICC_SDmapInfo_2_NtfSDmapNaviCameraInfo
      data DataElement_NtfSDmapNaviCameraInfo: type=ADT_ICC_strt_NaviCameraExt
    ICC_SDmapInfo_2_NtfSDmapCruiseFacilityInfo
      data DataElement_NtfSDmapCruiseFacilityInfo: type=ADT_ICC_strt_CruiseFacilityInfo
    ICC_SDmapInfo_2_NtfSDmapTrafficLightCDInfo
      data DataElement_NtfSDmapTrafficLightCDInfo: type=ADT_ICC_arr_TrafficLightCountdown
    ICC_SDmapInfo_2_NtfSDmapNaviIntCamDynInfo
      data DataElement_NtfSDmapNaviIntCamDynInfo: type=ADT_ICC_arr_NaviIntCameraDynInfo
    ICC_SDmapInfo_2_NtfSDmapNaviWeatherInfo
      data DataElement_NtfSDmapNaviWeatherInfo: type=ADT_ICC_strt_NaviWeatherInfo
    ICC_SDmapInfo_2_NtfSDmapNaviCongestionInfo
      data DataElement_NtfSDmapNaviCongestionInfo: type=ADT_ICC_strt_NaviCongestionInfo
    ICC_SDmapInfo_2_NtfSDmapNaviGreenWaveCarSpd
      data DataElement_NtfSDmapNaviGreenWaveCarSpd: type=ADT_ICC_arr_NaviGreenWaveCarSpeed
    ICC_SDmapInfo_2_notifySDmapLaneInfo
      data DataElement_notifySDmapLaneInfo: type=ADT_ICC_strt_LaneInfo
    ICC_SDmapInfo_2_NtfSDmapMixForkInfo
      data DataElement_NtfSDmapMixForkInfo: type=ADT_ICC_arr_MixForkInfoList
    ICC_SDmapInfo_2_NtfSDmapMyLocationInfo
      data DataElement_NtfSDmapMyLocationInfo: type=ADT_ICC_strt_MyLocationInfo
    ICC_SDmapInfo_2_NtfSDmapNaviStatusInfo
      data DataElement_NtfSDmapNaviStatusInfo: type=ADT_ICC_strt_NaviStatusBean
    ICC_SDmapInfo_2_NtfSDmapSoundInfo
      data DataElement_NtfSDmapSoundInfo: type=ADT_ICC_string_SoundInfo
    ICC_SDmapInfo_2_NtfSDmapRouteOption
      data DataElement_NtfSDmapRouteOption: type=ADT_ICC_int32_RouteOption
    ICC_SDmapInfo_2_NtfSDmapCruiseInfo
      data DataElement_NtfSDmapCruiseInfo: type=ADT_ICC_strt_CruiseInfo
    ICC_SDmapInfo_2_NtfSDmapNaviRoadInfo
      data DataElement_NtfSDmapNaviRoadInfo: type=ADT_ICC_strt_NaviRoadInfo
    ICC_SDmapInfo_2_NtfSDmapAheadLaneInfo
      data DataElement_NtfSDmapAheadLaneInfo: type=ADT_ICC_arr_AheadLaneInfoList
    ICC_SDmapInfo_2_NtfSDmapTollGateInfo
      data DataElement_NtfSDmapTollGateInfo: type=ADT_ICC_strt_TollGateInfo
    ICC_SDmapInfo_2_NtfSDmapServiceAreaInfo
      data DataElement_NtfSDmapServiceAreaInfo: type=ADT_ICC_strt_ServiceAreaInfo
    ICC_SDmapInfo_2_NtfSDmapTunnelInfo
      data DataElement_NtfSDmapTunnelInfo: type=ADT_ICC_strt_TunnelInfo
    ICC_SDmapInfo_2_NtfSDmapRampInfo
      data DataElement_NtfSDmapRampInfo: type=ADT_ICC_strt_RampInfo
    ICC_SDmapInfo_2_NtfSDmapFacilityInfo
      data DataElement_NtfSDmapFacilityInfo: type=ADT_ICC_strt_FacilityInfo
    ICC_SDmapInfo_2_NtfSDmapLocMatchInfo
      data DataElement_NtfSDmapLocMatchInfo: type=ADT_ICC_strt_LocMatchInfo
    ICC_SDmapInfo_2_notifySDmapTollGateLaneInfo
      data DataElement_notifySDmapTollGateLaneInfo: type=ADT_Arr_TollGateLaneInfo
    ICC_SDmapInfo_2_notifySDmapNavArriveAim
      data DataElement_notifySDmapNavArriveAim: type=ADT_Enum_NavArriveAim
    ADCC_DrivingHmiEnv_NtfDynamicObjectList_Drvg
      data DataElement_NtfDynamicObjectList_Drvg: type=ADT_ADAS_arr_DynamicObjects
    ADCC_DrivingHmiEnv_NtfStaticObjectList_Drvg
      data DataElement_NtfStaticObjectList_Drvg: type=ADT_ADAS_arr_StaticObjects
    ADCC_DrivingHmiEnv_NtfLaneLineListt_Drvg
      data DataElement_NtfLaneLineListt_Drvg: type=ADT_ADAS_arr_LaneLineData
    ADCC_DrivingHmiEnv_NtfEgoFusionPose_Drvg
      data DataElement_NtfEgoFusionPose_Drvg: type=ADT_ADAS_strt_EgoFusionPose
    ADCC_DrivingHmiEnv_NtfRoadMarkerList
      data DataElement_NtfRoadMarkerList: type=ADT_ADAS_arr_RoadMarker
    ADCC_DrivingHmiEnv_NtfLaneLineListt_Drvg_2
      data DataElement_NtfLaneLineListt_Drvg_2: type=ADT_ADAS_arr_LaneLineData_2
    ADCC_DrivingHmiEnv_NtfEgoPose
      data DataElement_NtfEgoPose: type=ADT_ADAS_strt_EgoPose
    ADCC_DrivingHmiEnv_NtfFusionMapData
      data DataElement_NtfFusionMapData: type=ADT_ADAS_strt_FusionMapInfo
    ADCC_DrivingHmiEnv_NtfRoadMarkerListSupplement
      data DataElement_NtfRoadMarkerListSupplement: type=ADT_ADAS_arr_RoadMarkerSupplement
    ADCC_DrivingHmiEnv_NtfTrafficLightList_Drvg
      data DataElement_NtfTrafficLightList_Drvg: type=ADT_ADAS_strt_TrafficLightList
    ADCC_DrivingHmiEnv_NtfFreeSpaceList_Drvg
      data DataElement_NtfFreeSpaceList_Drvg: type=ADT_ADAS_strt_FreeSpaceList
    ADCC_DrivingHmiEnv_Ntf3DTrafficSignList_Drvg
      data DataElement_Ntf3DTrafficSignList_Drvg: type=ADT_ADAS_strt_Traffic3DSignList
    ADCC_DrivingHmiEnv_NtfDynamicObjectList_Drvg_2
      data DataElement_NtfDynamicObjectList_Drvg_2: type=ADT_ADAS_arr_DynamicObjects_2
    ADCC_DrivingHmiEnv_NtfStaticObjectList_Drvg_2
      data DataElement_NtfStaticObjectList_Drvg_2: type=ADT_ADAS_arr_StaticObjects_2
    ADCC_DrivingHmiEnv_NtfRoadMarkerList_2
      data DataElement_NtfRoadMarkerList_2: type=ADT_ADAS_arr_RoadMarker_2
    ADCC_DrivingHmiEnv_NtfRoadSurfaceMes
      data DataElement_NtfRoadSurfaceMes: type=ADT_ADAS_strt_RoadSurfaceMesh
  client server interface ADCC_SensorInfo
    operation RROper_getAvmCamIntrinsics
      arg RROperationArgument_getAvmCamIntrinsics_In_0: type=ADT_AvmCamIntrinsicsDataReq, direction=IN
      arg RROperationArgument_getAvmCamIntrinsics_Out_0: type=ADT_AvmCamIntrinsicsData, direction=OUT
    operation RROper_getAvmCamCalPrms
      arg RROperationArgument_getAvmCamCalPrms_In_0: type=ADT_Enum_AvmCamCalPrmsReq, direction=IN
      arg RROperationArgument_getAvmCamCalPrms_Out_0: type=ADT_Arr_AvmCamCalPrms, direction=OUT
    operation RROper_RR_ADASVersInfo
      arg RROperationArgument_RR_ADASVersInfo_Out_0: type=ADT_Strt_VersInfo, direction=OUT
  66 x sender receiver interface:
    ADCC_SensorInfo_NtfSensorSt
      data DataElement_NtfSensorSt: type=ADT_ADAS_strt_SensorSt
    ADCC_SensorInfo_CamStreamStResp
      data DataElement_CamStreamStResp: type=ADT_Str_CamStreamStResp
    ADCC_SensorInfo_CamStreamSwtReq
      data DataElement_CamStreamSwtReq: type=ADT_Str_CamStreamSwtReq
    ADCC_DrivingFuncInfo_NtfTrafficSign_Drvg
      data DataElement_NtfTrafficSign_Drvg: type=ADT_ADAS_strt_TrafficSign
    ADCC_DrivingFuncInfo_NtfISLIInfo_Drvg
      data DataElement_NtfISLIInfo_Drvg: type=ADT_ADAS_strt_ISLIInfo
    ADCC_DrivingFuncInfo_NtfACCInfo_Drvg
      data DataElement_NtfACCInfo_Drvg: type=ADT_ADAS_strt_ACCInfo
    ADCC_DrivingFuncInfo_NtfALCInfo_Drvg
      data DataElement_NtfALCInfo_Drvg: type=ADT_ADAS_strt_ALCInfo
    ADCC_DrivingFuncInfo_NtfICAInfo_Drvg
      data DataElement_NtfICAInfo_Drvg: type=ADT_ADAS_strt_ICAInfo
    ADCC_DrivingFuncInfo_NtfIntelligentEvasionInfo_Drvg
      data DataElement_NtfIntelligentEvasionInfo_Drvg: type=ADT_ADAS_strt_IntelligentEvasionInfo
    ADCC_DrivingFuncInfo_NtfHNOPfunctionInfo_Drvg
      data DataElement_NtfHNOPfunctionInfo_Drvg: type=ADT_ADAS_strt_HNOPfunctionInfo
    ADCC_DrivingFuncInfo_NtfUNOPfunctionInfo_Drvg
      data DataElement_NtfUNOPfunctionInfo_Drvg: type=ADT_ADAS_strt_UNOPfunctionInfo
    ADCC_DrivingFuncInfo_NtfHodDmsInfo_Drvg
      data DataElement_NtfHodDmsInfo_Drvg: type=ADT_ADAS_strt_HodDmsInfo
    ADCC_DrivingFuncInfo_NtfLSSInfo_Drvg
      data DataElement_NtfLSSInfo_Drvg: type=ADT_ADAS_strt_LSSInfo
    ADCC_DrivingFuncInfo_NtfESSInfo_Drvg
      data DataElement_NtfESSInfo_Drvg: type=ADT_ADAS_strt_ESSInfo
    ADCC_DrivingFuncInfo_NtfDAIInfo_Drvg
      data DataElement_NtfDAIInfo_Drvg: type=ADT_ADAS_strt_DAIInfo
    ADCC_DrivingFuncInfo_NtfNRAInfo_Drvg
      data DataElement_NtfNRAInfo_Drvg: type=ADT_ADAS_struct_NRAInfo
    ADCC_DrivingFuncInfo_NtfDrivingSoundInfo_Drvg
      data DataElement_NtfDrivingSoundInfo_Drvg: type=ADT_ADAS_strt_DrivingSoundInfo
    ADCC_DrivingFuncInfo_NtfMNPInfo_Drvg
      data DataElement_NtfMNPInfo_Drvg: type=ADT_ADAS_strt_MNPInfo
    ADCC_DrivingFuncInfo_NtfMNPRoutesInfo_Drvg
      data DataElement_NtfMNPRoutesInfo_Drvg: type=ADT_ADAS_strt_MNPRoutesInfo
    ADCC_DrivingFuncInfo_NtfIHCInfo_Drvg
      data DataElement_NtfIHCInfo_Drvg: type=ADT_ADAS_strt_IHCInfo
    ADCC_DrivingFuncInfo_NtfISLIInfo_Drvg_2
      data DataElement_NtfISLIInfo_Drvg_2: type=ADT_ADAS_strt_ISLIInfo_2
    ADCC_DrivingFuncInfo_NtfALCInfo_Drvg_2
      data DataElement_NtfALCInfo_Drvg_2: type=ADT_ADAS_strt_ALCInfo_2
    ADCC_DrivingFuncInfo_NtfICAInfo_Drvg_2
      data DataElement_NtfICAInfo_Drvg_2: type=ADT_ADAS_strt_ICAInfo_2
    ADCC_DrivingFuncInfo_NtfLSSInfo_Drvg_2
      data DataElement_NtfLSSInfo_Drvg_2: type=ADT_ADAS_strt_LSSInfo_2
    ADCC_DrivingFuncInfo_NtfESSInfo_Drvg_2
      data DataElement_NtfESSInfo_Drvg_2: type=ADT_ADAS_strt_ESSInfo_2
    ADCC_DrivingFuncInfo_NtfTrafficSignIdentify_Drvg
      data DataElement_NtfTrafficSignIdentify_Drvg: type=ADT_ADAS_strt_TrafficSignIdentify
    ADCC_DrivingFuncInfo_NtfACCSupplementInfo_Drvg
      data DataElement_NtfACCSupplementInfo_Drvg: type=ADT_ADAS_strt_ACCSupplementInfo
    ADCC_DrivingFuncInfo_NtfHNOPSupplementInfo_Drvg
      data DataElement_NtfHNOPSupplementInfo_Drvg: type=ADT_ADAS_strt_HNOPSupplementInfo
    ADCC_DrivingFuncInfo_NtfMNPAllRoutesInfo_Drvg
      data DataElement_NtfMNPAllRoutesInfo_Drvg: type=ADT_ADAS_strt_MNPAllRoutesInfo
    ADCC_DrivingFuncInfo_NtfMNPMemRouteInfo_Drvg
      data DataElement_NtfMNPMemRouteInfo_Drvg: type=ADT_ADAS_strt_MNPRouteInfo
    ADCC_DrivingFuncInfo_NtfTLRInfo_Drvg
      data DataElement_NtfTLRInfo_Drvg: type=ADT_ADAS_strt_TLRInfo
    ADCC_DrivingFuncInfo_NtfTLAInfo_Drvg
      data DataElement_NtfTLAInfo_Drvg: type=ADT_ADAS_strt_TLAInfo
    ADCC_DrivingFuncInfo_NtfMNPInfo_Drvg_2
      data DataElement_NtfMNPInfo_Drvg_2: type=ADT_ADAS_strt_MNPInfo_2
    ADCC_DrivingFuncInfo_NtfTrafficSign_Drvg_2
      data DataElement_NtfTrafficSign_Drvg_2: type=ADT_ADAS_strt_TrafficSign_2
    ADCC_DrivingFuncInfo_TolNtfADDrivingCardinfo
      data DataElement_TolNtfADDrivingCardinfo: type=ADT_ADAS_strt_TolNtfADDrivingCardinfo
    ADCC_DrivingFuncInfo_SglNtfADDrivingCardinfo
      data DataElement_SglNtfADDrivingCardinfo: type=ADT_ADAS_strt_SglNtfADDrivingCardinfo
    ADCC_ParkingFuncInfo_NtfParkingGenaralInfo
      data DataElement_NtfParkingGenaralInfo: type=ADT_ADAS_strt_ParkingGenaralInfo
    ADCC_ParkingFuncInfo_NtfAPARPAInfo
      data DataElement_NtfAPARPAInfo: type=ADT_ADAS_strt_APARPAInfo
    ADCC_ParkingFuncInfo_NtfAdvanceParkingInfo
      data DataElement_NtfAdvanceParkingInfo: type=ADT_ADAS_strt_AdvanceParkingInfo
    ADCC_ParkingFuncInfo_NtfHPAPathDetail
      data DataElement_NtfHPAPathDetail: type=ADT_ADAS_arr_HPAPathDetail
    ADCC_ParkingFuncInfo_NtfHPATrainigPathInfo
      data DataElement_NtfHPATrainigPathInfo: type=ADT_ADAS_strt_HPATrainingPathInfo
    ADCC_ParkingFuncInfo_NtfVPASelfBuildMapDate
      data DataElement_NtfVPASelfBuildMapDate: type=ADT_ADAS_strt_VPASelfBuildMapDate
    ADCC_ParkingFuncInfo_NtfMRAInfo
      data DataElement_NtfMRAInfo: type=ADT_ADAS_strt_MRAInfo
    ADCC_ParkingFuncInfo_NtfMEBInfo
      data DataElement_NtfMEBInfo: type=ADT_ADAS_enum_MEBSts
    ADCC_ParkingFuncInfo_NtfMAAInfo
      data DataElement_NtfMAAInfo: type=ADT_ADAS_enum_MAASts
    ADCC_ParkingFuncInfo_NtfHPARepalyPathInfo
      data DataElement_NtfHPARepalyPathInfo: type=ADT_ADAS_strt_HPARepalyPathInfo
    ADCC_ParkingFuncInfo_NtfParkingGenaralInfo_2
      data DataElement_NtfParkingGenaralInfo_2: type=ADT_ADAS_strt_ParkingGenaralInfo_2
    ADCC_ParkingFuncInfo_NtfMRAInfo_2
      data DataElement_NtfMRAInfo_2: type=ADT_ADAS_strt_MRAInfo_2
    ADCC_ParkingFuncInfo_NtfAPARPAInfo_2
      data DataElement_NtfAPARPAInfo_2: type=ADT_ADAS_strt_APARPAInfo_2
    ADCC_ParkingFuncInfo_NtfAdvanceParkingInfo_2
      data DataElement_NtfAdvanceParkingInfo_2: type=ADT_ADAS_strt_AdvanceParkingInfo_2
    ADCC_ParkingFuncInfo_NtfHPAPathDetail_2
      data DataElement_NtfHPAPathDetail_2: type=ADT_ADAS_arr_HPAPathDetail_2
    ADCC_ParkingFuncInfo_NtfHPATrainigPathInfo_2
      data DataElement_NtfHPATrainigPathInfo_2: type=ADT_ADAS_strt_HPATrainingPathInfo_2
    ADCC_ParkingFuncInfo_NtfHPARepalyPathInfo_2
      data DataElement_NtfHPARepalyPathInfo_2: type=ADT_ADAS_strt_HPARepalyPathInfo_2
    ADCC_ParkingFuncInfo_NtfVPAInfo
      data DataElement_NtfVPAInfo: type=ADT_ADAS_strt_VPAParkingInfo
    ADCC_ParkingFuncInfo_NtfParkingHMIInfo
      data DataElement_NtfParkingHMIInfo: type=ADT_ADAS_strt_ParkingHMIInfo
    ADCC_ParkingHmiEnv_NtfDynamicObjectList_Prkg
      data DataElement_NtfDynamicObjectList_Prkg: type=ADT_ADAS_arr_ParkingDynamicObjects
    ADCC_ParkingHmiEnv_NtfStaticObjectList_Prkg
      data DataElement_NtfStaticObjectList_Prkg: type=ADT_ADAS_arr_ParkingStaticObjects
    ADCC_ParkingHmiEnv_NtfParkingSlot_Prkg
      data DataElement_NtfParkingSlot_Prkg: type=ADT_ADAS_arr_ParkingSlot
    ADCC_ParkingHmiEnv_NtfHPAStaticObjectList_Prkg
      data DataElement_NtfHPAStaticObjectList_Prkg: type=ADT_ADAS_arr_HPAParkingStaticObjects
    ADCC_ParkingHmiEnv_NtfHPAParkingSlot_Prkg
      data DataElement_NtfHPAParkingSlot_Prkg: type=ADT_ADAS_arr_HPAParkingSlot
    ADCC_ParkingHmiEnv_NtfVPASelfBuildMapInfo
      data DataElement_NtfVPASelfBuildMapInfo: type=ADT_ADAS_strt_VPASelfBuildMapInfo
    ADCC_ParkingHmiEnv_NtfVPAParkingLotInfo
      data DataElement_NtfVPAParkingLotInfo: type=ADT_ADAS_strt_VPAParkingLotInfo
    ADCC_ParkingHmiEnv_NtfDynamicObjectList_Prkg_2
      data DataElement_NtfDynamicObjectList_Prkg_2: type=ADT_ADAS_arr_ParkingDynamicObjects_2
    ADCC_ParkingHmiEnv_NtfStaticObjectList_Prkg_2
      data DataElement_NtfStaticObjectList_Prkg_2: type=ADT_ADAS_arr_ParkingStaticObjects_2
    ADCC_AomMMSt_notifyExtMMResWLnk
      data DataElement_notifyExtMMResWLnk: type=ADT_Struct_ExtMMResWLnk
    ADCC_AomMMSt_HDMapInfo
      data DataElement_HDMapInfo: type=ADT_Struct_HDMapInfo
  client server interface ADCC_AomDB
    operation RROper_GetPackageData
      arg RROperationArgument_GetPackageData_In_0: type=ADT_Array_DataType, direction=IN
      arg RROperationArgument_GetPackageData_Out_0: type=ADT_Array_Data, direction=OUT
  26 x sender receiver interface:
    ADCC_RtMM_notifyRtMatchRes
      data DataElement_notifyRtMatchRes: type=ADT_Struct_RouteMatchingResult
    FCM_DrivingHmiEnv_NtfDynamicObjectList
      data DataElement_NtfDynamicObjectList: type=ADT_ADAS_arr_DynamicObjects
    FCM_DrivingHmiEnv_NtfStaticObjectList
      data DataElement_NtfStaticObjectList: type=ADT_ADAS_arr_StaticObjects
    FCM_DrivingHmiEnv_NtfLaneLineList
      data DataElement_NtfLaneLineList: type=ADT_ADAS_arr_LaneLineData
    FCM_DrivingHmiEnv_NtfLaneLineList_2
      data DataElement_NtfLaneLineList_2: type=ADT_ADAS_arr_LaneLineData_2
    FCM_DrivingHmiEnv_NtfEgoFusionPose
      data DataElement_NtfEgoFusionPose: type=ADT_ADAS_strt_EgoFusionPose
    FCM_DrivingHmiEnv_NtfDynamicObjectList_2
      data DataElement_NtfDynamicObjectList_2: type=ADT_ADAS_arr_DynamicObjects_2
    FCM_DrivingHmiEnv_NtfStaticObjectList_2
      data DataElement_NtfStaticObjectList_2: type=ADT_ADAS_arr_StaticObjects_2
    FCM_ActiveSafetyInfo_NtfActiveSafetyFcnInfo
      data DataElement_NtfActiveSafetyFcnInfo: type=ADT_ADAS_strt_ActiveSafetyFcnInfo
    FCM_ActiveSafetyInfo_NtfAEBTargetObjInfo
      data DataElement_NtfAEBTargetObjInfo: type=ADT_ADAS_strt_AebTargetObjInfo
    FCM_ActiveSafetyInfo_NtfActiveSafetyFcnInfo_2
      data DataElement_NtfActiveSafetyFcnInfo_2: type=ADT_ADAS_strt_ActiveSafetyFcnInfo_2
    FCM_ActiveSafetyInfo_NtfAEBTargetObjInfo_2
      data DataElement_NtfAEBTargetObjInfo_2: type=ADT_ADAS_strt_AebTargetObjInfo_2
    FCM_DrivingFuncInfo_NtfTrafficSign
      data DataElement_NtfTrafficSign: type=ADT_ADAS_strt_TrafficSign
    FCM_DrivingFuncInfo_NtfISLIinfo
      data DataElement_NtfISLIinfo: type=ADT_ADAS_strt_ISLIInfo
    FCM_DrivingFuncInfo_NtfACCinfo
      data DataElement_NtfACCinfo: type=ADT_ADAS_strt_ACCInfo
    FCM_DrivingFuncInfo_NtfICAInfo
      data DataElement_NtfICAInfo: type=ADT_ADAS_strt_ICAInfo
    FCM_DrivingFuncInfo_NtfIntelligentEvasionInfo
      data DataElement_NtfIntelligentEvasionInfo: type=ADT_ADAS_strt_IntelligentEvasionInfo
    FCM_DrivingFuncInfo_NtfHodDmsInfo
      data DataElement_NtfHodDmsInfo: type=ADT_ADAS_strt_HodDmsInfo
    FCM_DrivingFuncInfo_NtfLSSInfo
      data DataElement_NtfLSSInfo: type=ADT_ADAS_strt_LSSInfo
    FCM_DrivingFuncInfo_NtfESSInfo
      data DataElement_NtfESSInfo: type=ADT_ADAS_strt_ESSInfo
    FCM_DrivingFuncInfo_NtfDAIInfo
      data DataElement_NtfDAIInfo: type=ADT_ADAS_strt_DAIInfo
    FCM_DrivingFuncInfo_NtfISLIinfo_2
      data DataElement_NtfISLIinfo_2: type=ADT_ADAS_strt_ISLIInfo_2
    FCM_DrivingFuncInfo_NtfLSSInfo_2
      data DataElement_NtfLSSInfo_2: type=ADT_ADAS_strt_LSSInfo_2
    FCM_DrivingFuncInfo_NtfDrivingSoundInfo
      data DataElement_NtfDrivingSoundInfo: type=ADT_ADAS_strt_DrivingSoundInfo
    FCM_DrivingFuncInfo_NtfIHCInfo
      data DataElement_NtfIHCInfo: type=ADT_ADAS_strt_IHCInfo
    FCM_DrivingFuncInfo_NtfHNOPfunctionInfo
      data DataElement_NtfHNOPfunctionInfo: type=ADT_ADAS_strt_HNOPfunctionInfo
  client server interface FCM_DVRSts
    operation RROper_getCameraInterParm
      arg RROperationArgument_getCameraInterParm_Out_0: type=ADT_FcmCamIntrinsicsData, direction=OUT
  sender receiver interface FCM_DVRSts_notifyDVRSts
    data DataElement_notifyDVRSts: type=ADT_DVRSts
  sender receiver interface FCM_DVRSts_notifyDVRcameraSts
    data DataElement_notifyDVRcameraSts: type=ADT_DVRcameraSts
  sender receiver interface FCM_DVRSts_notifyCameraInterParm
    data DataElement_notifyCameraInterParm: type=ADT_FcmCamIntrinsicsData
  client server interface FCM_UUID
    operation RROper_GetUUIDCodeResponse
      arg RROperationArgument_GetUUIDCodeResponse_In_0: type=ADT_UUIDCodeRequest, direction=IN
      arg RROperationArgument_GetUUIDCodeResponse_Out_0: type=ADT_GetUUIDCodeResponse, direction=OUT
  7 x sender receiver interface:
    LCM_ICC_Data_NtfIMUInfo
      data DataElement_NtfIMUInfo: type=ADT_LCM_strt_IMUData
    LCM_ADCC_RawData_NtfGRawInfo
      data DataElement_NtfGRawInfo: type=ADT_LCM_Array_GNSSData
    ADCC_ActiveSafetyInfo_NtfActiveSafetyFcnInfo_Act
      data DataElement_NtfActiveSafetyFcnInfo_Act: type=ADT_ADAS_strt_ActiveSafetyFcnInfo
    ADCC_ActiveSafetyInfo_NtfAEBTargetObjInfo_Act
      data DataElement_NtfAEBTargetObjInfo_Act: type=ADT_ADAS_strt_AebTargetObjInfo
    ADCC_ActiveSafetyInfo_NtfActiveSafetyFcnInfo_Act_2
      data DataElement_NtfActiveSafetyFcnInfo_Act_2: type=ADT_ADAS_strt_ActiveSafetyFcnInfo_2
    ADCC_ActiveSafetyInfo_NtfAEBTargetObjInfo_Act_2
      data DataElement_NtfAEBTargetObjInfo_Act_2: type=ADT_ADAS_arr_AebTargetObjInfo
    ADCC_ActiveSafetyInfo_NtfAEBTargetObjInfo_Act_3
      data DataElement_NtfAEBTargetObjInfo_Act_3: type=ADT_ADAS_strt_AebTargetObjInfo_2
  client server interface ADCC_UUID
    operation RROper_GetUUIDCodeResponse_UUID
      arg RROperationArgument_GetUUIDCodeResponse_UUID_In_0: type=ADT_UUIDCodeRequest, direction=IN
      arg RROperationArgument_GetUUIDCodeResponse_UUID_Out_0: type=ADT_GetUUIDCodeResponse, direction=OUT
  sender receiver interface FCM_SensorInfo_NtfSensorSt_FCM
    data DataElement_NtfSensorSt_FCM: type=ADT_ADAS_strt_SensorSt
  client server interface TBOX_SystemInfo_ICC
    operation RROper_RR_SIMCardinfo_ICC
      arg RROperationArgument_RR_SIMCardinfo_ICC_Out_0: type=ADT_Struct_SIMCardinfo, direction=OUT
    operation RROper_RR_TSPConnectionState_ICC
      arg RROperationArgument_RR_TSPConnectionState_ICC_Out_0: type=ADT_Enum_TSPConnectionState, direction=OUT
    operation RROper_RR_KL15State_ICC
      arg RROperationArgument_RR_KL15State_ICC_Out_0: type=ADT_Enum_KL15State, direction=OUT
  sender receiver interface TBOX_SystemInfo_ICC_Event_NetworkStatus_ICC
    data DataElement_Event_NetworkStatus_ICC: type=ADT_Struct_NetworkStatus
  client server interface ADCC_DVRSts
    operation RROper_getCameraInterParm_ADCC
      arg RROperationArgument_getCameraInterParm_ADCC_Out_0: type=ADT_FcmCamIntrinsicsData, direction=OUT
  9 x sender receiver interface:
    ADCC_DVRSts_notifyDVRSts_ADCC
      data DataElement_notifyDVRSts_ADCC: type=ADT_DVRSts
    ADCC_DVRSts_notifyDVRcameraSts_ADCC
      data DataElement_notifyDVRcameraSts_ADCC: type=ADT_DVRcameraSts
    ADCC_DVRSts_notifyCameraInterParm_ADCC
      data DataElement_notifyCameraInterParm_ADCC: type=ADT_FcmCamIntrinsicsData
    ADAS_DataInLoop_notifyData_ID
      data DataElement_notifyData_ID: type=ADT_Enum_Data_ID
    ADAS_DataInLoop_notifyDataInLoop_1
      data DataElement_notifyDataInLoop_1: type=ADT_Arr_DataInLoop
    ADAS_DataInLoop_notifyDataInLoop_2
      data DataElement_notifyDataInLoop_2: type=ADT_Arr_DataInLoop
    ADAS_DataInLoop_notifyDataInLoop_3
      data DataElement_notifyDataInLoop_3: type=ADT_Arr_DataInLoop
    ADAS_DataInLoop_notifyDataInLoop
      data DataElement_notifyDataInLoop: type=ADT_Arr_KPI_DataInLoop
    IVI_UnixTimestamp_notifyUnixTimestamp
      data DataElement_notifyUnixTimestamp: type=ADT_Enum_UnixTimestamp
  client server interface ADAS_GNSSInfo
    operation RROper_RR_ADASGNSSType
      arg RROperationArgument_RR_ADASGNSSType_In_0: type=ADT_Enum_GNSSType1, direction=IN
      arg RROperationArgument_RR_ADASGNSSType_Out_0: type=ADT_Enum_GNSSType2, direction=OUT
  sender receiver interface ADAS_GNSSInfo_notifyGNSSInfo
    data DataElement_notifyGNSSInfo: type=ADT_Strt_GNSSInfo
package /System
  system System_AirMi: category=SYSTEM_DESCRIPTION
    system mapping Mappings
      data-mappings:
        sender-receiver-to-signal-mapping={service-instance=[AEP_VLAN62_ICC_8155_Android_UDP_30500/PSI_eHMI_ParkingUI_1_VLAN62_ICC_8155_Android, AEP_VLAN62_ICC_8155_Android_TCP_30500/PSI_eHMI_ParkingUI_1_VLAN62_ICC_8155_Android], data-element=AM_CompositionPrototype67.eHMI_ParkingUI_Provider.AM_CompositionType1.eHMI_ParkingUI_NtfParkingFuncModReq_SndP.DataElement_NtfParkingFuncModReq, system-signal=SysSIG_Event_NtfParkingFuncModReq_eHMI_ParkingUI}
        sender-receiver-to-signal-mapping={service-instance=[AEP_VLAN62_ADCC_UDP_30501/CSI_eHMI_ParkingUI_VLAN62_ADCC, AEP_VLAN62_ADCC_TCP_30501/CSI_eHMI_ParkingUI_VLAN62_ADCC], data-element=AM_CompositionPrototype67.eHMI_ParkingUIConsumer_ADCC.AM_CompositionType1.eHMI_ParkingUI_NtfParkingFuncModReq_RcvP.DataElement_NtfParkingFuncModReq, system-signal=SysSIG_Event_NtfParkingFuncModReq_eHMI_ParkingUI}
        sender-receiver-to-signal-mapping={service-instance=[AEP_VLAN62_ICC_8155_Android_UDP_30500/PSI_eHMI_ParkingUI_1_VLAN62_ICC_8155_Android, AEP_VLAN62_ICC_8155_Android_TCP_30500/PSI_eHMI_ParkingUI_1_VLAN62_ICC_8155_Android], data-element=AM_CompositionPrototype67.eHMI_ParkingUI_Provider.AM_CompositionType1.eHMI_ParkingUI_NtfApaRpaFcnOperating_SndP.DataElement_NtfApaRpaFcnOperating, system-signal=SysSIG_Event_NtfApaRpaFcnOperating_eHMI_ParkingUI}
        sender-receiver-to-signal-mapping={service-instance=[AEP_VLAN62_ADCC_UDP_30501/CSI_eHMI_ParkingUI_VLAN62_ADCC, AEP_VLAN62_ADCC_TCP_30501/CSI_eHMI_ParkingUI_VLAN62_ADCC], data-element=AM_CompositionPrototype67.eHMI_ParkingUIConsumer_ADCC.AM_CompositionType1.eHMI_ParkingUI_NtfApaRpaFcnOperating_RcvP.DataElement_NtfApaRpaFcnOperating, system-signal=SysSIG_Event_NtfApaRpaFcnOperating_eHMI_ParkingUI}
        sender-receiver-to-signal-mapping={service-instance=[AEP_VLAN62_ICC_8155_Android_UDP_30500/PSI_eHMI_ParkingUI_1_VLAN62_ICC_8155_Android, AEP_VLAN62_ICC_8155_Android_TCP_30500/PSI_eHMI_ParkingUI_1_VLAN62_ICC_8155_Android], data-element=AM_CompositionPrototype67.eHMI_ParkingUI_Provider.AM_CompositionType1.eHMI_ParkingUI_NtfHpaFcnOperating_SndP.DataElement_NtfHpaFcnOperating, system-signal=SysSIG_Event_NtfHpaFcnOperating_eHMI_ParkingUI}
        sender-receiver-to-signal-mapping={service-instance=[AEP_VLAN62_ADCC_UDP_30501/CSI_eHMI_ParkingUI_VLAN62_ADCC, AEP_VLAN62_ADCC_TCP_30501/CSI_eHMI_ParkingUI_VLAN62_ADCC], data-element=AM_CompositionPrototype67.eHMI_ParkingUIConsumer_ADCC.AM_CompositionType1.eHMI_ParkingUI_NtfHpaFcnOperating_RcvP.DataElement_NtfHpaFcnOperating, system-signal=SysSIG_Event_NtfHpaFcnOperating_eHMI_ParkingUI}
        sender-receiver-to-signal-mapping={service-instance=[AEP_VLAN62_ICC_8155_Android_UDP_30500/PSI_eHMI_ParkingUI_1_VLAN62_ICC_8155_Android, AEP_VLAN62_ICC_8155_Android_TCP_30500/PSI_eHMI_ParkingUI_1_VLAN62_ICC_8155_Android], data-element=AM_CompositionPrototype67.eHMI_ParkingUI_Provider.AM_CompositionType1.eHMI_ParkingUI_NtfVpaFcnOperating_SndP.DataElement_NtfVpaFcnOperating, system-signal=SysSIG_Event_NtfVpaFcnOperating_eHMI_ParkingUI}
        sender-receiver-to-signal-mapping={service-instance=[AEP_VLAN62_ADCC_UDP_30501/CSI_eHMI_ParkingUI_VLAN62_ADCC, AEP_VLAN62_ADCC_TCP_30501/CSI_eHMI_ParkingUI_VLAN62_ADCC], data-element=AM_CompositionPrototype67.eHMI_ParkingUIConsumer_ADCC.AM_CompositionType1.eHMI_ParkingUI_NtfVpaFcnOperating_RcvP.DataElement_NtfVpaFcnOperating, system-signal=SysSIG_Event_NtfVpaFcnOperating_eHMI_ParkingUI}
        sender-receiver-to-signal-mapping={service-instance=[AEP_VLAN62_ICC_8155_Android_UDP_30500/PSI_eHMI_ParkingUI_1_VLAN62_ICC_8155_Android, AEP_VLAN62_ICC_8155_Android_TCP_30500/PSI_eHMI_ParkingUI_1_VLAN62_ICC_8155_Android], data-element=AM_CompositionPrototype67.eHMI_ParkingUI_Provider.AM_CompositionType1.eHMI_ParkingUI_NtfMraFcnOperating_SndP.DataElement_NtfMraFcnOperating, system-signal=SysSIG_Event_NtfMraFcnOperating_eHMI_ParkingUI}
        sender-receiver-to-signal-mapping={service-instance=[AEP_VLAN62_ADCC_UDP_30501/CSI_eHMI_ParkingUI_VLAN62_ADCC, AEP_VLAN62_ADCC_TCP_30501/CSI_eHMI_ParkingUI_VLAN62_ADCC], data-element=AM_CompositionPrototype67.eHMI_ParkingUIConsumer_ADCC.AM_CompositionType1.eHMI_ParkingUI_NtfMraFcnOperating_RcvP.DataElement_NtfMraFcnOperating, system-signal=SysSIG_Event_NtfMraFcnOperating_eHMI_ParkingUI}
        sender-receiver-to-signal-mapping={service-instance=[AEP_VLAN62_ICC_8155_Android_UDP_30500/PSI_eHMI_ParkingUI_1_VLAN62_ICC_8155_Android, AEP_VLAN62_ICC_8155_Android_TCP_30500/PSI_eHMI_ParkingUI_1_VLAN62_ICC_8155_Android], data-element=AM_CompositionPrototype67.eHMI_ParkingUI_Provider.AM_CompositionType1.eHMI_ParkingUI_NtfSVSStatus_SndP.DataElement_NtfSVSStatus, system-signal=SysSIG_Event_NtfSVSStatus_eHMI_ParkingUI}
        sender-receiver-to-signal-mapping={service-instance=[AEP_VLAN62_ADCC_UDP_30501/CSI_eHMI_ParkingUI_VLAN62_ADCC, AEP_VLAN62_ADCC_TCP_30501/CSI_eHMI_ParkingUI_VLAN62_ADCC], data-element=AM_CompositionPrototype67.eHMI_ParkingUIConsumer_ADCC.AM_CompositionType1.eHMI_ParkingUI_NtfSVSStatus_RcvP.DataElement_NtfSVSStatus, system-signal=SysSIG_Event_NtfSVSStatus_eHMI_ParkingUI}
        sender-receiver-to-signal-mapping={service-instance=[AEP_VLAN62_ICC_8155_Android_UDP_30500/PSI_eHMI_ParkingUI_1_VLAN62_ICC_8155_Android, AEP_VLAN62_ICC_8155_Android_TCP_30500/PSI_eHMI_ParkingUI_1_VLAN62_ICC_8155_Android], data-element=AM_CompositionPrototype67.eHMI_ParkingUI_Provider.AM_CompositionType1.eHMI_ParkingUI_NtfApaRpaFcnOperating_2_SndP.DataElement_NtfApaRpaFcnOperating_2, system-signal=SysSIG_Event_NtfApaRpaFcnOperating_2_eHMI_ParkingUI}
        sender-receiver-to-signal-mapping={service-instance=[AEP_VLAN62_ADCC_UDP_30501/CSI_eHMI_ParkingUI_VLAN62_ADCC, AEP_VLAN62_ADCC_TCP_30501/CSI_eHMI_ParkingUI_VLAN62_ADCC], data-element=AM_CompositionPrototype67.eHMI_ParkingUIConsumer_ADCC.AM_CompositionType1.eHMI_ParkingUI_NtfApaRpaFcnOperating_2_RcvP.DataElement_NtfApaRpaFcnOperating_2, system-signal=SysSIG_Event_NtfApaRpaFcnOperating_2_eHMI_ParkingUI}
        sender-receiver-to-signal-mapping={service-instance=[AEP_VLAN62_ICC_8155_Android_UDP_30500/PSI_eHMI_ParkingUI_1_VLAN62_ICC_8155_Android, AEP_VLAN62_ICC_8155_Android_TCP_30500/PSI_eHMI_ParkingUI_1_VLAN62_ICC_8155_Android], data-element=AM_CompositionPrototype67.eHMI_ParkingUI_Provider.AM_CompositionType1.eHMI_ParkingUI_NtfHpaFcnOperating_2_SndP.DataElement_NtfHpaFcnOperating_2, system-signal=SysSIG_Event_NtfHpaFcnOperating_2_eHMI_ParkingUI}
        sender-receiver-to-signal-mapping={service-instance=[AEP_VLAN62_ADCC_UDP_30501/CSI_eHMI_ParkingUI_VLAN62_ADCC, AEP_VLAN62_ADCC_TCP_30501/CSI_eHMI_ParkingUI_VLAN62_ADCC], data-element=AM_CompositionPrototype67.eHMI_ParkingUIConsumer_ADCC.AM_CompositionType1.eHMI_ParkingUI_NtfHpaFcnOperating_2_RcvP.DataElement_NtfHpaFcnOperating_2, system-signal=SysSIG_Event_NtfHpaFcnOperating_2_eHMI_ParkingUI}
        sender-receiver-to-signal-mapping={service-instance=PSI_eHMI_ADASSetting_1_VLAN62_ICC_8155_Android, data-element=AM_CompositionPrototype67.eHMI_ADASSetting_Provider.AM_CompositionType1.eHMI_ADASSetting_NtfADASSettingInfo_SndP.DataElement_NtfADASSettingInfo, system-signal=SysSIG_Event_NtfADASSettingInfo_eHMI_ADASSetting}
        sender-receiver-to-signal-mapping={service-instance=CSI_eHMI_ADASSetting_VLAN62_ADCC, data-element=AM_CompositionPrototype67.eHMI_ADASSettingConsumer_ADCC.AM_CompositionType1.eHMI_ADASSetting_NtfADASSettingInfo_RcvP.DataElement_NtfADASSettingInfo, system-signal=SysSIG_Event_NtfADASSettingInfo_eHMI_ADASSetting}
        sender-receiver-to-signal-mapping={service-instance=PSI_eHMI_ADASSetting_1_VLAN62_ICC_8155_Android, data-element=AM_CompositionPrototype67.eHMI_ADASSetting_Provider.AM_CompositionType1.eHMI_ADASSetting_NtfADASSettingInfo_2_SndP.DataElement_NtfADASSettingInfo_2, system-signal=SysSIG_Event_NtfADASSettingInfo_2_eHMI_ADASSetting}
        sender-receiver-to-signal-mapping={service-instance=CSI_eHMI_ADASSetting_VLAN62_ADCC, data-element=AM_CompositionPrototype67.eHMI_ADASSettingConsumer_ADCC.AM_CompositionType1.eHMI_ADASSetting_NtfADASSettingInfo_2_RcvP.DataElement_NtfADASSettingInfo_2, system-signal=SysSIG_Event_NtfADASSettingInfo_2_eHMI_ADASSetting}
        sender-receiver-to-signal-mapping={service-instance=PSI_eHMI_ADASSetting_1_VLAN62_ICC_8155_Android, data-element=AM_CompositionPrototype67.eHMI_ADASSetting_Provider.AM_CompositionType1.eHMI_ADASSetting_NtfADASSettingInfo_3_SndP.DataElement_NtfADASSettingInfo_3, system-signal=SysSIG_Event_NtfADASSettingInfo_3_eHMI_ADASSetting}
        sender-receiver-to-signal-mapping={service-instance=CSI_eHMI_ADASSetting_VLAN62_ADCC, data-element=AM_CompositionPrototype67.eHMI_ADASSettingConsumer_ADCC.AM_CompositionType1.eHMI_ADASSetting_NtfADASSettingInfo_3_RcvP.DataElement_NtfADASSettingInfo_3, system-signal=SysSIG_Event_NtfADASSettingInfo_3_eHMI_ADASSetting}
        sender-receiver-to-signal-mapping={service-instance=PSI_eHMI_ADASSetting_1_VLAN62_ICC_8155_Android, data-element=AM_CompositionPrototype67.eHMI_ADASSetting_Provider.AM_CompositionType1.eHMI_ADASSetting_NtfADASSettingInfo_SndP.DataElement_NtfADASSettingInfo, system-signal=SysSIG_Event_NtfADASSettingInfo_eHMI_ADASSetting_1}
        sender-receiver-to-signal-mapping={service-instance=CSI_eHMI_ADASSetting_VLAN62_FCM, data-element=AM_CompositionPrototype67.eHMI_ADASSettingConsumer_FCM.AM_CompositionType1.eHMI_ADASSetting_NtfADASSettingInfo_RcvP.DataElement_NtfADASSettingInfo, system-signal=SysSIG_Event_NtfADASSettingInfo_eHMI_ADASSetting_1}
        sender-receiver-to-signal-mapping={service-instance=PSI_eHMI_ADASSetting_1_VLAN62_ICC_8155_Android, data-element=AM_CompositionPrototype67.eHMI_ADASSetting_Provider.AM_CompositionType1.eHMI_ADASSetting_NtfADASSettingInfo_2_SndP.DataElement_NtfADASSettingInfo_2, system-signal=SysSIG_Event_NtfADASSettingInfo_2_eHMI_ADASSetting_1}
        sender-receiver-to-signal-mapping={service-instance=CSI_eHMI_ADASSetting_VLAN62_FCM, data-element=AM_CompositionPrototype67.eHMI_ADASSettingConsumer_FCM.AM_CompositionType1.eHMI_ADASSetting_NtfADASSettingInfo_2_RcvP.DataElement_NtfADASSettingInfo_2, system-signal=SysSIG_Event_NtfADASSettingInfo_2_eHMI_ADASSetting_1}
        sender-receiver-to-signal-mapping={service-instance=PSI_eHMI_ADASSetting_1_VLAN62_ICC_8155_Android, data-element=AM_CompositionPrototype67.eHMI_ADASSetting_Provider.AM_CompositionType1.eHMI_ADASSetting_NtfADASSettingInfo_3_SndP.DataElement_NtfADASSettingInfo_3, system-signal=SysSIG_Event_NtfADASSettingInfo_3_eHMI_ADASSetting_1}
        sender-receiver-to-signal-mapping={service-instance=CSI_eHMI_ADASSetting_VLAN62_FCM, data-element=AM_CompositionPrototype67.eHMI_ADASSettingConsumer_FCM.AM_CompositionType1.eHMI_ADASSetting_NtfADASSettingInfo_3_RcvP.DataElement_NtfADASSettingInfo_3, system-signal=SysSIG_Event_NtfADASSettingInfo_3_eHMI_ADASSetting_1}
        sender-receiver-to-signal-mapping={service-instance=PSI_eHMI_DVRSet_1_VLAN62_ICC_8155_Android, data-element=AM_CompositionPrototype67.eHMI_DVRSet_Provider.AM_CompositionType1.eHMI_DVRSet_notifyDVRRequest_SndP.DataElement_notifyDVRRequest, system-signal=SysSIG_Event_notifyDVRRequest_eHMI_DVRSet}
        sender-receiver-to-signal-mapping={service-instance=CSI_eHMI_DVRSet_VLAN62_FCM, data-element=AM_CompositionPrototype67.eHMI_DVRSetConsumer_FCM.AM_CompositionType1.eHMI_DVRSet_notifyDVRRequest_RcvP.DataElement_notifyDVRRequest, system-signal=SysSIG_Event_notifyDVRRequest_eHMI_DVRSet}
        sender-receiver-to-signal-mapping={service-instance=PSI_TBOX_TimeManagement_1_VLAN62_TBOX, data-element=AM_CompositionPrototype67.TBOX_TimeManagement_Provider.AM_CompositionType1.TBOX_TimeManagement_notifyTimeManagement_SndP.DataElement_notifyTimeManagement, system-signal=SysSIG_Event_notifyTimeManagement_TBOX_TimeManagement}
        sender-receiver-to-signal-mapping={service-instance=CSI_TBOX_TimeManagement_VLAN62_ICC_8155_Android, data-element=AM_CompositionPrototype67.TBOX_TimeManagementConsumer_ICC_8155_Android.AM_CompositionType1.TBOX_TimeManagement_notifyTimeManagement_RcvP.DataElement_notifyTimeManagement, system-signal=SysSIG_Event_notifyTimeManagement_TBOX_TimeManagement}
        sender-receiver-to-signal-mapping={service-instance=[AEP_VLAN62_TBOX_UDP_30500/PSI_TBOX_ResSwtSts_1_VLAN62_TBOX, AEP_VLAN62_TBOX_TCP_30500/PSI_TBOX_ResSwtSts_1_VLAN62_TBOX], data-element=AM_CompositionPrototype67.TBOX_ResSwtSts_Provider.AM_CompositionType1.TBOX_ResSwtSts_notify5GSwtSts_Fb_SndP.DataElement_notify5GSwtSts_Fb, system-signal=SysSIG_Event_notify5GSwtSts_Fb_TBOX_ResSwtSts}
        sender-receiver-to-signal-mapping={service-instance=[AEP_VLAN62_ICC_8155_Android_UDP_30501/CSI_TBOX_ResSwtSts_VLAN62_ICC_8155_Android, AEP_VLAN62_ICC_8155_Android_TCP_30501/CSI_TBOX_ResSwtSts_VLAN62_ICC_8155_Android], data-element=AM_CompositionPrototype67.TBOX_ResSwtStsConsumer_ICC_8155_Android.AM_CompositionType1.TBOX_ResSwtSts_notify5GSwtSts_Fb_RcvP.DataElement_notify5GSwtSts_Fb, system-signal=SysSIG_Event_notify5GSwtSts_Fb_TBOX_ResSwtSts}
        sender-receiver-to-signal-mapping={service-instance=[AEP_VLAN62_TBOX_UDP_30500/PSI_TBOX_ResSwtSts_1_VLAN62_TBOX, AEP_VLAN62_TBOX_TCP_30500/PSI_TBOX_ResSwtSts_1_VLAN62_TBOX], data-element=AM_CompositionPrototype67.TBOX_ResSwtSts_Provider.AM_CompositionType1.TBOX_ResSwtSts_notifyV2XSwtSts_Fb_SndP.DataElement_notifyV2XSwtSts_Fb, system-signal=SysSIG_Event_notifyV2XSwtSts_Fb_TBOX_ResSwtSts}
        sender-receiver-to-signal-mapping={service-instance=[AEP_VLAN62_ICC_8155_Android_UDP_30501/CSI_TBOX_ResSwtSts_VLAN62_ICC_8155_Android, AEP_VLAN62_ICC_8155_Android_TCP_30501/CSI_TBOX_ResSwtSts_VLAN62_ICC_8155_Android], data-element=AM_CompositionPrototype67.TBOX_ResSwtStsConsumer_ICC_8155_Android.AM_CompositionType1.TBOX_ResSwtSts_notifyV2XSwtSts_Fb_RcvP.DataElement_notifyV2XSwtSts_Fb, system-signal=SysSIG_Event_notifyV2XSwtSts_Fb_TBOX_ResSwtSts}
        sender-receiver-to-signal-mapping={service-instance=[AEP_VLAN62_TBOX_UDP_30500/PSI_TBOX_ResSwtSts_1_VLAN62_TBOX, AEP_VLAN62_TBOX_TCP_30500/PSI_TBOX_ResSwtSts_1_VLAN62_TBOX], data-element=AM_CompositionPrototype67.TBOX_ResSwtSts_Provider.AM_CompositionType1.TBOX_ResSwtSts_notifyDownLogSwtSts_Fb_SndP.DataElement_notifyDownLogSwtSts_Fb, system-signal=SysSIG_Event_notifyDownLogSwtSts_Fb_TBOX_ResSwtSts}
        sender-receiver-to-signal-mapping={service-instance=[AEP_VLAN62_ICC_8155_Android_UDP_30501/CSI_TBOX_ResSwtSts_VLAN62_ICC_8155_Android, AEP_VLAN62_ICC_8155_Android_TCP_30501/CSI_TBOX_ResSwtSts_VLAN62_ICC_8155_Android], data-element=AM_CompositionPrototype67.TBOX_ResSwtStsConsumer_ICC_8155_Android.AM_CompositionType1.TBOX_ResSwtSts_notifyDownLogSwtSts_Fb_RcvP.DataElement_notifyDownLogSwtSts_Fb, system-signal=SysSIG_Event_notifyDownLogSwtSts_Fb_TBOX_ResSwtSts}
        sender-receiver-to-signal-mapping={service-instance=[AEP_VLAN62_TBOX_UDP_30500/PSI_TBOX_ResSwtSts_1_VLAN62_TBOX, AEP_VLAN62_TBOX_TCP_30500/PSI_TBOX_ResSwtSts_1_VLAN62_TBOX], data-element=AM_CompositionPrototype67.TBOX_ResSwtSts_Provider.AM_CompositionType1.TBOX_ResSwtSts_notifyUSBUpdateSwtSts_Fb_SndP.DataElement_notifyUSBUpdateSwtSts_Fb, system-signal=SysSIG_Event_notifyUSBUpdateSwtSts_Fb_TBOX_ResSwtSts}
        sender-receiver-to-signal-mapping={service-instance=[AEP_VLAN62_ICC_8155_Android_UDP_30501/CSI_TBOX_ResSwtSts_VLAN62_ICC_8155_Android, AEP_VLAN62_ICC_8155_Android_TCP_30501/CSI_TBOX_ResSwtSts_VLAN62_ICC_8155_Android], data-element=AM_CompositionPrototype67.TBOX_ResSwtStsConsumer_ICC_8155_Android.AM_CompositionType1.TBOX_ResSwtSts_notifyUSBUpdateSwtSts_Fb_RcvP.DataElement_notifyUSBUpdateSwtSts_Fb, system-signal=SysSIG_Event_notifyUSBUpdateSwtSts_Fb_TBOX_ResSwtSts}
        sender-receiver-to-signal-mapping={service-instance=[AEP_VLAN62_TBOX_UDP_30500/PSI_TBOX_ResSwtSts_1_VLAN62_TBOX, AEP_VLAN62_TBOX_TCP_30500/PSI_TBOX_ResSwtSts_1_VLAN62_TBOX], data-element=AM_CompositionPrototype67.TBOX_ResSwtSts_Provider.AM_CompositionType1.TBOX_ResSwtSts_notifyResumeFactorySet_Fb_SndP.DataElement_notifyResumeFactorySet_Fb, system-signal=SysSIG_Event_notifyResumeFactorySet_Fb_TBOX_ResSwtSts}
        sender-receiver-to-signal-mapping={service-instance=[AEP_VLAN62_ICC_8155_Android_UDP_30501/CSI_TBOX_ResSwtSts_VLAN62_ICC_8155_Android, AEP_VLAN62_ICC_8155_Android_TCP_30501/CSI_TBOX_ResSwtSts_VLAN62_ICC_8155_Android], data-element=AM_CompositionPrototype67.TBOX_ResSwtStsConsumer_ICC_8155_Android.AM_CompositionType1.TBOX_ResSwtSts_notifyResumeFactorySet_Fb_RcvP.DataElement_notifyResumeFactorySet_Fb, system-signal=SysSIG_Event_notifyResumeFactorySet_Fb_TBOX_ResSwtSts}
        client-server-to-signal-mapping={service-instance=[AEP_VLAN62_TBOX_UDP_30500/PSI_TBOX_ResSwtSts_1_VLAN62_TBOX, AEP_VLAN62_TBOX_TCP_30500/PSI_TBOX_ResSwtSts_1_VLAN62_TBOX], call-signal=SysSIG_RR_get5GSwtSts_Fb_call_Cis_ICC_8155_Android_TBOX_ResSwtSts, client-server-operation=AM_CompositionType1.AM_CompositionPrototype67.TBOX_ResSwtSts_Provider.ServerPort_TBOX_ResSwtSts.RROper_get5GSwtSts_Fb, return-signal=SysSIG_RR_get5GSwtSts_Fb_return_Cis_ICC_8155_Android_TBOX_ResSwtSts}
        client-server-to-signal-mapping={service-instance=[AEP_VLAN62_ICC_8155_Android_UDP_30501/CSI_TBOX_ResSwtSts_VLAN62_ICC_8155_Android, AEP_VLAN62_ICC_8155_Android_TCP_30501/CSI_TBOX_ResSwtSts_VLAN62_ICC_8155_Android], call-signal=SysSIG_RR_get5GSwtSts_Fb_call_Cis_ICC_8155_Android_TBOX_ResSwtSts, client-server-operation=AM_CompositionType1.AM_CompositionPrototype67.TBOX_ResSwtStsConsumer_ICC_8155_Android.ClientPort_TBOX_ResSwtSts.RROper_get5GSwtSts_Fb, return-signal=SysSIG_RR_get5GSwtSts_Fb_return_Cis_ICC_8155_Android_TBOX_ResSwtSts}
        client-server-to-signal-mapping={service-instance=[AEP_VLAN62_TBOX_UDP_30500/PSI_TBOX_ResSwtSts_1_VLAN62_TBOX, AEP_VLAN62_TBOX_TCP_30500/PSI_TBOX_ResSwtSts_1_VLAN62_TBOX], call-signal=SysSIG_RR_getV2XSwtSts_Fb_call_Cis_ICC_8155_Android_TBOX_ResSwtSts, client-server-operation=AM_CompositionType1.AM_CompositionPrototype67.TBOX_ResSwtSts_Provider.ServerPort_TBOX_ResSwtSts.RROper_getV2XSwtSts_Fb, return-signal=SysSIG_RR_getV2XSwtSts_Fb_return_Cis_ICC_8155_Android_TBOX_ResSwtSts}
        client-server-to-signal-mapping={service-instance=[AEP_VLAN62_ICC_8155_Android_UDP_30501/CSI_TBOX_ResSwtSts_VLAN62_ICC_8155_Android, AEP_VLAN62_ICC_8155_Android_TCP_30501/CSI_TBOX_ResSwtSts_VLAN62_ICC_8155_Android], call-signal=SysSIG_RR_getV2XSwtSts_Fb_call_Cis_ICC_8155_Android_TBOX_ResSwtSts, client-server-operation=AM_CompositionType1.AM_CompositionPrototype67.TBOX_ResSwtStsConsumer_ICC_8155_Android.ClientPort_TBOX_ResSwtSts.RROper_getV2XSwtSts_Fb, return-signal=SysSIG_RR_getV2XSwtSts_Fb_return_Cis_ICC_8155_Android_TBOX_ResSwtSts}
        client-server-to-signal-mapping={service-instance=[AEP_VLAN62_TBOX_UDP_30500/PSI_TBOX_ResSwtSts_1_VLAN62_TBOX, AEP_VLAN62_TBOX_TCP_30500/PSI_TBOX_ResSwtSts_1_VLAN62_TBOX], call-signal=SysSIG_RR_getDownLogSwtSts_Fb_call_Cis_ICC_8155_Android_TBOX_ResSwtSts, client-server-operation=AM_CompositionType1.AM_CompositionPrototype67.TBOX_ResSwtSts_Provider.ServerPort_TBOX_ResSwtSts.RROper_getDownLogSwtSts_Fb, return-signal=SysSIG_RR_getDownLogSwtSts_Fb_return_Cis_ICC_8155_Android_TBOX_ResSwtSts}
        client-server-to-signal-mapping={service-instance=[AEP_VLAN62_ICC_8155_Android_UDP_30501/CSI_TBOX_ResSwtSts_VLAN62_ICC_8155_Android, AEP_VLAN62_ICC_8155_Android_TCP_30501/CSI_TBOX_ResSwtSts_VLAN62_ICC_8155_Android], call-signal=SysSIG_RR_getDownLogSwtSts_Fb_call_Cis_ICC_8155_Android_TBOX_ResSwtSts, client-server-operation=AM_CompositionType1.AM_CompositionPrototype67.TBOX_ResSwtStsConsumer_ICC_8155_Android.ClientPort_TBOX_ResSwtSts.RROper_getDownLogSwtSts_Fb, return-signal=SysSIG_RR_getDownLogSwtSts_Fb_return_Cis_ICC_8155_Android_TBOX_ResSwtSts}
        client-server-to-signal-mapping={service-instance=[AEP_VLAN62_TBOX_UDP_30500/PSI_TBOX_ResSwtSts_1_VLAN62_TBOX, AEP_VLAN62_TBOX_TCP_30500/PSI_TBOX_ResSwtSts_1_VLAN62_TBOX], call-signal=SysSIG_RR_getUSBUpdateSwtSts_Fb_call_Cis_ICC_8155_Android_TBOX_ResSwtSts, client-server-operation=AM_CompositionType1.AM_CompositionPrototype67.TBOX_ResSwtSts_Provider.ServerPort_TBOX_ResSwtSts.RROper_getUSBUpdateSwtSts_Fb, return-signal=SysSIG_RR_getUSBUpdateSwtSts_Fb_return_Cis_ICC_8155_Android_TBOX_ResSwtSts}
        client-server-to-signal-mapping={service-instance=[AEP_VLAN62_ICC_8155_Android_UDP_30501/CSI_TBOX_ResSwtSts_VLAN62_ICC_8155_Android, AEP_VLAN62_ICC_8155_Android_TCP_30501/CSI_TBOX_ResSwtSts_VLAN62_ICC_8155_Android], call-signal=SysSIG_RR_getUSBUpdateSwtSts_Fb_call_Cis_ICC_8155_Android_TBOX_ResSwtSts, client-server-operation=AM_CompositionType1.AM_CompositionPrototype67.TBOX_ResSwtStsConsumer_ICC_8155_Android.ClientPort_TBOX_ResSwtSts.RROper_getUSBUpdateSwtSts_Fb, return-signal=SysSIG_RR_getUSBUpdateSwtSts_Fb_return_Cis_ICC_8155_Android_TBOX_ResSwtSts}
        client-server-to-signal-mapping={service-instance=[AEP_VLAN62_TBOX_UDP_30500/PSI_TBOX_ResSwtSts_1_VLAN62_TBOX, AEP_VLAN62_TBOX_TCP_30500/PSI_TBOX_ResSwtSts_1_VLAN62_TBOX], call-signal=SysSIG_RR_getResumeFactorySet_Fb_call_Cis_ICC_8155_Android_TBOX_ResSwtSts, client-server-operation=AM_CompositionType1.AM_CompositionPrototype67.TBOX_ResSwtSts_Provider.ServerPort_TBOX_ResSwtSts.RROper_getResumeFactorySet_Fb, return-signal=SysSIG_RR_getResumeFactorySet_Fb_return_Cis_ICC_8155_Android_TBOX_ResSwtSts}
        client-server-to-signal-mapping={service-instance=[AEP_VLAN62_ICC_8155_Android_UDP_30501/CSI_TBOX_ResSwtSts_VLAN62_ICC_8155_Android, AEP_VLAN62_ICC_8155_Android_TCP_30501/CSI_TBOX_ResSwtSts_VLAN62_ICC_8155_Android], call-signal=SysSIG_RR_getResumeFactorySet_Fb_call_Cis_ICC_8155_Android_TBOX_ResSwtSts, client-server-operation=AM_CompositionType1.AM_CompositionPrototype67.TBOX_ResSwtStsConsumer_ICC_8155_Android.ClientPort_TBOX_ResSwtSts.RROper_getResumeFactorySet_Fb, return-signal=SysSIG_RR_getResumeFactorySet_Fb_return_Cis_ICC_8155_Android_TBOX_ResSwtSts}
        client-server-to-signal-mapping={service-instance=[AEP_VLAN62_TBOX_UDP_30500/PSI_TBOX_ResSwtSts_1_VLAN62_TBOX, AEP_VLAN62_TBOX_TCP_30500/PSI_TBOX_ResSwtSts_1_VLAN62_TBOX], call-signal=SysSIG_RR_set5GSwtSts_call_Cis_ICC_8155_Android_TBOX_ResSwtSts, client-server-operation=AM_CompositionType1.AM_CompositionPrototype67.TBOX_ResSwtSts_Provider.ServerPort_TBOX_ResSwtSts.RROper_set5GSwtSts, return-signal=SysSIG_RR_set5GSwtSts_return_Cis_ICC_8155_Android_TBOX_ResSwtSts}
        client-server-to-signal-mapping={service-instance=[AEP_VLAN62_ICC_8155_Android_UDP_30501/CSI_TBOX_ResSwtSts_VLAN62_ICC_8155_Android, AEP_VLAN62_ICC_8155_Android_TCP_30501/CSI_TBOX_ResSwtSts_VLAN62_ICC_8155_Android], call-signal=SysSIG_RR_set5GSwtSts_call_Cis_ICC_8155_Android_TBOX_ResSwtSts, client-server-operation=AM_CompositionType1.AM_CompositionPrototype67.TBOX_ResSwtStsConsumer_ICC_8155_Android.ClientPort_TBOX_ResSwtSts.RROper_set5GSwtSts, return-signal=SysSIG_RR_set5GSwtSts_return_Cis_ICC_8155_Android_TBOX_ResSwtSts}
        client-server-to-signal-mapping={service-instance=[AEP_VLAN62_TBOX_UDP_30500/PSI_TBOX_ResSwtSts_1_VLAN62_TBOX, AEP_VLAN62_TBOX_TCP_30500/PSI_TBOX_ResSwtSts_1_VLAN62_TBOX], call-signal=SysSIG_RR_setV2XSwtSts_call_Cis_ICC_8155_Android_TBOX_ResSwtSts, client-server-operation=AM_CompositionType1.AM_CompositionPrototype67.TBOX_ResSwtSts_Provider.ServerPort_TBOX_ResSwtSts.RROper_setV2XSwtSts, return-signal=SysSIG_RR_setV2XSwtSts_return_Cis_ICC_8155_Android_TBOX_ResSwtSts}
        client-server-to-signal-mapping={service-instance=[AEP_VLAN62_ICC_8155_Android_UDP_30501/CSI_TBOX_ResSwtSts_VLAN62_ICC_8155_Android, AEP_VLAN62_ICC_8155_Android_TCP_30501/CSI_TBOX_ResSwtSts_VLAN62_ICC_8155_Android], call-signal=SysSIG_RR_setV2XSwtSts_call_Cis_ICC_8155_Android_TBOX_ResSwtSts, client-server-operation=AM_CompositionType1.AM_CompositionPrototype67.TBOX_ResSwtStsConsumer_ICC_8155_Android.ClientPort_TBOX_ResSwtSts.RROper_setV2XSwtSts, return-signal=SysSIG_RR_setV2XSwtSts_return_Cis_ICC_8155_Android_TBOX_ResSwtSts}
        client-server-to-signal-mapping={service-instance=[AEP_VLAN62_TBOX_UDP_30500/PSI_TBOX_ResSwtSts_1_VLAN62_TBOX, AEP_VLAN62_TBOX_TCP_30500/PSI_TBOX_ResSwtSts_1_VLAN62_TBOX], call-signal=SysSIG_RR_setDownLogSwtSts_call_Cis_ICC_8155_Android_TBOX_ResSwtSts, client-server-operation=AM_CompositionType1.AM_CompositionPrototype67.TBOX_ResSwtSts_Provider.ServerPort_TBOX_ResSwtSts.RROper_setDownLogSwtSts, return-signal=SysSIG_RR_setDownLogSwtSts_return_Cis_ICC_8155_Android_TBOX_ResSwtSts}
        client-server-to-signal-mapping={service-instance=[AEP_VLAN62_ICC_8155_Android_UDP_30501/CSI_TBOX_ResSwtSts_VLAN62_ICC_8155_Android, AEP_VLAN62_ICC_8155_Android_TCP_30501/CSI_TBOX_ResSwtSts_VLAN62_ICC_8155_Android], call-signal=SysSIG_RR_setDownLogSwtSts_call_Cis_ICC_8155_Android_TBOX_ResSwtSts, client-server-operation=AM_CompositionType1.AM_CompositionPrototype67.TBOX_ResSwtStsConsumer_ICC_8155_Android.ClientPort_TBOX_ResSwtSts.RROper_setDownLogSwtSts, return-signal=SysSIG_RR_setDownLogSwtSts_return_Cis_ICC_8155_Android_TBOX_ResSwtSts}
        client-server-to-signal-mapping={service-instance=[AEP_VLAN62_TBOX_UDP_30500/PSI_TBOX_ResSwtSts_1_VLAN62_TBOX, AEP_VLAN62_TBOX_TCP_30500/PSI_TBOX_ResSwtSts_1_VLAN62_TBOX], call-signal=SysSIG_RR_setUSBUpdateSwtSts_call_Cis_ICC_8155_Android_TBOX_ResSwtSts, client-server-operation=AM_CompositionType1.AM_CompositionPrototype67.TBOX_ResSwtSts_Provider.ServerPort_TBOX_ResSwtSts.RROper_setUSBUpdateSwtSts, return-signal=SysSIG_RR_setUSBUpdateSwtSts_return_Cis_ICC_8155_Android_TBOX_ResSwtSts}
        client-server-to-signal-mapping={service-instance=[AEP_VLAN62_ICC_8155_Android_UDP_30501/CSI_TBOX_ResSwtSts_VLAN62_ICC_8155_Android, AEP_VLAN62_ICC_8155_Android_TCP_30501/CSI_TBOX_ResSwtSts_VLAN62_ICC_8155_Android], call-signal=SysSIG_RR_setUSBUpdateSwtSts_call_Cis_ICC_8155_Android_TBOX_ResSwtSts, client-server-operation=AM_CompositionType1.AM_CompositionPrototype67.TBOX_ResSwtStsConsumer_ICC_8155_Android.ClientPort_TBOX_ResSwtSts.RROper_setUSBUpdateSwtSts, return-signal=SysSIG_RR_setUSBUpdateSwtSts_return_Cis_ICC_8155_Android_TBOX_ResSwtSts}
        client-server-to-signal-mapping={service-instance=[AEP_VLAN62_TBOX_UDP_30500/PSI_TBOX_ResSwtSts_1_VLAN62_TBOX, AEP_VLAN62_TBOX_TCP_30500/PSI_TBOX_ResSwtSts_1_VLAN62_TBOX], call-signal=SysSIG_RR_setResumeFactorySet_call_Cis_ICC_8155_Android_TBOX_ResSwtSts, client-server-operation=AM_CompositionType1.AM_CompositionPrototype67.TBOX_ResSwtSts_Provider.ServerPort_TBOX_ResSwtSts.RROper_setResumeFactorySet, return-signal=SysSIG_RR_setResumeFactorySet_return_Cis_ICC_8155_Android_TBOX_ResSwtSts}
        client-server-to-signal-mapping={service-instance=[AEP_VLAN62_ICC_8155_Android_UDP_30501/CSI_TBOX_ResSwtSts_VLAN62_ICC_8155_Android, AEP_VLAN62_ICC_8155_Android_TCP_30501/CSI_TBOX_ResSwtSts_VLAN62_ICC_8155_Android], call-signal=SysSIG_RR_setResumeFactorySet_call_Cis_ICC_8155_Android_TBOX_ResSwtSts, client-server-operation=AM_CompositionType1.AM_CompositionPrototype67.TBOX_ResSwtStsConsumer_ICC_8155_Android.ClientPort_TBOX_ResSwtSts.RROper_setResumeFactorySet, return-signal=SysSIG_RR_setResumeFactorySet_return_Cis_ICC_8155_Android_TBOX_ResSwtSts}
        sender-receiver-to-signal-mapping={service-instance=PSI_TBOX_SystemInfo_1_VLAN62_TBOX, data-element=AM_CompositionPrototype67.TBOX_SystemInfo_Provider.AM_CompositionType1.TBOX_SystemInfo_Event_NetworkStatus_SndP.DataElement_Event_NetworkStatus, system-signal=SysSIG_Event_Event_NetworkStatus_TBOX_SystemInfo}
        sender-receiver-to-signal-mapping={service-instance=CSI_TBOX_SystemInfo_VLAN62_ADCC, data-element=AM_CompositionPrototype67.TBOX_SystemInfoConsumer_ADCC.AM_CompositionType1.TBOX_SystemInfo_Event_NetworkStatus_RcvP.DataElement_Event_NetworkStatus, system-signal=SysSIG_Event_Event_NetworkStatus_TBOX_SystemInfo}
        sender-receiver-to-signal-mapping={service-instance=PSI_TBOX_SystemInfo_1_VLAN62_TBOX, data-element=AM_CompositionPrototype67.TBOX_SystemInfo_Provider.AM_CompositionType1.TBOX_SystemInfo_Event_VehicleDiagStatus_SndP.DataElement_Event_VehicleDiagStatus, system-signal=SysSIG_Event_Event_VehicleDiagStatus_TBOX_SystemInfo}
        sender-receiver-to-signal-mapping={service-instance=CSI_TBOX_SystemInfo_VLAN62_ADCC, data-element=AM_CompositionPrototype67.TBOX_SystemInfoConsumer_ADCC.AM_CompositionType1.TBOX_SystemInfo_Event_VehicleDiagStatus_RcvP.DataElement_Event_VehicleDiagStatus, system-signal=SysSIG_Event_Event_VehicleDiagStatus_TBOX_SystemInfo}
        client-server-to-signal-mapping={service-instance=PSI_TBOX_SystemInfo_1_VLAN62_TBOX, call-signal=SysSIG_RR_RR_TBoxVersionInfo_call_Cis_ADCC_TBOX_SystemInfo, client-server-operation=AM_CompositionType1.AM_CompositionPrototype67.TBOX_SystemInfo_Provider.ServerPort_TBOX_SystemInfo.RROper_RR_TBoxVersionInfo, return-signal=SysSIG_RR_RR_TBoxVersionInfo_return_Cis_ADCC_TBOX_SystemInfo}
        client-server-to-signal-mapping={service-instance=CSI_TBOX_SystemInfo_VLAN62_ADCC, call-signal=SysSIG_RR_RR_TBoxVersionInfo_call_Cis_ADCC_TBOX_SystemInfo, client-server-operation=AM_CompositionType1.AM_CompositionPrototype67.TBOX_SystemInfoConsumer_ADCC.ClientPort_TBOX_SystemInfo.RROper_RR_TBoxVersionInfo, return-signal=SysSIG_RR_RR_TBoxVersionInfo_return_Cis_ADCC_TBOX_SystemInfo}
        client-server-to-signal-mapping={service-instance=PSI_TBOX_SystemInfo_1_VLAN62_TBOX, call-signal=SysSIG_RR_RR_BleModuleInfo_call_Cis_ADCC_TBOX_SystemInfo, client-server-operation=AM_CompositionType1.AM_CompositionPrototype67.TBOX_SystemInfo_Provider.ServerPort_TBOX_SystemInfo.RROper_RR_BleModuleInfo, return-signal=SysSIG_RR_RR_BleModuleInfo_return_Cis_ADCC_TBOX_SystemInfo}
        client-server-to-signal-mapping={service-instance=CSI_TBOX_SystemInfo_VLAN62_ADCC, call-signal=SysSIG_RR_RR_BleModuleInfo_call_Cis_ADCC_TBOX_SystemInfo, client-server-operation=AM_CompositionType1.AM_CompositionPrototype67.TBOX_SystemInfoConsumer_ADCC.ClientPort_TBOX_SystemInfo.RROper_RR_BleModuleInfo, return-signal=SysSIG_RR_RR_BleModuleInfo_return_Cis_ADCC_TBOX_SystemInfo}
        client-server-to-signal-mapping={service-instance=PSI_TBOX_SystemInfo_1_VLAN62_TBOX, call-signal=SysSIG_RR_RR_VIN_call_Cis_ADCC_TBOX_SystemInfo, client-server-operation=AM_CompositionType1.AM_CompositionPrototype67.TBOX_SystemInfo_Provider.ServerPort_TBOX_SystemInfo.RROper_RR_VIN, return-signal=SysSIG_RR_RR_VIN_return_Cis_ADCC_TBOX_SystemInfo}
        client-server-to-signal-mapping={service-instance=CSI_TBOX_SystemInfo_VLAN62_ADCC, call-signal=SysSIG_RR_RR_VIN_call_Cis_ADCC_TBOX_SystemInfo, client-server-operation=AM_CompositionType1.AM_CompositionPrototype67.TBOX_SystemInfoConsumer_ADCC.ClientPort_TBOX_SystemInfo.RROper_RR_VIN, return-signal=SysSIG_RR_RR_VIN_return_Cis_ADCC_TBOX_SystemInfo}
        client-server-to-signal-mapping={service-instance=PSI_TBOX_SystemInfo_1_VLAN62_TBOX, call-signal=SysSIG_RR_RR_SIMCardinfo_call_Cis_ADCC_TBOX_SystemInfo, client-server-operation=AM_CompositionType1.AM_CompositionPrototype67.TBOX_SystemInfo_Provider.ServerPort_TBOX_SystemInfo.RROper_RR_SIMCardinfo, return-signal=SysSIG_RR_RR_SIMCardinfo_return_Cis_ADCC_TBOX_SystemInfo}
        client-server-to-signal-mapping={service-instance=CSI_TBOX_SystemInfo_VLAN62_ADCC, call-signal=SysSIG_RR_RR_SIMCardinfo_call_Cis_ADCC_TBOX_SystemInfo, client-server-operation=AM_CompositionType1.AM_CompositionPrototype67.TBOX_SystemInfoConsumer_ADCC.ClientPort_TBOX_SystemInfo.RROper_RR_SIMCardinfo, return-signal=SysSIG_RR_RR_SIMCardinfo_return_Cis_ADCC_TBOX_SystemInfo}
        client-server-to-signal-mapping={service-instance=PSI_TBOX_SystemInfo_1_VLAN62_TBOX, call-signal=SysSIG_RR_RR_IMEIInfo_call_Cis_ADCC_TBOX_SystemInfo, client-server-operation=AM_CompositionType1.AM_CompositionPrototype67.TBOX_SystemInfo_Provider.ServerPort_TBOX_SystemInfo.RROper_RR_IMEIInfo, return-signal=SysSIG_RR_RR_IMEIInfo_return_Cis_ADCC_TBOX_SystemInfo}
        client-server-to-signal-mapping={service-instance=CSI_TBOX_SystemInfo_VLAN62_ADCC, call-signal=SysSIG_RR_RR_IMEIInfo_call_Cis_ADCC_TBOX_SystemInfo, client-server-operation=AM_CompositionType1.AM_CompositionPrototype67.TBOX_SystemInfoConsumer_ADCC.ClientPort_TBOX_SystemInfo.RROper_RR_IMEIInfo, return-signal=SysSIG_RR_RR_IMEIInfo_return_Cis_ADCC_TBOX_SystemInfo}
        client-server-to-signal-mapping={service-instance=PSI_TBOX_SystemInfo_1_VLAN62_TBOX, call-signal=SysSIG_RR_RR_CallNumberList_call_Cis_ADCC_TBOX_SystemInfo, client-server-operation=AM_CompositionType1.AM_CompositionPrototype67.TBOX_SystemInfo_Provider.ServerPort_TBOX_SystemInfo.RROper_RR_CallNumberList, return-signal=SysSIG_RR_RR_CallNumberList_return_Cis_ADCC_TBOX_SystemInfo}
        client-server-to-signal-mapping={service-instance=CSI_TBOX_SystemInfo_VLAN62_ADCC, call-signal=SysSIG_RR_RR_CallNumberList_call_Cis_ADCC_TBOX_SystemInfo, client-server-operation=AM_CompositionType1.AM_CompositionPrototype67.TBOX_SystemInfoConsumer_ADCC.ClientPort_TBOX_SystemInfo.RROper_RR_CallNumberList, return-signal=SysSIG_RR_RR_CallNumberList_return_Cis_ADCC_TBOX_SystemInfo}
        client-server-to-signal-mapping={service-instance=PSI_TBOX_SystemInfo_1_VLAN62_TBOX, call-signal=SysSIG_RR_RR_WorkModel_call_Cis_ADCC_TBOX_SystemInfo, client-server-operation=AM_CompositionType1.AM_CompositionPrototype67.TBOX_SystemInfo_Provider.ServerPort_TBOX_SystemInfo.RROper_RR_WorkModel, return-signal=SysSIG_RR_RR_WorkModel_return_Cis_ADCC_TBOX_SystemInfo}
        client-server-to-signal-mapping={service-instance=CSI_TBOX_SystemInfo_VLAN62_ADCC, call-signal=SysSIG_RR_RR_WorkModel_call_Cis_ADCC_TBOX_SystemInfo, client-server-operation=AM_CompositionType1.AM_CompositionPrototype67.TBOX_SystemInfoConsumer_ADCC.ClientPort_TBOX_SystemInfo.RROper_RR_WorkModel, return-signal=SysSIG_RR_RR_WorkModel_return_Cis_ADCC_TBOX_SystemInfo}
        client-server-to-signal-mapping={service-instance=PSI_TBOX_SystemInfo_1_VLAN62_TBOX, call-signal=SysSIG_RR_RR_CertificateIssuedMark_call_Cis_ADCC_TBOX_SystemInfo, client-server-operation=AM_CompositionType1.AM_CompositionPrototype67.TBOX_SystemInfo_Provider.ServerPort_TBOX_SystemInfo.RROper_RR_CertificateIssuedMark, return-signal=SysSIG_RR_RR_CertificateIssuedMark_return_Cis_ADCC_TBOX_SystemInfo}
        client-server-to-signal-mapping={service-instance=CSI_TBOX_SystemInfo_VLAN62_ADCC, call-signal=SysSIG_RR_RR_CertificateIssuedMark_call_Cis_ADCC_TBOX_SystemInfo, client-server-operation=AM_CompositionType1.AM_CompositionPrototype67.TBOX_SystemInfoConsumer_ADCC.ClientPort_TBOX_SystemInfo.RROper_RR_CertificateIssuedMark, return-signal=SysSIG_RR_RR_CertificateIssuedMark_return_Cis_ADCC_TBOX_SystemInfo}
        client-server-to-signal-mapping={service-instance=PSI_TBOX_SystemInfo_1_VLAN62_TBOX, call-signal=SysSIG_RR_RR_SetCallNumber_call_Cis_ADCC_TBOX_SystemInfo, client-server-operation=AM_CompositionType1.AM_CompositionPrototype67.TBOX_SystemInfo_Provider.ServerPort_TBOX_SystemInfo.RROper_RR_SetCallNumber, return-signal=SysSIG_RR_RR_SetCallNumber_return_Cis_ADCC_TBOX_SystemInfo}
        client-server-to-signal-mapping={service-instance=CSI_TBOX_SystemInfo_VLAN62_ADCC, call-signal=SysSIG_RR_RR_SetCallNumber_call_Cis_ADCC_TBOX_SystemInfo, client-server-operation=AM_CompositionType1.AM_CompositionPrototype67.TBOX_SystemInfoConsumer_ADCC.ClientPort_TBOX_SystemInfo.RROper_RR_SetCallNumber, return-signal=SysSIG_RR_RR_SetCallNumber_return_Cis_ADCC_TBOX_SystemInfo}
        client-server-to-signal-mapping={service-instance=PSI_TBOX_SystemInfo_1_VLAN62_TBOX, call-signal=SysSIG_RR_RR_Cellinfo_call_Cis_ADCC_TBOX_SystemInfo, client-server-operation=AM_CompositionType1.AM_CompositionPrototype67.TBOX_SystemInfo_Provider.ServerPort_TBOX_SystemInfo.RROper_RR_Cellinfo, return-signal=SysSIG_RR_RR_Cellinfo_return_Cis_ADCC_TBOX_SystemInfo}
        client-server-to-signal-mapping={service-instance=CSI_TBOX_SystemInfo_VLAN62_ADCC, call-signal=SysSIG_RR_RR_Cellinfo_call_Cis_ADCC_TBOX_SystemInfo, client-server-operation=AM_CompositionType1.AM_CompositionPrototype67.TBOX_SystemInfoConsumer_ADCC.ClientPort_TBOX_SystemInfo.RROper_RR_Cellinfo, return-signal=SysSIG_RR_RR_Cellinfo_return_Cis_ADCC_TBOX_SystemInfo}
        client-server-to-signal-mapping={service-instance=PSI_TBOX_SystemInfo_1_VLAN62_TBOX, call-signal=SysSIG_RR_RR_VehicleDiag_call_Cis_ADCC_TBOX_SystemInfo, client-server-operation=AM_CompositionType1.AM_CompositionPrototype67.TBOX_SystemInfo_Provider.ServerPort_TBOX_SystemInfo.RROper_RR_VehicleDiag, return-signal=SysSIG_RR_RR_VehicleDiag_return_Cis_ADCC_TBOX_SystemInfo}
        client-server-to-signal-mapping={service-instance=CSI_TBOX_SystemInfo_VLAN62_ADCC, call-signal=SysSIG_RR_RR_VehicleDiag_call_Cis_ADCC_TBOX_SystemInfo, client-server-operation=AM_CompositionType1.AM_CompositionPrototype67.TBOX_SystemInfoConsumer_ADCC.ClientPort_TBOX_SystemInfo.RROper_RR_VehicleDiag, return-signal=SysSIG_RR_RR_VehicleDiag_return_Cis_ADCC_TBOX_SystemInfo}
        client-server-to-signal-mapping={service-instance=PSI_TBOX_SystemInfo_1_VLAN62_TBOX, call-signal=SysSIG_RR_RR_CurrenMonthTalkTime_call_Cis_ADCC_TBOX_SystemInfo, client-server-operation=AM_CompositionType1.AM_CompositionPrototype67.TBOX_SystemInfo_Provider.ServerPort_TBOX_SystemInfo.RROper_RR_CurrenMonthTalkTime, return-signal=SysSIG_RR_RR_CurrenMonthTalkTime_return_Cis_ADCC_TBOX_SystemInfo}
        client-server-to-signal-mapping={service-instance=CSI_TBOX_SystemInfo_VLAN62_ADCC, call-signal=SysSIG_RR_RR_CurrenMonthTalkTime_call_Cis_ADCC_TBOX_SystemInfo, client-server-operation=AM_CompositionType1.AM_CompositionPrototype67.TBOX_SystemInfoConsumer_ADCC.ClientPort_TBOX_SystemInfo.RROper_RR_CurrenMonthTalkTime, return-signal=SysSIG_RR_RR_CurrenMonthTalkTime_return_Cis_ADCC_TBOX_SystemInfo}
        client-server-to-signal-mapping={service-instance=PSI_TBOX_SystemInfo_1_VLAN62_TBOX, call-signal=SysSIG_RR_RR_TSPConnectionState_call_Cis_ADCC_TBOX_SystemInfo, client-server-operation=AM_CompositionType1.AM_CompositionPrototype67.TBOX_SystemInfo_Provider.ServerPort_TBOX_SystemInfo.RROper_RR_TSPConnectionState, return-signal=SysSIG_RR_RR_TSPConnectionState_return_Cis_ADCC_TBOX_SystemInfo}
        client-server-to-signal-mapping={service-instance=CSI_TBOX_SystemInfo_VLAN62_ADCC, call-signal=SysSIG_RR_RR_TSPConnectionState_call_Cis_ADCC_TBOX_SystemInfo, client-server-operation=AM_CompositionType1.AM_CompositionPrototype67.TBOX_SystemInfoConsumer_ADCC.ClientPort_TBOX_SystemInfo.RROper_RR_TSPConnectionState, return-signal=SysSIG_RR_RR_TSPConnectionState_return_Cis_ADCC_TBOX_SystemInfo}
        client-server-to-signal-mapping={service-instance=PSI_TBOX_SystemInfo_1_VLAN62_TBOX, call-signal=SysSIG_RR_RR_MicState_call_Cis_ADCC_TBOX_SystemInfo, client-server-operation=AM_CompositionType1.AM_CompositionPrototype67.TBOX_SystemInfo_Provider.ServerPort_TBOX_SystemInfo.RROper_RR_MicState, return-signal=SysSIG_RR_RR_MicState_return_Cis_ADCC_TBOX_SystemInfo}
        client-server-to-signal-mapping={service-instance=CSI_TBOX_SystemInfo_VLAN62_ADCC, call-signal=SysSIG_RR_RR_MicState_call_Cis_ADCC_TBOX_SystemInfo, client-server-operation=AM_CompositionType1.AM_CompositionPrototype67.TBOX_SystemInfoConsumer_ADCC.ClientPort_TBOX_SystemInfo.RROper_RR_MicState, return-signal=SysSIG_RR_RR_MicState_return_Cis_ADCC_TBOX_SystemInfo}
        client-server-to-signal-mapping={service-instance=PSI_TBOX_SystemInfo_1_VLAN62_TBOX, call-signal=SysSIG_RR_RR_ECUVersion_call_Cis_ADCC_TBOX_SystemInfo, client-server-operation=AM_CompositionType1.AM_CompositionPrototype67.TBOX_SystemInfo_Provider.ServerPort_TBOX_SystemInfo.RROper_RR_ECUVersion, return-signal=SysSIG_RR_RR_ECUVersion_return_Cis_ADCC_TBOX_SystemInfo}
        client-server-to-signal-mapping={service-instance=CSI_TBOX_SystemInfo_VLAN62_ADCC, call-signal=SysSIG_RR_RR_ECUVersion_call_Cis_ADCC_TBOX_SystemInfo, client-server-operation=AM_CompositionType1.AM_CompositionPrototype67.TBOX_SystemInfoConsumer_ADCC.ClientPort_TBOX_SystemInfo.RROper_RR_ECUVersion, return-signal=SysSIG_RR_RR_ECUVersion_return_Cis_ADCC_TBOX_SystemInfo}
        client-server-to-signal-mapping={service-instance=PSI_TBOX_SystemInfo_1_VLAN62_TBOX, call-signal=SysSIG_RR_RR_CanConfig_call_Cis_ADCC_TBOX_SystemInfo, client-server-operation=AM_CompositionType1.AM_CompositionPrototype67.TBOX_SystemInfo_Provider.ServerPort_TBOX_SystemInfo.RROper_RR_CanConfig, return-signal=SysSIG_RR_RR_CanConfig_return_Cis_ADCC_TBOX_SystemInfo}
        client-server-to-signal-mapping={service-instance=CSI_TBOX_SystemInfo_VLAN62_ADCC, call-signal=SysSIG_RR_RR_CanConfig_call_Cis_ADCC_TBOX_SystemInfo, client-server-operation=AM_CompositionType1.AM_CompositionPrototype67.TBOX_SystemInfoConsumer_ADCC.ClientPort_TBOX_SystemInfo.RROper_RR_CanConfig, return-signal=SysSIG_RR_RR_CanConfig_return_Cis_ADCC_TBOX_SystemInfo}
        client-server-to-signal-mapping={service-instance=PSI_TBOX_SystemInfo_1_VLAN62_TBOX, call-signal=SysSIG_RR_RR_KL15State_call_Cis_ADCC_TBOX_SystemInfo, client-server-operation=AM_CompositionType1.AM_CompositionPrototype67.TBOX_SystemInfo_Provider.ServerPort_TBOX_SystemInfo.RROper_RR_KL15State, return-signal=SysSIG_RR_RR_KL15State_return_Cis_ADCC_TBOX_SystemInfo}
        client-server-to-signal-mapping={service-instance=CSI_TBOX_SystemInfo_VLAN62_ADCC, call-signal=SysSIG_RR_RR_KL15State_call_Cis_ADCC_TBOX_SystemInfo, client-server-operation=AM_CompositionType1.AM_CompositionPrototype67.TBOX_SystemInfoConsumer_ADCC.ClientPort_TBOX_SystemInfo.RROper_RR_KL15State, return-signal=SysSIG_RR_RR_KL15State_return_Cis_ADCC_TBOX_SystemInfo}
        client-server-to-signal-mapping={service-instance=PSI_TBOX_SystemInfo_1_VLAN62_TBOX, call-signal=SysSIG_RR_RR_SPKState_call_Cis_ADCC_TBOX_SystemInfo, client-server-operation=AM_CompositionType1.AM_CompositionPrototype67.TBOX_SystemInfo_Provider.ServerPort_TBOX_SystemInfo.RROper_RR_SPKState, return-signal=SysSIG_RR_RR_SPKState_return_Cis_ADCC_TBOX_SystemInfo}
        client-server-to-signal-mapping={service-instance=CSI_TBOX_SystemInfo_VLAN62_ADCC, call-signal=SysSIG_RR_RR_SPKState_call_Cis_ADCC_TBOX_SystemInfo, client-server-operation=AM_CompositionType1.AM_CompositionPrototype67.TBOX_SystemInfoConsumer_ADCC.ClientPort_TBOX_SystemInfo.RROper_RR_SPKState, return-signal=SysSIG_RR_RR_SPKState_return_Cis_ADCC_TBOX_SystemInfo}
        client-server-to-signal-mapping={service-instance=PSI_TBOX_SystemInfo_1_VLAN62_TBOX, call-signal=SysSIG_RR_RR_AntState_call_Cis_ADCC_TBOX_SystemInfo, client-server-operation=AM_CompositionType1.AM_CompositionPrototype67.TBOX_SystemInfo_Provider.ServerPort_TBOX_SystemInfo.RROper_RR_AntState, return-signal=SysSIG_RR_RR_AntState_return_Cis_ADCC_TBOX_SystemInfo}
        client-server-to-signal-mapping={service-instance=CSI_TBOX_SystemInfo_VLAN62_ADCC, call-signal=SysSIG_RR_RR_AntState_call_Cis_ADCC_TBOX_SystemInfo, client-server-operation=AM_CompositionType1.AM_CompositionPrototype67.TBOX_SystemInfoConsumer_ADCC.ClientPort_TBOX_SystemInfo.RROper_RR_AntState, return-signal=SysSIG_RR_RR_AntState_return_Cis_ADCC_TBOX_SystemInfo}
        sender-receiver-to-signal-mapping={service-instance=PSI_TBOX_SystemInfo_1_VLAN62_TBOX, data-element=AM_CompositionPrototype67.TBOX_SystemInfo_Provider.AM_CompositionType1.TBOX_SystemInfo_Event_NetworkStatus_SndP.DataElement_Event_NetworkStatus, system-signal=SysSIG_Event_Event_NetworkStatus_TBOX_SystemInfo_1}
        sender-receiver-to-signal-mapping={service-instance=CSI_TBOX_SystemInfo_VLAN62_LCM, data-element=AM_CompositionPrototype67.TBOX_SystemInfoConsumer_LCM.AM_CompositionType1.TBOX_SystemInfo_Event_NetworkStatus_RcvP.DataElement_Event_NetworkStatus, system-signal=SysSIG_Event_Event_NetworkStatus_TBOX_SystemInfo_1}
        sender-receiver-to-signal-mapping={service-instance=PSI_TBOX_SystemInfo_1_VLAN62_TBOX, data-element=AM_CompositionPrototype67.TBOX_SystemInfo_Provider.AM_CompositionType1.TBOX_SystemInfo_Event_VehicleDiagStatus_SndP.DataElement_Event_VehicleDiagStatus, system-signal=SysSIG_Event_Event_VehicleDiagStatus_TBOX_SystemInfo_1}
        sender-receiver-to-signal-mapping={service-instance=CSI_TBOX_SystemInfo_VLAN62_LCM, data-element=AM_CompositionPrototype67.TBOX_SystemInfoConsumer_LCM.AM_CompositionType1.TBOX_SystemInfo_Event_VehicleDiagStatus_RcvP.DataElement_Event_VehicleDiagStatus, system-signal=SysSIG_Event_Event_VehicleDiagStatus_TBOX_SystemInfo_1}
        client-server-to-signal-mapping={service-instance=PSI_TBOX_SystemInfo_1_VLAN62_TBOX, call-signal=SysSIG_RR_RR_TBoxVersionInfo_call_Cis_LCM_TBOX_SystemInfo, client-server-operation=AM_CompositionType1.AM_CompositionPrototype67.TBOX_SystemInfo_Provider.ServerPort_TBOX_SystemInfo.RROper_RR_TBoxVersionInfo, return-signal=SysSIG_RR_RR_TBoxVersionInfo_return_Cis_LCM_TBOX_SystemInfo}
        client-server-to-signal-mapping={service-instance=CSI_TBOX_SystemInfo_VLAN62_LCM, call-signal=SysSIG_RR_RR_TBoxVersionInfo_call_Cis_LCM_TBOX_SystemInfo, client-server-operation=AM_CompositionType1.AM_CompositionPrototype67.TBOX_SystemInfoConsumer_LCM.ClientPort_TBOX_SystemInfo.RROper_RR_TBoxVersionInfo, return-signal=SysSIG_RR_RR_TBoxVersionInfo_return_Cis_LCM_TBOX_SystemInfo}
        client-server-to-signal-mapping={service-instance=PSI_TBOX_SystemInfo_1_VLAN62_TBOX, call-signal=SysSIG_RR_RR_BleModuleInfo_call_Cis_LCM_TBOX_SystemInfo, client-server-operation=AM_CompositionType1.AM_CompositionPrototype67.TBOX_SystemInfo_Provider.ServerPort_TBOX_SystemInfo.RROper_RR_BleModuleInfo, return-signal=SysSIG_RR_RR_BleModuleInfo_return_Cis_LCM_TBOX_SystemInfo}
        client-server-to-signal-mapping={service-instance=CSI_TBOX_SystemInfo_VLAN62_LCM, call-signal=SysSIG_RR_RR_BleModuleInfo_call_Cis_LCM_TBOX_SystemInfo, client-server-operation=AM_CompositionType1.AM_CompositionPrototype67.TBOX_SystemInfoConsumer_LCM.ClientPort_TBOX_SystemInfo.RROper_RR_BleModuleInfo, return-signal=SysSIG_RR_RR_BleModuleInfo_return_Cis_LCM_TBOX_SystemInfo}
        client-server-to-signal-mapping={service-instance=PSI_TBOX_SystemInfo_1_VLAN62_TBOX, call-signal=SysSIG_RR_RR_VIN_call_Cis_LCM_TBOX_SystemInfo, client-server-operation=AM_CompositionType1.AM_CompositionPrototype67.TBOX_SystemInfo_Provider.ServerPort_TBOX_SystemInfo.RROper_RR_VIN, return-signal=SysSIG_RR_RR_VIN_return_Cis_LCM_TBOX_SystemInfo}
        client-server-to-signal-mapping={service-instance=CSI_TBOX_SystemInfo_VLAN62_LCM, call-signal=SysSIG_RR_RR_VIN_call_Cis_LCM_TBOX_SystemInfo, client-server-operation=AM_CompositionType1.AM_CompositionPrototype67.TBOX_SystemInfoConsumer_LCM.ClientPort_TBOX_SystemInfo.RROper_RR_VIN, return-signal=SysSIG_RR_RR_VIN_return_Cis_LCM_TBOX_SystemInfo}
        client-server-to-signal-mapping={service-instance=PSI_TBOX_SystemInfo_1_VLAN62_TBOX, call-signal=SysSIG_RR_RR_SIMCardinfo_call_Cis_LCM_TBOX_SystemInfo, client-server-operation=AM_CompositionType1.AM_CompositionPrototype67.TBOX_SystemInfo_Provider.ServerPort_TBOX_SystemInfo.RROper_RR_SIMCardinfo, return-signal=SysSIG_RR_RR_SIMCardinfo_return_Cis_LCM_TBOX_SystemInfo}
        client-server-to-signal-mapping={service-instance=CSI_TBOX_SystemInfo_VLAN62_LCM, call-signal=SysSIG_RR_RR_SIMCardinfo_call_Cis_LCM_TBOX_SystemInfo, client-server-operation=AM_CompositionType1.AM_CompositionPrototype67.TBOX_SystemInfoConsumer_LCM.ClientPort_TBOX_SystemInfo.RROper_RR_SIMCardinfo, return-signal=SysSIG_RR_RR_SIMCardinfo_return_Cis_LCM_TBOX_SystemInfo}
        client-server-to-signal-mapping={service-instance=PSI_TBOX_SystemInfo_1_VLAN62_TBOX, call-signal=SysSIG_RR_RR_IMEIInfo_call_Cis_LCM_TBOX_SystemInfo, client-server-operation=AM_CompositionType1.AM_CompositionPrototype67.TBOX_SystemInfo_Provider.ServerPort_TBOX_SystemInfo.RROper_RR_IMEIInfo, return-signal=SysSIG_RR_RR_IMEIInfo_return_Cis_LCM_TBOX_SystemInfo}
        client-server-to-signal-mapping={service-instance=CSI_TBOX_SystemInfo_VLAN62_LCM, call-signal=SysSIG_RR_RR_IMEIInfo_call_Cis_LCM_TBOX_SystemInfo, client-server-operation=AM_CompositionType1.AM_CompositionPrototype67.TBOX_SystemInfoConsumer_LCM.ClientPort_TBOX_SystemInfo.RROper_RR_IMEIInfo, return-signal=SysSIG_RR_RR_IMEIInfo_return_Cis_LCM_TBOX_SystemInfo}
        client-server-to-signal-mapping={service-instance=PSI_TBOX_SystemInfo_1_VLAN62_TBOX, call-signal=SysSIG_RR_RR_CallNumberList_call_Cis_LCM_TBOX_SystemInfo, client-server-operation=AM_CompositionType1.AM_CompositionPrototype67.TBOX_SystemInfo_Provider.ServerPort_TBOX_SystemInfo.RROper_RR_CallNumberList, return-signal=SysSIG_RR_RR_CallNumberList_return_Cis_LCM_TBOX_SystemInfo}
        client-server-to-signal-mapping={service-instance=CSI_TBOX_SystemInfo_VLAN62_LCM, call-signal=SysSIG_RR_RR_CallNumberList_call_Cis_LCM_TBOX_SystemInfo, client-server-operation=AM_CompositionType1.AM_CompositionPrototype67.TBOX_SystemInfoConsumer_LCM.ClientPort_TBOX_SystemInfo.RROper_RR_CallNumberList, return-signal=SysSIG_RR_RR_CallNumberList_return_Cis_LCM_TBOX_SystemInfo}
        client-server-to-signal-mapping={service-instance=PSI_TBOX_SystemInfo_1_VLAN62_TBOX, call-signal=SysSIG_RR_RR_WorkModel_call_Cis_LCM_TBOX_SystemInfo, client-server-operation=AM_CompositionType1.AM_CompositionPrototype67.TBOX_SystemInfo_Provider.ServerPort_TBOX_SystemInfo.RROper_RR_WorkModel, return-signal=SysSIG_RR_RR_WorkModel_return_Cis_LCM_TBOX_SystemInfo}
        client-server-to-signal-mapping={service-instance=CSI_TBOX_SystemInfo_VLAN62_LCM, call-signal=SysSIG_RR_RR_WorkModel_call_Cis_LCM_TBOX_SystemInfo, client-server-operation=AM_CompositionType1.AM_CompositionPrototype67.TBOX_SystemInfoConsumer_LCM.ClientPort_TBOX_SystemInfo.RROper_RR_WorkModel, return-signal=SysSIG_RR_RR_WorkModel_return_Cis_LCM_TBOX_SystemInfo}
        client-server-to-signal-mapping={service-instance=PSI_TBOX_SystemInfo_1_VLAN62_TBOX, call-signal=SysSIG_RR_RR_CertificateIssuedMark_call_Cis_LCM_TBOX_SystemInfo, client-server-operation=AM_CompositionType1.AM_CompositionPrototype67.TBOX_SystemInfo_Provider.ServerPort_TBOX_SystemInfo.RROper_RR_CertificateIssuedMark, return-signal=SysSIG_RR_RR_CertificateIssuedMark_return_Cis_LCM_TBOX_SystemInfo}
        client-server-to-signal-mapping={service-instance=CSI_TBOX_SystemInfo_VLAN62_LCM, call-signal=SysSIG_RR_RR_CertificateIssuedMark_call_Cis_LCM_TBOX_SystemInfo, client-server-operation=AM_CompositionType1.AM_CompositionPrototype67.TBOX_SystemInfoConsumer_LCM.ClientPort_TBOX_SystemInfo.RROper_RR_CertificateIssuedMark, return-signal=SysSIG_RR_RR_CertificateIssuedMark_return_Cis_LCM_TBOX_SystemInfo}
        client-server-to-signal-mapping={service-instance=PSI_TBOX_SystemInfo_1_VLAN62_TBOX, call-signal=SysSIG_RR_RR_SetCallNumber_call_Cis_LCM_TBOX_SystemInfo, client-server-operation=AM_CompositionType1.AM_CompositionPrototype67.TBOX_SystemInfo_Provider.ServerPort_TBOX_SystemInfo.RROper_RR_SetCallNumber, return-signal=SysSIG_RR_RR_SetCallNumber_return_Cis_LCM_TBOX_SystemInfo}
        client-server-to-signal-mapping={service-instance=CSI_TBOX_SystemInfo_VLAN62_LCM, call-signal=SysSIG_RR_RR_SetCallNumber_call_Cis_LCM_TBOX_SystemInfo, client-server-operation=AM_CompositionType1.AM_CompositionPrototype67.TBOX_SystemInfoConsumer_LCM.ClientPort_TBOX_SystemInfo.RROper_RR_SetCallNumber, return-signal=SysSIG_RR_RR_SetCallNumber_return_Cis_LCM_TBOX_SystemInfo}
        client-server-to-signal-mapping={service-instance=PSI_TBOX_SystemInfo_1_VLAN62_TBOX, call-signal=SysSIG_RR_RR_Cellinfo_call_Cis_LCM_TBOX_SystemInfo, client-server-operation=AM_CompositionType1.AM_CompositionPrototype67.TBOX_SystemInfo_Provider.ServerPort_TBOX_SystemInfo.RROper_RR_Cellinfo, return-signal=SysSIG_RR_RR_Cellinfo_return_Cis_LCM_TBOX_SystemInfo}
        client-server-to-signal-mapping={service-instance=CSI_TBOX_SystemInfo_VLAN62_LCM, call-signal=SysSIG_RR_RR_Cellinfo_call_Cis_LCM_TBOX_SystemInfo, client-server-operation=AM_CompositionType1.AM_CompositionPrototype67.TBOX_SystemInfoConsumer_LCM.ClientPort_TBOX_SystemInfo.RROper_RR_Cellinfo, return-signal=SysSIG_RR_RR_Cellinfo_return_Cis_LCM_TBOX_SystemInfo}
        client-server-to-signal-mapping={service-instance=PSI_TBOX_SystemInfo_1_VLAN62_TBOX, call-signal=SysSIG_RR_RR_VehicleDiag_call_Cis_LCM_TBOX_SystemInfo, client-server-operation=AM_CompositionType1.AM_CompositionPrototype67.TBOX_SystemInfo_Provider.ServerPort_TBOX_SystemInfo.RROper_RR_VehicleDiag, return-signal=SysSIG_RR_RR_VehicleDiag_return_Cis_LCM_TBOX_SystemInfo}
        client-server-to-signal-mapping={service-instance=CSI_TBOX_SystemInfo_VLAN62_LCM, call-signal=SysSIG_RR_RR_VehicleDiag_call_Cis_LCM_TBOX_SystemInfo, client-server-operation=AM_CompositionType1.AM_CompositionPrototype67.TBOX_SystemInfoConsumer_LCM.ClientPort_TBOX_SystemInfo.RROper_RR_VehicleDiag, return-signal=SysSIG_RR_RR_VehicleDiag_return_Cis_LCM_TBOX_SystemInfo}
        client-server-to-signal-mapping={service-instance=PSI_TBOX_SystemInfo_1_VLAN62_TBOX, call-signal=SysSIG_RR_RR_CurrenMonthTalkTime_call_Cis_LCM_TBOX_SystemInfo, client-server-operation=AM_CompositionType1.AM_CompositionPrototype67.TBOX_SystemInfo_Provider.ServerPort_TBOX_SystemInfo.RROper_RR_CurrenMonthTalkTime, return-signal=SysSIG_RR_RR_CurrenMonthTalkTime_return_Cis_LCM_TBOX_SystemInfo}
        client-server-to-signal-mapping={service-instance=CSI_TBOX_SystemInfo_VLAN62_LCM, call-signal=SysSIG_RR_RR_CurrenMonthTalkTime_call_Cis_LCM_TBOX_SystemInfo, client-server-operation=AM_CompositionType1.AM_CompositionPrototype67.TBOX_SystemInfoConsumer_LCM.ClientPort_TBOX_SystemInfo.RROper_RR_CurrenMonthTalkTime, return-signal=SysSIG_RR_RR_CurrenMonthTalkTime_return_Cis_LCM_TBOX_SystemInfo}
        client-server-to-signal-mapping={service-instance=PSI_TBOX_SystemInfo_1_VLAN62_TBOX, call-signal=SysSIG_RR_RR_TSPConnectionState_call_Cis_LCM_TBOX_SystemInfo, client-server-operation=AM_CompositionType1.AM_CompositionPrototype67.TBOX_SystemInfo_Provider.ServerPort_TBOX_SystemInfo.RROper_RR_TSPConnectionState, return-signal=SysSIG_RR_RR_TSPConnectionState_return_Cis_LCM_TBOX_SystemInfo}
        client-server-to-signal-mapping={service-instance=CSI_TBOX_SystemInfo_VLAN62_LCM, call-signal=SysSIG_RR_RR_TSPConnectionState_call_Cis_LCM_TBOX_SystemInfo, client-server-operation=AM_CompositionType1.AM_CompositionPrototype67.TBOX_SystemInfoConsumer_LCM.ClientPort_TBOX_SystemInfo.RROper_RR_TSPConnectionState, return-signal=SysSIG_RR_RR_TSPConnectionState_return_Cis_LCM_TBOX_SystemInfo}
        client-server-to-signal-mapping={service-instance=PSI_TBOX_SystemInfo_1_VLAN62_TBOX, call-signal=SysSIG_RR_RR_MicState_call_Cis_LCM_TBOX_SystemInfo, client-server-operation=AM_CompositionType1.AM_CompositionPrototype67.TBOX_SystemInfo_Provider.ServerPort_TBOX_SystemInfo.RROper_RR_MicState, return-signal=SysSIG_RR_RR_MicState_return_Cis_LCM_TBOX_SystemInfo}
        client-server-to-signal-mapping={service-instance=CSI_TBOX_SystemInfo_VLAN62_LCM, call-signal=SysSIG_RR_RR_MicState_call_Cis_LCM_TBOX_SystemInfo, client-server-operation=AM_CompositionType1.AM_CompositionPrototype67.TBOX_SystemInfoConsumer_LCM.ClientPort_TBOX_SystemInfo.RROper_RR_MicState, return-signal=SysSIG_RR_RR_MicState_return_Cis_LCM_TBOX_SystemInfo}
        client-server-to-signal-mapping={service-instance=PSI_TBOX_SystemInfo_1_VLAN62_TBOX, call-signal=SysSIG_RR_RR_ECUVersion_call_Cis_LCM_TBOX_SystemInfo, client-server-operation=AM_CompositionType1.AM_CompositionPrototype67.TBOX_SystemInfo_Provider.ServerPort_TBOX_SystemInfo.RROper_RR_ECUVersion, return-signal=SysSIG_RR_RR_ECUVersion_return_Cis_LCM_TBOX_SystemInfo}
        client-server-to-signal-mapping={service-instance=CSI_TBOX_SystemInfo_VLAN62_LCM, call-signal=SysSIG_RR_RR_ECUVersion_call_Cis_LCM_TBOX_SystemInfo, client-server-operation=AM_CompositionType1.AM_CompositionPrototype67.TBOX_SystemInfoConsumer_LCM.ClientPort_TBOX_SystemInfo.RROper_RR_ECUVersion, return-signal=SysSIG_RR_RR_ECUVersion_return_Cis_LCM_TBOX_SystemInfo}
        client-server-to-signal-mapping={service-instance=PSI_TBOX_SystemInfo_1_VLAN62_TBOX, call-signal=SysSIG_RR_RR_CanConfig_call_Cis_LCM_TBOX_SystemInfo, client-server-operation=AM_CompositionType1.AM_CompositionPrototype67.TBOX_SystemInfo_Provider.ServerPort_TBOX_SystemInfo.RROper_RR_CanConfig, return-signal=SysSIG_RR_RR_CanConfig_return_Cis_LCM_TBOX_SystemInfo}
        client-server-to-signal-mapping={service-instance=CSI_TBOX_SystemInfo_VLAN62_LCM, call-signal=SysSIG_RR_RR_CanConfig_call_Cis_LCM_TBOX_SystemInfo, client-server-operation=AM_CompositionType1.AM_CompositionPrototype67.TBOX_SystemInfoConsumer_LCM.ClientPort_TBOX_SystemInfo.RROper_RR_CanConfig, return-signal=SysSIG_RR_RR_CanConfig_return_Cis_LCM_TBOX_SystemInfo}
        client-server-to-signal-mapping={service-instance=PSI_TBOX_SystemInfo_1_VLAN62_TBOX, call-signal=SysSIG_RR_RR_KL15State_call_Cis_LCM_TBOX_SystemInfo, client-server-operation=AM_CompositionType1.AM_CompositionPrototype67.TBOX_SystemInfo_Provider.ServerPort_TBOX_SystemInfo.RROper_RR_KL15State, return-signal=SysSIG_RR_RR_KL15State_return_Cis_LCM_TBOX_SystemInfo}
        client-server-to-signal-mapping={service-instance=CSI_TBOX_SystemInfo_VLAN62_LCM, call-signal=SysSIG_RR_RR_KL15State_call_Cis_LCM_TBOX_SystemInfo, client-server-operation=AM_CompositionType1.AM_CompositionPrototype67.TBOX_SystemInfoConsumer_LCM.ClientPort_TBOX_SystemInfo.RROper_RR_KL15State, return-signal=SysSIG_RR_RR_KL15State_return_Cis_LCM_TBOX_SystemInfo}
        client-server-to-signal-mapping={service-instance=PSI_TBOX_SystemInfo_1_VLAN62_TBOX, call-signal=SysSIG_RR_RR_SPKState_call_Cis_LCM_TBOX_SystemInfo, client-server-operation=AM_CompositionType1.AM_CompositionPrototype67.TBOX_SystemInfo_Provider.ServerPort_TBOX_SystemInfo.RROper_RR_SPKState, return-signal=SysSIG_RR_RR_SPKState_return_Cis_LCM_TBOX_SystemInfo}
        client-server-to-signal-mapping={service-instance=CSI_TBOX_SystemInfo_VLAN62_LCM, call-signal=SysSIG_RR_RR_SPKState_call_Cis_LCM_TBOX_SystemInfo, client-server-operation=AM_CompositionType1.AM_CompositionPrototype67.TBOX_SystemInfoConsumer_LCM.ClientPort_TBOX_SystemInfo.RROper_RR_SPKState, return-signal=SysSIG_RR_RR_SPKState_return_Cis_LCM_TBOX_SystemInfo}
        client-server-to-signal-mapping={service-instance=PSI_TBOX_SystemInfo_1_VLAN62_TBOX, call-signal=SysSIG_RR_RR_AntState_call_Cis_LCM_TBOX_SystemInfo, client-server-operation=AM_CompositionType1.AM_CompositionPrototype67.TBOX_SystemInfo_Provider.ServerPort_TBOX_SystemInfo.RROper_RR_AntState, return-signal=SysSIG_RR_RR_AntState_return_Cis_LCM_TBOX_SystemInfo}
        client-server-to-signal-mapping={service-instance=CSI_TBOX_SystemInfo_VLAN62_LCM, call-signal=SysSIG_RR_RR_AntState_call_Cis_LCM_TBOX_SystemInfo, client-server-operation=AM_CompositionType1.AM_CompositionPrototype67.TBOX_SystemInfoConsumer_LCM.ClientPort_TBOX_SystemInfo.RROper_RR_AntState, return-signal=SysSIG_RR_RR_AntState_return_Cis_LCM_TBOX_SystemInfo}
        sender-receiver-to-signal-mapping={service-instance=PSI_TBOX_SystemInfo_1_VLAN62_TBOX, data-element=AM_CompositionPrototype67.TBOX_SystemInfo_Provider.AM_CompositionType1.TBOX_SystemInfo_Event_NetworkStatus_SndP.DataElement_Event_NetworkStatus, system-signal=SysSIG_Event_Event_NetworkStatus_TBOX_SystemInfo_2}
        sender-receiver-to-signal-mapping={service-instance=CSI_TBOX_SystemInfo_VLAN62_ICC_8155_Android, data-element=AM_CompositionPrototype67.TBOX_SystemInfoConsumer_ICC_8155_Android.AM_CompositionType1.TBOX_SystemInfo_Event_NetworkStatus_RcvP.DataElement_Event_NetworkStatus, system-signal=SysSIG_Event_Event_NetworkStatus_TBOX_SystemInfo_2}
        sender-receiver-to-signal-mapping={service-instance=PSI_TBOX_SystemInfo_1_VLAN62_TBOX, data-element=AM_CompositionPrototype67.TBOX_SystemInfo_Provider.AM_CompositionType1.TBOX_SystemInfo_Event_VehicleDiagStatus_SndP.DataElement_Event_VehicleDiagStatus, system-signal=SysSIG_Event_Event_VehicleDiagStatus_TBOX_SystemInfo_2}
        sender-receiver-to-signal-mapping={service-instance=CSI_TBOX_SystemInfo_VLAN62_ICC_8155_Android, data-element=AM_CompositionPrototype67.TBOX_SystemInfoConsumer_ICC_8155_Android.AM_CompositionType1.TBOX_SystemInfo_Event_VehicleDiagStatus_RcvP.DataElement_Event_VehicleDiagStatus, system-signal=SysSIG_Event_Event_VehicleDiagStatus_TBOX_SystemInfo_2}
        client-server-to-signal-mapping={service-instance=PSI_TBOX_SystemInfo_1_VLAN62_TBOX, call-signal=SysSIG_RR_RR_TBoxVersionInfo_call_Cis_ICC_8155_Android_TBOX_SystemInfo, client-server-operation=AM_CompositionType1.AM_CompositionPrototype67.TBOX_SystemInfo_Provider.ServerPort_TBOX_SystemInfo.RROper_RR_TBoxVersionInfo, return-signal=SysSIG_RR_RR_TBoxVersionInfo_return_Cis_ICC_8155_Android_TBOX_SystemInfo}
        client-server-to-signal-mapping={service-instance=CSI_TBOX_SystemInfo_VLAN62_ICC_8155_Android, call-signal=SysSIG_RR_RR_TBoxVersionInfo_call_Cis_ICC_8155_Android_TBOX_SystemInfo, client-server-operation=AM_CompositionType1.AM_CompositionPrototype67.TBOX_SystemInfoConsumer_ICC_8155_Android.ClientPort_TBOX_SystemInfo.RROper_RR_TBoxVersionInfo, return-signal=SysSIG_RR_RR_TBoxVersionInfo_return_Cis_ICC_8155_Android_TBOX_SystemInfo}
        client-server-to-signal-mapping={service-instance=PSI_TBOX_SystemInfo_1_VLAN62_TBOX, call-signal=SysSIG_RR_RR_BleModuleInfo_call_Cis_ICC_8155_Android_TBOX_SystemInfo, client-server-operation=AM_CompositionType1.AM_CompositionPrototype67.TBOX_SystemInfo_Provider.ServerPort_TBOX_SystemInfo.RROper_RR_BleModuleInfo, return-signal=SysSIG_RR_RR_BleModuleInfo_return_Cis_ICC_8155_Android_TBOX_SystemInfo}
        client-server-to-signal-mapping={service-instance=CSI_TBOX_SystemInfo_VLAN62_ICC_8155_Android, call-signal=SysSIG_RR_RR_BleModuleInfo_call_Cis_ICC_8155_Android_TBOX_SystemInfo, client-server-operation=AM_CompositionType1.AM_CompositionPrototype67.TBOX_SystemInfoConsumer_ICC_8155_Android.ClientPort_TBOX_SystemInfo.RROper_RR_BleModuleInfo, return-signal=SysSIG_RR_RR_BleModuleInfo_return_Cis_ICC_8155_Android_TBOX_SystemInfo}
        client-server-to-signal-mapping={service-instance=PSI_TBOX_SystemInfo_1_VLAN62_TBOX, call-signal=SysSIG_RR_RR_VIN_call_Cis_ICC_8155_Android_TBOX_SystemInfo, client-server-operation=AM_CompositionType1.AM_CompositionPrototype67.TBOX_SystemInfo_Provider.ServerPort_TBOX_SystemInfo.RROper_RR_VIN, return-signal=SysSIG_RR_RR_VIN_return_Cis_ICC_8155_Android_TBOX_SystemInfo}
        client-server-to-signal-mapping={service-instance=CSI_TBOX_SystemInfo_VLAN62_ICC_8155_Android, call-signal=SysSIG_RR_RR_VIN_call_Cis_ICC_8155_Android_TBOX_SystemInfo, client-server-operation=AM_CompositionType1.AM_CompositionPrototype67.TBOX_SystemInfoConsumer_ICC_8155_Android.ClientPort_TBOX_SystemInfo.RROper_RR_VIN, return-signal=SysSIG_RR_RR_VIN_return_Cis_ICC_8155_Android_TBOX_SystemInfo}
        client-server-to-signal-mapping={service-instance=PSI_TBOX_SystemInfo_1_VLAN62_TBOX, call-signal=SysSIG_RR_RR_SIMCardinfo_call_Cis_ICC_8155_Android_TBOX_SystemInfo, client-server-operation=AM_CompositionType1.AM_CompositionPrototype67.TBOX_SystemInfo_Provider.ServerPort_TBOX_SystemInfo.RROper_RR_SIMCardinfo, return-signal=SysSIG_RR_RR_SIMCardinfo_return_Cis_ICC_8155_Android_TBOX_SystemInfo}
        client-server-to-signal-mapping={service-instance=CSI_TBOX_SystemInfo_VLAN62_ICC_8155_Android, call-signal=SysSIG_RR_RR_SIMCardinfo_call_Cis_ICC_8155_Android_TBOX_SystemInfo, client-server-operation=AM_CompositionType1.AM_CompositionPrototype67.TBOX_SystemInfoConsumer_ICC_8155_Android.ClientPort_TBOX_SystemInfo.RROper_RR_SIMCardinfo, return-signal=SysSIG_RR_RR_SIMCardinfo_return_Cis_ICC_8155_Android_TBOX_SystemInfo}
        client-server-to-signal-mapping={service-instance=PSI_TBOX_SystemInfo_1_VLAN62_TBOX, call-signal=SysSIG_RR_RR_IMEIInfo_call_Cis_ICC_8155_Android_TBOX_SystemInfo, client-server-operation=AM_CompositionType1.AM_CompositionPrototype67.TBOX_SystemInfo_Provider.ServerPort_TBOX_SystemInfo.RROper_RR_IMEIInfo, return-signal=SysSIG_RR_RR_IMEIInfo_return_Cis_ICC_8155_Android_TBOX_SystemInfo}
        client-server-to-signal-mapping={service-instance=CSI_TBOX_SystemInfo_VLAN62_ICC_8155_Android, call-signal=SysSIG_RR_RR_IMEIInfo_call_Cis_ICC_8155_Android_TBOX_SystemInfo, client-server-operation=AM_CompositionType1.AM_CompositionPrototype67.TBOX_SystemInfoConsumer_ICC_8155_Android.ClientPort_TBOX_SystemInfo.RROper_RR_IMEIInfo, return-signal=SysSIG_RR_RR_IMEIInfo_return_Cis_ICC_8155_Android_TBOX_SystemInfo}
        client-server-to-signal-mapping={service-instance=PSI_TBOX_SystemInfo_1_VLAN62_TBOX, call-signal=SysSIG_RR_RR_CallNumberList_call_Cis_ICC_8155_Android_TBOX_SystemInfo, client-server-operation=AM_CompositionType1.AM_CompositionPrototype67.TBOX_SystemInfo_Provider.ServerPort_TBOX_SystemInfo.RROper_RR_CallNumberList, return-signal=SysSIG_RR_RR_CallNumberList_return_Cis_ICC_8155_Android_TBOX_SystemInfo}
        client-server-to-signal-mapping={service-instance=CSI_TBOX_SystemInfo_VLAN62_ICC_8155_Android, call-signal=SysSIG_RR_RR_CallNumberList_call_Cis_ICC_8155_Android_TBOX_SystemInfo, client-server-operation=AM_CompositionType1.AM_CompositionPrototype67.TBOX_SystemInfoConsumer_ICC_8155_Android.ClientPort_TBOX_SystemInfo.RROper_RR_CallNumberList, return-signal=SysSIG_RR_RR_CallNumberList_return_Cis_ICC_8155_Android_TBOX_SystemInfo}
        client-server-to-signal-mapping={service-instance=PSI_TBOX_SystemInfo_1_VLAN62_TBOX, call-signal=SysSIG_RR_RR_WorkModel_call_Cis_ICC_8155_Android_TBOX_SystemInfo, client-server-operation=AM_CompositionType1.AM_CompositionPrototype67.TBOX_SystemInfo_Provider.ServerPort_TBOX_SystemInfo.RROper_RR_WorkModel, return-signal=SysSIG_RR_RR_WorkModel_return_Cis_ICC_8155_Android_TBOX_SystemInfo}
        client-server-to-signal-mapping={service-instance=CSI_TBOX_SystemInfo_VLAN62_ICC_8155_Android, call-signal=SysSIG_RR_RR_WorkModel_call_Cis_ICC_8155_Android_TBOX_SystemInfo, client-server-operation=AM_CompositionType1.AM_CompositionPrototype67.TBOX_SystemInfoConsumer_ICC_8155_Android.ClientPort_TBOX_SystemInfo.RROper_RR_WorkModel, return-signal=SysSIG_RR_RR_WorkModel_return_Cis_ICC_8155_Android_TBOX_SystemInfo}
        client-server-to-signal-mapping={service-instance=PSI_TBOX_SystemInfo_1_VLAN62_TBOX, call-signal=SysSIG_RR_RR_CertificateIssuedMark_call_Cis_ICC_8155_Android_TBOX_SystemInfo, client-server-operation=AM_CompositionType1.AM_CompositionPrototype67.TBOX_SystemInfo_Provider.ServerPort_TBOX_SystemInfo.RROper_RR_CertificateIssuedMark, return-signal=SysSIG_RR_RR_CertificateIssuedMark_return_Cis_ICC_8155_Android_TBOX_SystemInfo}
        client-server-to-signal-mapping={service-instance=CSI_TBOX_SystemInfo_VLAN62_ICC_8155_Android, call-signal=SysSIG_RR_RR_CertificateIssuedMark_call_Cis_ICC_8155_Android_TBOX_SystemInfo, client-server-operation=AM_CompositionType1.AM_CompositionPrototype67.TBOX_SystemInfoConsumer_ICC_8155_Android.ClientPort_TBOX_SystemInfo.RROper_RR_CertificateIssuedMark, return-signal=SysSIG_RR_RR_CertificateIssuedMark_return_Cis_ICC_8155_Android_TBOX_SystemInfo}
        client-server-to-signal-mapping={service-instance=PSI_TBOX_SystemInfo_1_VLAN62_TBOX, call-signal=SysSIG_RR_RR_SetCallNumber_call_Cis_ICC_8155_Android_TBOX_SystemInfo, client-server-operation=AM_CompositionType1.AM_CompositionPrototype67.TBOX_SystemInfo_Provider.ServerPort_TBOX_SystemInfo.RROper_RR_SetCallNumber, return-signal=SysSIG_RR_RR_SetCallNumber_return_Cis_ICC_8155_Android_TBOX_SystemInfo}
        client-server-to-signal-mapping={service-instance=CSI_TBOX_SystemInfo_VLAN62_ICC_8155_Android, call-signal=SysSIG_RR_RR_SetCallNumber_call_Cis_ICC_8155_Android_TBOX_SystemInfo, client-server-operation=AM_CompositionType1.AM_CompositionPrototype67.TBOX_SystemInfoConsumer_ICC_8155_Android.ClientPort_TBOX_SystemInfo.RROper_RR_SetCallNumber, return-signal=SysSIG_RR_RR_SetCallNumber_return_Cis_ICC_8155_Android_TBOX_SystemInfo}
        client-server-to-signal-mapping={service-instance=PSI_TBOX_SystemInfo_1_VLAN62_TBOX, call-signal=SysSIG_RR_RR_Cellinfo_call_Cis_ICC_8155_Android_TBOX_SystemInfo, client-server-operation=AM_CompositionType1.AM_CompositionPrototype67.TBOX_SystemInfo_Provider.ServerPort_TBOX_SystemInfo.RROper_RR_Cellinfo, return-signal=SysSIG_RR_RR_Cellinfo_return_Cis_ICC_8155_Android_TBOX_SystemInfo}
        client-server-to-signal-mapping={service-instance=CSI_TBOX_SystemInfo_VLAN62_ICC_8155_Android, call-signal=SysSIG_RR_RR_Cellinfo_call_Cis_ICC_8155_Android_TBOX_SystemInfo, client-server-operation=AM_CompositionType1.AM_CompositionPrototype67.TBOX_SystemInfoConsumer_ICC_8155_Android.ClientPort_TBOX_SystemInfo.RROper_RR_Cellinfo, return-signal=SysSIG_RR_RR_Cellinfo_return_Cis_ICC_8155_Android_TBOX_SystemInfo}
        client-server-to-signal-mapping={service-instance=PSI_TBOX_SystemInfo_1_VLAN62_TBOX, call-signal=SysSIG_RR_RR_VehicleDiag_call_Cis_ICC_8155_Android_TBOX_SystemInfo, client-server-operation=AM_CompositionType1.AM_CompositionPrototype67.TBOX_SystemInfo_Provider.ServerPort_TBOX_SystemInfo.RROper_RR_VehicleDiag, return-signal=SysSIG_RR_RR_VehicleDiag_return_Cis_ICC_8155_Android_TBOX_SystemInfo}
        client-server-to-signal-mapping={service-instance=CSI_TBOX_SystemInfo_VLAN62_ICC_8155_Android, call-signal=SysSIG_RR_RR_VehicleDiag_call_Cis_ICC_8155_Android_TBOX_SystemInfo, client-server-operation=AM_CompositionType1.AM_CompositionPrototype67.TBOX_SystemInfoConsumer_ICC_8155_Android.ClientPort_TBOX_SystemInfo.RROper_RR_VehicleDiag, return-signal=SysSIG_RR_RR_VehicleDiag_return_Cis_ICC_8155_Android_TBOX_SystemInfo}
        client-server-to-signal-mapping={service-instance=PSI_TBOX_SystemInfo_1_VLAN62_TBOX, call-signal=SysSIG_RR_RR_CurrenMonthTalkTime_call_Cis_ICC_8155_Android_TBOX_SystemInfo, client-server-operation=AM_CompositionType1.AM_CompositionPrototype67.TBOX_SystemInfo_Provider.ServerPort_TBOX_SystemInfo.RROper_RR_CurrenMonthTalkTime, return-signal=SysSIG_RR_RR_CurrenMonthTalkTime_return_Cis_ICC_8155_Android_TBOX_SystemInfo}
        client-server-to-signal-mapping={service-instance=CSI_TBOX_SystemInfo_VLAN62_ICC_8155_Android, call-signal=SysSIG_RR_RR_CurrenMonthTalkTime_call_Cis_ICC_8155_Android_TBOX_SystemInfo, client-server-operation=AM_CompositionType1.AM_CompositionPrototype67.TBOX_SystemInfoConsumer_ICC_8155_Android.ClientPort_TBOX_SystemInfo.RROper_RR_CurrenMonthTalkTime, return-signal=SysSIG_RR_RR_CurrenMonthTalkTime_return_Cis_ICC_8155_Android_TBOX_SystemInfo}
        client-server-to-signal-mapping={service-instance=PSI_TBOX_SystemInfo_1_VLAN62_TBOX, call-signal=SysSIG_RR_RR_TSPConnectionState_call_Cis_ICC_8155_Android_TBOX_SystemInfo, client-server-operation=AM_CompositionType1.AM_CompositionPrototype67.TBOX_SystemInfo_Provider.ServerPort_TBOX_SystemInfo.RROper_RR_TSPConnectionState, return-signal=SysSIG_RR_RR_TSPConnectionState_return_Cis_ICC_8155_Android_TBOX_SystemInfo}
        client-server-to-signal-mapping={service-instance=CSI_TBOX_SystemInfo_VLAN62_ICC_8155_Android, call-signal=SysSIG_RR_RR_TSPConnectionState_call_Cis_ICC_8155_Android_TBOX_SystemInfo, client-server-operation=AM_CompositionType1.AM_CompositionPrototype67.TBOX_SystemInfoConsumer_ICC_8155_Android.ClientPort_TBOX_SystemInfo.RROper_RR_TSPConnectionState, return-signal=SysSIG_RR_RR_TSPConnectionState_return_Cis_ICC_8155_Android_TBOX_SystemInfo}
        client-server-to-signal-mapping={service-instance=PSI_TBOX_SystemInfo_1_VLAN62_TBOX, call-signal=SysSIG_RR_RR_MicState_call_Cis_ICC_8155_Android_TBOX_SystemInfo, client-server-operation=AM_CompositionType1.AM_CompositionPrototype67.TBOX_SystemInfo_Provider.ServerPort_TBOX_SystemInfo.RROper_RR_MicState, return-signal=SysSIG_RR_RR_MicState_return_Cis_ICC_8155_Android_TBOX_SystemInfo}
        client-server-to-signal-mapping={service-instance=CSI_TBOX_SystemInfo_VLAN62_ICC_8155_Android, call-signal=SysSIG_RR_RR_MicState_call_Cis_ICC_8155_Android_TBOX_SystemInfo, client-server-operation=AM_CompositionType1.AM_CompositionPrototype67.TBOX_SystemInfoConsumer_ICC_8155_Android.ClientPort_TBOX_SystemInfo.RROper_RR_MicState, return-signal=SysSIG_RR_RR_MicState_return_Cis_ICC_8155_Android_TBOX_SystemInfo}
        client-server-to-signal-mapping={service-instance=PSI_TBOX_SystemInfo_1_VLAN62_TBOX, call-signal=SysSIG_RR_RR_ECUVersion_call_Cis_ICC_8155_Android_TBOX_SystemInfo, client-server-operation=AM_CompositionType1.AM_CompositionPrototype67.TBOX_SystemInfo_Provider.ServerPort_TBOX_SystemInfo.RROper_RR_ECUVersion, return-signal=SysSIG_RR_RR_ECUVersion_return_Cis_ICC_8155_Android_TBOX_SystemInfo}
        client-server-to-signal-mapping={service-instance=CSI_TBOX_SystemInfo_VLAN62_ICC_8155_Android, call-signal=SysSIG_RR_RR_ECUVersion_call_Cis_ICC_8155_Android_TBOX_SystemInfo, client-server-operation=AM_CompositionType1.AM_CompositionPrototype67.TBOX_SystemInfoConsumer_ICC_8155_Android.ClientPort_TBOX_SystemInfo.RROper_RR_ECUVersion, return-signal=SysSIG_RR_RR_ECUVersion_return_Cis_ICC_8155_Android_TBOX_SystemInfo}
        client-server-to-signal-mapping={service-instance=PSI_TBOX_SystemInfo_1_VLAN62_TBOX, call-signal=SysSIG_RR_RR_CanConfig_call_Cis_ICC_8155_Android_TBOX_SystemInfo, client-server-operation=AM_CompositionType1.AM_CompositionPrototype67.TBOX_SystemInfo_Provider.ServerPort_TBOX_SystemInfo.RROper_RR_CanConfig, return-signal=SysSIG_RR_RR_CanConfig_return_Cis_ICC_8155_Android_TBOX_SystemInfo}
        client-server-to-signal-mapping={service-instance=CSI_TBOX_SystemInfo_VLAN62_ICC_8155_Android, call-signal=SysSIG_RR_RR_CanConfig_call_Cis_ICC_8155_Android_TBOX_SystemInfo, client-server-operation=AM_CompositionType1.AM_CompositionPrototype67.TBOX_SystemInfoConsumer_ICC_8155_Android.ClientPort_TBOX_SystemInfo.RROper_RR_CanConfig, return-signal=SysSIG_RR_RR_CanConfig_return_Cis_ICC_8155_Android_TBOX_SystemInfo}
        client-server-to-signal-mapping={service-instance=PSI_TBOX_SystemInfo_1_VLAN62_TBOX, call-signal=SysSIG_RR_RR_KL15State_call_Cis_ICC_8155_Android_TBOX_SystemInfo, client-server-operation=AM_CompositionType1.AM_CompositionPrototype67.TBOX_SystemInfo_Provider.ServerPort_TBOX_SystemInfo.RROper_RR_KL15State, return-signal=SysSIG_RR_RR_KL15State_return_Cis_ICC_8155_Android_TBOX_SystemInfo}
        client-server-to-signal-mapping={service-instance=CSI_TBOX_SystemInfo_VLAN62_ICC_8155_Android, call-signal=SysSIG_RR_RR_KL15State_call_Cis_ICC_8155_Android_TBOX_SystemInfo, client-server-operation=AM_CompositionType1.AM_CompositionPrototype67.TBOX_SystemInfoConsumer_ICC_8155_Android.ClientPort_TBOX_SystemInfo.RROper_RR_KL15State, return-signal=SysSIG_RR_RR_KL15State_return_Cis_ICC_8155_Android_TBOX_SystemInfo}
        client-server-to-signal-mapping={service-instance=PSI_TBOX_SystemInfo_1_VLAN62_TBOX, call-signal=SysSIG_RR_RR_SPKState_call_Cis_ICC_8155_Android_TBOX_SystemInfo, client-server-operation=AM_CompositionType1.AM_CompositionPrototype67.TBOX_SystemInfo_Provider.ServerPort_TBOX_SystemInfo.RROper_RR_SPKState, return-signal=SysSIG_RR_RR_SPKState_return_Cis_ICC_8155_Android_TBOX_SystemInfo}
        client-server-to-signal-mapping={service-instance=CSI_TBOX_SystemInfo_VLAN62_ICC_8155_Android, call-signal=SysSIG_RR_RR_SPKState_call_Cis_ICC_8155_Android_TBOX_SystemInfo, client-server-operation=AM_CompositionType1.AM_CompositionPrototype67.TBOX_SystemInfoConsumer_ICC_8155_Android.ClientPort_TBOX_SystemInfo.RROper_RR_SPKState, return-signal=SysSIG_RR_RR_SPKState_return_Cis_ICC_8155_Android_TBOX_SystemInfo}
        client-server-to-signal-mapping={service-instance=PSI_TBOX_SystemInfo_1_VLAN62_TBOX, call-signal=SysSIG_RR_RR_AntState_call_Cis_ICC_8155_Android_TBOX_SystemInfo, client-server-operation=AM_CompositionType1.AM_CompositionPrototype67.TBOX_SystemInfo_Provider.ServerPort_TBOX_SystemInfo.RROper_RR_AntState, return-signal=SysSIG_RR_RR_AntState_return_Cis_ICC_8155_Android_TBOX_SystemInfo}
        client-server-to-signal-mapping={service-instance=CSI_TBOX_SystemInfo_VLAN62_ICC_8155_Android, call-signal=SysSIG_RR_RR_AntState_call_Cis_ICC_8155_Android_TBOX_SystemInfo, client-server-operation=AM_CompositionType1.AM_CompositionPrototype67.TBOX_SystemInfoConsumer_ICC_8155_Android.ClientPort_TBOX_SystemInfo.RROper_RR_AntState, return-signal=SysSIG_RR_RR_AntState_return_Cis_ICC_8155_Android_TBOX_SystemInfo}
        sender-receiver-to-signal-mapping={service-instance=PSI_TBOX_BEICALL_1_VLAN62_TBOX, data-element=AM_CompositionPrototype67.TBOX_BEICALL_Provider.AM_CompositionType1.TBOX_BEICALL_Event_UploadBEICALLSts_SndP.DataElement_Event_UploadBEICALLSts, system-signal=SysSIG_Event_Event_UploadBEICALLSts_TBOX_BEICALL}
        sender-receiver-to-signal-mapping={service-instance=CSI_TBOX_BEICALL_VLAN62_ICC_8155_Android, data-element=AM_CompositionPrototype67.TBOX_BEICALLConsumer_ICC_8155_Android.AM_CompositionType1.TBOX_BEICALL_Event_UploadBEICALLSts_RcvP.DataElement_Event_UploadBEICALLSts, system-signal=SysSIG_Event_Event_UploadBEICALLSts_TBOX_BEICALL}
        sender-receiver-to-signal-mapping={service-instance=PSI_TBOX_BEICALL_1_VLAN62_TBOX, data-element=AM_CompositionPrototype67.TBOX_BEICALL_Provider.AM_CompositionType1.TBOX_BEICALL_notifyEcallMdoe_SndP.DataElement_notifyEcallMdoe, system-signal=SysSIG_Event_notifyEcallMdoe_TBOX_BEICALL}
        sender-receiver-to-signal-mapping={service-instance=CSI_TBOX_BEICALL_VLAN62_ICC_8155_Android, data-element=AM_CompositionPrototype67.TBOX_BEICALLConsumer_ICC_8155_Android.AM_CompositionType1.TBOX_BEICALL_notifyEcallMdoe_RcvP.DataElement_notifyEcallMdoe, system-signal=SysSIG_Event_notifyEcallMdoe_TBOX_BEICALL}
        client-server-to-signal-mapping={service-instance=PSI_TBOX_BEICALL_1_VLAN62_TBOX, call-signal=SysSIG_RR_RR_BEICALL_call_Cis_ICC_8155_Android_TBOX_BEICALL, client-server-operation=AM_CompositionType1.AM_CompositionPrototype67.TBOX_BEICALL_Provider.ServerPort_TBOX_BEICALL.RROper_RR_BEICALL, return-signal=SysSIG_RR_RR_BEICALL_return_Cis_ICC_8155_Android_TBOX_BEICALL}
        client-server-to-signal-mapping={service-instance=CSI_TBOX_BEICALL_VLAN62_ICC_8155_Android, call-signal=SysSIG_RR_RR_BEICALL_call_Cis_ICC_8155_Android_TBOX_BEICALL, client-server-operation=AM_CompositionType1.AM_CompositionPrototype67.TBOX_BEICALLConsumer_ICC_8155_Android.ClientPort_TBOX_BEICALL.RROper_RR_BEICALL, return-signal=SysSIG_RR_RR_BEICALL_return_Cis_ICC_8155_Android_TBOX_BEICALL}
        sender-receiver-to-signal-mapping={service-instance=PSI_TBOX_USBUpdate_1_VLAN62_TBOX, data-element=AM_CompositionPrototype67.TBOX_USBUpdate_Provider.AM_CompositionType1.TBOX_USBUpdate_Event_UsbUpdateSta_SndP.DataElement_Event_UsbUpdateSta, system-signal=SysSIG_Event_Event_UsbUpdateSta_TBOX_USBUpdate}
        sender-receiver-to-signal-mapping={service-instance=CSI_TBOX_USBUpdate_VLAN62_ICC_8155_Android, data-element=AM_CompositionPrototype67.TBOX_USBUpdateConsumer_ICC_8155_Android.AM_CompositionType1.TBOX_USBUpdate_Event_UsbUpdateSta_RcvP.DataElement_Event_UsbUpdateSta, system-signal=SysSIG_Event_Event_UsbUpdateSta_TBOX_USBUpdate}
        client-server-to-signal-mapping={service-instance=PSI_TBOX_USBUpdate_1_VLAN62_TBOX, call-signal=SysSIG_RR_RR_UpdatePrepare_call_Cis_ICC_8155_Android_TBOX_USBUpdate, client-server-operation=AM_CompositionType1.AM_CompositionPrototype67.TBOX_USBUpdate_Provider.ServerPort_TBOX_USBUpdate.RROper_RR_UpdatePrepare, return-signal=SysSIG_RR_RR_UpdatePrepare_return_Cis_ICC_8155_Android_TBOX_USBUpdate}
        client-server-to-signal-mapping={service-instance=CSI_TBOX_USBUpdate_VLAN62_ICC_8155_Android, call-signal=SysSIG_RR_RR_UpdatePrepare_call_Cis_ICC_8155_Android_TBOX_USBUpdate, client-server-operation=AM_CompositionType1.AM_CompositionPrototype67.TBOX_USBUpdateConsumer_ICC_8155_Android.ClientPort_TBOX_USBUpdate.RROper_RR_UpdatePrepare, return-signal=SysSIG_RR_RR_UpdatePrepare_return_Cis_ICC_8155_Android_TBOX_USBUpdate}
        client-server-to-signal-mapping={service-instance=PSI_TBOX_USBUpdate_1_VLAN62_TBOX, call-signal=SysSIG_RR_RR_UpdateFTPSts_call_Cis_ICC_8155_Android_TBOX_USBUpdate, client-server-operation=AM_CompositionType1.AM_CompositionPrototype67.TBOX_USBUpdate_Provider.ServerPort_TBOX_USBUpdate.RROper_RR_UpdateFTPSts, return-signal=SysSIG_RR_RR_UpdateFTPSts_return_Cis_ICC_8155_Android_TBOX_USBUpdate}
        client-server-to-signal-mapping={service-instance=CSI_TBOX_USBUpdate_VLAN62_ICC_8155_Android, call-signal=SysSIG_RR_RR_UpdateFTPSts_call_Cis_ICC_8155_Android_TBOX_USBUpdate, client-server-operation=AM_CompositionType1.AM_CompositionPrototype67.TBOX_USBUpdateConsumer_ICC_8155_Android.ClientPort_TBOX_USBUpdate.RROper_RR_UpdateFTPSts, return-signal=SysSIG_RR_RR_UpdateFTPSts_return_Cis_ICC_8155_Android_TBOX_USBUpdate}
        client-server-to-signal-mapping={service-instance=PSI_TBOX_USBUpdate_1_VLAN62_TBOX, call-signal=SysSIG_RR_RR_UsbUpdateStart_call_Cis_ICC_8155_Android_TBOX_USBUpdate, client-server-operation=AM_CompositionType1.AM_CompositionPrototype67.TBOX_USBUpdate_Provider.ServerPort_TBOX_USBUpdate.RROper_RR_UsbUpdateStart, return-signal=SysSIG_RR_RR_UsbUpdateStart_return_Cis_ICC_8155_Android_TBOX_USBUpdate}
        client-server-to-signal-mapping={service-instance=CSI_TBOX_USBUpdate_VLAN62_ICC_8155_Android, call-signal=SysSIG_RR_RR_UsbUpdateStart_call_Cis_ICC_8155_Android_TBOX_USBUpdate, client-server-operation=AM_CompositionType1.AM_CompositionPrototype67.TBOX_USBUpdateConsumer_ICC_8155_Android.ClientPort_TBOX_USBUpdate.RROper_RR_UsbUpdateStart, return-signal=SysSIG_RR_RR_UsbUpdateStart_return_Cis_ICC_8155_Android_TBOX_USBUpdate}
        sender-receiver-to-signal-mapping={service-instance=PSI_TBOX_USBUpdate_1_VLAN62_TBOX, data-element=AM_CompositionPrototype67.TBOX_USBUpdate_Provider.AM_CompositionType1.TBOX_USBUpdate_FF_UpdateCompleted_RcvP.DataElement_FF_UpdateCompleted, system-signal=SysSIG_FF_FF_UpdateCompleted_Cis_ICC_8155_Android_TBOX_USBUpdate}
        sender-receiver-to-signal-mapping={service-instance=CSI_TBOX_USBUpdate_VLAN62_ICC_8155_Android, data-element=AM_CompositionPrototype67.TBOX_USBUpdateConsumer_ICC_8155_Android.AM_CompositionType1.TBOX_USBUpdate_FF_UpdateCompleted_SndP.DataElement_FF_UpdateCompleted, system-signal=SysSIG_FF_FF_UpdateCompleted_Cis_ICC_8155_Android_TBOX_USBUpdate}
        client-server-to-signal-mapping={service-instance=PSI_TBOX_USBTBOXlog_1_VLAN62_TBOX, call-signal=SysSIG_RR_RR_logPrepare_call_Cis_ICC_8155_Android_TBOX_USBTBOXlog, client-server-operation=AM_CompositionType1.AM_CompositionPrototype67.TBOX_USBTBOXlog_Provider.ServerPort_TBOX_USBTBOXlog.RROper_RR_logPrepare, return-signal=SysSIG_RR_RR_logPrepare_return_Cis_ICC_8155_Android_TBOX_USBTBOXlog}
        client-server-to-signal-mapping={service-instance=CSI_TBOX_USBTBOXlog_VLAN62_ICC_8155_Android, call-signal=SysSIG_RR_RR_logPrepare_call_Cis_ICC_8155_Android_TBOX_USBTBOXlog, client-server-operation=AM_CompositionType1.AM_CompositionPrototype67.TBOX_USBTBOXlogConsumer_ICC_8155_Android.ClientPort_TBOX_USBTBOXlog.RROper_RR_logPrepare, return-signal=SysSIG_RR_RR_logPrepare_return_Cis_ICC_8155_Android_TBOX_USBTBOXlog}
        client-server-to-signal-mapping={service-instance=PSI_TBOX_USBTBOXlog_1_VLAN62_TBOX, call-signal=SysSIG_RR_RR_LogFTPSts_call_Cis_ICC_8155_Android_TBOX_USBTBOXlog, client-server-operation=AM_CompositionType1.AM_CompositionPrototype67.TBOX_USBTBOXlog_Provider.ServerPort_TBOX_USBTBOXlog.RROper_RR_LogFTPSts, return-signal=SysSIG_RR_RR_LogFTPSts_return_Cis_ICC_8155_Android_TBOX_USBTBOXlog}
        client-server-to-signal-mapping={service-instance=CSI_TBOX_USBTBOXlog_VLAN62_ICC_8155_Android, call-signal=SysSIG_RR_RR_LogFTPSts_call_Cis_ICC_8155_Android_TBOX_USBTBOXlog, client-server-operation=AM_CompositionType1.AM_CompositionPrototype67.TBOX_USBTBOXlogConsumer_ICC_8155_Android.ClientPort_TBOX_USBTBOXlog.RROper_RR_LogFTPSts, return-signal=SysSIG_RR_RR_LogFTPSts_return_Cis_ICC_8155_Android_TBOX_USBTBOXlog}
        sender-receiver-to-signal-mapping={service-instance=[AEP_VLAN62_TBOX_UDP_30500/PSI_TBOX_GNSSInfo_1_VLAN62_TBOX, AEP_VLAN62_TBOX_TCP_30500/PSI_TBOX_GNSSInfo_1_VLAN62_TBOX], data-element=AM_CompositionPrototype67.TBOX_GNSSInfo_Provider.AM_CompositionType1.TBOX_GNSSInfo_Event_GNSSInfo1_SndP.DataElement_Event_GNSSInfo1, system-signal=SysSIG_Event_Event_GNSSInfo1_TBOX_GNSSInfo}
        sender-receiver-to-signal-mapping={service-instance=[AEP_VLAN62_ICC_8155_Android_UDP_30501/CSI_TBOX_GNSSInfo_VLAN62_ICC_8155_Android, AEP_VLAN62_ICC_8155_Android_TCP_30501/CSI_TBOX_GNSSInfo_VLAN62_ICC_8155_Android], data-element=AM_CompositionPrototype67.TBOX_GNSSInfoConsumer_ICC_8155_Android.AM_CompositionType1.TBOX_GNSSInfo_Event_GNSSInfo1_RcvP.DataElement_Event_GNSSInfo1, system-signal=SysSIG_Event_Event_GNSSInfo1_TBOX_GNSSInfo}
        client-server-to-signal-mapping={service-instance=[AEP_VLAN62_TBOX_UDP_30500/PSI_TBOX_GNSSInfo_1_VLAN62_TBOX, AEP_VLAN62_TBOX_TCP_30500/PSI_TBOX_GNSSInfo_1_VLAN62_TBOX], call-signal=SysSIG_RR_RR_DMCGNSSType_call_Cis_ICC_8155_Android_TBOX_GNSSInfo, client-server-operation=AM_CompositionType1.AM_CompositionPrototype67.TBOX_GNSSInfo_Provider.ServerPort_TBOX_GNSSInfo.RROper_RR_DMCGNSSType, return-signal=SysSIG_RR_RR_DMCGNSSType_return_Cis_ICC_8155_Android_TBOX_GNSSInfo}
        client-server-to-signal-mapping={service-instance=[AEP_VLAN62_ICC_8155_Android_UDP_30501/CSI_TBOX_GNSSInfo_VLAN62_ICC_8155_Android, AEP_VLAN62_ICC_8155_Android_TCP_30501/CSI_TBOX_GNSSInfo_VLAN62_ICC_8155_Android], call-signal=SysSIG_RR_RR_DMCGNSSType_call_Cis_ICC_8155_Android_TBOX_GNSSInfo, client-server-operation=AM_CompositionType1.AM_CompositionPrototype67.TBOX_GNSSInfoConsumer_ICC_8155_Android.ClientPort_TBOX_GNSSInfo.RROper_RR_DMCGNSSType, return-signal=SysSIG_RR_RR_DMCGNSSType_return_Cis_ICC_8155_Android_TBOX_GNSSInfo}
        sender-receiver-to-signal-mapping={service-instance=[AEP_VLAN62_TBOX_UDP_30500/PSI_TBOX_GNSSInfo_1_VLAN62_TBOX, AEP_VLAN62_TBOX_TCP_30500/PSI_TBOX_GNSSInfo_1_VLAN62_TBOX], data-element=AM_CompositionPrototype67.TBOX_GNSSInfo_Provider.AM_CompositionType1.TBOX_GNSSInfo_Event_GNSSInfo1_SndP.DataElement_Event_GNSSInfo1, system-signal=SysSIG_Event_Event_GNSSInfo1_TBOX_GNSSInfo_1}
        sender-receiver-to-signal-mapping={service-instance=[AEP_VLAN62_ADCC_UDP_30501/CSI_TBOX_GNSSInfo_VLAN62_ADCC, AEP_VLAN62_ADCC_TCP_30501/CSI_TBOX_GNSSInfo_VLAN62_ADCC], data-element=AM_CompositionPrototype67.TBOX_GNSSInfoConsumer_ADCC.AM_CompositionType1.TBOX_GNSSInfo_Event_GNSSInfo1_RcvP.DataElement_Event_GNSSInfo1, system-signal=SysSIG_Event_Event_GNSSInfo1_TBOX_GNSSInfo_1}
        client-server-to-signal-mapping={service-instance=[AEP_VLAN62_TBOX_UDP_30500/PSI_TBOX_GNSSInfo_1_VLAN62_TBOX, AEP_VLAN62_TBOX_TCP_30500/PSI_TBOX_GNSSInfo_1_VLAN62_TBOX], call-signal=SysSIG_RR_RR_DMCGNSSType_call_Cis_ADCC_TBOX_GNSSInfo, client-server-operation=AM_CompositionType1.AM_CompositionPrototype67.TBOX_GNSSInfo_Provider.ServerPort_TBOX_GNSSInfo.RROper_RR_DMCGNSSType, return-signal=SysSIG_RR_RR_DMCGNSSType_return_Cis_ADCC_TBOX_GNSSInfo}
        client-server-to-signal-mapping={service-instance=[AEP_VLAN62_ADCC_UDP_30501/CSI_TBOX_GNSSInfo_VLAN62_ADCC, AEP_VLAN62_ADCC_TCP_30501/CSI_TBOX_GNSSInfo_VLAN62_ADCC], call-signal=SysSIG_RR_RR_DMCGNSSType_call_Cis_ADCC_TBOX_GNSSInfo, client-server-operation=AM_CompositionType1.AM_CompositionPrototype67.TBOX_GNSSInfoConsumer_ADCC.ClientPort_TBOX_GNSSInfo.RROper_RR_DMCGNSSType, return-signal=SysSIG_RR_RR_DMCGNSSType_return_Cis_ADCC_TBOX_GNSSInfo}
        sender-receiver-to-signal-mapping={service-instance=PSI_ICC_Android_OutService_1_VLAN62_ICC_8155_Android, data-element=AM_CompositionPrototype67.ICC_Android_OutService_Provider.AM_CompositionType1.ICC_Android_OutService_notifyEcallMdoeFed_SndP.DataElement_notifyEcallMdoeFed, system-signal=SysSIG_Event_notifyEcallMdoeFed_ICC_Android_OutService}
        sender-receiver-to-signal-mapping={service-instance=CSI_ICC_Android_OutService_VLAN62_TBOX, data-element=AM_CompositionPrototype67.ICC_Android_OutServiceConsumer_TBOX.AM_CompositionType1.ICC_Android_OutService_notifyEcallMdoeFed_RcvP.DataElement_notifyEcallMdoeFed, system-signal=SysSIG_Event_notifyEcallMdoeFed_ICC_Android_OutService}
        sender-receiver-to-signal-mapping={service-instance=[AEP_VLAN62_ICC_8155_Android_UDP_30500/PSI_ICC_Aom_1_VLAN62_ICC_8155_Android, AEP_VLAN62_ICC_8155_Android_TCP_30500/PSI_ICC_Aom_1_VLAN62_ICC_8155_Android], data-element=AM_CompositionPrototype67.ICC_Aom_Provider.AM_CompositionType1.ICC_Aom_notifyADCC_Command_SndP.DataElement_notifyADCC_Command, system-signal=SysSIG_Event_notifyADCC_Command_ICC_Aom}
        sender-receiver-to-signal-mapping={service-instance=[AEP_VLAN62_ADCC_UDP_30501/CSI_ICC_Aom_VLAN62_ADCC, AEP_VLAN62_ADCC_TCP_30501/CSI_ICC_Aom_VLAN62_ADCC], data-element=AM_CompositionPrototype67.ICC_AomConsumer_ADCC.AM_CompositionType1.ICC_Aom_notifyADCC_Command_RcvP.DataElement_notifyADCC_Command, system-signal=SysSIG_Event_notifyADCC_Command_ICC_Aom}
        client-server-to-signal-mapping={service-instance=[AEP_VLAN62_ICC_8155_Android_UDP_30500/PSI_ICC_Aom_1_VLAN62_ICC_8155_Android, AEP_VLAN62_ICC_8155_Android_TCP_30500/PSI_ICC_Aom_1_VLAN62_ICC_8155_Android], call-signal=SysSIG_RR_GetRenderDBInfo_call_Cis_ADCC_ICC_Aom, client-server-operation=AM_CompositionType1.AM_CompositionPrototype67.ICC_Aom_Provider.ServerPort_ICC_Aom.RROper_GetRenderDBInfo, return-signal=SysSIG_RR_GetRenderDBInfo_return_Cis_ADCC_ICC_Aom}
        client-server-to-signal-mapping={service-instance=[AEP_VLAN62_ADCC_UDP_30501/CSI_ICC_Aom_VLAN62_ADCC, AEP_VLAN62_ADCC_TCP_30501/CSI_ICC_Aom_VLAN62_ADCC], call-signal=SysSIG_RR_GetRenderDBInfo_call_Cis_ADCC_ICC_Aom, client-server-operation=AM_CompositionType1.AM_CompositionPrototype67.ICC_AomConsumer_ADCC.ClientPort_ICC_Aom.RROper_GetRenderDBInfo, return-signal=SysSIG_RR_GetRenderDBInfo_return_Cis_ADCC_ICC_Aom}
        sender-receiver-to-signal-mapping={service-instance=PSI_ICC_SDmapInfo_1_VLAN62_ICC_8155_Android, data-element=AM_CompositionPrototype67.ICC_SDmapInfo_Provider.AM_CompositionType1.ICC_SDmapInfo_NtfSDmapInfo_SndP.DataElement_NtfSDmapInfo, system-signal=SysSIG_Event_NtfSDmapInfo_ICC_SDmapInfo}
        sender-receiver-to-signal-mapping={service-instance=CSI_ICC_SDmapInfo_VLAN62_ADCC, data-element=AM_CompositionPrototype67.ICC_SDmapInfoConsumer_ADCC.AM_CompositionType1.ICC_SDmapInfo_NtfSDmapInfo_RcvP.DataElement_NtfSDmapInfo, system-signal=SysSIG_Event_NtfSDmapInfo_ICC_SDmapInfo}
        sender-receiver-to-signal-mapping={service-instance=PSI_ICC_SDmapInfo_1_VLAN62_ICC_8155_Android, data-element=AM_CompositionPrototype67.ICC_SDmapInfo_Provider.AM_CompositionType1.ICC_SDmapInfo_notifyNOA_SDMapPosInfo_SndP.DataElement_notifyNOA_SDMapPosInfo, system-signal=SysSIG_Event_notifyNOA_SDMapPosInfo_ICC_SDmapInfo}
        sender-receiver-to-signal-mapping={service-instance=CSI_ICC_SDmapInfo_VLAN62_ADCC, data-element=AM_CompositionPrototype67.ICC_SDmapInfoConsumer_ADCC.AM_CompositionType1.ICC_SDmapInfo_notifyNOA_SDMapPosInfo_RcvP.DataElement_notifyNOA_SDMapPosInfo, system-signal=SysSIG_Event_notifyNOA_SDMapPosInfo_ICC_SDmapInfo}
        sender-receiver-to-signal-mapping={service-instance=PSI_ICC_SDmapInfo_1_VLAN62_ICC_8155_Android, data-element=AM_CompositionPrototype67.ICC_SDmapInfo_Provider.AM_CompositionType1.ICC_SDmapInfo_notifyNOA_SDMapStubInfo_SndP.DataElement_notifyNOA_SDMapStubInfo, system-signal=SysSIG_Event_notifyNOA_SDMapStubInfo_ICC_SDmapInfo}
        sender-receiver-to-signal-mapping={service-instance=CSI_ICC_SDmapInfo_VLAN62_ADCC, data-element=AM_CompositionPrototype67.ICC_SDmapInfoConsumer_ADCC.AM_CompositionType1.ICC_SDmapInfo_notifyNOA_SDMapStubInfo_RcvP.DataElement_notifyNOA_SDMapStubInfo, system-signal=SysSIG_Event_notifyNOA_SDMapStubInfo_ICC_SDmapInfo}
        sender-receiver-to-signal-mapping={service-instance=PSI_ICC_SDmapInfo_1_VLAN62_ICC_8155_Android, data-element=AM_CompositionPrototype67.ICC_SDmapInfo_Provider.AM_CompositionType1.ICC_SDmapInfo_notifyNOA_SDMapSegmentInfo_SndP.DataElement_notifyNOA_SDMapSegmentInfo, system-signal=SysSIG_Event_notifyNOA_SDMapSegmentInfo_ICC_SDmapInfo}
        sender-receiver-to-signal-mapping={service-instance=CSI_ICC_SDmapInfo_VLAN62_ADCC, data-element=AM_CompositionPrototype67.ICC_SDmapInfoConsumer_ADCC.AM_CompositionType1.ICC_SDmapInfo_notifyNOA_SDMapSegmentInfo_RcvP.DataElement_notifyNOA_SDMapSegmentInfo, system-signal=SysSIG_Event_notifyNOA_SDMapSegmentInfo_ICC_SDmapInfo}
        sender-receiver-to-signal-mapping={service-instance=PSI_ICC_SDmapInfo_1_VLAN62_ICC_8155_Android, data-element=AM_CompositionPrototype67.ICC_SDmapInfo_Provider.AM_CompositionType1.ICC_SDmapInfo_notifyNOA_SDMapShortInfo_SndP.DataElement_notifyNOA_SDMapShortInfo, system-signal=SysSIG_Event_notifyNOA_SDMapShortInfo_ICC_SDmapInfo}
        sender-receiver-to-signal-mapping={service-instance=CSI_ICC_SDmapInfo_VLAN62_ADCC, data-element=AM_CompositionPrototype67.ICC_SDmapInfoConsumer_ADCC.AM_CompositionType1.ICC_SDmapInfo_notifyNOA_SDMapShortInfo_RcvP.DataElement_notifyNOA_SDMapShortInfo, system-signal=SysSIG_Event_notifyNOA_SDMapShortInfo_ICC_SDmapInfo}
        sender-receiver-to-signal-mapping={service-instance=PSI_ICC_SDmapInfo_1_VLAN62_ICC_8155_Android, data-element=AM_CompositionPrototype67.ICC_SDmapInfo_Provider.AM_CompositionType1.ICC_SDmapInfo_notifyNOA_SDMapLongInfo_SndP.DataElement_notifyNOA_SDMapLongInfo, system-signal=SysSIG_Event_notifyNOA_SDMapLongInfo_ICC_SDmapInfo}
        sender-receiver-to-signal-mapping={service-instance=CSI_ICC_SDmapInfo_VLAN62_ADCC, data-element=AM_CompositionPrototype67.ICC_SDmapInfoConsumer_ADCC.AM_CompositionType1.ICC_SDmapInfo_notifyNOA_SDMapLongInfo_RcvP.DataElement_notifyNOA_SDMapLongInfo, system-signal=SysSIG_Event_notifyNOA_SDMapLongInfo_ICC_SDmapInfo}
        sender-receiver-to-signal-mapping={service-instance=PSI_ICC_SDmapInfo_1_VLAN62_ICC_8155_Android, data-element=AM_CompositionPrototype67.ICC_SDmapInfo_Provider.AM_CompositionType1.ICC_SDmapInfo_notifyNOA_SDMapMetaInfo_SndP.DataElement_notifyNOA_SDMapMetaInfo, system-signal=SysSIG_Event_notifyNOA_SDMapMetaInfo_ICC_SDmapInfo}
        sender-receiver-to-signal-mapping={service-instance=CSI_ICC_SDmapInfo_VLAN62_ADCC, data-element=AM_CompositionPrototype67.ICC_SDmapInfoConsumer_ADCC.AM_CompositionType1.ICC_SDmapInfo_notifyNOA_SDMapMetaInfo_RcvP.DataElement_notifyNOA_SDMapMetaInfo, system-signal=SysSIG_Event_notifyNOA_SDMapMetaInfo_ICC_SDmapInfo}
        sender-receiver-to-signal-mapping={service-instance=PSI_ICC_SDmapInfo_1_VLAN62_ICC_8155_Android, data-element=AM_CompositionPrototype67.ICC_SDmapInfo_Provider.AM_CompositionType1.ICC_SDmapInfo_NtfSDmapInfo_international_SndP.DataElement_NtfSDmapInfo_international, system-signal=SysSIG_Event_NtfSDmapInfo_international_ICC_SDmapInfo}
        sender-receiver-to-signal-mapping={service-instance=CSI_ICC_SDmapInfo_VLAN62_ADCC, data-element=AM_CompositionPrototype67.ICC_SDmapInfoConsumer_ADCC.AM_CompositionType1.ICC_SDmapInfo_NtfSDmapInfo_international_RcvP.DataElement_NtfSDmapInfo_international, system-signal=SysSIG_Event_NtfSDmapInfo_international_ICC_SDmapInfo}
        sender-receiver-to-signal-mapping={service-instance=PSI_ICC_SDmapInfo_1_VLAN62_ICC_8155_Android, data-element=AM_CompositionPrototype67.ICC_SDmapInfo_Provider.AM_CompositionType1.ICC_SDmapInfo_NtfSDmapLaneInfo_SndP.DataElement_NtfSDmapLaneInfo, system-signal=SysSIG_Event_NtfSDmapLaneInfo_ICC_SDmapInfo}
        sender-receiver-to-signal-mapping={service-instance=CSI_ICC_SDmapInfo_VLAN62_ADCC, data-element=AM_CompositionPrototype67.ICC_SDmapInfoConsumer_ADCC.AM_CompositionType1.ICC_SDmapInfo_NtfSDmapLaneInfo_RcvP.DataElement_NtfSDmapLaneInfo, system-signal=SysSIG_Event_NtfSDmapLaneInfo_ICC_SDmapInfo}
        sender-receiver-to-signal-mapping={service-instance=PSI_ICC_SDmapInfo_1_VLAN62_ICC_8155_Android, data-element=AM_CompositionPrototype67.ICC_SDmapInfo_Provider.AM_CompositionType1.ICC_SDmapInfo_NtfSDmapInfo_SndP.DataElement_NtfSDmapInfo, system-signal=SysSIG_Event_NtfSDmapInfo_ICC_SDmapInfo_1}
        sender-receiver-to-signal-mapping={service-instance=CSI_ICC_SDmapInfo_VLAN62_FCM, data-element=AM_CompositionPrototype67.ICC_SDmapInfoConsumer_FCM.AM_CompositionType1.ICC_SDmapInfo_NtfSDmapInfo_RcvP.DataElement_NtfSDmapInfo, system-signal=SysSIG_Event_NtfSDmapInfo_ICC_SDmapInfo_1}
        sender-receiver-to-signal-mapping={service-instance=PSI_ICC_SDmapInfo_1_VLAN62_ICC_8155_Android, data-element=AM_CompositionPrototype67.ICC_SDmapInfo_Provider.AM_CompositionType1.ICC_SDmapInfo_notifyNOA_SDMapPosInfo_SndP.DataElement_notifyNOA_SDMapPosInfo, system-signal=SysSIG_Event_notifyNOA_SDMapPosInfo_ICC_SDmapInfo_1}
        sender-receiver-to-signal-mapping={service-instance=CSI_ICC_SDmapInfo_VLAN62_FCM, data-element=AM_CompositionPrototype67.ICC_SDmapInfoConsumer_FCM.AM_CompositionType1.ICC_SDmapInfo_notifyNOA_SDMapPosInfo_RcvP.DataElement_notifyNOA_SDMapPosInfo, system-signal=SysSIG_Event_notifyNOA_SDMapPosInfo_ICC_SDmapInfo_1}
        sender-receiver-to-signal-mapping={service-instance=PSI_ICC_SDmapInfo_1_VLAN62_ICC_8155_Android, data-element=AM_CompositionPrototype67.ICC_SDmapInfo_Provider.AM_CompositionType1.ICC_SDmapInfo_notifyNOA_SDMapStubInfo_SndP.DataElement_notifyNOA_SDMapStubInfo, system-signal=SysSIG_Event_notifyNOA_SDMapStubInfo_ICC_SDmapInfo_1}
        sender-receiver-to-signal-mapping={service-instance=CSI_ICC_SDmapInfo_VLAN62_FCM, data-element=AM_CompositionPrototype67.ICC_SDmapInfoConsumer_FCM.AM_CompositionType1.ICC_SDmapInfo_notifyNOA_SDMapStubInfo_RcvP.DataElement_notifyNOA_SDMapStubInfo, system-signal=SysSIG_Event_notifyNOA_SDMapStubInfo_ICC_SDmapInfo_1}
        sender-receiver-to-signal-mapping={service-instance=PSI_ICC_SDmapInfo_1_VLAN62_ICC_8155_Android, data-element=AM_CompositionPrototype67.ICC_SDmapInfo_Provider.AM_CompositionType1.ICC_SDmapInfo_notifyNOA_SDMapSegmentInfo_SndP.DataElement_notifyNOA_SDMapSegmentInfo, system-signal=SysSIG_Event_notifyNOA_SDMapSegmentInfo_ICC_SDmapInfo_1}
        sender-receiver-to-signal-mapping={service-instance=CSI_ICC_SDmapInfo_VLAN62_FCM, data-element=AM_CompositionPrototype67.ICC_SDmapInfoConsumer_FCM.AM_CompositionType1.ICC_SDmapInfo_notifyNOA_SDMapSegmentInfo_RcvP.DataElement_notifyNOA_SDMapSegmentInfo, system-signal=SysSIG_Event_notifyNOA_SDMapSegmentInfo_ICC_SDmapInfo_1}
        sender-receiver-to-signal-mapping={service-instance=PSI_ICC_SDmapInfo_1_VLAN62_ICC_8155_Android, data-element=AM_CompositionPrototype67.ICC_SDmapInfo_Provider.AM_CompositionType1.ICC_SDmapInfo_notifyNOA_SDMapShortInfo_SndP.DataElement_notifyNOA_SDMapShortInfo, system-signal=SysSIG_Event_notifyNOA_SDMapShortInfo_ICC_SDmapInfo_1}
        sender-receiver-to-signal-mapping={service-instance=CSI_ICC_SDmapInfo_VLAN62_FCM, data-element=AM_CompositionPrototype67.ICC_SDmapInfoConsumer_FCM.AM_CompositionType1.ICC_SDmapInfo_notifyNOA_SDMapShortInfo_RcvP.DataElement_notifyNOA_SDMapShortInfo, system-signal=SysSIG_Event_notifyNOA_SDMapShortInfo_ICC_SDmapInfo_1}
        sender-receiver-to-signal-mapping={service-instance=PSI_ICC_SDmapInfo_1_VLAN62_ICC_8155_Android, data-element=AM_CompositionPrototype67.ICC_SDmapInfo_Provider.AM_CompositionType1.ICC_SDmapInfo_notifyNOA_SDMapLongInfo_SndP.DataElement_notifyNOA_SDMapLongInfo, system-signal=SysSIG_Event_notifyNOA_SDMapLongInfo_ICC_SDmapInfo_1}
        sender-receiver-to-signal-mapping={service-instance=CSI_ICC_SDmapInfo_VLAN62_FCM, data-element=AM_CompositionPrototype67.ICC_SDmapInfoConsumer_FCM.AM_CompositionType1.ICC_SDmapInfo_notifyNOA_SDMapLongInfo_RcvP.DataElement_notifyNOA_SDMapLongInfo, system-signal=SysSIG_Event_notifyNOA_SDMapLongInfo_ICC_SDmapInfo_1}
        sender-receiver-to-signal-mapping={service-instance=PSI_ICC_SDmapInfo_1_VLAN62_ICC_8155_Android, data-element=AM_CompositionPrototype67.ICC_SDmapInfo_Provider.AM_CompositionType1.ICC_SDmapInfo_notifyNOA_SDMapMetaInfo_SndP.DataElement_notifyNOA_SDMapMetaInfo, system-signal=SysSIG_Event_notifyNOA_SDMapMetaInfo_ICC_SDmapInfo_1}
        sender-receiver-to-signal-mapping={service-instance=CSI_ICC_SDmapInfo_VLAN62_FCM, data-element=AM_CompositionPrototype67.ICC_SDmapInfoConsumer_FCM.AM_CompositionType1.ICC_SDmapInfo_notifyNOA_SDMapMetaInfo_RcvP.DataElement_notifyNOA_SDMapMetaInfo, system-signal=SysSIG_Event_notifyNOA_SDMapMetaInfo_ICC_SDmapInfo_1}
        sender-receiver-to-signal-mapping={service-instance=PSI_ICC_SDmapInfo_1_VLAN62_ICC_8155_Android, data-element=AM_CompositionPrototype67.ICC_SDmapInfo_Provider.AM_CompositionType1.ICC_SDmapInfo_NtfSDmapInfo_international_SndP.DataElement_NtfSDmapInfo_international, system-signal=SysSIG_Event_NtfSDmapInfo_international_ICC_SDmapInfo_1}
        sender-receiver-to-signal-mapping={service-instance=CSI_ICC_SDmapInfo_VLAN62_FCM, data-element=AM_CompositionPrototype67.ICC_SDmapInfoConsumer_FCM.AM_CompositionType1.ICC_SDmapInfo_NtfSDmapInfo_international_RcvP.DataElement_NtfSDmapInfo_international, system-signal=SysSIG_Event_NtfSDmapInfo_international_ICC_SDmapInfo_1}
        sender-receiver-to-signal-mapping={service-instance=PSI_ICC_SDmapInfo_1_VLAN62_ICC_8155_Android, data-element=AM_CompositionPrototype67.ICC_SDmapInfo_Provider.AM_CompositionType1.ICC_SDmapInfo_NtfSDmapLaneInfo_SndP.DataElement_NtfSDmapLaneInfo, system-signal=SysSIG_Event_NtfSDmapLaneInfo_ICC_SDmapInfo_1}
        sender-receiver-to-signal-mapping={service-instance=CSI_ICC_SDmapInfo_VLAN62_FCM, data-element=AM_CompositionPrototype67.ICC_SDmapInfoConsumer_FCM.AM_CompositionType1.ICC_SDmapInfo_NtfSDmapLaneInfo_RcvP.DataElement_NtfSDmapLaneInfo, system-signal=SysSIG_Event_NtfSDmapLaneInfo_ICC_SDmapInfo_1}
        sender-receiver-to-signal-mapping={service-instance=[AEP_VLAN62_ICC_8155_Android_UDP_30500/PSI_ICC_SDmapInfo_2_1_VLAN62_ICC_8155_Android, AEP_VLAN62_ICC_8155_Android_TCP_30500/PSI_ICC_SDmapInfo_2_1_VLAN62_ICC_8155_Android], data-element=AM_CompositionPrototype67.ICC_SDmapInfo_2_Provider.AM_CompositionType1.ICC_SDmapInfo_2_NtfSDmapRouteInfo_SndP.DataElement_NtfSDmapRouteInfo, system-signal=SysSIG_Event_NtfSDmapRouteInfo_ICC_SDmapInfo_2}
        sender-receiver-to-signal-mapping={service-instance=[AEP_VLAN62_ADCC_UDP_30501/CSI_ICC_SDmapInfo_2_VLAN62_ADCC, AEP_VLAN62_ADCC_TCP_30501/CSI_ICC_SDmapInfo_2_VLAN62_ADCC], data-element=AM_CompositionPrototype67.ICC_SDmapInfo_2Consumer_ADCC.AM_CompositionType1.ICC_SDmapInfo_2_NtfSDmapRouteInfo_RcvP.DataElement_NtfSDmapRouteInfo, system-signal=SysSIG_Event_NtfSDmapRouteInfo_ICC_SDmapInfo_2}
        sender-receiver-to-signal-mapping={service-instance=[AEP_VLAN62_ICC_8155_Android_UDP_30500/PSI_ICC_SDmapInfo_2_1_VLAN62_ICC_8155_Android, AEP_VLAN62_ICC_8155_Android_TCP_30500/PSI_ICC_SDmapInfo_2_1_VLAN62_ICC_8155_Android], data-element=AM_CompositionPrototype67.ICC_SDmapInfo_2_Provider.AM_CompositionType1.ICC_SDmapInfo_2_NtfSDmapTBTNaviInfo_SndP.DataElement_NtfSDmapTBTNaviInfo, system-signal=SysSIG_Event_NtfSDmapTBTNaviInfo_ICC_SDmapInfo_2}
        sender-receiver-to-signal-mapping={service-instance=[AEP_VLAN62_ADCC_UDP_30501/CSI_ICC_SDmapInfo_2_VLAN62_ADCC, AEP_VLAN62_ADCC_TCP_30501/CSI_ICC_SDmapInfo_2_VLAN62_ADCC], data-element=AM_CompositionPrototype67.ICC_SDmapInfo_2Consumer_ADCC.AM_CompositionType1.ICC_SDmapInfo_2_NtfSDmapTBTNaviInfo_RcvP.DataElement_NtfSDmapTBTNaviInfo, system-signal=SysSIG_Event_NtfSDmapTBTNaviInfo_ICC_SDmapInfo_2}
        sender-receiver-to-signal-mapping={service-instance=[AEP_VLAN62_ICC_8155_Android_UDP_30500/PSI_ICC_SDmapInfo_2_1_VLAN62_ICC_8155_Android, AEP_VLAN62_ICC_8155_Android_TCP_30500/PSI_ICC_SDmapInfo_2_1_VLAN62_ICC_8155_Android], data-element=AM_CompositionPrototype67.ICC_SDmapInfo_2_Provider.AM_CompositionType1.ICC_SDmapInfo_2_NtfSDmapNaviCameraInfo_SndP.DataElement_NtfSDmapNaviCameraInfo, system-signal=SysSIG_Event_NtfSDmapNaviCameraInfo_ICC_SDmapInfo_2}
        sender-receiver-to-signal-mapping={service-instance=[AEP_VLAN62_ADCC_UDP_30501/CSI_ICC_SDmapInfo_2_VLAN62_ADCC, AEP_VLAN62_ADCC_TCP_30501/CSI_ICC_SDmapInfo_2_VLAN62_ADCC], data-element=AM_CompositionPrototype67.ICC_SDmapInfo_2Consumer_ADCC.AM_CompositionType1.ICC_SDmapInfo_2_NtfSDmapNaviCameraInfo_RcvP.DataElement_NtfSDmapNaviCameraInfo, system-signal=SysSIG_Event_NtfSDmapNaviCameraInfo_ICC_SDmapInfo_2}
        sender-receiver-to-signal-mapping={service-instance=[AEP_VLAN62_ICC_8155_Android_UDP_30500/PSI_ICC_SDmapInfo_2_1_VLAN62_ICC_8155_Android, AEP_VLAN62_ICC_8155_Android_TCP_30500/PSI_ICC_SDmapInfo_2_1_VLAN62_ICC_8155_Android], data-element=AM_CompositionPrototype67.ICC_SDmapInfo_2_Provider.AM_CompositionType1.ICC_SDmapInfo_2_NtfSDmapCruiseFacilityInfo_SndP.DataElement_NtfSDmapCruiseFacilityInfo, system-signal=SysSIG_Event_NtfSDmapCruiseFacilityInfo_ICC_SDmapInfo_2}
        sender-receiver-to-signal-mapping={service-instance=[AEP_VLAN62_ADCC_UDP_30501/CSI_ICC_SDmapInfo_2_VLAN62_ADCC, AEP_VLAN62_ADCC_TCP_30501/CSI_ICC_SDmapInfo_2_VLAN62_ADCC], data-element=AM_CompositionPrototype67.ICC_SDmapInfo_2Consumer_ADCC.AM_CompositionType1.ICC_SDmapInfo_2_NtfSDmapCruiseFacilityInfo_RcvP.DataElement_NtfSDmapCruiseFacilityInfo, system-signal=SysSIG_Event_NtfSDmapCruiseFacilityInfo_ICC_SDmapInfo_2}
        sender-receiver-to-signal-mapping={service-instance=[AEP_VLAN62_ICC_8155_Android_UDP_30500/PSI_ICC_SDmapInfo_2_1_VLAN62_ICC_8155_Android, AEP_VLAN62_ICC_8155_Android_TCP_30500/PSI_ICC_SDmapInfo_2_1_VLAN62_ICC_8155_Android], data-element=AM_CompositionPrototype67.ICC_SDmapInfo_2_Provider.AM_CompositionType1.ICC_SDmapInfo_2_NtfSDmapTrafficLightCDInfo_SndP.DataElement_NtfSDmapTrafficLightCDInfo, system-signal=SysSIG_Event_NtfSDmapTrafficLightCDInfo_ICC_SDmapInfo_2}
        sender-receiver-to-signal-mapping={service-instance=[AEP_VLAN62_ADCC_UDP_30501/CSI_ICC_SDmapInfo_2_VLAN62_ADCC, AEP_VLAN62_ADCC_TCP_30501/CSI_ICC_SDmapInfo_2_VLAN62_ADCC], data-element=AM_CompositionPrototype67.ICC_SDmapInfo_2Consumer_ADCC.AM_CompositionType1.ICC_SDmapInfo_2_NtfSDmapTrafficLightCDInfo_RcvP.DataElement_NtfSDmapTrafficLightCDInfo, system-signal=SysSIG_Event_NtfSDmapTrafficLightCDInfo_ICC_SDmapInfo_2}
        sender-receiver-to-signal-mapping={service-instance=[AEP_VLAN62_ICC_8155_Android_UDP_30500/PSI_ICC_SDmapInfo_2_1_VLAN62_ICC_8155_Android, AEP_VLAN62_ICC_8155_Android_TCP_30500/PSI_ICC_SDmapInfo_2_1_VLAN62_ICC_8155_Android], data-element=AM_CompositionPrototype67.ICC_SDmapInfo_2_Provider.AM_CompositionType1.ICC_SDmapInfo_2_NtfSDmapNaviIntCamDynInfo_SndP.DataElement_NtfSDmapNaviIntCamDynInfo, system-signal=SysSIG_Event_NtfSDmapNaviIntCamDynInfo_ICC_SDmapInfo_2}
        sender-receiver-to-signal-mapping={service-instance=[AEP_VLAN62_ADCC_UDP_30501/CSI_ICC_SDmapInfo_2_VLAN62_ADCC, AEP_VLAN62_ADCC_TCP_30501/CSI_ICC_SDmapInfo_2_VLAN62_ADCC], data-element=AM_CompositionPrototype67.ICC_SDmapInfo_2Consumer_ADCC.AM_CompositionType1.ICC_SDmapInfo_2_NtfSDmapNaviIntCamDynInfo_RcvP.DataElement_NtfSDmapNaviIntCamDynInfo, system-signal=SysSIG_Event_NtfSDmapNaviIntCamDynInfo_ICC_SDmapInfo_2}
        sender-receiver-to-signal-mapping={service-instance=[AEP_VLAN62_ICC_8155_Android_UDP_30500/PSI_ICC_SDmapInfo_2_1_VLAN62_ICC_8155_Android, AEP_VLAN62_ICC_8155_Android_TCP_30500/PSI_ICC_SDmapInfo_2_1_VLAN62_ICC_8155_Android], data-element=AM_CompositionPrototype67.ICC_SDmapInfo_2_Provider.AM_CompositionType1.ICC_SDmapInfo_2_NtfSDmapNaviWeatherInfo_SndP.DataElement_NtfSDmapNaviWeatherInfo, system-signal=SysSIG_Event_NtfSDmapNaviWeatherInfo_ICC_SDmapInfo_2}
        sender-receiver-to-signal-mapping={service-instance=[AEP_VLAN62_ADCC_UDP_30501/CSI_ICC_SDmapInfo_2_VLAN62_ADCC, AEP_VLAN62_ADCC_TCP_30501/CSI_ICC_SDmapInfo_2_VLAN62_ADCC], data-element=AM_CompositionPrototype67.ICC_SDmapInfo_2Consumer_ADCC.AM_CompositionType1.ICC_SDmapInfo_2_NtfSDmapNaviWeatherInfo_RcvP.DataElement_NtfSDmapNaviWeatherInfo, system-signal=SysSIG_Event_NtfSDmapNaviWeatherInfo_ICC_SDmapInfo_2}
        sender-receiver-to-signal-mapping={service-instance=[AEP_VLAN62_ICC_8155_Android_UDP_30500/PSI_ICC_SDmapInfo_2_1_VLAN62_ICC_8155_Android, AEP_VLAN62_ICC_8155_Android_TCP_30500/PSI_ICC_SDmapInfo_2_1_VLAN62_ICC_8155_Android], data-element=AM_CompositionPrototype67.ICC_SDmapInfo_2_Provider.AM_CompositionType1.ICC_SDmapInfo_2_NtfSDmapNaviCongestionInfo_SndP.DataElement_NtfSDmapNaviCongestionInfo, system-signal=SysSIG_Event_NtfSDmapNaviCongestionInfo_ICC_SDmapInfo_2}
        sender-receiver-to-signal-mapping={service-instance=[AEP_VLAN62_ADCC_UDP_30501/CSI_ICC_SDmapInfo_2_VLAN62_ADCC, AEP_VLAN62_ADCC_TCP_30501/CSI_ICC_SDmapInfo_2_VLAN62_ADCC], data-element=AM_CompositionPrototype67.ICC_SDmapInfo_2Consumer_ADCC.AM_CompositionType1.ICC_SDmapInfo_2_NtfSDmapNaviCongestionInfo_RcvP.DataElement_NtfSDmapNaviCongestionInfo, system-signal=SysSIG_Event_NtfSDmapNaviCongestionInfo_ICC_SDmapInfo_2}
        sender-receiver-to-signal-mapping={service-instance=[AEP_VLAN62_ICC_8155_Android_UDP_30500/PSI_ICC_SDmapInfo_2_1_VLAN62_ICC_8155_Android, AEP_VLAN62_ICC_8155_Android_TCP_30500/PSI_ICC_SDmapInfo_2_1_VLAN62_ICC_8155_Android], data-element=AM_CompositionPrototype67.ICC_SDmapInfo_2_Provider.AM_CompositionType1.ICC_SDmapInfo_2_NtfSDmapNaviGreenWaveCarSpd_SndP.DataElement_NtfSDmapNaviGreenWaveCarSpd, system-signal=SysSIG_Event_NtfSDmapNaviGreenWaveCarSpd_ICC_SDmapInfo_2}
        sender-receiver-to-signal-mapping={service-instance=[AEP_VLAN62_ADCC_UDP_30501/CSI_ICC_SDmapInfo_2_VLAN62_ADCC, AEP_VLAN62_ADCC_TCP_30501/CSI_ICC_SDmapInfo_2_VLAN62_ADCC], data-element=AM_CompositionPrototype67.ICC_SDmapInfo_2Consumer_ADCC.AM_CompositionType1.ICC_SDmapInfo_2_NtfSDmapNaviGreenWaveCarSpd_RcvP.DataElement_NtfSDmapNaviGreenWaveCarSpd, system-signal=SysSIG_Event_NtfSDmapNaviGreenWaveCarSpd_ICC_SDmapInfo_2}
        sender-receiver-to-signal-mapping={service-instance=[AEP_VLAN62_ICC_8155_Android_UDP_30500/PSI_ICC_SDmapInfo_2_1_VLAN62_ICC_8155_Android, AEP_VLAN62_ICC_8155_Android_TCP_30500/PSI_ICC_SDmapInfo_2_1_VLAN62_ICC_8155_Android], data-element=AM_CompositionPrototype67.ICC_SDmapInfo_2_Provider.AM_CompositionType1.ICC_SDmapInfo_2_notifySDmapLaneInfo_SndP.DataElement_notifySDmapLaneInfo, system-signal=SysSIG_Event_notifySDmapLaneInfo_ICC_SDmapInfo_2}
        sender-receiver-to-signal-mapping={service-instance=[AEP_VLAN62_ADCC_UDP_30501/CSI_ICC_SDmapInfo_2_VLAN62_ADCC, AEP_VLAN62_ADCC_TCP_30501/CSI_ICC_SDmapInfo_2_VLAN62_ADCC], data-element=AM_CompositionPrototype67.ICC_SDmapInfo_2Consumer_ADCC.AM_CompositionType1.ICC_SDmapInfo_2_notifySDmapLaneInfo_RcvP.DataElement_notifySDmapLaneInfo, system-signal=SysSIG_Event_notifySDmapLaneInfo_ICC_SDmapInfo_2}
        sender-receiver-to-signal-mapping={service-instance=[AEP_VLAN62_ICC_8155_Android_UDP_30500/PSI_ICC_SDmapInfo_2_1_VLAN62_ICC_8155_Android, AEP_VLAN62_ICC_8155_Android_TCP_30500/PSI_ICC_SDmapInfo_2_1_VLAN62_ICC_8155_Android], data-element=AM_CompositionPrototype67.ICC_SDmapInfo_2_Provider.AM_CompositionType1.ICC_SDmapInfo_2_NtfSDmapMixForkInfo_SndP.DataElement_NtfSDmapMixForkInfo, system-signal=SysSIG_Event_NtfSDmapMixForkInfo_ICC_SDmapInfo_2}
        sender-receiver-to-signal-mapping={service-instance=[AEP_VLAN62_ADCC_UDP_30501/CSI_ICC_SDmapInfo_2_VLAN62_ADCC, AEP_VLAN62_ADCC_TCP_30501/CSI_ICC_SDmapInfo_2_VLAN62_ADCC], data-element=AM_CompositionPrototype67.ICC_SDmapInfo_2Consumer_ADCC.AM_CompositionType1.ICC_SDmapInfo_2_NtfSDmapMixForkInfo_RcvP.DataElement_NtfSDmapMixForkInfo, system-signal=SysSIG_Event_NtfSDmapMixForkInfo_ICC_SDmapInfo_2}
        sender-receiver-to-signal-mapping={service-instance=[AEP_VLAN62_ICC_8155_Android_UDP_30500/PSI_ICC_SDmapInfo_2_1_VLAN62_ICC_8155_Android, AEP_VLAN62_ICC_8155_Android_TCP_30500/PSI_ICC_SDmapInfo_2_1_VLAN62_ICC_8155_Android], data-element=AM_CompositionPrototype67.ICC_SDmapInfo_2_Provider.AM_CompositionType1.ICC_SDmapInfo_2_NtfSDmapMyLocationInfo_SndP.DataElement_NtfSDmapMyLocationInfo, system-signal=SysSIG_Event_NtfSDmapMyLocationInfo_ICC_SDmapInfo_2}
        sender-receiver-to-signal-mapping={service-instance=[AEP_VLAN62_ADCC_UDP_30501/CSI_ICC_SDmapInfo_2_VLAN62_ADCC, AEP_VLAN62_ADCC_TCP_30501/CSI_ICC_SDmapInfo_2_VLAN62_ADCC], data-element=AM_CompositionPrototype67.ICC_SDmapInfo_2Consumer_ADCC.AM_CompositionType1.ICC_SDmapInfo_2_NtfSDmapMyLocationInfo_RcvP.DataElement_NtfSDmapMyLocationInfo, system-signal=SysSIG_Event_NtfSDmapMyLocationInfo_ICC_SDmapInfo_2}
        sender-receiver-to-signal-mapping={service-instance=[AEP_VLAN62_ICC_8155_Android_UDP_30500/PSI_ICC_SDmapInfo_2_1_VLAN62_ICC_8155_Android, AEP_VLAN62_ICC_8155_Android_TCP_30500/PSI_ICC_SDmapInfo_2_1_VLAN62_ICC_8155_Android], data-element=AM_CompositionPrototype67.ICC_SDmapInfo_2_Provider.AM_CompositionType1.ICC_SDmapInfo_2_NtfSDmapNaviStatusInfo_SndP.DataElement_NtfSDmapNaviStatusInfo, system-signal=SysSIG_Event_NtfSDmapNaviStatusInfo_ICC_SDmapInfo_2}
        sender-receiver-to-signal-mapping={service-instance=[AEP_VLAN62_ADCC_UDP_30501/CSI_ICC_SDmapInfo_2_VLAN62_ADCC, AEP_VLAN62_ADCC_TCP_30501/CSI_ICC_SDmapInfo_2_VLAN62_ADCC], data-element=AM_CompositionPrototype67.ICC_SDmapInfo_2Consumer_ADCC.AM_CompositionType1.ICC_SDmapInfo_2_NtfSDmapNaviStatusInfo_RcvP.DataElement_NtfSDmapNaviStatusInfo, system-signal=SysSIG_Event_NtfSDmapNaviStatusInfo_ICC_SDmapInfo_2}
        sender-receiver-to-signal-mapping={service-instance=[AEP_VLAN62_ICC_8155_Android_UDP_30500/PSI_ICC_SDmapInfo_2_1_VLAN62_ICC_8155_Android, AEP_VLAN62_ICC_8155_Android_TCP_30500/PSI_ICC_SDmapInfo_2_1_VLAN62_ICC_8155_Android], data-element=AM_CompositionPrototype67.ICC_SDmapInfo_2_Provider.AM_CompositionType1.ICC_SDmapInfo_2_NtfSDmapSoundInfo_SndP.DataElement_NtfSDmapSoundInfo, system-signal=SysSIG_Event_NtfSDmapSoundInfo_ICC_SDmapInfo_2}
        sender-receiver-to-signal-mapping={service-instance=[AEP_VLAN62_ADCC_UDP_30501/CSI_ICC_SDmapInfo_2_VLAN62_ADCC, AEP_VLAN62_ADCC_TCP_30501/CSI_ICC_SDmapInfo_2_VLAN62_ADCC], data-element=AM_CompositionPrototype67.ICC_SDmapInfo_2Consumer_ADCC.AM_CompositionType1.ICC_SDmapInfo_2_NtfSDmapSoundInfo_RcvP.DataElement_NtfSDmapSoundInfo, system-signal=SysSIG_Event_NtfSDmapSoundInfo_ICC_SDmapInfo_2}
        sender-receiver-to-signal-mapping={service-instance=[AEP_VLAN62_ICC_8155_Android_UDP_30500/PSI_ICC_SDmapInfo_2_1_VLAN62_ICC_8155_Android, AEP_VLAN62_ICC_8155_Android_TCP_30500/PSI_ICC_SDmapInfo_2_1_VLAN62_ICC_8155_Android], data-element=AM_CompositionPrototype67.ICC_SDmapInfo_2_Provider.AM_CompositionType1.ICC_SDmapInfo_2_NtfSDmapRouteOption_SndP.DataElement_NtfSDmapRouteOption, system-signal=SysSIG_Event_NtfSDmapRouteOption_ICC_SDmapInfo_2}
        sender-receiver-to-signal-mapping={service-instance=[AEP_VLAN62_ADCC_UDP_30501/CSI_ICC_SDmapInfo_2_VLAN62_ADCC, AEP_VLAN62_ADCC_TCP_30501/CSI_ICC_SDmapInfo_2_VLAN62_ADCC], data-element=AM_CompositionPrototype67.ICC_SDmapInfo_2Consumer_ADCC.AM_CompositionType1.ICC_SDmapInfo_2_NtfSDmapRouteOption_RcvP.DataElement_NtfSDmapRouteOption, system-signal=SysSIG_Event_NtfSDmapRouteOption_ICC_SDmapInfo_2}
        sender-receiver-to-signal-mapping={service-instance=[AEP_VLAN62_ICC_8155_Android_UDP_30500/PSI_ICC_SDmapInfo_2_1_VLAN62_ICC_8155_Android, AEP_VLAN62_ICC_8155_Android_TCP_30500/PSI_ICC_SDmapInfo_2_1_VLAN62_ICC_8155_Android], data-element=AM_CompositionPrototype67.ICC_SDmapInfo_2_Provider.AM_CompositionType1.ICC_SDmapInfo_2_NtfSDmapCruiseInfo_SndP.DataElement_NtfSDmapCruiseInfo, system-signal=SysSIG_Event_NtfSDmapCruiseInfo_ICC_SDmapInfo_2}
        sender-receiver-to-signal-mapping={service-instance=[AEP_VLAN62_ADCC_UDP_30501/CSI_ICC_SDmapInfo_2_VLAN62_ADCC, AEP_VLAN62_ADCC_TCP_30501/CSI_ICC_SDmapInfo_2_VLAN62_ADCC], data-element=AM_CompositionPrototype67.ICC_SDmapInfo_2Consumer_ADCC.AM_CompositionType1.ICC_SDmapInfo_2_NtfSDmapCruiseInfo_RcvP.DataElement_NtfSDmapCruiseInfo, system-signal=SysSIG_Event_NtfSDmapCruiseInfo_ICC_SDmapInfo_2}
        sender-receiver-to-signal-mapping={service-instance=[AEP_VLAN62_ICC_8155_Android_UDP_30500/PSI_ICC_SDmapInfo_2_1_VLAN62_ICC_8155_Android, AEP_VLAN62_ICC_8155_Android_TCP_30500/PSI_ICC_SDmapInfo_2_1_VLAN62_ICC_8155_Android], data-element=AM_CompositionPrototype67.ICC_SDmapInfo_2_Provider.AM_CompositionType1.ICC_SDmapInfo_2_NtfSDmapNaviRoadInfo_SndP.DataElement_NtfSDmapNaviRoadInfo, system-signal=SysSIG_Event_NtfSDmapNaviRoadInfo_ICC_SDmapInfo_2}
        sender-receiver-to-signal-mapping={service-instance=[AEP_VLAN62_ADCC_UDP_30501/CSI_ICC_SDmapInfo_2_VLAN62_ADCC, AEP_VLAN62_ADCC_TCP_30501/CSI_ICC_SDmapInfo_2_VLAN62_ADCC], data-element=AM_CompositionPrototype67.ICC_SDmapInfo_2Consumer_ADCC.AM_CompositionType1.ICC_SDmapInfo_2_NtfSDmapNaviRoadInfo_RcvP.DataElement_NtfSDmapNaviRoadInfo, system-signal=SysSIG_Event_NtfSDmapNaviRoadInfo_ICC_SDmapInfo_2}
        sender-receiver-to-signal-mapping={service-instance=[AEP_VLAN62_ICC_8155_Android_UDP_30500/PSI_ICC_SDmapInfo_2_1_VLAN62_ICC_8155_Android, AEP_VLAN62_ICC_8155_Android_TCP_30500/PSI_ICC_SDmapInfo_2_1_VLAN62_ICC_8155_Android], data-element=AM_CompositionPrototype67.ICC_SDmapInfo_2_Provider.AM_CompositionType1.ICC_SDmapInfo_2_NtfSDmapAheadLaneInfo_SndP.DataElement_NtfSDmapAheadLaneInfo, system-signal=SysSIG_Event_NtfSDmapAheadLaneInfo_ICC_SDmapInfo_2}
        sender-receiver-to-signal-mapping={service-instance=[AEP_VLAN62_ADCC_UDP_30501/CSI_ICC_SDmapInfo_2_VLAN62_ADCC, AEP_VLAN62_ADCC_TCP_30501/CSI_ICC_SDmapInfo_2_VLAN62_ADCC], data-element=AM_CompositionPrototype67.ICC_SDmapInfo_2Consumer_ADCC.AM_CompositionType1.ICC_SDmapInfo_2_NtfSDmapAheadLaneInfo_RcvP.DataElement_NtfSDmapAheadLaneInfo, system-signal=SysSIG_Event_NtfSDmapAheadLaneInfo_ICC_SDmapInfo_2}
        sender-receiver-to-signal-mapping={service-instance=[AEP_VLAN62_ICC_8155_Android_UDP_30500/PSI_ICC_SDmapInfo_2_1_VLAN62_ICC_8155_Android, AEP_VLAN62_ICC_8155_Android_TCP_30500/PSI_ICC_SDmapInfo_2_1_VLAN62_ICC_8155_Android], data-element=AM_CompositionPrototype67.ICC_SDmapInfo_2_Provider.AM_CompositionType1.ICC_SDmapInfo_2_NtfSDmapTollGateInfo_SndP.DataElement_NtfSDmapTollGateInfo, system-signal=SysSIG_Event_NtfSDmapTollGateInfo_ICC_SDmapInfo_2}
        sender-receiver-to-signal-mapping={service-instance=[AEP_VLAN62_ADCC_UDP_30501/CSI_ICC_SDmapInfo_2_VLAN62_ADCC, AEP_VLAN62_ADCC_TCP_30501/CSI_ICC_SDmapInfo_2_VLAN62_ADCC], data-element=AM_CompositionPrototype67.ICC_SDmapInfo_2Consumer_ADCC.AM_CompositionType1.ICC_SDmapInfo_2_NtfSDmapTollGateInfo_RcvP.DataElement_NtfSDmapTollGateInfo, system-signal=SysSIG_Event_NtfSDmapTollGateInfo_ICC_SDmapInfo_2}
        sender-receiver-to-signal-mapping={service-instance=[AEP_VLAN62_ICC_8155_Android_UDP_30500/PSI_ICC_SDmapInfo_2_1_VLAN62_ICC_8155_Android, AEP_VLAN62_ICC_8155_Android_TCP_30500/PSI_ICC_SDmapInfo_2_1_VLAN62_ICC_8155_Android], data-element=AM_CompositionPrototype67.ICC_SDmapInfo_2_Provider.AM_CompositionType1.ICC_SDmapInfo_2_NtfSDmapServiceAreaInfo_SndP.DataElement_NtfSDmapServiceAreaInfo, system-signal=SysSIG_Event_NtfSDmapServiceAreaInfo_ICC_SDmapInfo_2}
        sender-receiver-to-signal-mapping={service-instance=[AEP_VLAN62_ADCC_UDP_30501/CSI_ICC_SDmapInfo_2_VLAN62_ADCC, AEP_VLAN62_ADCC_TCP_30501/CSI_ICC_SDmapInfo_2_VLAN62_ADCC], data-element=AM_CompositionPrototype67.ICC_SDmapInfo_2Consumer_ADCC.AM_CompositionType1.ICC_SDmapInfo_2_NtfSDmapServiceAreaInfo_RcvP.DataElement_NtfSDmapServiceAreaInfo, system-signal=SysSIG_Event_NtfSDmapServiceAreaInfo_ICC_SDmapInfo_2}
        sender-receiver-to-signal-mapping={service-instance=[AEP_VLAN62_ICC_8155_Android_UDP_30500/PSI_ICC_SDmapInfo_2_1_VLAN62_ICC_8155_Android, AEP_VLAN62_ICC_8155_Android_TCP_30500/PSI_ICC_SDmapInfo_2_1_VLAN62_ICC_8155_Android], data-element=AM_CompositionPrototype67.ICC_SDmapInfo_2_Provider.AM_CompositionType1.ICC_SDmapInfo_2_NtfSDmapTunnelInfo_SndP.DataElement_NtfSDmapTunnelInfo, system-signal=SysSIG_Event_NtfSDmapTunnelInfo_ICC_SDmapInfo_2}
        sender-receiver-to-signal-mapping={service-instance=[AEP_VLAN62_ADCC_UDP_30501/CSI_ICC_SDmapInfo_2_VLAN62_ADCC, AEP_VLAN62_ADCC_TCP_30501/CSI_ICC_SDmapInfo_2_VLAN62_ADCC], data-element=AM_CompositionPrototype67.ICC_SDmapInfo_2Consumer_ADCC.AM_CompositionType1.ICC_SDmapInfo_2_NtfSDmapTunnelInfo_RcvP.DataElement_NtfSDmapTunnelInfo, system-signal=SysSIG_Event_NtfSDmapTunnelInfo_ICC_SDmapInfo_2}
        sender-receiver-to-signal-mapping={service-instance=[AEP_VLAN62_ICC_8155_Android_UDP_30500/PSI_ICC_SDmapInfo_2_1_VLAN62_ICC_8155_Android, AEP_VLAN62_ICC_8155_Android_TCP_30500/PSI_ICC_SDmapInfo_2_1_VLAN62_ICC_8155_Android], data-element=AM_CompositionPrototype67.ICC_SDmapInfo_2_Provider.AM_CompositionType1.ICC_SDmapInfo_2_NtfSDmapRampInfo_SndP.DataElement_NtfSDmapRampInfo, system-signal=SysSIG_Event_NtfSDmapRampInfo_ICC_SDmapInfo_2}
        sender-receiver-to-signal-mapping={service-instance=[AEP_VLAN62_ADCC_UDP_30501/CSI_ICC_SDmapInfo_2_VLAN62_ADCC, AEP_VLAN62_ADCC_TCP_30501/CSI_ICC_SDmapInfo_2_VLAN62_ADCC], data-element=AM_CompositionPrototype67.ICC_SDmapInfo_2Consumer_ADCC.AM_CompositionType1.ICC_SDmapInfo_2_NtfSDmapRampInfo_RcvP.DataElement_NtfSDmapRampInfo, system-signal=SysSIG_Event_NtfSDmapRampInfo_ICC_SDmapInfo_2}
        sender-receiver-to-signal-mapping={service-instance=[AEP_VLAN62_ICC_8155_Android_UDP_30500/PSI_ICC_SDmapInfo_2_1_VLAN62_ICC_8155_Android, AEP_VLAN62_ICC_8155_Android_TCP_30500/PSI_ICC_SDmapInfo_2_1_VLAN62_ICC_8155_Android], data-element=AM_CompositionPrototype67.ICC_SDmapInfo_2_Provider.AM_CompositionType1.ICC_SDmapInfo_2_NtfSDmapFacilityInfo_SndP.DataElement_NtfSDmapFacilityInfo, system-signal=SysSIG_Event_NtfSDmapFacilityInfo_ICC_SDmapInfo_2}
        sender-receiver-to-signal-mapping={service-instance=[AEP_VLAN62_ADCC_UDP_30501/CSI_ICC_SDmapInfo_2_VLAN62_ADCC, AEP_VLAN62_ADCC_TCP_30501/CSI_ICC_SDmapInfo_2_VLAN62_ADCC], data-element=AM_CompositionPrototype67.ICC_SDmapInfo_2Consumer_ADCC.AM_CompositionType1.ICC_SDmapInfo_2_NtfSDmapFacilityInfo_RcvP.DataElement_NtfSDmapFacilityInfo, system-signal=SysSIG_Event_NtfSDmapFacilityInfo_ICC_SDmapInfo_2}
        sender-receiver-to-signal-mapping={service-instance=[AEP_VLAN62_ICC_8155_Android_UDP_30500/PSI_ICC_SDmapInfo_2_1_VLAN62_ICC_8155_Android, AEP_VLAN62_ICC_8155_Android_TCP_30500/PSI_ICC_SDmapInfo_2_1_VLAN62_ICC_8155_Android], data-element=AM_CompositionPrototype67.ICC_SDmapInfo_2_Provider.AM_CompositionType1.ICC_SDmapInfo_2_NtfSDmapLocMatchInfo_SndP.DataElement_NtfSDmapLocMatchInfo, system-signal=SysSIG_Event_NtfSDmapLocMatchInfo_ICC_SDmapInfo_2}
        sender-receiver-to-signal-mapping={service-instance=[AEP_VLAN62_ADCC_UDP_30501/CSI_ICC_SDmapInfo_2_VLAN62_ADCC, AEP_VLAN62_ADCC_TCP_30501/CSI_ICC_SDmapInfo_2_VLAN62_ADCC], data-element=AM_CompositionPrototype67.ICC_SDmapInfo_2Consumer_ADCC.AM_CompositionType1.ICC_SDmapInfo_2_NtfSDmapLocMatchInfo_RcvP.DataElement_NtfSDmapLocMatchInfo, system-signal=SysSIG_Event_NtfSDmapLocMatchInfo_ICC_SDmapInfo_2}
        sender-receiver-to-signal-mapping={service-instance=[AEP_VLAN62_ICC_8155_Android_UDP_30500/PSI_ICC_SDmapInfo_2_1_VLAN62_ICC_8155_Android, AEP_VLAN62_ICC_8155_Android_TCP_30500/PSI_ICC_SDmapInfo_2_1_VLAN62_ICC_8155_Android], data-element=AM_CompositionPrototype67.ICC_SDmapInfo_2_Provider.AM_CompositionType1.ICC_SDmapInfo_2_notifySDmapTollGateLaneInfo_SndP.DataElement_notifySDmapTollGateLaneInfo, system-signal=SysSIG_Event_notifySDmapTollGateLaneInfo_ICC_SDmapInfo_2}
        sender-receiver-to-signal-mapping={service-instance=[AEP_VLAN62_ADCC_UDP_30501/CSI_ICC_SDmapInfo_2_VLAN62_ADCC, AEP_VLAN62_ADCC_TCP_30501/CSI_ICC_SDmapInfo_2_VLAN62_ADCC], data-element=AM_CompositionPrototype67.ICC_SDmapInfo_2Consumer_ADCC.AM_CompositionType1.ICC_SDmapInfo_2_notifySDmapTollGateLaneInfo_RcvP.DataElement_notifySDmapTollGateLaneInfo, system-signal=SysSIG_Event_notifySDmapTollGateLaneInfo_ICC_SDmapInfo_2}
        sender-receiver-to-signal-mapping={service-instance=[AEP_VLAN62_ICC_8155_Android_UDP_30500/PSI_ICC_SDmapInfo_2_1_VLAN62_ICC_8155_Android, AEP_VLAN62_ICC_8155_Android_TCP_30500/PSI_ICC_SDmapInfo_2_1_VLAN62_ICC_8155_Android], data-element=AM_CompositionPrototype67.ICC_SDmapInfo_2_Provider.AM_CompositionType1.ICC_SDmapInfo_2_notifySDmapNavArriveAim_SndP.DataElement_notifySDmapNavArriveAim, system-signal=SysSIG_Event_notifySDmapNavArriveAim_ICC_SDmapInfo_2}
        sender-receiver-to-signal-mapping={service-instance=[AEP_VLAN62_ADCC_UDP_30501/CSI_ICC_SDmapInfo_2_VLAN62_ADCC, AEP_VLAN62_ADCC_TCP_30501/CSI_ICC_SDmapInfo_2_VLAN62_ADCC], data-element=AM_CompositionPrototype67.ICC_SDmapInfo_2Consumer_ADCC.AM_CompositionType1.ICC_SDmapInfo_2_notifySDmapNavArriveAim_RcvP.DataElement_notifySDmapNavArriveAim, system-signal=SysSIG_Event_notifySDmapNavArriveAim_ICC_SDmapInfo_2}
        sender-receiver-to-signal-mapping={service-instance=[AEP_VLAN62_ICC_8155_Android_UDP_30500/PSI_ICC_SDmapInfo_2_1_VLAN62_ICC_8155_Android, AEP_VLAN62_ICC_8155_Android_TCP_30500/PSI_ICC_SDmapInfo_2_1_VLAN62_ICC_8155_Android], data-element=AM_CompositionPrototype67.ICC_SDmapInfo_2_Provider.AM_CompositionType1.ICC_SDmapInfo_2_NtfSDmapRouteInfo_SndP.DataElement_NtfSDmapRouteInfo, system-signal=SysSIG_Event_NtfSDmapRouteInfo_ICC_SDmapInfo_2_1}
        sender-receiver-to-signal-mapping={service-instance=[AEP_VLAN62_FCM_UDP_30501/CSI_ICC_SDmapInfo_2_VLAN62_FCM, AEP_VLAN62_FCM_TCP_30501/CSI_ICC_SDmapInfo_2_VLAN62_FCM], data-element=AM_CompositionPrototype67.ICC_SDmapInfo_2Consumer_FCM.AM_CompositionType1.ICC_SDmapInfo_2_NtfSDmapRouteInfo_RcvP.DataElement_NtfSDmapRouteInfo, system-signal=SysSIG_Event_NtfSDmapRouteInfo_ICC_SDmapInfo_2_1}
        sender-receiver-to-signal-mapping={service-instance=[AEP_VLAN62_ICC_8155_Android_UDP_30500/PSI_ICC_SDmapInfo_2_1_VLAN62_ICC_8155_Android, AEP_VLAN62_ICC_8155_Android_TCP_30500/PSI_ICC_SDmapInfo_2_1_VLAN62_ICC_8155_Android], data-element=AM_CompositionPrototype67.ICC_SDmapInfo_2_Provider.AM_CompositionType1.ICC_SDmapInfo_2_NtfSDmapTBTNaviInfo_SndP.DataElement_NtfSDmapTBTNaviInfo, system-signal=SysSIG_Event_NtfSDmapTBTNaviInfo_ICC_SDmapInfo_2_1}
        sender-receiver-to-signal-mapping={service-instance=[AEP_VLAN62_FCM_UDP_30501/CSI_ICC_SDmapInfo_2_VLAN62_FCM, AEP_VLAN62_FCM_TCP_30501/CSI_ICC_SDmapInfo_2_VLAN62_FCM], data-element=AM_CompositionPrototype67.ICC_SDmapInfo_2Consumer_FCM.AM_CompositionType1.ICC_SDmapInfo_2_NtfSDmapTBTNaviInfo_RcvP.DataElement_NtfSDmapTBTNaviInfo, system-signal=SysSIG_Event_NtfSDmapTBTNaviInfo_ICC_SDmapInfo_2_1}
        sender-receiver-to-signal-mapping={service-instance=[AEP_VLAN62_ICC_8155_Android_UDP_30500/PSI_ICC_SDmapInfo_2_1_VLAN62_ICC_8155_Android, AEP_VLAN62_ICC_8155_Android_TCP_30500/PSI_ICC_SDmapInfo_2_1_VLAN62_ICC_8155_Android], data-element=AM_CompositionPrototype67.ICC_SDmapInfo_2_Provider.AM_CompositionType1.ICC_SDmapInfo_2_NtfSDmapNaviCameraInfo_SndP.DataElement_NtfSDmapNaviCameraInfo, system-signal=SysSIG_Event_NtfSDmapNaviCameraInfo_ICC_SDmapInfo_2_1}
        sender-receiver-to-signal-mapping={service-instance=[AEP_VLAN62_FCM_UDP_30501/CSI_ICC_SDmapInfo_2_VLAN62_FCM, AEP_VLAN62_FCM_TCP_30501/CSI_ICC_SDmapInfo_2_VLAN62_FCM], data-element=AM_CompositionPrototype67.ICC_SDmapInfo_2Consumer_FCM.AM_CompositionType1.ICC_SDmapInfo_2_NtfSDmapNaviCameraInfo_RcvP.DataElement_NtfSDmapNaviCameraInfo, system-signal=SysSIG_Event_NtfSDmapNaviCameraInfo_ICC_SDmapInfo_2_1}
        sender-receiver-to-signal-mapping={service-instance=[AEP_VLAN62_ICC_8155_Android_UDP_30500/PSI_ICC_SDmapInfo_2_1_VLAN62_ICC_8155_Android, AEP_VLAN62_ICC_8155_Android_TCP_30500/PSI_ICC_SDmapInfo_2_1_VLAN62_ICC_8155_Android], data-element=AM_CompositionPrototype67.ICC_SDmapInfo_2_Provider.AM_CompositionType1.ICC_SDmapInfo_2_NtfSDmapCruiseFacilityInfo_SndP.DataElement_NtfSDmapCruiseFacilityInfo, system-signal=SysSIG_Event_NtfSDmapCruiseFacilityInfo_ICC_SDmapInfo_2_1}
        sender-receiver-to-signal-mapping={service-instance=[AEP_VLAN62_FCM_UDP_30501/CSI_ICC_SDmapInfo_2_VLAN62_FCM, AEP_VLAN62_FCM_TCP_30501/CSI_ICC_SDmapInfo_2_VLAN62_FCM], data-element=AM_CompositionPrototype67.ICC_SDmapInfo_2Consumer_FCM.AM_CompositionType1.ICC_SDmapInfo_2_NtfSDmapCruiseFacilityInfo_RcvP.DataElement_NtfSDmapCruiseFacilityInfo, system-signal=SysSIG_Event_NtfSDmapCruiseFacilityInfo_ICC_SDmapInfo_2_1}
        sender-receiver-to-signal-mapping={service-instance=[AEP_VLAN62_ICC_8155_Android_UDP_30500/PSI_ICC_SDmapInfo_2_1_VLAN62_ICC_8155_Android, AEP_VLAN62_ICC_8155_Android_TCP_30500/PSI_ICC_SDmapInfo_2_1_VLAN62_ICC_8155_Android], data-element=AM_CompositionPrototype67.ICC_SDmapInfo_2_Provider.AM_CompositionType1.ICC_SDmapInfo_2_NtfSDmapTrafficLightCDInfo_SndP.DataElement_NtfSDmapTrafficLightCDInfo, system-signal=SysSIG_Event_NtfSDmapTrafficLightCDInfo_ICC_SDmapInfo_2_1}
        sender-receiver-to-signal-mapping={service-instance=[AEP_VLAN62_FCM_UDP_30501/CSI_ICC_SDmapInfo_2_VLAN62_FCM, AEP_VLAN62_FCM_TCP_30501/CSI_ICC_SDmapInfo_2_VLAN62_FCM], data-element=AM_CompositionPrototype67.ICC_SDmapInfo_2Consumer_FCM.AM_CompositionType1.ICC_SDmapInfo_2_NtfSDmapTrafficLightCDInfo_RcvP.DataElement_NtfSDmapTrafficLightCDInfo, system-signal=SysSIG_Event_NtfSDmapTrafficLightCDInfo_ICC_SDmapInfo_2_1}
        sender-receiver-to-signal-mapping={service-instance=[AEP_VLAN62_ICC_8155_Android_UDP_30500/PSI_ICC_SDmapInfo_2_1_VLAN62_ICC_8155_Android, AEP_VLAN62_ICC_8155_Android_TCP_30500/PSI_ICC_SDmapInfo_2_1_VLAN62_ICC_8155_Android], data-element=AM_CompositionPrototype67.ICC_SDmapInfo_2_Provider.AM_CompositionType1.ICC_SDmapInfo_2_NtfSDmapNaviIntCamDynInfo_SndP.DataElement_NtfSDmapNaviIntCamDynInfo, system-signal=SysSIG_Event_NtfSDmapNaviIntCamDynInfo_ICC_SDmapInfo_2_1}
        sender-receiver-to-signal-mapping={service-instance=[AEP_VLAN62_FCM_UDP_30501/CSI_ICC_SDmapInfo_2_VLAN62_FCM, AEP_VLAN62_FCM_TCP_30501/CSI_ICC_SDmapInfo_2_VLAN62_FCM], data-element=AM_CompositionPrototype67.ICC_SDmapInfo_2Consumer_FCM.AM_CompositionType1.ICC_SDmapInfo_2_NtfSDmapNaviIntCamDynInfo_RcvP.DataElement_NtfSDmapNaviIntCamDynInfo, system-signal=SysSIG_Event_NtfSDmapNaviIntCamDynInfo_ICC_SDmapInfo_2_1}
        sender-receiver-to-signal-mapping={service-instance=[AEP_VLAN62_ICC_8155_Android_UDP_30500/PSI_ICC_SDmapInfo_2_1_VLAN62_ICC_8155_Android, AEP_VLAN62_ICC_8155_Android_TCP_30500/PSI_ICC_SDmapInfo_2_1_VLAN62_ICC_8155_Android], data-element=AM_CompositionPrototype67.ICC_SDmapInfo_2_Provider.AM_CompositionType1.ICC_SDmapInfo_2_NtfSDmapNaviWeatherInfo_SndP.DataElement_NtfSDmapNaviWeatherInfo, system-signal=SysSIG_Event_NtfSDmapNaviWeatherInfo_ICC_SDmapInfo_2_1}
        sender-receiver-to-signal-mapping={service-instance=[AEP_VLAN62_FCM_UDP_30501/CSI_ICC_SDmapInfo_2_VLAN62_FCM, AEP_VLAN62_FCM_TCP_30501/CSI_ICC_SDmapInfo_2_VLAN62_FCM], data-element=AM_CompositionPrototype67.ICC_SDmapInfo_2Consumer_FCM.AM_CompositionType1.ICC_SDmapInfo_2_NtfSDmapNaviWeatherInfo_RcvP.DataElement_NtfSDmapNaviWeatherInfo, system-signal=SysSIG_Event_NtfSDmapNaviWeatherInfo_ICC_SDmapInfo_2_1}
        sender-receiver-to-signal-mapping={service-instance=[AEP_VLAN62_ICC_8155_Android_UDP_30500/PSI_ICC_SDmapInfo_2_1_VLAN62_ICC_8155_Android, AEP_VLAN62_ICC_8155_Android_TCP_30500/PSI_ICC_SDmapInfo_2_1_VLAN62_ICC_8155_Android], data-element=AM_CompositionPrototype67.ICC_SDmapInfo_2_Provider.AM_CompositionType1.ICC_SDmapInfo_2_NtfSDmapNaviCongestionInfo_SndP.DataElement_NtfSDmapNaviCongestionInfo, system-signal=SysSIG_Event_NtfSDmapNaviCongestionInfo_ICC_SDmapInfo_2_1}
        sender-receiver-to-signal-mapping={service-instance=[AEP_VLAN62_FCM_UDP_30501/CSI_ICC_SDmapInfo_2_VLAN62_FCM, AEP_VLAN62_FCM_TCP_30501/CSI_ICC_SDmapInfo_2_VLAN62_FCM], data-element=AM_CompositionPrototype67.ICC_SDmapInfo_2Consumer_FCM.AM_CompositionType1.ICC_SDmapInfo_2_NtfSDmapNaviCongestionInfo_RcvP.DataElement_NtfSDmapNaviCongestionInfo, system-signal=SysSIG_Event_NtfSDmapNaviCongestionInfo_ICC_SDmapInfo_2_1}
        sender-receiver-to-signal-mapping={service-instance=[AEP_VLAN62_ICC_8155_Android_UDP_30500/PSI_ICC_SDmapInfo_2_1_VLAN62_ICC_8155_Android, AEP_VLAN62_ICC_8155_Android_TCP_30500/PSI_ICC_SDmapInfo_2_1_VLAN62_ICC_8155_Android], data-element=AM_CompositionPrototype67.ICC_SDmapInfo_2_Provider.AM_CompositionType1.ICC_SDmapInfo_2_NtfSDmapNaviGreenWaveCarSpd_SndP.DataElement_NtfSDmapNaviGreenWaveCarSpd, system-signal=SysSIG_Event_NtfSDmapNaviGreenWaveCarSpd_ICC_SDmapInfo_2_1}
        sender-receiver-to-signal-mapping={service-instance=[AEP_VLAN62_FCM_UDP_30501/CSI_ICC_SDmapInfo_2_VLAN62_FCM, AEP_VLAN62_FCM_TCP_30501/CSI_ICC_SDmapInfo_2_VLAN62_FCM], data-element=AM_CompositionPrototype67.ICC_SDmapInfo_2Consumer_FCM.AM_CompositionType1.ICC_SDmapInfo_2_NtfSDmapNaviGreenWaveCarSpd_RcvP.DataElement_NtfSDmapNaviGreenWaveCarSpd, system-signal=SysSIG_Event_NtfSDmapNaviGreenWaveCarSpd_ICC_SDmapInfo_2_1}
        sender-receiver-to-signal-mapping={service-instance=[AEP_VLAN62_ICC_8155_Android_UDP_30500/PSI_ICC_SDmapInfo_2_1_VLAN62_ICC_8155_Android, AEP_VLAN62_ICC_8155_Android_TCP_30500/PSI_ICC_SDmapInfo_2_1_VLAN62_ICC_8155_Android], data-element=AM_CompositionPrototype67.ICC_SDmapInfo_2_Provider.AM_CompositionType1.ICC_SDmapInfo_2_notifySDmapLaneInfo_SndP.DataElement_notifySDmapLaneInfo, system-signal=SysSIG_Event_notifySDmapLaneInfo_ICC_SDmapInfo_2_1}
        sender-receiver-to-signal-mapping={service-instance=[AEP_VLAN62_FCM_UDP_30501/CSI_ICC_SDmapInfo_2_VLAN62_FCM, AEP_VLAN62_FCM_TCP_30501/CSI_ICC_SDmapInfo_2_VLAN62_FCM], data-element=AM_CompositionPrototype67.ICC_SDmapInfo_2Consumer_FCM.AM_CompositionType1.ICC_SDmapInfo_2_notifySDmapLaneInfo_RcvP.DataElement_notifySDmapLaneInfo, system-signal=SysSIG_Event_notifySDmapLaneInfo_ICC_SDmapInfo_2_1}
        sender-receiver-to-signal-mapping={service-instance=[AEP_VLAN62_ICC_8155_Android_UDP_30500/PSI_ICC_SDmapInfo_2_1_VLAN62_ICC_8155_Android, AEP_VLAN62_ICC_8155_Android_TCP_30500/PSI_ICC_SDmapInfo_2_1_VLAN62_ICC_8155_Android], data-element=AM_CompositionPrototype67.ICC_SDmapInfo_2_Provider.AM_CompositionType1.ICC_SDmapInfo_2_NtfSDmapMixForkInfo_SndP.DataElement_NtfSDmapMixForkInfo, system-signal=SysSIG_Event_NtfSDmapMixForkInfo_ICC_SDmapInfo_2_1}
        sender-receiver-to-signal-mapping={service-instance=[AEP_VLAN62_FCM_UDP_30501/CSI_ICC_SDmapInfo_2_VLAN62_FCM, AEP_VLAN62_FCM_TCP_30501/CSI_ICC_SDmapInfo_2_VLAN62_FCM], data-element=AM_CompositionPrototype67.ICC_SDmapInfo_2Consumer_FCM.AM_CompositionType1.ICC_SDmapInfo_2_NtfSDmapMixForkInfo_RcvP.DataElement_NtfSDmapMixForkInfo, system-signal=SysSIG_Event_NtfSDmapMixForkInfo_ICC_SDmapInfo_2_1}
        sender-receiver-to-signal-mapping={service-instance=[AEP_VLAN62_ICC_8155_Android_UDP_30500/PSI_ICC_SDmapInfo_2_1_VLAN62_ICC_8155_Android, AEP_VLAN62_ICC_8155_Android_TCP_30500/PSI_ICC_SDmapInfo_2_1_VLAN62_ICC_8155_Android], data-element=AM_CompositionPrototype67.ICC_SDmapInfo_2_Provider.AM_CompositionType1.ICC_SDmapInfo_2_NtfSDmapMyLocationInfo_SndP.DataElement_NtfSDmapMyLocationInfo, system-signal=SysSIG_Event_NtfSDmapMyLocationInfo_ICC_SDmapInfo_2_1}
        sender-receiver-to-signal-mapping={service-instance=[AEP_VLAN62_FCM_UDP_30501/CSI_ICC_SDmapInfo_2_VLAN62_FCM, AEP_VLAN62_FCM_TCP_30501/CSI_ICC_SDmapInfo_2_VLAN62_FCM], data-element=AM_CompositionPrototype67.ICC_SDmapInfo_2Consumer_FCM.AM_CompositionType1.ICC_SDmapInfo_2_NtfSDmapMyLocationInfo_RcvP.DataElement_NtfSDmapMyLocationInfo, system-signal=SysSIG_Event_NtfSDmapMyLocationInfo_ICC_SDmapInfo_2_1}
        sender-receiver-to-signal-mapping={service-instance=[AEP_VLAN62_ICC_8155_Android_UDP_30500/PSI_ICC_SDmapInfo_2_1_VLAN62_ICC_8155_Android, AEP_VLAN62_ICC_8155_Android_TCP_30500/PSI_ICC_SDmapInfo_2_1_VLAN62_ICC_8155_Android], data-element=AM_CompositionPrototype67.ICC_SDmapInfo_2_Provider.AM_CompositionType1.ICC_SDmapInfo_2_NtfSDmapNaviStatusInfo_SndP.DataElement_NtfSDmapNaviStatusInfo, system-signal=SysSIG_Event_NtfSDmapNaviStatusInfo_ICC_SDmapInfo_2_1}
        sender-receiver-to-signal-mapping={service-instance=[AEP_VLAN62_FCM_UDP_30501/CSI_ICC_SDmapInfo_2_VLAN62_FCM, AEP_VLAN62_FCM_TCP_30501/CSI_ICC_SDmapInfo_2_VLAN62_FCM], data-element=AM_CompositionPrototype67.ICC_SDmapInfo_2Consumer_FCM.AM_CompositionType1.ICC_SDmapInfo_2_NtfSDmapNaviStatusInfo_RcvP.DataElement_NtfSDmapNaviStatusInfo, system-signal=SysSIG_Event_NtfSDmapNaviStatusInfo_ICC_SDmapInfo_2_1}
        sender-receiver-to-signal-mapping={service-instance=[AEP_VLAN62_ICC_8155_Android_UDP_30500/PSI_ICC_SDmapInfo_2_1_VLAN62_ICC_8155_Android, AEP_VLAN62_ICC_8155_Android_TCP_30500/PSI_ICC_SDmapInfo_2_1_VLAN62_ICC_8155_Android], data-element=AM_CompositionPrototype67.ICC_SDmapInfo_2_Provider.AM_CompositionType1.ICC_SDmapInfo_2_NtfSDmapSoundInfo_SndP.DataElement_NtfSDmapSoundInfo, system-signal=SysSIG_Event_NtfSDmapSoundInfo_ICC_SDmapInfo_2_1}
        sender-receiver-to-signal-mapping={service-instance=[AEP_VLAN62_FCM_UDP_30501/CSI_ICC_SDmapInfo_2_VLAN62_FCM, AEP_VLAN62_FCM_TCP_30501/CSI_ICC_SDmapInfo_2_VLAN62_FCM], data-element=AM_CompositionPrototype67.ICC_SDmapInfo_2Consumer_FCM.AM_CompositionType1.ICC_SDmapInfo_2_NtfSDmapSoundInfo_RcvP.DataElement_NtfSDmapSoundInfo, system-signal=SysSIG_Event_NtfSDmapSoundInfo_ICC_SDmapInfo_2_1}
        sender-receiver-to-signal-mapping={service-instance=[AEP_VLAN62_ICC_8155_Android_UDP_30500/PSI_ICC_SDmapInfo_2_1_VLAN62_ICC_8155_Android, AEP_VLAN62_ICC_8155_Android_TCP_30500/PSI_ICC_SDmapInfo_2_1_VLAN62_ICC_8155_Android], data-element=AM_CompositionPrototype67.ICC_SDmapInfo_2_Provider.AM_CompositionType1.ICC_SDmapInfo_2_NtfSDmapRouteOption_SndP.DataElement_NtfSDmapRouteOption, system-signal=SysSIG_Event_NtfSDmapRouteOption_ICC_SDmapInfo_2_1}
        sender-receiver-to-signal-mapping={service-instance=[AEP_VLAN62_FCM_UDP_30501/CSI_ICC_SDmapInfo_2_VLAN62_FCM, AEP_VLAN62_FCM_TCP_30501/CSI_ICC_SDmapInfo_2_VLAN62_FCM], data-element=AM_CompositionPrototype67.ICC_SDmapInfo_2Consumer_FCM.AM_CompositionType1.ICC_SDmapInfo_2_NtfSDmapRouteOption_RcvP.DataElement_NtfSDmapRouteOption, system-signal=SysSIG_Event_NtfSDmapRouteOption_ICC_SDmapInfo_2_1}
        sender-receiver-to-signal-mapping={service-instance=[AEP_VLAN62_ICC_8155_Android_UDP_30500/PSI_ICC_SDmapInfo_2_1_VLAN62_ICC_8155_Android, AEP_VLAN62_ICC_8155_Android_TCP_30500/PSI_ICC_SDmapInfo_2_1_VLAN62_ICC_8155_Android], data-element=AM_CompositionPrototype67.ICC_SDmapInfo_2_Provider.AM_CompositionType1.ICC_SDmapInfo_2_NtfSDmapCruiseInfo_SndP.DataElement_NtfSDmapCruiseInfo, system-signal=SysSIG_Event_NtfSDmapCruiseInfo_ICC_SDmapInfo_2_1}
        sender-receiver-to-signal-mapping={service-instance=[AEP_VLAN62_FCM_UDP_30501/CSI_ICC_SDmapInfo_2_VLAN62_FCM, AEP_VLAN62_FCM_TCP_30501/CSI_ICC_SDmapInfo_2_VLAN62_FCM], data-element=AM_CompositionPrototype67.ICC_SDmapInfo_2Consumer_FCM.AM_CompositionType1.ICC_SDmapInfo_2_NtfSDmapCruiseInfo_RcvP.DataElement_NtfSDmapCruiseInfo, system-signal=SysSIG_Event_NtfSDmapCruiseInfo_ICC_SDmapInfo_2_1}
        sender-receiver-to-signal-mapping={service-instance=[AEP_VLAN62_ICC_8155_Android_UDP_30500/PSI_ICC_SDmapInfo_2_1_VLAN62_ICC_8155_Android, AEP_VLAN62_ICC_8155_Android_TCP_30500/PSI_ICC_SDmapInfo_2_1_VLAN62_ICC_8155_Android], data-element=AM_CompositionPrototype67.ICC_SDmapInfo_2_Provider.AM_CompositionType1.ICC_SDmapInfo_2_NtfSDmapNaviRoadInfo_SndP.DataElement_NtfSDmapNaviRoadInfo, system-signal=SysSIG_Event_NtfSDmapNaviRoadInfo_ICC_SDmapInfo_2_1}
        sender-receiver-to-signal-mapping={service-instance=[AEP_VLAN62_FCM_UDP_30501/CSI_ICC_SDmapInfo_2_VLAN62_FCM, AEP_VLAN62_FCM_TCP_30501/CSI_ICC_SDmapInfo_2_VLAN62_FCM], data-element=AM_CompositionPrototype67.ICC_SDmapInfo_2Consumer_FCM.AM_CompositionType1.ICC_SDmapInfo_2_NtfSDmapNaviRoadInfo_RcvP.DataElement_NtfSDmapNaviRoadInfo, system-signal=SysSIG_Event_NtfSDmapNaviRoadInfo_ICC_SDmapInfo_2_1}
        sender-receiver-to-signal-mapping={service-instance=[AEP_VLAN62_ICC_8155_Android_UDP_30500/PSI_ICC_SDmapInfo_2_1_VLAN62_ICC_8155_Android, AEP_VLAN62_ICC_8155_Android_TCP_30500/PSI_ICC_SDmapInfo_2_1_VLAN62_ICC_8155_Android], data-element=AM_CompositionPrototype67.ICC_SDmapInfo_2_Provider.AM_CompositionType1.ICC_SDmapInfo_2_NtfSDmapAheadLaneInfo_SndP.DataElement_NtfSDmapAheadLaneInfo, system-signal=SysSIG_Event_NtfSDmapAheadLaneInfo_ICC_SDmapInfo_2_1}
        sender-receiver-to-signal-mapping={service-instance=[AEP_VLAN62_FCM_UDP_30501/CSI_ICC_SDmapInfo_2_VLAN62_FCM, AEP_VLAN62_FCM_TCP_30501/CSI_ICC_SDmapInfo_2_VLAN62_FCM], data-element=AM_CompositionPrototype67.ICC_SDmapInfo_2Consumer_FCM.AM_CompositionType1.ICC_SDmapInfo_2_NtfSDmapAheadLaneInfo_RcvP.DataElement_NtfSDmapAheadLaneInfo, system-signal=SysSIG_Event_NtfSDmapAheadLaneInfo_ICC_SDmapInfo_2_1}
        sender-receiver-to-signal-mapping={service-instance=[AEP_VLAN62_ICC_8155_Android_UDP_30500/PSI_ICC_SDmapInfo_2_1_VLAN62_ICC_8155_Android, AEP_VLAN62_ICC_8155_Android_TCP_30500/PSI_ICC_SDmapInfo_2_1_VLAN62_ICC_8155_Android], data-element=AM_CompositionPrototype67.ICC_SDmapInfo_2_Provider.AM_CompositionType1.ICC_SDmapInfo_2_NtfSDmapTollGateInfo_SndP.DataElement_NtfSDmapTollGateInfo, system-signal=SysSIG_Event_NtfSDmapTollGateInfo_ICC_SDmapInfo_2_1}
        sender-receiver-to-signal-mapping={service-instance=[AEP_VLAN62_FCM_UDP_30501/CSI_ICC_SDmapInfo_2_VLAN62_FCM, AEP_VLAN62_FCM_TCP_30501/CSI_ICC_SDmapInfo_2_VLAN62_FCM], data-element=AM_CompositionPrototype67.ICC_SDmapInfo_2Consumer_FCM.AM_CompositionType1.ICC_SDmapInfo_2_NtfSDmapTollGateInfo_RcvP.DataElement_NtfSDmapTollGateInfo, system-signal=SysSIG_Event_NtfSDmapTollGateInfo_ICC_SDmapInfo_2_1}
        sender-receiver-to-signal-mapping={service-instance=[AEP_VLAN62_ICC_8155_Android_UDP_30500/PSI_ICC_SDmapInfo_2_1_VLAN62_ICC_8155_Android, AEP_VLAN62_ICC_8155_Android_TCP_30500/PSI_ICC_SDmapInfo_2_1_VLAN62_ICC_8155_Android], data-element=AM_CompositionPrototype67.ICC_SDmapInfo_2_Provider.AM_CompositionType1.ICC_SDmapInfo_2_NtfSDmapServiceAreaInfo_SndP.DataElement_NtfSDmapServiceAreaInfo, system-signal=SysSIG_Event_NtfSDmapServiceAreaInfo_ICC_SDmapInfo_2_1}
        sender-receiver-to-signal-mapping={service-instance=[AEP_VLAN62_FCM_UDP_30501/CSI_ICC_SDmapInfo_2_VLAN62_FCM, AEP_VLAN62_FCM_TCP_30501/CSI_ICC_SDmapInfo_2_VLAN62_FCM], data-element=AM_CompositionPrototype67.ICC_SDmapInfo_2Consumer_FCM.AM_CompositionType1.ICC_SDmapInfo_2_NtfSDmapServiceAreaInfo_RcvP.DataElement_NtfSDmapServiceAreaInfo, system-signal=SysSIG_Event_NtfSDmapServiceAreaInfo_ICC_SDmapInfo_2_1}
        sender-receiver-to-signal-mapping={service-instance=[AEP_VLAN62_ICC_8155_Android_UDP_30500/PSI_ICC_SDmapInfo_2_1_VLAN62_ICC_8155_Android, AEP_VLAN62_ICC_8155_Android_TCP_30500/PSI_ICC_SDmapInfo_2_1_VLAN62_ICC_8155_Android], data-element=AM_CompositionPrototype67.ICC_SDmapInfo_2_Provider.AM_CompositionType1.ICC_SDmapInfo_2_NtfSDmapTunnelInfo_SndP.DataElement_NtfSDmapTunnelInfo, system-signal=SysSIG_Event_NtfSDmapTunnelInfo_ICC_SDmapInfo_2_1}
        sender-receiver-to-signal-mapping={service-instance=[AEP_VLAN62_FCM_UDP_30501/CSI_ICC_SDmapInfo_2_VLAN62_FCM, AEP_VLAN62_FCM_TCP_30501/CSI_ICC_SDmapInfo_2_VLAN62_FCM], data-element=AM_CompositionPrototype67.ICC_SDmapInfo_2Consumer_FCM.AM_CompositionType1.ICC_SDmapInfo_2_NtfSDmapTunnelInfo_RcvP.DataElement_NtfSDmapTunnelInfo, system-signal=SysSIG_Event_NtfSDmapTunnelInfo_ICC_SDmapInfo_2_1}
        sender-receiver-to-signal-mapping={service-instance=[AEP_VLAN62_ICC_8155_Android_UDP_30500/PSI_ICC_SDmapInfo_2_1_VLAN62_ICC_8155_Android, AEP_VLAN62_ICC_8155_Android_TCP_30500/PSI_ICC_SDmapInfo_2_1_VLAN62_ICC_8155_Android], data-element=AM_CompositionPrototype67.ICC_SDmapInfo_2_Provider.AM_CompositionType1.ICC_SDmapInfo_2_NtfSDmapRampInfo_SndP.DataElement_NtfSDmapRampInfo, system-signal=SysSIG_Event_NtfSDmapRampInfo_ICC_SDmapInfo_2_1}
        sender-receiver-to-signal-mapping={service-instance=[AEP_VLAN62_FCM_UDP_30501/CSI_ICC_SDmapInfo_2_VLAN62_FCM, AEP_VLAN62_FCM_TCP_30501/CSI_ICC_SDmapInfo_2_VLAN62_FCM], data-element=AM_CompositionPrototype67.ICC_SDmapInfo_2Consumer_FCM.AM_CompositionType1.ICC_SDmapInfo_2_NtfSDmapRampInfo_RcvP.DataElement_NtfSDmapRampInfo, system-signal=SysSIG_Event_NtfSDmapRampInfo_ICC_SDmapInfo_2_1}
        sender-receiver-to-signal-mapping={service-instance=[AEP_VLAN62_ICC_8155_Android_UDP_30500/PSI_ICC_SDmapInfo_2_1_VLAN62_ICC_8155_Android, AEP_VLAN62_ICC_8155_Android_TCP_30500/PSI_ICC_SDmapInfo_2_1_VLAN62_ICC_8155_Android], data-element=AM_CompositionPrototype67.ICC_SDmapInfo_2_Provider.AM_CompositionType1.ICC_SDmapInfo_2_NtfSDmapFacilityInfo_SndP.DataElement_NtfSDmapFacilityInfo, system-signal=SysSIG_Event_NtfSDmapFacilityInfo_ICC_SDmapInfo_2_1}
        sender-receiver-to-signal-mapping={service-instance=[AEP_VLAN62_FCM_UDP_30501/CSI_ICC_SDmapInfo_2_VLAN62_FCM, AEP_VLAN62_FCM_TCP_30501/CSI_ICC_SDmapInfo_2_VLAN62_FCM], data-element=AM_CompositionPrototype67.ICC_SDmapInfo_2Consumer_FCM.AM_CompositionType1.ICC_SDmapInfo_2_NtfSDmapFacilityInfo_RcvP.DataElement_NtfSDmapFacilityInfo, system-signal=SysSIG_Event_NtfSDmapFacilityInfo_ICC_SDmapInfo_2_1}
        sender-receiver-to-signal-mapping={service-instance=[AEP_VLAN62_ICC_8155_Android_UDP_30500/PSI_ICC_SDmapInfo_2_1_VLAN62_ICC_8155_Android, AEP_VLAN62_ICC_8155_Android_TCP_30500/PSI_ICC_SDmapInfo_2_1_VLAN62_ICC_8155_Android], data-element=AM_CompositionPrototype67.ICC_SDmapInfo_2_Provider.AM_CompositionType1.ICC_SDmapInfo_2_NtfSDmapLocMatchInfo_SndP.DataElement_NtfSDmapLocMatchInfo, system-signal=SysSIG_Event_NtfSDmapLocMatchInfo_ICC_SDmapInfo_2_1}
        sender-receiver-to-signal-mapping={service-instance=[AEP_VLAN62_FCM_UDP_30501/CSI_ICC_SDmapInfo_2_VLAN62_FCM, AEP_VLAN62_FCM_TCP_30501/CSI_ICC_SDmapInfo_2_VLAN62_FCM], data-element=AM_CompositionPrototype67.ICC_SDmapInfo_2Consumer_FCM.AM_CompositionType1.ICC_SDmapInfo_2_NtfSDmapLocMatchInfo_RcvP.DataElement_NtfSDmapLocMatchInfo, system-signal=SysSIG_Event_NtfSDmapLocMatchInfo_ICC_SDmapInfo_2_1}
        sender-receiver-to-signal-mapping={service-instance=[AEP_VLAN62_ICC_8155_Android_UDP_30500/PSI_ICC_SDmapInfo_2_1_VLAN62_ICC_8155_Android, AEP_VLAN62_ICC_8155_Android_TCP_30500/PSI_ICC_SDmapInfo_2_1_VLAN62_ICC_8155_Android], data-element=AM_CompositionPrototype67.ICC_SDmapInfo_2_Provider.AM_CompositionType1.ICC_SDmapInfo_2_notifySDmapTollGateLaneInfo_SndP.DataElement_notifySDmapTollGateLaneInfo, system-signal=SysSIG_Event_notifySDmapTollGateLaneInfo_ICC_SDmapInfo_2_1}
        sender-receiver-to-signal-mapping={service-instance=[AEP_VLAN62_FCM_UDP_30501/CSI_ICC_SDmapInfo_2_VLAN62_FCM, AEP_VLAN62_FCM_TCP_30501/CSI_ICC_SDmapInfo_2_VLAN62_FCM], data-element=AM_CompositionPrototype67.ICC_SDmapInfo_2Consumer_FCM.AM_CompositionType1.ICC_SDmapInfo_2_notifySDmapTollGateLaneInfo_RcvP.DataElement_notifySDmapTollGateLaneInfo, system-signal=SysSIG_Event_notifySDmapTollGateLaneInfo_ICC_SDmapInfo_2_1}
        sender-receiver-to-signal-mapping={service-instance=[AEP_VLAN62_ICC_8155_Android_UDP_30500/PSI_ICC_SDmapInfo_2_1_VLAN62_ICC_8155_Android, AEP_VLAN62_ICC_8155_Android_TCP_30500/PSI_ICC_SDmapInfo_2_1_VLAN62_ICC_8155_Android], data-element=AM_CompositionPrototype67.ICC_SDmapInfo_2_Provider.AM_CompositionType1.ICC_SDmapInfo_2_notifySDmapNavArriveAim_SndP.DataElement_notifySDmapNavArriveAim, system-signal=SysSIG_Event_notifySDmapNavArriveAim_ICC_SDmapInfo_2_1}
        sender-receiver-to-signal-mapping={service-instance=[AEP_VLAN62_FCM_UDP_30501/CSI_ICC_SDmapInfo_2_VLAN62_FCM, AEP_VLAN62_FCM_TCP_30501/CSI_ICC_SDmapInfo_2_VLAN62_FCM], data-element=AM_CompositionPrototype67.ICC_SDmapInfo_2Consumer_FCM.AM_CompositionType1.ICC_SDmapInfo_2_notifySDmapNavArriveAim_RcvP.DataElement_notifySDmapNavArriveAim, system-signal=SysSIG_Event_notifySDmapNavArriveAim_ICC_SDmapInfo_2_1}
        sender-receiver-to-signal-mapping={service-instance=[AEP_VLAN62_ADCC_UDP_30500/PSI_ADCC_DrivingHmiEnv_1_VLAN62_ADCC, AEP_VLAN62_ADCC_TCP_30500/PSI_ADCC_DrivingHmiEnv_1_VLAN62_ADCC], data-element=AM_CompositionPrototype67.ADCC_DrivingHmiEnv_Provider.AM_CompositionType1.ADCC_DrivingHmiEnv_NtfDynamicObjectList_Drvg_SndP.DataElement_NtfDynamicObjectList_Drvg, system-signal=SysSIG_Event_NtfDynamicObjectList_Drvg_ADCC_DrivingHmiEnv}
        sender-receiver-to-signal-mapping={service-instance=[AEP_VLAN62_ICC_8155_Android_UDP_30501/CSI_ADCC_DrivingHmiEnv_VLAN62_ICC_8155_Android, AEP_VLAN62_ICC_8155_Android_TCP_30501/CSI_ADCC_DrivingHmiEnv_VLAN62_ICC_8155_Android], data-element=AM_CompositionPrototype67.ADCC_DrivingHmiEnvConsumer_ICC_8155_Android.AM_CompositionType1.ADCC_DrivingHmiEnv_NtfDynamicObjectList_Drvg_RcvP.DataElement_NtfDynamicObjectList_Drvg, system-signal=SysSIG_Event_NtfDynamicObjectList_Drvg_ADCC_DrivingHmiEnv}
        sender-receiver-to-signal-mapping={service-instance=[AEP_VLAN62_ADCC_UDP_30500/PSI_ADCC_DrivingHmiEnv_1_VLAN62_ADCC, AEP_VLAN62_ADCC_TCP_30500/PSI_ADCC_DrivingHmiEnv_1_VLAN62_ADCC], data-element=AM_CompositionPrototype67.ADCC_DrivingHmiEnv_Provider.AM_CompositionType1.ADCC_DrivingHmiEnv_NtfStaticObjectList_Drvg_SndP.DataElement_NtfStaticObjectList_Drvg, system-signal=SysSIG_Event_NtfStaticObjectList_Drvg_ADCC_DrivingHmiEnv}
        sender-receiver-to-signal-mapping={service-instance=[AEP_VLAN62_ICC_8155_Android_UDP_30501/CSI_ADCC_DrivingHmiEnv_VLAN62_ICC_8155_Android, AEP_VLAN62_ICC_8155_Android_TCP_30501/CSI_ADCC_DrivingHmiEnv_VLAN62_ICC_8155_Android], data-element=AM_CompositionPrototype67.ADCC_DrivingHmiEnvConsumer_ICC_8155_Android.AM_CompositionType1.ADCC_DrivingHmiEnv_NtfStaticObjectList_Drvg_RcvP.DataElement_NtfStaticObjectList_Drvg, system-signal=SysSIG_Event_NtfStaticObjectList_Drvg_ADCC_DrivingHmiEnv}
        sender-receiver-to-signal-mapping={service-instance=[AEP_VLAN62_ADCC_UDP_30500/PSI_ADCC_DrivingHmiEnv_1_VLAN62_ADCC, AEP_VLAN62_ADCC_TCP_30500/PSI_ADCC_DrivingHmiEnv_1_VLAN62_ADCC], data-element=AM_CompositionPrototype67.ADCC_DrivingHmiEnv_Provider.AM_CompositionType1.ADCC_DrivingHmiEnv_NtfLaneLineListt_Drvg_SndP.DataElement_NtfLaneLineListt_Drvg, system-signal=SysSIG_Event_NtfLaneLineListt_Drvg_ADCC_DrivingHmiEnv}
        sender-receiver-to-signal-mapping={service-instance=[AEP_VLAN62_ICC_8155_Android_UDP_30501/CSI_ADCC_DrivingHmiEnv_VLAN62_ICC_8155_Android, AEP_VLAN62_ICC_8155_Android_TCP_30501/CSI_ADCC_DrivingHmiEnv_VLAN62_ICC_8155_Android], data-element=AM_CompositionPrototype67.ADCC_DrivingHmiEnvConsumer_ICC_8155_Android.AM_CompositionType1.ADCC_DrivingHmiEnv_NtfLaneLineListt_Drvg_RcvP.DataElement_NtfLaneLineListt_Drvg, system-signal=SysSIG_Event_NtfLaneLineListt_Drvg_ADCC_DrivingHmiEnv}
        sender-receiver-to-signal-mapping={service-instance=[AEP_VLAN62_ADCC_UDP_30500/PSI_ADCC_DrivingHmiEnv_1_VLAN62_ADCC, AEP_VLAN62_ADCC_TCP_30500/PSI_ADCC_DrivingHmiEnv_1_VLAN62_ADCC], data-element=AM_CompositionPrototype67.ADCC_DrivingHmiEnv_Provider.AM_CompositionType1.ADCC_DrivingHmiEnv_NtfEgoFusionPose_Drvg_SndP.DataElement_NtfEgoFusionPose_Drvg, system-signal=SysSIG_Event_NtfEgoFusionPose_Drvg_ADCC_DrivingHmiEnv}
        sender-receiver-to-signal-mapping={service-instance=[AEP_VLAN62_ICC_8155_Android_UDP_30501/CSI_ADCC_DrivingHmiEnv_VLAN62_ICC_8155_Android, AEP_VLAN62_ICC_8155_Android_TCP_30501/CSI_ADCC_DrivingHmiEnv_VLAN62_ICC_8155_Android], data-element=AM_CompositionPrototype67.ADCC_DrivingHmiEnvConsumer_ICC_8155_Android.AM_CompositionType1.ADCC_DrivingHmiEnv_NtfEgoFusionPose_Drvg_RcvP.DataElement_NtfEgoFusionPose_Drvg, system-signal=SysSIG_Event_NtfEgoFusionPose_Drvg_ADCC_DrivingHmiEnv}
        sender-receiver-to-signal-mapping={service-instance=[AEP_VLAN62_ADCC_UDP_30500/PSI_ADCC_DrivingHmiEnv_1_VLAN62_ADCC, AEP_VLAN62_ADCC_TCP_30500/PSI_ADCC_DrivingHmiEnv_1_VLAN62_ADCC], data-element=AM_CompositionPrototype67.ADCC_DrivingHmiEnv_Provider.AM_CompositionType1.ADCC_DrivingHmiEnv_NtfRoadMarkerList_SndP.DataElement_NtfRoadMarkerList, system-signal=SysSIG_Event_NtfRoadMarkerList_ADCC_DrivingHmiEnv}
        sender-receiver-to-signal-mapping={service-instance=[AEP_VLAN62_ICC_8155_Android_UDP_30501/CSI_ADCC_DrivingHmiEnv_VLAN62_ICC_8155_Android, AEP_VLAN62_ICC_8155_Android_TCP_30501/CSI_ADCC_DrivingHmiEnv_VLAN62_ICC_8155_Android], data-element=AM_CompositionPrototype67.ADCC_DrivingHmiEnvConsumer_ICC_8155_Android.AM_CompositionType1.ADCC_DrivingHmiEnv_NtfRoadMarkerList_RcvP.DataElement_NtfRoadMarkerList, system-signal=SysSIG_Event_NtfRoadMarkerList_ADCC_DrivingHmiEnv}
        sender-receiver-to-signal-mapping={service-instance=[AEP_VLAN62_ADCC_UDP_30500/PSI_ADCC_DrivingHmiEnv_1_VLAN62_ADCC, AEP_VLAN62_ADCC_TCP_30500/PSI_ADCC_DrivingHmiEnv_1_VLAN62_ADCC], data-element=AM_CompositionPrototype67.ADCC_DrivingHmiEnv_Provider.AM_CompositionType1.ADCC_DrivingHmiEnv_NtfLaneLineListt_Drvg_2_SndP.DataElement_NtfLaneLineListt_Drvg_2, system-signal=SysSIG_Event_NtfLaneLineListt_Drvg_2_ADCC_DrivingHmiEnv}
        sender-receiver-to-signal-mapping={service-instance=[AEP_VLAN62_ICC_8155_Android_UDP_30501/CSI_ADCC_DrivingHmiEnv_VLAN62_ICC_8155_Android, AEP_VLAN62_ICC_8155_Android_TCP_30501/CSI_ADCC_DrivingHmiEnv_VLAN62_ICC_8155_Android], data-element=AM_CompositionPrototype67.ADCC_DrivingHmiEnvConsumer_ICC_8155_Android.AM_CompositionType1.ADCC_DrivingHmiEnv_NtfLaneLineListt_Drvg_2_RcvP.DataElement_NtfLaneLineListt_Drvg_2, system-signal=SysSIG_Event_NtfLaneLineListt_Drvg_2_ADCC_DrivingHmiEnv}
        sender-receiver-to-signal-mapping={service-instance=[AEP_VLAN62_ADCC_UDP_30500/PSI_ADCC_DrivingHmiEnv_1_VLAN62_ADCC, AEP_VLAN62_ADCC_TCP_30500/PSI_ADCC_DrivingHmiEnv_1_VLAN62_ADCC], data-element=AM_CompositionPrototype67.ADCC_DrivingHmiEnv_Provider.AM_CompositionType1.ADCC_DrivingHmiEnv_NtfEgoPose_SndP.DataElement_NtfEgoPose, system-signal=SysSIG_Event_NtfEgoPose_ADCC_DrivingHmiEnv}
        sender-receiver-to-signal-mapping={service-instance=[AEP_VLAN62_ICC_8155_Android_UDP_30501/CSI_ADCC_DrivingHmiEnv_VLAN62_ICC_8155_Android, AEP_VLAN62_ICC_8155_Android_TCP_30501/CSI_ADCC_DrivingHmiEnv_VLAN62_ICC_8155_Android], data-element=AM_CompositionPrototype67.ADCC_DrivingHmiEnvConsumer_ICC_8155_Android.AM_CompositionType1.ADCC_DrivingHmiEnv_NtfEgoPose_RcvP.DataElement_NtfEgoPose, system-signal=SysSIG_Event_NtfEgoPose_ADCC_DrivingHmiEnv}
        sender-receiver-to-signal-mapping={service-instance=[AEP_VLAN62_ADCC_UDP_30500/PSI_ADCC_DrivingHmiEnv_1_VLAN62_ADCC, AEP_VLAN62_ADCC_TCP_30500/PSI_ADCC_DrivingHmiEnv_1_VLAN62_ADCC], data-element=AM_CompositionPrototype67.ADCC_DrivingHmiEnv_Provider.AM_CompositionType1.ADCC_DrivingHmiEnv_NtfFusionMapData_SndP.DataElement_NtfFusionMapData, system-signal=SysSIG_Event_NtfFusionMapData_ADCC_DrivingHmiEnv}
        sender-receiver-to-signal-mapping={service-instance=[AEP_VLAN62_ICC_8155_Android_UDP_30501/CSI_ADCC_DrivingHmiEnv_VLAN62_ICC_8155_Android, AEP_VLAN62_ICC_8155_Android_TCP_30501/CSI_ADCC_DrivingHmiEnv_VLAN62_ICC_8155_Android], data-element=AM_CompositionPrototype67.ADCC_DrivingHmiEnvConsumer_ICC_8155_Android.AM_CompositionType1.ADCC_DrivingHmiEnv_NtfFusionMapData_RcvP.DataElement_NtfFusionMapData, system-signal=SysSIG_Event_NtfFusionMapData_ADCC_DrivingHmiEnv}
        sender-receiver-to-signal-mapping={service-instance=[AEP_VLAN62_ADCC_UDP_30500/PSI_ADCC_DrivingHmiEnv_1_VLAN62_ADCC, AEP_VLAN62_ADCC_TCP_30500/PSI_ADCC_DrivingHmiEnv_1_VLAN62_ADCC], data-element=AM_CompositionPrototype67.ADCC_DrivingHmiEnv_Provider.AM_CompositionType1.ADCC_DrivingHmiEnv_NtfRoadMarkerListSupplement_SndP.DataElement_NtfRoadMarkerListSupplement, system-signal=SysSIG_Event_NtfRoadMarkerListSupplement_ADCC_DrivingHmiEnv}
        sender-receiver-to-signal-mapping={service-instance=[AEP_VLAN62_ICC_8155_Android_UDP_30501/CSI_ADCC_DrivingHmiEnv_VLAN62_ICC_8155_Android, AEP_VLAN62_ICC_8155_Android_TCP_30501/CSI_ADCC_DrivingHmiEnv_VLAN62_ICC_8155_Android], data-element=AM_CompositionPrototype67.ADCC_DrivingHmiEnvConsumer_ICC_8155_Android.AM_CompositionType1.ADCC_DrivingHmiEnv_NtfRoadMarkerListSupplement_RcvP.DataElement_NtfRoadMarkerListSupplement, system-signal=SysSIG_Event_NtfRoadMarkerListSupplement_ADCC_DrivingHmiEnv}
        sender-receiver-to-signal-mapping={service-instance=[AEP_VLAN62_ADCC_UDP_30500/PSI_ADCC_DrivingHmiEnv_1_VLAN62_ADCC, AEP_VLAN62_ADCC_TCP_30500/PSI_ADCC_DrivingHmiEnv_1_VLAN62_ADCC], data-element=AM_CompositionPrototype67.ADCC_DrivingHmiEnv_Provider.AM_CompositionType1.ADCC_DrivingHmiEnv_NtfTrafficLightList_Drvg_SndP.DataElement_NtfTrafficLightList_Drvg, system-signal=SysSIG_Event_NtfTrafficLightList_Drvg_ADCC_DrivingHmiEnv}
        sender-receiver-to-signal-mapping={service-instance=[AEP_VLAN62_ICC_8155_Android_UDP_30501/CSI_ADCC_DrivingHmiEnv_VLAN62_ICC_8155_Android, AEP_VLAN62_ICC_8155_Android_TCP_30501/CSI_ADCC_DrivingHmiEnv_VLAN62_ICC_8155_Android], data-element=AM_CompositionPrototype67.ADCC_DrivingHmiEnvConsumer_ICC_8155_Android.AM_CompositionType1.ADCC_DrivingHmiEnv_NtfTrafficLightList_Drvg_RcvP.DataElement_NtfTrafficLightList_Drvg, system-signal=SysSIG_Event_NtfTrafficLightList_Drvg_ADCC_DrivingHmiEnv}
        sender-receiver-to-signal-mapping={service-instance=[AEP_VLAN62_ADCC_UDP_30500/PSI_ADCC_DrivingHmiEnv_1_VLAN62_ADCC, AEP_VLAN62_ADCC_TCP_30500/PSI_ADCC_DrivingHmiEnv_1_VLAN62_ADCC], data-element=AM_CompositionPrototype67.ADCC_DrivingHmiEnv_Provider.AM_CompositionType1.ADCC_DrivingHmiEnv_NtfFreeSpaceList_Drvg_SndP.DataElement_NtfFreeSpaceList_Drvg, system-signal=SysSIG_Event_NtfFreeSpaceList_Drvg_ADCC_DrivingHmiEnv}
        sender-receiver-to-signal-mapping={service-instance=[AEP_VLAN62_ICC_8155_Android_UDP_30501/CSI_ADCC_DrivingHmiEnv_VLAN62_ICC_8155_Android, AEP_VLAN62_ICC_8155_Android_TCP_30501/CSI_ADCC_DrivingHmiEnv_VLAN62_ICC_8155_Android], data-element=AM_CompositionPrototype67.ADCC_DrivingHmiEnvConsumer_ICC_8155_Android.AM_CompositionType1.ADCC_DrivingHmiEnv_NtfFreeSpaceList_Drvg_RcvP.DataElement_NtfFreeSpaceList_Drvg, system-signal=SysSIG_Event_NtfFreeSpaceList_Drvg_ADCC_DrivingHmiEnv}
        sender-receiver-to-signal-mapping={service-instance=[AEP_VLAN62_ADCC_UDP_30500/PSI_ADCC_DrivingHmiEnv_1_VLAN62_ADCC, AEP_VLAN62_ADCC_TCP_30500/PSI_ADCC_DrivingHmiEnv_1_VLAN62_ADCC], data-element=AM_CompositionPrototype67.ADCC_DrivingHmiEnv_Provider.AM_CompositionType1.ADCC_DrivingHmiEnv_Ntf3DTrafficSignList_Drvg_SndP.DataElement_Ntf3DTrafficSignList_Drvg, system-signal=SysSIG_Event_Ntf3DTrafficSignList_Drvg_ADCC_DrivingHmiEnv}
        sender-receiver-to-signal-mapping={service-instance=[AEP_VLAN62_ICC_8155_Android_UDP_30501/CSI_ADCC_DrivingHmiEnv_VLAN62_ICC_8155_Android, AEP_VLAN62_ICC_8155_Android_TCP_30501/CSI_ADCC_DrivingHmiEnv_VLAN62_ICC_8155_Android], data-element=AM_CompositionPrototype67.ADCC_DrivingHmiEnvConsumer_ICC_8155_Android.AM_CompositionType1.ADCC_DrivingHmiEnv_Ntf3DTrafficSignList_Drvg_RcvP.DataElement_Ntf3DTrafficSignList_Drvg, system-signal=SysSIG_Event_Ntf3DTrafficSignList_Drvg_ADCC_DrivingHmiEnv}
        sender-receiver-to-signal-mapping={service-instance=[AEP_VLAN62_ADCC_UDP_30500/PSI_ADCC_DrivingHmiEnv_1_VLAN62_ADCC, AEP_VLAN62_ADCC_TCP_30500/PSI_ADCC_DrivingHmiEnv_1_VLAN62_ADCC], data-element=AM_CompositionPrototype67.ADCC_DrivingHmiEnv_Provider.AM_CompositionType1.ADCC_DrivingHmiEnv_NtfDynamicObjectList_Drvg_2_SndP.DataElement_NtfDynamicObjectList_Drvg_2, system-signal=SysSIG_Event_NtfDynamicObjectList_Drvg_2_ADCC_DrivingHmiEnv}
        sender-receiver-to-signal-mapping={service-instance=[AEP_VLAN62_ICC_8155_Android_UDP_30501/CSI_ADCC_DrivingHmiEnv_VLAN62_ICC_8155_Android, AEP_VLAN62_ICC_8155_Android_TCP_30501/CSI_ADCC_DrivingHmiEnv_VLAN62_ICC_8155_Android], data-element=AM_CompositionPrototype67.ADCC_DrivingHmiEnvConsumer_ICC_8155_Android.AM_CompositionType1.ADCC_DrivingHmiEnv_NtfDynamicObjectList_Drvg_2_RcvP.DataElement_NtfDynamicObjectList_Drvg_2, system-signal=SysSIG_Event_NtfDynamicObjectList_Drvg_2_ADCC_DrivingHmiEnv}
        sender-receiver-to-signal-mapping={service-instance=[AEP_VLAN62_ADCC_UDP_30500/PSI_ADCC_DrivingHmiEnv_1_VLAN62_ADCC, AEP_VLAN62_ADCC_TCP_30500/PSI_ADCC_DrivingHmiEnv_1_VLAN62_ADCC], data-element=AM_CompositionPrototype67.ADCC_DrivingHmiEnv_Provider.AM_CompositionType1.ADCC_DrivingHmiEnv_NtfStaticObjectList_Drvg_2_SndP.DataElement_NtfStaticObjectList_Drvg_2, system-signal=SysSIG_Event_NtfStaticObjectList_Drvg_2_ADCC_DrivingHmiEnv}
        sender-receiver-to-signal-mapping={service-instance=[AEP_VLAN62_ICC_8155_Android_UDP_30501/CSI_ADCC_DrivingHmiEnv_VLAN62_ICC_8155_Android, AEP_VLAN62_ICC_8155_Android_TCP_30501/CSI_ADCC_DrivingHmiEnv_VLAN62_ICC_8155_Android], data-element=AM_CompositionPrototype67.ADCC_DrivingHmiEnvConsumer_ICC_8155_Android.AM_CompositionType1.ADCC_DrivingHmiEnv_NtfStaticObjectList_Drvg_2_RcvP.DataElement_NtfStaticObjectList_Drvg_2, system-signal=SysSIG_Event_NtfStaticObjectList_Drvg_2_ADCC_DrivingHmiEnv}
        sender-receiver-to-signal-mapping={service-instance=[AEP_VLAN62_ADCC_UDP_30500/PSI_ADCC_DrivingHmiEnv_1_VLAN62_ADCC, AEP_VLAN62_ADCC_TCP_30500/PSI_ADCC_DrivingHmiEnv_1_VLAN62_ADCC], data-element=AM_CompositionPrototype67.ADCC_DrivingHmiEnv_Provider.AM_CompositionType1.ADCC_DrivingHmiEnv_NtfRoadMarkerList_2_SndP.DataElement_NtfRoadMarkerList_2, system-signal=SysSIG_Event_NtfRoadMarkerList_2_ADCC_DrivingHmiEnv}
