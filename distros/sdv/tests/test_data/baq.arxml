[part 10 of 11: package /DataTypes/ImplementationDataTypes]
AUTOSAR XML (schema 00048)
package /DataTypes/ImplementationDataTypes  (continued)
  1376 x impl type:  (continued)
    IDT_ADAS_strt_HPATrainingPathInfo_2: category=STRUCTURE
      12 x element, all with category=TYPE_REFERENCE:
        DTE_HpaTrainingPathID: implementation-data-type=IDT_Gen_val_ID  # 路线ID
        DTE_TrainingPathName: implementation-data-type=IDT_ADAS_string_PathName  # 路线名称
        DTE_HPAtrainingPathCurrentDist: implementation-data-type=IDT_ADAS_val_ParkingDist  # 记忆泊车路线学习实时累计距离
        DTE_TrainingPathLength: implementation-data-type=IDT_ADAS_val_ParkingDist  # 路线长度
        DTE_TrainingLinePoint: implementation-data-type=IDT_ADAS_arr_PathPoint_2  # 路线学习点集
        DTE_HPATrainingPathSlotInfo: implementation-data-type=IDT_ADAS_arr_HPAPathslot_2  # 路线记忆车位
        DTE_HPASpeedBumpInfo: implementation-data-type=IDT_ADAS_arr_HPASpeedBumpInfo  # 路线记忆减速带
        DTE_TrainingPathLabel: implementation-data-type=IDT_ADAS_enum_PathLabel  # 路线标签
        DTE_HPATrainingStaticObject: implementation-data-type=IDT_ADAS_arr_HPAParkingStaticObjects  # 静态障碍物显示
        DTE_CompleteTrainingButtonSts: implementation-data-type=IDT_ADAS_enum_ParkingButtonSts  # 完成学习按钮
        DTE_CompleteAndParkTrainingButtonSts: implementation-data-type=IDT_ADAS_enum_ParkingButtonSts  # 泊入并完成学习按钮
        DTE_HPATrainingReserved: implementation-data-type=IDT_HPATraining_arr_Reserved  # 预留
    IDT_ICC_strt_NaviStatusBean: category=STRUCTURE  # 导航状态
      element DTE_NaviMode: implementation-data-type=IDT_ICC_int32_NaviMode  # 导航模式
      element DTE_NaviStatus: implementation-data-type=IDT_ICC_int32_NaviStatus  # 导航状态
      element DTE_NaviStatusReserved: implementation-data-type=IDT_NaviStatus_arr_Reserved  # 预留
    IDT_ADAS_arr_VPAStaticObjects: category=STRUCTURE, dynamic-array-size-profile=VSA_LINEAR  # vpa静态障碍物列表
      element sizeIndicator: implementation-data-type=specialIDT_DynamicLengthField_uint32
      element IDT_ADAS_arr_VPAStaticObjects: category=ARRAY
        element IDT_ADAS_arr_VPAStaticObjects: array-size=300, array-size-handling=ALL-INDICES-SAME-ARRAY-SIZE, array-size-semantics=VARIABLE-SIZE, implementation-data-type=IDT_ADAS_strt_VPAStaticObjects
    IDT_SentryModeFaults: category=VALUE, base-type=uint32  # 哨兵模式异常状态
    IDT_ICC_val_Direction: category=VALUE, base-type=uint8
    IDT_ICC_enum_FCWSettingSt: category=VALUE, base-type=uint8  # FCW功能设置状态
    IDT_Gen_val_int16: category=VALUE, base-type=sint16
    IDT_ADAS_enum_FSRASpdSetMod: category=VALUE, base-type=uint8
    IDT_ADAS_enum_ParkingScreen_ctrl: category=VALUE, base-type=uint8
    IDT_ADAS_Meta_CountryCode: category=VALUE, base-type=uint8
    IDT_ICC_enum_VoiceControlCruiseDistanceAdjust: category=VALUE, base-type=uint8  # 语音巡航距离调节指令
    IDT_HDOP: category=VALUE, base-type=float32
    IDT_ADAS_strt_OccPoint: category=STRUCTURE
      element DTE_Coordinate_X: implementation-data-type=IDT_Gen_val_Coordinate_X  # X坐标
      element DTE_Coordinate_Y: implementation-data-type=IDT_Gen_val_Coordinate_Y  # Y坐标
    IDT_ADAS_strt_SensorSt: category=STRUCTURE  # ADAS域控及传感器状态
      29 x element, all with category=TYPE_REFERENCE:
        DTE_ADASSysSts: implementation-data-type=IDT_Gen_enum_SystemSts  # ADAS系统状态
        DTE_FLCameraSysSts: implementation-data-type=IDT_Gen_enum_SystemSts  # 左前摄像头故障状态
        DTE_FLCameraCalSts: implementation-data-type=IDT_Gen_enum_CalibrationSts  # 左前摄像头状标定态
        DTE_FRCameraSysSts: implementation-data-type=IDT_Gen_enum_SystemSts  # 右前摄像头故障状态
        DTE_FRCameraCalSts: implementation-data-type=IDT_Gen_enum_CalibrationSts  # 右前摄像头状标定态
        DTE_RLCameraSysSts: implementation-data-type=IDT_Gen_enum_SystemSts  # 左后摄像头故障状态
        DTE_RLCameraCalSts: implementation-data-type=IDT_Gen_enum_CalibrationSts  # 左后摄像头状标定态
        DTE_RRCameraSysSts: implementation-data-type=IDT_Gen_enum_SystemSts  # 右后摄像头故障状态
        DTE_RRCameraCalSts: implementation-data-type=IDT_Gen_enum_CalibrationSts  # 右后摄像头状标定态
        DTE_RearCameraSysSts: implementation-data-type=IDT_Gen_enum_SystemSts  # 后摄像头故障状态
        DTE_RearCameraCalSts: implementation-data-type=IDT_Gen_enum_CalibrationSts  # 后摄像头状标定态
        DTE_FrontFarCameraSysSts: implementation-data-type=IDT_Gen_enum_SystemSts  # 前远距摄像头故障状态
        DTE_FrontFarCameraCalSts: implementation-data-type=IDT_Gen_enum_CalibrationSts  # 前远距摄像头状标定态
        DTE_FrontNearCameraSysSts: implementation-data-type=IDT_Gen_enum_SystemSts  # 前广角摄像头故障状态
        DTE_FrontNearCameraCalSts: implementation-data-type=IDT_Gen_enum_CalibrationSts  # 前广角摄像头状标定态
        DTE_MainLidarSysSts: implementation-data-type=IDT_Gen_enum_SystemSts  # 主激光雷达故障状态
        DTE_MainLidarCalSts: implementation-data-type=IDT_Gen_enum_CalibrationSts  # 主激光雷达标定状态
        DTE_FLLidarSysSts: implementation-data-type=IDT_Gen_enum_SystemSts  # 前左激光雷达故障状态
        DTE_FLLidarCalSts: implementation-data-type=IDT_Gen_enum_CalibrationSts  # 前左激光雷达标定状态
        DTE_FRLidarSysSts: implementation-data-type=IDT_Gen_enum_SystemSts  # 前右激光雷达故障状态
        DTE_FRLidarCalSts: implementation-data-type=IDT_Gen_enum_CalibrationSts  # 前右激光雷达标定状态
        DTE_SVSFrontCameraSysSts: implementation-data-type=IDT_Gen_enum_SystemSts  # 前环视相机故障状态
        DTE_SVSLeftCameraSysSts: implementation-data-type=IDT_Gen_enum_SystemSts  # 左环视相机故障状态
        DTE_SVSRightCameraSysSts: implementation-data-type=IDT_Gen_enum_SystemSts  # 右环视相机故障状态
        DTE_SVSRearCameraSysSts: implementation-data-type=IDT_Gen_enum_SystemSts  # 后环视相机故障状态
        DTE_SVSFrontCameraCalSts: implementation-data-type=IDT_Gen_enum_CalibrationSts  # 前环视相机标定状态
        DTE_SVSLeftCameraCalSts: implementation-data-type=IDT_Gen_enum_CalibrationSts  # 左环视相机标定状态
        DTE_SVSRightCameraCalSts: implementation-data-type=IDT_Gen_enum_CalibrationSts  # 右环视相机标定状态
        DTE_SVSRearCameraCalSts: implementation-data-type=IDT_Gen_enum_CalibrationSts  # 后环视相机标定状态
    IDT_SwtSts: category=VALUE, base-type=uint8  # 开关状态
    IDT_ValetParkingRealtimeInfoReserved: category=ARRAY  # 代客泊车实时信息预留
      element ADS_ReservedUnit8: array-size=32, array-size-semantics=FIXED-SIZE, implementation-data-type=IDT_ADS_ReservedUnit8
    IDT_ResponseVhrCompLogReportEnableCfg: category=VALUE, base-type=sint32  # 部件日志主动上报开关配置--响应
    IDT_ADAS_arr_FusionMetaData: category=STRUCTURE, dynamic-array-size-profile=VSA_LINEAR
      element sizeIndicator: implementation-data-type=specialIDT_DynamicLengthField_uint32
      element IDT_ADAS_arr_FusionMetaData: category=ARRAY
        element IDT_ADAS_arr_FusionMetaData: array-size=5000, array-size-handling=ALL-INDICES-SAME-ARRAY-SIZE, array-size-semantics=VARIABLE-SIZE, implementation-data-type=IDT_ADAS_val_FusionMetaData
    IDT_ADAS_enum_TrafficSignType: category=VALUE, base-type=uint8
    IDT_ICC_int32_LightType: category=VALUE, base-type=sint32  # 红绿灯状态类型
    IDT_ICC_strt_NaviIntervalCameraInfo1: category=STRUCTURE
      4 x element, all with category=TYPE_REFERENCE:
        DTE_NavigationSubCameraExtType: implementation-data-type=IDT_ICC_enum_SubCameraExtType  # 导航状态电子眼类型
        DTE_NavigationCameraDistance: implementation-data-type=IDT_ICC_val_Distance  # 自车距离前方电子眼位置距离
        DTE_NavSpeedLimitValue: implementation-data-type=IDT_ICC_enum_SpeedLimitValue  # 限速值
        DTE_NavSpeedLimitUnit: implementation-data-type=IDT_ICC_enum_SpeedLimitUnit  # 限速单位
    IDT_ICC_strt_MyLocationInfo: category=STRUCTURE  # 位置信息
      element DTE_MyLocationCurrentPos: implementation-data-type=IDT_ICC_strt_Coord3DDouble  # 自车经纬度
      element DTE_MyLocationSpeed: implementation-data-type=IDT_ICC_float_Speed  # 自车车速 km/h
      element DTE_MyLocationReserved: implementation-data-type=IDT_MyLocation_arr_Reserved  # 预留
    IDT_ADAS_Stub_SubPathIdx: category=VALUE, base-type=uint8
    IDT_keeptimelengthResponse: category=VALUE, base-type=uint32  # 保持恢厂状态时长响应
    IDT_ADAS_arr_StaticObjects: category=STRUCTURE, dynamic-array-size-profile=VSA_LINEAR  # 行车静态目标数组
      element sizeIndicator: implementation-data-type=specialIDT_DynamicLengthField_uint32
      element IDT_ADAS_arr_StaticObjects: category=ARRAY
        element IDT_ADAS_arr_StaticObjects: array-size=42, array-size-handling=ALL-INDICES-SAME-ARRAY-SIZE, array-size-semantics=VARIABLE-SIZE, implementation-data-type=IDT_ADAS_strt_StaticObject
    IDT_Enum_CarrierInfo: category=VALUE, base-type=float64  # 载波频率信息 Carrier frequency information
    IDT_SentryModeRpt: category=STRUCTURE  # 哨兵模式运行报告
      element DTE_sentryModeRunDuration: implementation-data-type=IDT_SentryModeDuration  # 哨兵模式运行时长(mins)
      element DTE_sentryModeAlarmLv1Cnt: implementation-data-type=IDT_SentryModeAlarmCnt  # 哨兵模式告警总次数
      element DTE_sentryModeAlarmLv2Cnt: implementation-data-type=IDT_SentryModeAlarmCnt  # 哨兵模式警报告警次数
    IDT_ADAS_Seg_PathIdx: category=VALUE, base-type=uint8
    IDT_ADAS_val_DrivingTrajectoryPointNum: category=VALUE, base-type=uint16  # 轨迹形点个数
    IDT_ADAS_val_LightNum: category=VALUE, base-type=uint8  # 红绿灯个数
    IDT_TotalTalkTime: category=VALUE, base-type=uint32  # 通话时长总计
    IDT_ADAS_enum_TargetSlotAvailableParkInType: category=VALUE, base-type=uint8
    IDT_ICC_enum_APARoad_Class: category=VALUE, base-type=uint8
    IDT_ADAS_Posn_Age: category=VALUE, base-type=uint16
    IDT_ICC_int32_RouteOption: category=VALUE, base-type=sint32  # 偏航
    IDT_ADAS_arr_VPAParkingLotInfo: category=STRUCTURE, dynamic-array-size-profile=VSA_LINEAR
      element sizeIndicator: implementation-data-type=specialIDT_DynamicLengthField_uint32
      element IDT_ADAS_arr_VPAParkingLotInfo: category=ARRAY
        element IDT_ADAS_arr_VPAParkingLotInfo: array-size=100, array-size-handling=ALL-INDICES-SAME-ARRAY-SIZE, array-size-semantics=VARIABLE-SIZE, implementation-data-type=IDT_ADAS_strt_VPAParkingLotBaseData
    IDT_Reserved_uint8_Type: category=VALUE, base-type=uint8  # 预留
    IDT_Gen_val_int32: category=VALUE, base-type=sint32
    IDT_ADAS_enum_TolAutoAvoidObstacle: category=VALUE, base-type=uint64  # 自动避障（避障变道和避障bypass）
    IDT_ADAS_enum_TrafficLightColor: category=VALUE, base-type=uint8
    IDT_HPAStaticObject_arr_Reserved: category=ARRAY  # 预留
      element Reserved_uint8_Type: array-size=30, array-size-semantics=FIXED-SIZE, implementation-data-type=IDT_Reserved_uint8_Type
    IDT_Enum_DiagnosisState: category=VALUE, base-type=uint8  # 诊断状态
    IDT_Enum_TollStationPathSet: category=VALUE, base-type=uint8  # 收费站通道设置 Toll gate lane setting
    IDT_ADAS_enum_TSISgnLongStay: category=VALUE, base-type=uint8  # TSR长时类标识牌
    IDT_ValetParkingCurrentIndex: category=VALUE, base-type=uint32  # 代客泊车当前所处索引点
    IDT_Struct_SIMCardinfo: category=STRUCTURE  # SIM卡信息
      4 x element, all with category=TYPE_REFERENCE:
        DTE_Network: implementation-data-type=IDT_Enum_Network  # 网络
        DTE_SIM_ICCID: implementation-data-type=IDT_StrVar_SIM_ICCID  # 20位数字组成的集成电路卡识别码
        DTE_SIM_IMSI: implementation-data-type=IDT_StrVar_SIM_IMSI  # 15位的国际移动用户识别码
        DTE_MSISDN: implementation-data-type=IDT_StrVar_MSISDN  # 15位移动电话号码
    IDT_RequestVhrCompLogReportEnableCfg: category=STRUCTURE  # 部件日志主动上报开关配置--请求
      element DTE_vhrCompID: implementation-data-type=IDT_VhrCompID  # 部件ID
      element DTE_vhrReportEnable: implementation-data-type=IDT_vhrReportEnable  # 日志上报使能开关
    IDT_RoadMarkerSupplement_arr_Reserved: category=ARRAY  # 预留
      element Reserved_uint8_Type: array-size=30, array-size-semantics=FIXED-SIZE, implementation-data-type=IDT_Reserved_uint8_Type
    IDT_ICC_enum_PathOperationId: category=VALUE, base-type=uint8
    IDT_ICC_strt_FacilityInfo: category=STRUCTURE  # 道路设施信息
      4 x element, all with category=TYPE_REFERENCE:
        DTE_FacilityCoord: implementation-data-type=IDT_ICC_strt_Coord2DDouble  # 道路设施坐标
        DTE_FacilityType: implementation-data-type=IDT_ICC_int32_FacilityType  # 道路设施类型
        DTE_FacilityDistance: implementation-data-type=IDT_ICC_int32_Dist
        DTE_FacilityInfoReserved: implementation-data-type=IDT_FacilityInfo_arr_Reserved  # 预留
    IDT_ICC_arr_NaviInfoPanel: category=STRUCTURE, dynamic-array-size-profile=VSA_LINEAR  # NaviInfo标签板显示内容专用
      element sizeIndicator: implementation-data-type=specialIDT_DynamicLengthField_uint32
      element IDT_ICC_arr_NaviInfoPanel: category=ARRAY
        element IDT_ICC_arr_NaviInfoPanel: array-size=10, array-size-handling=ALL-INDICES-SAME-ARRAY-SIZE, array-size-semantics=VARIABLE-SIZE, implementation-data-type=IDT_ICC_strt_NaviInfoPanel
    IDT_ADAS_arr_ParkingDynamicObjects: category=STRUCTURE, dynamic-array-size-profile=VSA_LINEAR  # 泊车动态目标数组
      element sizeIndicator: implementation-data-type=specialIDT_DynamicLengthField_uint32
      element IDT_ADAS_arr_ParkingDynamicObjects: category=ARRAY
        element IDT_ADAS_arr_ParkingDynamicObjects: array-size=42, array-size-handling=ALL-INDICES-SAME-ARRAY-SIZE, array-size-semantics=VARIABLE-SIZE, implementation-data-type=IDT_ADAS_strt_DynamicObject
    IDT_ADAS_strt_LinePoint: category=STRUCTURE  # 形点信息
      4 x element, all with category=TYPE_REFERENCE:
        DTE_LinePointX: implementation-data-type=IDT_Gen_val_Coordinate_X  # 点位置X坐标，车辆坐标系参考后轴中心点的X，单位cm
        DTE_LinePointY: implementation-data-type=IDT_Gen_val_Coordinate_Y  # 点位置Y坐标，车辆坐标系参考后轴中心点的Y，单位cm
        DTE_LinePointZ: implementation-data-type=IDT_Gen_val_Coordinate_Z  # 点位置Z坐标，车辆坐标系参考后轴中心点的Z，单位cm
        DTE_LinePointReserved: implementation-data-type=IDT_LinePoint_arr_Reserved  # 预留
    IDT_ADAS_enum_ICAPlusONOFFSts: category=VALUE, base-type=uint8
    IDT_EndPoi_arr_Reserved: category=ARRAY
      element Reserved_int32_Type: array-size=10, array-size-semantics=FIXED-SIZE, implementation-data-type=IDT_Reserved_int32_Type
    IDT_ACCSupplementInfo_arr_Reserved: category=ARRAY
      element Reserved_uint8_Type: array-size=30, array-size-semantics=FIXED-SIZE, implementation-data-type=IDT_Reserved_uint8_Type
    IDT_Enum_Network: category=VALUE, base-type=uint8  # 网络
    IDT_ADAS_strt_MNPMemRoutePoint: category=STRUCTURE
      element DTE_Coordinate_X: implementation-data-type=IDT_Gen_val_Coordinate_X  # 记忆路线轨迹点坐标X
      element DTE_Coordinate_Y: implementation-data-type=IDT_Gen_val_Coordinate_Y  # 记忆路线轨迹点坐标Y
      element DTE_Coordinate_Z: implementation-data-type=IDT_Gen_val_Coordinate_Z  # 记忆路线轨迹点坐标Z
    IDT_StrVar_ECUSoftwareNumber: category=STRUCTURE, dynamic-array-size-profile=VSA_LINEAR  # ECU软件号
      element sizeIndicator: implementation-data-type=specialIDT_DynamicLengthField_uint32
      element IDT_StrVar_ECUSoftwareNumber: category=ARRAY
        element IDT_StrVar_ECUSoftwareNumber: array-size=8, array-size-handling=ALL-INDICES-SAME-ARRAY-SIZE, array-size-semantics=VARIABLE-SIZE, implementation-data-type=specialIDT_StringRef
    IDT_ADAS_enum_EfficientPassageBtnStFb: category=VALUE, base-type=uint8  # 高效通行软开关设置反馈
    IDT_ADAS_val_YboundMax: category=VALUE, base-type=float32
    IDT_GnssInfo: category=STRUCTURE  # GNSS数据上报
      9 x element, all with category=TYPE_REFERENCE:
        DTE_gpsStatus: implementation-data-type=IDT_GpsStatus  # GPS定位状态
        DTE_longitude: implementation-data-type=IDT_Longitude  # 经度
        DTE_latitude: implementation-data-type=IDT_Latitude  # 纬度
        DTE_speed: implementation-data-type=IDT_Speed  # 速度
        DTE_heading: implementation-data-type=IDT_Heading  # 航向
        DTE_satelliteNum: implementation-data-type=IDT_SatelliteNum  # 搜星数量
        DTE_hdop: implementation-data-type=IDT_HDOP  # 水平定位精度
        DTE_utcTime: implementation-data-type=IDT_UTC  # UTC时间戳
        DTE_altitude: implementation-data-type=IDT_Altitude  # 海拔高速
    IDT_ADAS_enum_LongiTakeOverReq: category=VALUE, base-type=uint8
    IDT_ADAS_enum_VPADriOperateInd: category=VALUE, base-type=uint8
    IDT_ICC_uint16_SelectSlotID: category=VALUE, base-type=uint16
    IDT_ADAS_strt_SlotPoint: category=STRUCTURE
      element DTE_Point_X: implementation-data-type=IDT_ADAS_float_Point  # x坐标位置信息
      element DTE_Point_Y: implementation-data-type=IDT_ADAS_float_Point  # y坐标位置信息
    IDT_ADAS_arr_LaneLineData: category=STRUCTURE, dynamic-array-size-profile=VSA_LINEAR  # 车道线信息数组
      element sizeIndicator: implementation-data-type=specialIDT_DynamicLengthField_uint32
      element IDT_ADAS_arr_LaneLineData: category=ARRAY
        element IDT_ADAS_arr_LaneLineData: array-size=8, array-size-handling=ALL-INDICES-SAME-ARRAY-SIZE, array-size-semantics=VARIABLE-SIZE, implementation-data-type=IDT_ADAS_strt_LaneLine
    IDT_ADAS_enum_RGearDefaultFunctionBtnStFb: category=VALUE, base-type=uint8  # R挡默认打开项设置反馈
    IDT_LanePositionInfo_heading: category=VALUE, base-type=float32
    IDT_ADAS_strt_ICAInfo: category=STRUCTURE
      4 x element, all with category=TYPE_REFERENCE:
        DTE_ICASts: implementation-data-type=IDT_ADAS_enum_ICASts  # ICA 工作状态
        DTE_ICATextInfo: implementation-data-type=IDT_ADAS_enum_ICATextInfo  # ICA 提示信息
        DTE_ICAQuitReason: implementation-data-type=IDT_ADAS_enum_ICAQuitReason  # ICA 退出原因
        DTE_ICASenarioReminder: implementation-data-type=IDT_ADAS_enum_ICASenarioReminder  # ICA场景提示
    IDT_ADAS_arr_Traffic3DSignList: category=STRUCTURE, dynamic-array-size-profile=VSA_LINEAR  # 交通标识数组
      element sizeIndicator: implementation-data-type=specialIDT_DynamicLengthField_uint32
      element IDT_ADAS_arr_Traffic3DSignList: category=ARRAY
        element IDT_ADAS_arr_Traffic3DSignList: array-size=50, array-size-handling=ALL-INDICES-SAME-ARRAY-SIZE, array-size-semantics=VARIABLE-SIZE, implementation-data-type=IDT_ADAS_strt_Traffic3DSign
    IDT_Strt_TollGateLaneInfo: category=STRUCTURE  # 收费站通道信息 Toll gate lane information
      element DTE_TollLaneType: implementation-data-type=IDT_Enum_TollLaneType  # 收费站通道类型 Toll gate lane types
      element DTE_TollGateInfoReserved: implementation-data-type=IDT_Arr_TollGateInfoReserved  # 预留 Reserved
    IDT_keeptimelength: category=VALUE, base-type=uint32  # 保持恢厂状态时长
    IDT_ADAS_Seg_FormOfWay: category=VALUE, base-type=uint8
    IDT_Integer_SignalStrength: category=VALUE, base-type=uint8  # 信号强度
    IDT_ADAS_strt_HPAVPAPathInfo: category=STRUCTURE
      element DTE_Coordinate_X: implementation-data-type=IDT_Gen_val_Coordinate_X  # X坐标
      element DTE_Coordinate_Y: implementation-data-type=IDT_Gen_val_Coordinate_Y  # Y坐标
      element DTE_Coordinate_Z: implementation-data-type=IDT_Gen_val_Coordinate_Z  # Z坐标
    IDT_ICC_arr_CameraSpeed: category=STRUCTURE, dynamic-array-size-profile=VSA_LINEAR
      element sizeIndicator: implementation-data-type=specialIDT_DynamicLengthField_uint32
      element IDT_ICC_arr_CameraSpeed: category=ARRAY
        element IDT_ICC_arr_CameraSpeed: array-size=10, array-size-handling=ALL-INDICES-SAME-ARRAY-SIZE, array-size-semantics=VARIABLE-SIZE, implementation-data-type=IDT_ICC_strt_CameraSpeed
    IDT_ICC_string_Trend: category=STRUCTURE, dynamic-array-size-profile=VSA_LINEAR
      element sizeIndicator: implementation-data-type=specialIDT_DynamicLengthField_uint32
      element IDT_ICC_string_Trend: category=ARRAY
        element IDT_ICC_string_Trend: array-size=1000, array-size-handling=ALL-INDICES-SAME-ARRAY-SIZE, array-size-semantics=VARIABLE-SIZE, implementation-data-type=specialIDT_StringRef
    IDT_ResumeFactorySet: category=VALUE, base-type=uint8  # 恢复出厂设置
    IDT_ADAS_Seg_Offset: category=VALUE, base-type=uint16
    IDT_ICC_int32_AlertLevel: category=VALUE, base-type=sint32  # 预警等级
    IDT_ADAS_enum_SidePassConfirmReq: category=VALUE, base-type=uint8
    IDT_StrVar_TBoxVersion: category=STRUCTURE, dynamic-array-size-profile=VSA_LINEAR  # TBOX版本号
      element sizeIndicator: implementation-data-type=specialIDT_DynamicLengthField_uint32
      element IDT_StrVar_TBoxVersion: category=ARRAY
        element IDT_StrVar_TBoxVersion: array-size=32, array-size-handling=ALL-INDICES-SAME-ARRAY-SIZE, array-size-semantics=VARIABLE-SIZE, implementation-data-type=specialIDT_StringRef
    IDT_StrVar_user: category=STRUCTURE, dynamic-array-size-profile=VSA_LINEAR
      element sizeIndicator: implementation-data-type=specialIDT_DynamicLengthField_uint32
      element IDT_StrVar_user: category=ARRAY
        element IDT_StrVar_user: array-size=15, array-size-handling=ALL-INDICES-SAME-ARRAY-SIZE, array-size-semantics=VARIABLE-SIZE, implementation-data-type=specialIDT_StringRef
    IDT_ADAS_enum_ISLIWarningMod: category=VALUE, base-type=uint8
    IDT_ICC_enum_MNPUseRouteIDBtnSt: category=VALUE, base-type=uint8  # 选中使用的记忆路线ID
    IDT_ICC_enum_NavigationSts: category=VALUE, base-type=uint8
    IDT_ADAS_strt_MNPInfo_2: category=STRUCTURE
      16 x element, all with category=TYPE_REFERENCE:
        DTE_MNPSts: implementation-data-type=IDT_ADAS_enum_MNPSts  # MNP工作状态
        DTE_MNPBuildMapSts: implementation-data-type=IDT_ADAS_enum_MNPBuildMapSts  # MNP建图工作状态
        DTE_MNPNewRoute: implementation-data-type=IDT_ADAS_enum_MNPNewRoute  # 可以新建路线提示
        DTE_MNPRouteMileage: implementation-data-type=IDT_ADAS_enum_MNPRouteMileage  # 当前记忆里程数
        DTE_MNPRouteSaving: implementation-data-type=IDT_ADAS_enum_MNPNewRouteSaving  # 记忆路线保存进度
        DTE_MNPMemRoutesNum: implementation-data-type=IDT_ADAS_arr_MNPMemRoutesNum  # 已记忆路线数量
        DTE_MNPRouteAvailable: implementation-data-type=IDT_ADAS_enum_MNPRouteAvailable  # 记忆路线推荐提示
        DTE_MNPBuildMapTextInfomation: implementation-data-type=IDT_ADAS_enum_MNPBuildMapTextInfo  # 记忆行车建图阶段文言提示信息
        DTE_MNPUseMapTextInfomation: implementation-data-type=IDT_ADAS_enum_MNPUseMapTextInfo  # 记忆行车使用阶段文言提示信息
        DTE_MNPDelRouteID: implementation-data-type=IDT_Str_MemRouteInfo  # 删除的路线ID
        DTE_MNPDelRouteSts: implementation-data-type=IDT_ADAS_enum_MNPDelRouteSts  # 删除路线是否成功
        DTE_MNPNewRouteBtnSt: implementation-data-type=IDT_ADAS_enum_MNPNewRouteBtnSt  # 新建路线按钮高亮提示
        DTE_MNPStopMemRouteDrawing: implementation-data-type=IDT_ADAS_enum_MNPStopMemRouteDrawing  # 通知导航停止记忆路线的描画
        DTE_MNPNewMapInfo: implementation-data-type=IDT_ADAS_strt_MNPRouteInfo  # 新建路线信息
        DTE_MNPAllRoutesStateInfo: implementation-data-type=IDT_ADAS_arr_MNPRoutesStateInfo  # 全部路线的状态信息
        DTE_MNPInfoReserved: implementation-data-type=IDT_MNPInfo_arr_Reserved2  # 预留
    IDT_ICC_enum_HNOACruiseSpdOffsetMod: category=VALUE, base-type=uint8  # 设定车速偏移方式
    IDT_ApnCount: category=VALUE, base-type=sint32
    IDT_ADAS_enum_AESESSTextInfo: category=VALUE, base-type=uint8
    IDT_ICC_int64_Speed: category=VALUE, base-type=sint64
    IDT_Struct_UsbUpdateSta: category=STRUCTURE  # TBOX上报升级状态
      element DTE_UpdSta: implementation-data-type=IDT_Enum_UpdSta  # TBOX升级状态
      element DTE_Progress: implementation-data-type=IDT_Progress  # TBOX升级进度
    IDT_ADAS_Meta_ProtVer_Major: category=VALUE, base-type=uint8
    IDT_ICC_enum_MEBSwtSet: category=VALUE, base-type=uint8  # MEB设置项开关
    IDT_CongestionExtend_arr_Reserved: category=ARRAY
      element Reserved_int32_Type: array-size=15, array-size-semantics=FIXED-SIZE, implementation-data-type=IDT_Reserved_int32_Type
    IDT_ADAS_enum_LDWSts: category=VALUE, base-type=uint8
    IDT_ICC_enum_NOPLaneChangeMod: category=VALUE, base-type=uint8  # NOP变道模式
    IDT_ICC_strt_NaviGreenWaveCarSpeed: category=STRUCTURE  # 绿波车速
      6 x element, all with category=TYPE_REFERENCE:
        DTE_GreenWavePathId: implementation-data-type=IDT_Gen_int64_ID  # 路线ID
        DTE_GreenWaveType: implementation-data-type=IDT_ICC_int32_GreenWaveType  # 绿灯数量类型
        DTE_GreenWaveMaxSpeed: implementation-data-type=IDT_ICC_int64_Speed  # 最大建议车速
        DTE_GreenWaveMinSpeed: implementation-data-type=IDT_ICC_int64_Speed  # 最小建议车速
        DTE_RemainLightCount: implementation-data-type=IDT_Gen_val_int64  # 剩余绿灯数量
        DTE_GreenWaveReserved: implementation-data-type=IDT_GreenWave_arr_Reserved  # 预留
    IDT_WiFiCurConnStatus: category=VALUE, base-type=sint32
    IDT_ICC_boolean_isNew: category=VALUE, base-type=sint32  # 是否是新增电子眼
    IDT_ICC_enum_HPALTEdbm: category=VALUE, base-type=uint8
    IDT_ICC_int32_WeatherID: category=VALUE, base-type=sint32  # 天气 ID
    IDT_ICC_string_Name: category=STRUCTURE, dynamic-array-size-profile=VSA_LINEAR
      element sizeIndicator: implementation-data-type=specialIDT_DynamicLengthField_uint32
      element IDT_ICC_string_Name: category=ARRAY
        element IDT_ICC_string_Name: array-size=1000, array-size-handling=ALL-INDICES-SAME-ARRAY-SIZE, array-size-semantics=VARIABLE-SIZE, implementation-data-type=specialIDT_StringRef
    IDT_ADAS_enum_SceneSts: category=VALUE, base-type=uint8  # 行泊切换状态机
    IDT_CelluarEsimStatus: category=VALUE, base-type=uint32
    IDT_ICC_uint64_Time: category=VALUE, base-type=uint64
    IDT_Str_MemRouteInfo: category=STRUCTURE, dynamic-array-size-profile=VSA_LINEAR
      element sizeIndicator: implementation-data-type=specialIDT_DynamicLengthField_uint32
      element IDT_Str_MemRouteInfo: category=ARRAY
        element IDT_Str_MemRouteInfo: array-size=100, array-size-handling=ALL-INDICES-SAME-ARRAY-SIZE, array-size-semantics=VARIABLE-SIZE, implementation-data-type=specialIDT_StringRef
    IDT_ADAS_arr_MNPMemRoutes: category=STRUCTURE, dynamic-array-size-profile=VSA_LINEAR  # 记忆路线信息数组
      element sizeIndicator: implementation-data-type=specialIDT_DynamicLengthField_uint32
      element IDT_ADAS_arr_MNPMemRoutes: category=ARRAY
        element IDT_ADAS_arr_MNPMemRoutes: array-size=64, array-size-handling=ALL-INDICES-SAME-ARRAY-SIZE, array-size-semantics=VARIABLE-SIZE, implementation-data-type=IDT_ADAS_strt_MNPMemRoute
    IDT_ADAS_enum_GoNotifier: category=VALUE, base-type=uint8
    IDT_Gen_int32_ManeuverID: category=VALUE, base-type=sint32
    IDT_SentryModeSetResult: category=VALUE, base-type=uint32  # 哨兵模式开关结果
    IDT_ADAS_enum_TLRONOFFSts: category=VALUE, base-type=uint8  # 交通灯识别系统开关状态
    IDT_ADAS_enum_PathState: category=VALUE, base-type=uint8
    IDT_Struct_TBOXOTAAPPTSet: category=STRUCTURE  # 设置预约升级时间
      element DTE_ScheduleID: implementation-data-type=IDT_StrVar_ScheduleID  # OTA的任务ID
      element DTE_OTAAPPTSecs: implementation-data-type=IDT_OTAAPPTSecs  # 预约升级时间
    IDT_ADAS_enum_HandsOffWarningStyle: category=VALUE, base-type=uint8  # 脱手报警风格
    IDT_ICC_int32_NaviSplit: category=VALUE, base-type=sint32
    IDT_ADAS_val_MeterPerPixely: category=VALUE, base-type=float32
    IDT_ADAS_val_MeterPerPixelx: category=VALUE, base-type=float32
    IDT_ICC_strt_VpaFcnOperating: category=STRUCTURE
      6 x element, all with category=TYPE_REFERENCE:
        DTE_VPAOperationId: implementation-data-type=IDT_ICC_enum_VPAOperationId  # VPA功能操作指令
        DTE_VPASelectZoneInfo: implementation-data-type=IDT_ICC_strt_VpaSelectZoneInfo  # VPA地图区域选择信息
        DTE_VPASubModReq: implementation-data-type=IDT_ICC_enum_VPASubModReq  # VPA功能模式选择
        DTE_VPAParkingLotOpInfo: implementation-data-type=IDT_ICC_strt_VpaParkingLotInfo  # VPA 停车场操作信息
        DTE_VPASelectSlotId: implementation-data-type=IDT_ADAS_val_SlotID  # VPA选择的目的地车位
        DTE_VPASelectEntranceId: implementation-data-type=IDT_ADAS_val_SlotID  # VPA选择的出入口id
    IDT_ICC_strt_HpaFcnOperating_2: category=STRUCTURE
      10 x element, all with category=TYPE_REFERENCE:
        DTE_HPAOperationId: implementation-data-type=IDT_ICC_enum_HPAOperationId  # HPA功能操作指令
        DTE_HPALearnOperationId: implementation-data-type=IDT_ICC_enum_LearnOperationId  # HPA学习操作指令
        DTE_HPAPathOperation: implementation-data-type=IDT_ICC_strt_HPAPathOperation_2  # HPA路线操作指令
        DTE_SelectSlotId: implementation-data-type=IDT_ICC_uint16_SelectSlotID  # HPA选择流动车位ID
        DTE_SelectPathId: implementation-data-type=IDT_ICC_uint8_SelectPathId  # HPA选择路线ID
        DTE_HPAUndoOperationID: implementation-data-type=IDT_ICC_enum_HPAUndoOperationID  # HPA功能撤回操作指令
        DTE_HPASlotSearchOperationID: implementation-data-type=IDT_ICC_enum_HPASlotSearchOperationID  # HPA沿途找车位操作指令
        DTE_HPASetOnwayLabel: implementation-data-type=IDT_ICC_strt_HPASetOnwayLabel  # 设置沿途标签
        DTE_HPALTEdbm: implementation-data-type=IDT_ICC_enum_HPALTEdbm  # 座舱LTE网络强度
        DTE_HpaFcnReserved: implementation-data-type=IDT_HpaFcn_arr_Reserved  # 预留
    IDT_ICC_int32_LaneCategoryType: category=VALUE, base-type=sint32
    IDT_Struct_VehicleDiagStatus: category=STRUCTURE  # TBOX上报诊断状态
      element DTE_DiagnosisState: implementation-data-type=IDT_Enum_DiagnosisState  # 诊断状态
      element DTE_Step: implementation-data-type=IDT_Step  # 诊断步骤
      element DTE_TotalStep: implementation-data-type=IDT_TotalStep  # 诊断步骤总数
    IDT_ICC_strt_NaviCongestionDetailInfo: category=STRUCTURE
      4 x element, all with category=TYPE_REFERENCE:
        DTE_scopeFlag: implementation-data-type=IDT_ICC_boolean_scopeFlag  # 自车位置是否在拥堵区域内
        DTE_CongestionStatus: implementation-data-type=IDT_ICC_enum_CongestionStatus  # 拥堵程度:0:道路状态未知,1:道路通畅,2:道路缓行, 3:道路阻塞,4:严重拥 堵,5:结尾状态，不应该使用
        DTE_beginExactPoint: implementation-data-type=IDT_ICC_Navi_GpsPoint  # 拥堵起点位置信息
        DTE_endExactPoint: implementation-data-type=IDT_ICC_Navi_GpsPoint  # 拥堵终点点位置信息
    IDT_ADAS_strt_ApaTargetSlotInfo: category=STRUCTURE
      7 x element, all with category=TYPE_REFERENCE:
        DTE_TargetSlotPoint0Top1: implementation-data-type=IDT_ADAS_strt_SlotPoint  # 车位顶点1
        DTE_TargetSlotPoint1Top2: implementation-data-type=IDT_ADAS_strt_SlotPoint  # 车位顶点2
        DTE_TargetSlotPoint2Bottom1: implementation-data-type=IDT_ADAS_strt_SlotPoint  # 车位顶点3
        DTE_TargetSlotPoint3Bottom2: implementation-data-type=IDT_ADAS_strt_SlotPoint  # 车位顶点4
        DTE_TargetSlotType: implementation-data-type=IDT_ADAS_enum_SlotType  # 车位类型
        DTE_TargetSlotAvailableParkInType: implementation-data-type=IDT_ADAS_enum_TargetSlotAvailableParkInType  # 车位可用泊入类型
        DTE_SlotWheelStopperInfo: implementation-data-type=IDT_ADAS_strt_SlotWheelStopperInfo  # 车位轮挡信息
    IDT_IHCInfo_arr_Reserved: category=ARRAY  # 预留
      element Reserved_uint8_Type: array-size=50, array-size-semantics=FIXED-SIZE, implementation-data-type=IDT_Reserved_uint8_Type
    IDT_ICC_int32_TunnelFlag: category=VALUE, base-type=sint32
    IDT_ADAS_arr_PathPoint: category=STRUCTURE, dynamic-array-size-profile=VSA_LINEAR
      element sizeIndicator: implementation-data-type=specialIDT_DynamicLengthField_uint32
      element IDT_ADAS_arr_PathPoint: category=ARRAY
        element IDT_ADAS_arr_PathPoint: array-size=2000, array-size-handling=ALL-INDICES-SAME-ARRAY-SIZE, array-size-semantics=VARIABLE-SIZE, implementation-data-type=IDT_ADAS_strt_HPAVPAPathInfo
    IDT_ICC_enum_DatauploadBtn: category=VALUE, base-type=uint8  # 一键数据回传使能
    IDT_ADAS_enum_TimeGapSet: category=VALUE, base-type=uint8
    IDT_ADAS_strt_HPAPathDetail: category=STRUCTURE
      8 x element, all with category=TYPE_REFERENCE:
        DTE_HpaPathID: implementation-data-type=IDT_Gen_val_ID  # 路线ID
        DTE_PathState: implementation-data-type=IDT_ADAS_enum_PathState  # 路线学习状态
        DTE_PathName: implementation-data-type=IDT_ADAS_string_PathName  # 路线名称
        DTE_PathSaveProgress: implementation-data-type=IDT_ADAS_val_PathSaveProgress  # 路线保存进度
        DTE_PathLength: implementation-data-type=IDT_ADAS_val_ParkingDist  # 路线长度
        DTE_LinePoint: implementation-data-type=IDT_ADAS_arr_PathPoint  # 路线学习点集
        DTE_PathMatchSts: implementation-data-type=IDT_ADAS_enum_PathMatchSts  # 路线匹配状态
        DTE_PathLabel: implementation-data-type=IDT_ADAS_enum_PathLabel  # 路线标签
    IDT_WiFiConnStatus: category=STRUCTURE  # Wifi当前连接状态
      6 x element, all with category=TYPE_REFERENCE:
        DTE_wiFiApName: implementation-data-type=IDT_WiFiApName  # 登入热点ID
        DTE_wiFiCurConnStatus: implementation-data-type=IDT_WiFiCurConnStatus  # 连接状态
        DTE_wiFiStrength: implementation-data-type=IDT_WiFiStrength  # 信号强度
        DTE_wiFiUploadDataStatus: implementation-data-type=IDT_WiFiUploadDataStatus  # 上行数据状态
        DTE_wiFiDownloadDataStatus: implementation-data-type=IDT_WiFiDownloadDataStatus  # 下行数据状态
        DTE_wiFiLinkedInternet: implementation-data-type=IDT_WiFiLinkedInternet  # 是否是可以上网
    IDT_ADAS_enum_SglAutoMergeChangeLane: category=VALUE, base-type=uint16  # 自动并道换道
    IDT_ICC_arr_NaviIntervalCameraInfo: category=STRUCTURE, dynamic-array-size-profile=VSA_LINEAR  # 导航模式下区间测速信息
      element sizeIndicator: implementation-data-type=specialIDT_DynamicLengthField_uint32
      element IDT_ICC_arr_NaviIntervalCameraInfo: category=ARRAY
        element IDT_ICC_arr_NaviIntervalCameraInfo: array-size=2, array-size-handling=ALL-INDICES-SAME-ARRAY-SIZE, array-size-semantics=VARIABLE-SIZE, implementation-data-type=IDT_ICC_strt_NaviIntervalCameraInfo
    IDT_UUIDCode: category=STRUCTURE, dynamic-array-size-profile=VSA_LINEAR  # 用户唯一识别码
      element sizeIndicator: implementation-data-type=specialIDT_DynamicLengthField_uint32
      element IDT_UUIDCode: category=ARRAY
        element IDT_UUIDCode: array-size=128, array-size-handling=ALL-INDICES-SAME-ARRAY-SIZE, array-size-semantics=VARIABLE-SIZE, implementation-data-type=specialIDT_StringRef
    IDT_DataInt8: category=VALUE, base-type=sint8  # 有符号8型数据
    IDT_SentryModeCmd: category=VALUE, base-type=uint32  # 哨兵模式开关设置
    IDT_Enum_TSPConnectionState: category=VALUE, base-type=uint8  # TSP连接状态
    IDT_ADAS_enum_AESSts: category=VALUE, base-type=uint8
    IDT_ADAS_strt_APARPAInfo_2: category=STRUCTURE
      28 x element, all with category=TYPE_REFERENCE:
        DTE_ApaOperationResp: implementation-data-type=IDT_ADAS_enum_ParkingOperationResp  # APARPA按键状态反馈
        DTE_ApaRpaSts: implementation-data-type=IDT_ADAS_enum_ApaRpaSts  # APARPA状态机信息
        DTE_ParkingTypeSelectFb: implementation-data-type=IDT_ADAS_enum_PicPocType  # 泊入泊出方式选择反馈
        DTE_ParkinDirectionSts: implementation-data-type=IDT_ADAS_enum_ParkinDirectionSts  # 泊入方向状态反馈
        DTE_FreeParkSlotAvaSts: implementation-data-type=IDT_Gen_enum_AvailableSts  # 自由泊入车位可用性状态
        DTE_ParkOutDirectionSt: implementation-data-type=IDT_ADAS_enum_ParkOutDirectionSt  # 泊出方向状态
        DTE_POCFLParallelSts: implementation-data-type=IDT_Gen_enum_ValidityStatus  # 左前平行泊出位置可用性
        DTE_POCFLCorssSts: implementation-data-type=IDT_Gen_enum_ValidityStatus  # 左前垂直泊出位置可用性
        DTE_POCFRParallelSts: implementation-data-type=IDT_Gen_enum_ValidityStatus  # 右前平行泊出位置可用性
        DTE_POCFRCrossSts: implementation-data-type=IDT_Gen_enum_ValidityStatus  # 右前垂直泊出位置可用性
        DTE_POCFrontCrossSts: implementation-data-type=IDT_Gen_enum_ValidityStatus  # 前方垂直泊出位置可用性
        DTE_POCRearCrossSts: implementation-data-type=IDT_Gen_enum_ValidityStatus  # 后方垂直泊出位置可用性
        DTE_POCRLCrossSts: implementation-data-type=IDT_Gen_enum_ValidityStatus  # 左后方垂直泊出位置可用性
        DTE_POCRRCrossSts: implementation-data-type=IDT_Gen_enum_ValidityStatus  # 右后方垂直泊出位置可用性
        DTE_APAActiveFuncInd: implementation-data-type=IDT_ADAS_enum_APAActiveFuncInd  # 自动泊车激活功能
        DTE_ApaSelectIDInd: implementation-data-type=IDT_ADAS_val_SlotID  # 泊车选择的车位ID
        DTE_ParkingStopDist: implementation-data-type=IDT_ADAS_val_ParkingDist  # 泊车剩余距离
        DTE_APARPATrajectory: implementation-data-type=IDT_ADAS_arr_TrajectoryPoint  # 泊车规划引导线
        DTE_RpaAvaliableStatus: implementation-data-type=IDT_Gen_enum_AvailableSts  # Rpa可用状态
        DTE_ApaEgoVehPos: implementation-data-type=IDT_ADAS_strt_EgoPose  # 泊车位姿信息
        DTE_ApaTargetSlotInfo: implementation-data-type=IDT_ADAS_strt_ApaTargetSlotInfo  # 泊入目标车位信息
        DTE_APAStartButtonSts: implementation-data-type=IDT_ADAS_enum_ParkingButtonSts  # 开始泊车按钮
        DTE_APARPAButtonSts: implementation-data-type=IDT_ADAS_enum_ParkingButtonSts  # 自动泊车切换RPA按钮
        DTE_BAFASts: implementation-data-type=IDT_ADAS_enum_BAFASts  # 遥控直入直出状态机信息
        DTE_ParkInDirectionAvaType: implementation-data-type=IDT_ADAS_enum_ParkInDirectionAvaType  # 泊入车位的可泊方向类型
        DTE_APAResumeButtonSts: implementation-data-type=IDT_ADAS_enum_ParkingButtonSts  # 恢复泊车按钮可用状态
        DTE_APAPopup: implementation-data-type=IDT_ADAS_enum_APAPopup  # APA弹窗
        DTE_APARPAInfoReserved: implementation-data-type=IDT_APARPAInfo_arr_Reserved  # 预留
    IDT_ADAS_enum_ApaRpaSts: category=VALUE, base-type=uint8
    IDT_U32_TBOXOSRTC: category=VALUE, base-type=uint32  # TBOX的系统RTC时间
    IDT_ADAS_enum_NOPLaneChangeMod: category=VALUE, base-type=uint8
    IDT_SentryModePlanFb: category=VALUE, base-type=uint32  # 哨兵模式预约设置反馈
    IDT_ICC_float_Percent: category=VALUE, base-type=float32
    IDT_CellularRat: category=VALUE, base-type=uint32  # 网络制式
    IDT_ADAS_enum_MNPMemRouteUseFlag: category=VALUE, base-type=uint8  # 路线是否正在使用中
    IDT_ICC_enum_Cause: category=VALUE, base-type=uint8  # 拥堵原因
    IDT_ADAS_val_laneID: category=VALUE, base-type=sint8
    IDT_Arr_VersInfoReserved: category=ARRAY  # 预留 Reserved
      element Reserved_uint8_Type: array-size=450, array-size-semantics=FIXED-SIZE, implementation-data-type=IDT_Reserved_uint8_Type
    IDT_ADAS_val_ParkingProcessTakeTime: category=VALUE, base-type=uint8
    IDT_EphemerisDataIndex: category=VALUE, base-type=uint32  # 数据包索引，针对A/PGNSS，每次从1开始，每包递增，针对实时星历，固定填0
    IDT_ADAS_strt_APARPAInfo: category=STRUCTURE
      21 x element, all with category=TYPE_REFERENCE:
        DTE_ApaOperationResp: implementation-data-type=IDT_ADAS_enum_ParkingOperationResp  # APARPA按键状态反馈
        DTE_ApaRpaSts: implementation-data-type=IDT_ADAS_enum_ApaRpaSts  # APARPA状态机信息
        DTE_ParkingTypeSelectFb: implementation-data-type=IDT_ADAS_enum_PicPocType  # 泊入泊出方式选择反馈
        DTE_ParkinDirectionSts: implementation-data-type=IDT_ADAS_enum_ParkinDirectionSts  # 泊入方向状态反馈
        DTE_FreeParkSlotAvaSts: implementation-data-type=IDT_Gen_enum_AvailableSts  # 自由泊入车位可用性状态
        DTE_ParkOutDirectionSt: implementation-data-type=IDT_ADAS_enum_ParkOutDirectionSt  # 泊出方向状态
        DTE_POCFLParallelSts: implementation-data-type=IDT_Gen_enum_ValidityStatus  # 左前平行泊出位置可用性
        DTE_POCFLCorssSts: implementation-data-type=IDT_Gen_enum_ValidityStatus  # 左前垂直泊出位置可用性
        DTE_POCFRParallelSts: implementation-data-type=IDT_Gen_enum_ValidityStatus  # 右前平行泊出位置可用性
        DTE_POCFRCrossSts: implementation-data-type=IDT_Gen_enum_ValidityStatus  # 右前垂直泊出位置可用性
        DTE_POCFrontCrossSts: implementation-data-type=IDT_Gen_enum_ValidityStatus  # 前方垂直泊出位置可用性
        DTE_POCRearCrossSts: implementation-data-type=IDT_Gen_enum_ValidityStatus  # 后方垂直泊出位置可用性
        DTE_POCRLCrossSts: implementation-data-type=IDT_Gen_enum_ValidityStatus  # 左后方垂直泊出位置可用性
        DTE_POCRRCrossSts: implementation-data-type=IDT_Gen_enum_ValidityStatus  # 右后方垂直泊出位置可用性
        DTE_APAActiveFuncInd: implementation-data-type=IDT_ADAS_enum_APAActiveFuncInd  # 自动泊车激活功能
        DTE_ApaSelectIDInd: implementation-data-type=IDT_ADAS_val_SlotID  # 泊车选择的车位ID
        DTE_ParkingStopDist: implementation-data-type=IDT_ADAS_val_ParkingDist  # 泊车剩余距离
        DTE_APARPATrajectory: implementation-data-type=IDT_ADAS_arr_TrajectoryPoint  # 泊车规划引导线
        DTE_RpaAvaliableStatus: implementation-data-type=IDT_Gen_enum_AvailableSts  # Rpa可用状态
        DTE_ApaEgoVehPos: implementation-data-type=IDT_ADAS_strt_EgoPose  # 泊车位姿信息
        DTE_ApaTargetSlotInfo: implementation-data-type=IDT_ADAS_strt_ApaTargetSlotInfo  # 泊入目标车位信息
    IDT_HPAPathInfo_arr_Reserved: category=ARRAY  # 预留
      element Reserved_uint8_Type: array-size=5, array-size-semantics=FIXED-SIZE, implementation-data-type=IDT_Reserved_uint8_Type
    IDT_ADAS_ProfShort_Dist1: category=VALUE, base-type=uint16
    IDT_ADAS_enum_NarrowRoadAssistSts: category=VALUE, base-type=uint8  # 窄路辅助功能状态
    IDT_ADAS_arr_DynamicObjects_2: category=STRUCTURE, dynamic-array-size-profile=VSA_LINEAR  # 行车动态目标数组
      element sizeIndicator: implementation-data-type=specialIDT_DynamicLengthField_uint32
      element IDT_ADAS_arr_DynamicObjects_2: category=ARRAY
        element IDT_ADAS_arr_DynamicObjects_2: array-size=150, array-size-handling=ALL-INDICES-SAME-ARRAY-SIZE, array-size-semantics=VARIABLE-SIZE, implementation-data-type=IDT_ADAS_strt_DynamicObject_2
    IDT_SecondTimeStampOffset: category=VALUE, base-type=sint64  # 秒差值
    IDT_Step: category=VALUE, base-type=uint8  # 诊断步骤
    IDT_ADAS_enum_NOPLaneChangeStyle: category=VALUE, base-type=uint8
    IDT_ADAS_strt_VPAParkingSLot: category=STRUCTURE  # VPA停车位信息
      10 x element, all with category=TYPE_REFERENCE:
        DTE_VPASlotID: implementation-data-type=IDT_ADAS_val_SlotID  # 车位ID
        DTE_VPASlotType: implementation-data-type=IDT_ADAS_enum_SlotType  # 车位类型
        DTE_VPASlotStatus: implementation-data-type=IDT_ADAS_enum_SlotStatus  # 车位可用状态
        DTE_VPASlotPointTop1: implementation-data-type=IDT_ADAS_strt_HPAVPAPathInfo  # 车位顶点1
        DTE_VPASlotPointTop2: implementation-data-type=IDT_ADAS_strt_HPAVPAPathInfo  # 车位顶点2
        DTE_VPASlotPointBottom1: implementation-data-type=IDT_ADAS_strt_HPAVPAPathInfo  # 车位顶点3
        DTE_VPASlotPointBottom2: implementation-data-type=IDT_ADAS_strt_HPAVPAPathInfo  # 车位顶点4
        DTE_VPASlotNum: implementation-data-type=IDT_ADAS_val_SlotID  # 车位序号
        DTE_VPASlotFloor: implementation-data-type=IDT_ADAS_enum_VPAFloor  # 车位楼层
        DTE_SlotWheelStopperInfo: implementation-data-type=IDT_ADAS_strt_SlotWheelStopperInfo  # 车位轮挡信息
    IDT_ADAS_strt_HpaEndPos: category=STRUCTURE
      5 x element, all with category=TYPE_REFERENCE, implementation-data-type=IDT_ADAS_strt_SlotPoint:
        DTE_EndPosCenterPoint  # 终点车位的中心点
        DTE_EndSlotPoint0Top1  # 终点车位顶点1
        DTE_EndSlotPoint1Top2  # 终点车位顶点2
        DTE_EndSlotPoint2Bottom1  # 终点车位顶点3
        DTE_EndSlotPoint3Bottom2  # 终点车位顶点4
    IDT_SimSwitchEvent: category=STRUCTURE  # 切卡事件通知
      4 x element, all with category=TYPE_REFERENCE:
        DTE_simSwitchStatus: implementation-data-type=IDT_SimSwitchStatus  # Sim切换状态
        DTE_simSwitchTargetMode: implementation-data-type=IDT_SimMode  # Sim卡切换目标模式
        DTE_simSwitchTargetOperator: implementation-data-type=IDT_SimOperator  # Sim卡切换目标运营商
        DTE_reserved: implementation-data-type=IDT_SimSwitchEventReserved  # 预留字段
    IDT_ParkingAreaCellMapInfo: category=STRUCTURE  # 进入停车场时，上报停车场范围内的所有小区消息，以小区为维度
      element DTE_cellNum: implementation-data-type=IDT_CellularCellNum  # 小区数量
      element DTE_cellMapArray: implementation-data-type=IDT_CellularCellMapArray  # 小区地图数组
    IDT_ICC_boolean_scopeFlag: category=VALUE, base-type=uint8  # 自车位置是否在拥堵区域内
    IDT_ADAS_enum_TLATextInfo: category=VALUE, base-type=uint8  # TLA提示信息
    IDT_IsSimInPostion: category=VALUE, base-type=uint32  # Sim卡是否在位
    IDT_StrVar_ModemVersion: category=STRUCTURE, dynamic-array-size-profile=VSA_LINEAR  # Modem版本号
      element sizeIndicator: implementation-data-type=specialIDT_DynamicLengthField_uint32
      element IDT_StrVar_ModemVersion: category=ARRAY
        element IDT_StrVar_ModemVersion: array-size=40, array-size-handling=ALL-INDICES-SAME-ARRAY-SIZE, array-size-semantics=VARIABLE-SIZE, implementation-data-type=specialIDT_StringRef
    IDT_ADAS_val_latitude: category=VALUE, base-type=float64
    IDT_SingleSimDetailInfo: category=STRUCTURE  # 单sim卡详细信息
      4 x element, all with category=TYPE_REFERENCE:
        DTE_simOperator: implementation-data-type=IDT_SimOperator  # sim卡运营商
        DTE_simRealNameInfo: implementation-data-type=IDT_SimRealNameInfo  # 实名制信息
        DTE_isSimInPostion: implementation-data-type=IDT_IsSimInPostion  # 卡是否在位
        DTE_reserved: implementation-data-type=IDT_SingleSimDetailInfoReserved  # 预留字段
    IDT_ADAS_strt_AdvanceParkingInfo_2: category=STRUCTURE
      28 x element, all with category=TYPE_REFERENCE:
        DTE_HPASts: implementation-data-type=IDT_ADAS_enum_HPASts  # 记忆泊车状态信息
        DTE_HPASearchOnWaySelectSlotID: implementation-data-type=IDT_ADAS_val_SlotID  # 记忆泊车沿途找车位泊入车位在记忆路线中的车位ID
        DTE_HPAUseData: implementation-data-type=IDT_ADAS_strt_HpaUseData  # 记忆泊车循迹信息统计
        DTE_VPAWarningInfo: implementation-data-type=IDT_ADAS_enum_VPAWarningInfo  # 代客泊车报警信息
        DTE_HPAPathSelectIDInd: implementation-data-type=IDT_Gen_val_ID  # 记忆泊车路线选择ID反馈
        DTE_HPAVPARepalyRemind: implementation-data-type=IDT_ADAS_enum_HPAVPARepalyRemind  # 记忆泊车代客泊车语音及显示提示
        DTE_HPAVPATrajectory: implementation-data-type=IDT_ADAS_arr_HPATrajectoryPoint  # 泊车规划引导线
        DTE_HpaOperationResp: implementation-data-type=IDT_ADAS_enum_ParkingOperationResp  # HPA按键状态反馈
        DTE_HpaEgoVehPos: implementation-data-type=IDT_ADAS_strt_EgoPose  # HPA位姿信息
        DTE_VPADropOffVld: implementation-data-type=IDT_Gen_enum_AvailableSts  # 代客泊车Drop off 可用性
        DTE_VPAPickUpVld: implementation-data-type=IDT_Gen_enum_AvailableSts  # 代客泊车Pick up 可用性
        DTE_VPASelfMapBuildVld: implementation-data-type=IDT_Gen_enum_AvailableSts  # 代客泊车自建地图可用性
        DTE_VPAProcessBarInd: implementation-data-type=IDT_ADAS_val_ParkingProgressBarInd  # 代客泊车进度条
        DTE_VPAVld: implementation-data-type=IDT_Gen_enum_AvailableSts  # 代客泊车可用性
        DTE_VPAPickUpPosSelectReq: implementation-data-type=IDT_ADAS_enum_VPAPickUpPosSelectReq  # 代客泊车Pick up 位置选择请求
        DTE_VPADropOffPosSelectReq: implementation-data-type=IDT_ADAS_enum_VPADropOffPosSelectReq  # 代客泊车Drop off位置选择请求
        DTE_VPASts: implementation-data-type=IDT_ADAS_enum_VPASts  # 代客泊车状态信息
        DTE_VPAFuncTypeFb: implementation-data-type=IDT_ADAS_enum_VPAFunctionType  # 代客泊车当前激活功能类型反馈
        DTE_VPARemainingDist: implementation-data-type=IDT_ADAS_val_ParkingDist  # 代客泊车剩余距离
        DTE_HPARequestAPAUI: implementation-data-type=IDT_ADAS_enum_HPARequestAPAUI  # 记忆泊车调用自动泊车UI请求
        DTE_HpaActiveCheckSts: implementation-data-type=IDT_ADAS_enum_HpaActiveCheckSts  # 记忆泊车激活检测结果反馈
        DTE_HPAReplayRecAvl: implementation-data-type=IDT_Gen_enum_AvailableSts  # 记忆泊车推荐回放路线可用
        DTE_HPAPopup: implementation-data-type=IDT_ADAS_enum_HPAPopup  # 记忆泊车弹窗
        DTE_HPAStartButtonSts: implementation-data-type=IDT_ADAS_enum_ParkingButtonSts  # 记忆泊车开始按钮
        DTE_HPAResumeButtonSts: implementation-data-type=IDT_ADAS_enum_ParkingButtonSts  # 记忆泊车恢复按钮
        DTE_HPARPAButtonSts: implementation-data-type=IDT_ADAS_enum_ParkingButtonSts  # 记忆泊车切换RPA按钮
        DTE_CreatPathButtonSts: implementation-data-type=IDT_ADAS_enum_ParkingButtonSts  # 创建路线图标显示状态
        DTE_AdvPrkgReserved: implementation-data-type=IDT_AdvPrkg_arr_Reserved  # 预留
    IDT_ADAS_string_PathName: category=STRUCTURE, dynamic-array-size-profile=VSA_LINEAR
      element sizeIndicator: implementation-data-type=specialIDT_DynamicLengthField_uint32
      element IDT_ADAS_string_PathName: category=ARRAY
        element IDT_ADAS_string_PathName: array-size=20, array-size-handling=ALL-INDICES-SAME-ARRAY-SIZE, array-size-semantics=VARIABLE-SIZE, implementation-data-type=specialIDT_StringRef
    IDT_ICC_enum_OutsideParkingBtnSt: category=VALUE, base-type=uint8  # 离车泊入软开关
    IDT_ADAS_strt_VPARoadLinePoint: category=STRUCTURE  # VPA中心道路点的结构
      element DTE_Point: implementation-data-type=IDT_ADAS_strt_VPAPointType  # 路线点
      element DTE_Layer: implementation-data-type=IDT_ADAS_enum_VPAFloor  # 所属楼层
    IDT_ADAS_val_TrafficLightCountdownNumber: category=VALUE, base-type=uint8
    IDT_ICC_enum_LearnOperationId: category=VALUE, base-type=uint8
    IDT_ADAS_enum_iLOAActdirection: category=VALUE, base-type=uint8
    IDT_LocMatchInfo_arr_Reserved: category=ARRAY  # 预留
      element Reserved_int32_Type: array-size=50, array-size-semantics=FIXED-SIZE, implementation-data-type=IDT_Reserved_int32_Type
    IDT_RoadPointCellArray: category=STRUCTURE, dynamic-array-size-profile=VSA_LINEAR  # 代客泊车单点小区信息数组
      element sizeIndicator: implementation-data-type=specialIDT_DynamicLengthField_uint32
      element IDT_RoadPointCellArray: category=ARRAY
        element IDT_RoadPointCellArray: array-size=8, array-size-handling=ALL-INDICES-SAME-ARRAY-SIZE, array-size-semantics=VARIABLE-SIZE, implementation-data-type=IDT_RoadPointCellInfo
    IDT_ADAS_enum_ISLISt: category=VALUE, base-type=uint8
    IDT_DVRcameraSts: category=VALUE, base-type=uint8
    IDT_ADAS_strt_VPASpot: category=STRUCTURE  # VPA用户特殊车位属性信息
      4 x element, all with category=TYPE_REFERENCE:
        DTE_VPASlotID: implementation-data-type=IDT_ADAS_val_SlotID  # 车位ID
        DTE_VPASpotName: implementation-data-type=IDT_ADAS_string_VPASpotName  # 用户特殊车位名字
        DTE_VPASpotFloor: implementation-data-type=IDT_ADAS_enum_VPAFloor  # 用户特殊车位的楼层
        DTE_VPASpotLabel: implementation-data-type=IDT_ADAS_arr_VPASpotLabel  # 用户特殊车位的标签信息
    IDT_ICC_int32_Busway: category=VALUE, base-type=sint32
    IDT_ADAS_strt_VPASpeedBump: category=STRUCTURE  # VPA地图范围
      element DTE_VPASpeedBumpFloor: implementation-data-type=IDT_ADAS_enum_VPAFloor  # 范围所属楼层
      element DTE_VPASpeedBumpStartPoint: implementation-data-type=IDT_ADAS_strt_VPAPointType  # 减速带起始点
      element DTE_VPASpeedBumpEndPoint: implementation-data-type=IDT_ADAS_strt_VPAPointType  # 监督带终点
    IDT_ADAS_strt_MNPAllRoutesInfo: category=STRUCTURE  # 全部路线信息
      element DTE_MNPRoutesInfo: implementation-data-type=IDT_ADAS_arr_MNPRoutesInfo  # 记忆路线信息数组
      element DTE_MNPMemRoutesNum: implementation-data-type=IDT_ADAS_arr_MNPMemRoutesNum  # 记忆路线数量
    IDT_TolNtfADDrivingCardinfo_arr_Reserved: category=ARRAY
      element Reserved_uint8_Type: array-size=100, array-size-semantics=FIXED-SIZE, implementation-data-type=IDT_Reserved_uint8_Type
    IDT_ADAS_strt_Traffic3DSign: category=STRUCTURE  # 交通标识信息
      4 x element, all with category=TYPE_REFERENCE:
        DTE_Traffic3DSignID: implementation-data-type=IDT_Gen_val_ID  # 交通标识ID
        DTE_Traffic3DSignPos: implementation-data-type=IDT_ADAS_strt_Traffic3DSignPos  # 交通标识位置
        DTE_Traffic3DSignType: implementation-data-type=IDT_ADAS_enum_Traffic3DSignType  # 交通标识类型
        DTE_Traffic3DSignReserved: implementation-data-type=IDT_Traffic3DSign_arr_Reserved  # 预留
    IDT_ICC_strt_LocMatchInfo: category=STRUCTURE  # 定位信息
      7 x element, all with category=TYPE_REFERENCE:
        DTE_Formway: implementation-data-type=IDT_ICC_int32_FormWay
        DTE_LinkType: implementation-data-type=IDT_ICC_int32_LinkType
        DTE_OwnerShip: implementation-data-type=IDT_ICC_int32_OwnerShip
        DTE_RoadClass: implementation-data-type=IDT_ICC_int32_RoadClass
        DTE_CurrentRoadSpeed: implementation-data-type=IDT_ICC_int32_Speed
        DTE_RoadName: implementation-data-type=IDT_ICC_string_RoadName
        DTE_LocMatchInfoReserved: implementation-data-type=IDT_LocMatchInfo_arr_Reserved  # 预留
    IDT_MNPRouteInfo_arr_Reserved: category=ARRAY
      element Reserved_uint8_Type: array-size=20, array-size-semantics=FIXED-SIZE, implementation-data-type=IDT_Reserved_uint8_Type
    IDT_SentryModePlanTime_flag: category=VALUE, base-type=uint32  # 哨兵模式预约开启开关
    IDT_PointIndex: category=VALUE, base-type=sint32  # 单点索引
    IDT_ICC_int32_Time: category=VALUE, base-type=sint32
    IDT_ADAS_arr_ParkingSlot: category=STRUCTURE, dynamic-array-size-profile=VSA_LINEAR
      element sizeIndicator: implementation-data-type=specialIDT_DynamicLengthField_uint32
      element IDT_ADAS_arr_ParkingSlot: category=ARRAY
        element IDT_ADAS_arr_ParkingSlot: array-size=20, array-size-handling=ALL-INDICES-SAME-ARRAY-SIZE, array-size-semantics=VARIABLE-SIZE, implementation-data-type=IDT_ADAS_strt_ParkingSlot
    IDT_ADAS_arr_OCCInfoList: category=STRUCTURE, dynamic-array-size-profile=VSA_LINEAR  # freespace数组
      element sizeIndicator: implementation-data-type=specialIDT_DynamicLengthField_uint32
      element IDT_ADAS_arr_OCCInfoList: category=ARRAY
        element IDT_ADAS_arr_OCCInfoList: array-size=10000, array-size-handling=ALL-INDICES-SAME-ARRAY-SIZE, array-size-semantics=VARIABLE-SIZE, implementation-data-type=IDT_ADAS_strt_OCCInfo
    IDT_Gen_enum_ValidityStatus: category=VALUE, base-type=uint8
    IDT_ADAS_enum_iLOATextInfo: category=VALUE, base-type=uint8
    IDT_ADAS_enum_HNOPConfidence: category=VALUE, base-type=uint8  # 高速领航辅助置信度
    IDT_CellularNetworkInfo: category=STRUCTURE  # 蜂窝网信息状态上报
      7 x element, all with category=TYPE_REFERENCE:
        DTE_celluarRegisterStatus: implementation-data-type=IDT_CelluarRegisterStatus  # 网络注册状态
        DTE_celluarEsimStatus: implementation-data-type=IDT_CelluarEsimStatus  # SIM卡状态
        DTE_celluarServiceStatus: implementation-data-type=IDT_CelluarServiceStatus  # 系统服务状态
        DTE_celluarRoamingStatus: implementation-data-type=IDT_CelluarRoamingStatus  # 网络漫游状态
        DTE_strength: implementation-data-type=IDT_Strength  # 网络信号状态
        DTE_apnCount: implementation-data-type=IDT_ApnCount  # apn个数
        DTE_apnArray: implementation-data-type=IDT_ApnArray  # apn数组
    IDT_Gen_val_Yaw: category=VALUE, base-type=float32  # 偏航角
    IDT_StrVar_usid: category=STRUCTURE, dynamic-array-size-profile=VSA_LINEAR
      element sizeIndicator: implementation-data-type=specialIDT_DynamicLengthField_uint32
      element IDT_StrVar_usid: category=ARRAY
        element IDT_StrVar_usid: array-size=32, array-size-handling=ALL-INDICES-SAME-ARRAY-SIZE, array-size-semantics=VARIABLE-SIZE, implementation-data-type=specialIDT_StringRef
    IDT_MixForkInfo_arr_Reserved: category=ARRAY
      element Reserved_int32_Type: array-size=20, array-size-semantics=FIXED-SIZE, implementation-data-type=IDT_Reserved_int32_Type
    IDT_ADAS_enum_DMSWarning: category=VALUE, base-type=uint8  # 脱眼报警
    IDT_Enum_CamStreamSt: category=VALUE, base-type=uint8  # 相机视频流状态反馈 Camera Video Stream Status Response
    IDT_LCM_strt_IMUData: category=STRUCTURE  # Measuring Data of IMU
      8 x element, all with category=TYPE_REFERENCE:
        DTE_IMU_Acc_X: implementation-data-type=IDT_LCM_IMU_Acc_X  # 加速度计:惯导X轴
        DTE_IMU_Acc_Y: implementation-data-type=IDT_LCM_IMU_Acc_Y  # 加速度计:惯导Y轴
        DTE_IMU_Acc_Z: implementation-data-type=IDT_LCM_IMU_Acc_Z  # 加速度计:惯导Z轴
        DTE_IMU_Gyro_X: implementation-data-type=IDT_LCM_IMU_Gyro_X  # 陀螺:惯导X轴
        DTE_IMU_Gyro_Y: implementation-data-type=IDT_LCM_IMU_Gyro_Y  # 陀螺:惯导Y轴
        DTE_IMU_Gyro_Z: implementation-data-type=IDT_LCM_IMU_Gyro_Z  # 陀螺:惯导Z轴
        DTE_IMU_gpsWeek: implementation-data-type=IDT_LCM_IMU_gpsWeek  # GPS周，起点时间是1980年1月6日0时0分0秒，未同步恒为0
        DTE_IMU_gpsSow: implementation-data-type=IDT_LCM_IMU_gpsSow  # GPS周内秒，起点每周日的0时0点0分0秒，未同步恒为0
    IDT_ADAS_strt_DynamicObject_2: category=STRUCTURE
      11 x element, all with category=TYPE_REFERENCE:
        DTE_objectId: implementation-data-type=IDT_Gen_uint64_ID  # 目标id
        DTE_objectType: implementation-data-type=IDT_ADAS_enum_DynamicObjectType  # 目标类型
        DTE_lightStatus: implementation-data-type=IDT_ADAS_enum_LightStatus  # 目标灯光状态
        DTE_objectPoseX: implementation-data-type=IDT_Gen_val_Coordinate_X  # 目标位置X坐标
        DTE_objectPoseY: implementation-data-type=IDT_Gen_val_Coordinate_Y  # 目标位置Y坐标
        DTE_objectYaw: implementation-data-type=IDT_Gen_val_Yaw  # 目标位姿
        DTE_objectColor: implementation-data-type=IDT_ADAS_enum_ObjectColor  # 高亮显示
        DTE_objectVelocityX: implementation-data-type=IDT_ADAS_val_vehicleSpd  # 目标X向速度
        DTE_objectVelocityY: implementation-data-type=IDT_ADAS_val_vehicleSpd  # 目标Y向速度
        DTE_timestampnSec: implementation-data-type=IDT_ADAS_val_timestampnSec  # 时间戳-纳秒
        DTE_laneID: implementation-data-type=IDT_ADAS_uint64_laneID  # 目标所属车道ID
    IDT_Strt_GNSSInfo: category=STRUCTURE  # GNSS信息
      12 x element, all with category=TYPE_REFERENCE:
        DTE_LongitudeInfo: implementation-data-type=IDT_ADAS_val_longitude  # 经度信息 Longitude information
        DTE_LatitudeInfo: implementation-data-type=IDT_ADAS_val_latitude  # 纬度信息 Latitude information
        DTE_HDOPInfo: implementation-data-type=IDT_Dbl_HDOPfInfo  # 水平精度因子信息 Horizontal dilution of precision information
        DTE_AltitudeInfo: implementation-data-type=IDT_ADAS_val_altitude  # 海拔高度信息 Altitude information
        DTE_VDOPInfo: implementation-data-type=IDT_Dbl_VDOPInfo  # 垂直精度因子信息 Vertical dilution of precision information
        DTE_PDOPInfo: implementation-data-type=IDT_Dbl_PDOPInfo  # 位置精度因子信息 Position dilution of precision information
        DTE_GndSpdInfo: implementation-data-type=IDT_Flt_GndSpdInfo  # 地面速度 (米每秒)信息 Ground velocity (meters per second) information
        DTE_TimeInfo: implementation-data-type=IDT_TimeManagement  # 时间信息 time information
        DTE_GndHeadInfo: implementation-data-type=IDT_Dbl_GndHeadInfo  # 地面航向信息 Ground course information
        DTE_SatelTotNrInfo: implementation-data-type=IDT_Enum_SatelTotNrInfo  # 卫星总个数信息 Total number of satellites information
        DTE_SatelInfo: implementation-data-type=IDT_Arr_SatelInfo  # 卫星信息 satellites information
        DTE_GNSSInfoResd: implementation-data-type=IDT_Arr_GNSSInfoResd  # 预留 Reserved
    IDT_Enum_KL15State: category=VALUE, base-type=uint8  # 查询TBOX KL15状态
    IDT_WiFiApName: category=STRUCTURE, dynamic-array-size-profile=VSA_LINEAR  # WiFi热点名称
      element sizeIndicator: implementation-data-type=specialIDT_DynamicLengthField_uint32
      element IDT_WiFiApName: category=ARRAY
        element IDT_WiFiApName: array-size=64, array-size-handling=ALL-INDICES-SAME-ARRAY-SIZE, array-size-semantics=VARIABLE-SIZE, implementation-data-type=specialIDT_StringRef
    IDT_ADAS_Seg_DividedRoad: category=VALUE, base-type=uint8
    IDT_ICC_enum_ESASettingSt: category=VALUE, base-type=uint8  # ESA功能设置状态
    IDT_Enum_DataInLoopUnit: category=VALUE, base-type=uint8
    IDT_SimDetailInfoArray: category=STRUCTURE, dynamic-array-size-profile=VSA_LINEAR  # sim卡数组
      element sizeIndicator: implementation-data-type=specialIDT_DynamicLengthField_uint32
      element IDT_SimDetailInfoArray: category=ARRAY
        element IDT_SimDetailInfoArray: array-size=8, array-size-handling=ALL-INDICES-SAME-ARRAY-SIZE, array-size-semantics=VARIABLE-SIZE, implementation-data-type=IDT_SingleSimDetailInfo
    IDT_LCM_IMU_gpsWeek: category=VALUE, base-type=uint16
    IDT_ALCInfo_arr_Reserved: category=ARRAY  # 预留
      element Reserved_uint8_Type: array-size=46, array-size-semantics=FIXED-SIZE, implementation-data-type=IDT_Reserved_uint8_Type
    IDT_TimeInfoDay: category=VALUE, base-type=uint8  # 日
    IDT_ADAS_enum_FcwWarnDist: category=VALUE, base-type=uint8
    IDT_ICC_arr_TrafficJamInfo: category=STRUCTURE, dynamic-array-size-profile=VSA_LINEAR
      element sizeIndicator: implementation-data-type=specialIDT_DynamicLengthField_uint32
      element IDT_ICC_arr_TrafficJamInfo: category=ARRAY
        element IDT_ICC_arr_TrafficJamInfo: array-size=5, array-size-handling=ALL-INDICES-SAME-ARRAY-SIZE, array-size-semantics=VARIABLE-SIZE, implementation-data-type=IDT_ICC_strt_TrafficJamInfo
    IDT_FcmCamIntrinsicsData: category=ARRAY  # FCM相机内参数据
      element FCM_val_CamParameter: array-size=12, array-size-semantics=FIXED-SIZE, implementation-data-type=IDT_FCM_val_CamParameter
    IDT_ADAS_enum_NarrowRoadAssistTextInfo: category=VALUE, base-type=uint8  # 窄路辅助提示信息
    IDT_ICC_enum_AEBSettingSt: category=VALUE, base-type=uint8  # AEB功能设置状态
    IDT_ADAS_Stub_TurnAngl: category=VALUE, base-type=uint8
    IDT_ADAS_enum_TrafficLightAssistBtnStFb: category=VALUE, base-type=uint8  # 红绿灯辅助设置反馈
    IDT_ADAS_enum_FCTAWarnActSt: category=VALUE, base-type=uint8  # FCTA报警执行状态
    IDT_ADAS_enum_MNPMemRouteGrade: category=VALUE, base-type=float32  # 路线评分
    IDT_ADAS_strt_HpaUseData: category=STRUCTURE
      5 x element, all with category=TYPE_REFERENCE:
        DTE_HpaCruiseDist: implementation-data-type=IDT_ADAS_val_ParkingDist  # 本次泊车距离
        DTE_HpaCruiseTime: implementation-data-type=IDT_ADAS_val_ParkingProcessTakeTime  # 本次泊车时长
        DTE_HPAVPAGiveWayPedTimes: implementation-data-type=IDT_ADAS_val_HPAVPAGiveWayPedTimes  # 让路行人次数
        DTE_HPAVPAGiveWayVehTimes: implementation-data-type=IDT_ADAS_val_HPAVPAGiveWayVehTimes  # 让路车辆次数
        DTE_HPASpeedBumpNum: implementation-data-type=IDT_Gen_val_unit8  # 通过减速带数量
    IDT_ICC_boolean_Valid: category=VALUE, base-type=sint32
    IDT_ICC_strt_CruiseFacilityInfo: category=STRUCTURE  # 巡航电子眼
      5 x element, all with category=TYPE_REFERENCE:
        DTE_CruiseFacilityPos: implementation-data-type=IDT_ICC_strt_Coord2DDouble  # 位置
        DTE_CruiseFacilitType: implementation-data-type=IDT_ICC_int32_CruiseFacilitType  # 类型
        DTE_CruiseFacilitDistance: implementation-data-type=IDT_ICC_int32_Dist  # 距离设施的剩余距离，单位:m
        DTE_CruiseFacilitLimitSpeed: implementation-data-type=IDT_ICC_int32_Speed  # 限速值，单位:km/h
        DTE_CruiseFacilityReserved: implementation-data-type=IDT_CruiseFacility_arr_Reserved  # 预留
    IDT_EphemerisDataInfo: category=STRUCTURE  # 星历数据信息
      6 x element, all with category=TYPE_REFERENCE:
        DTE_ephemerisDataType: implementation-data-type=IDT_EphemerisDataType  # 星历数据类型
        DTE_ephemerisDataFormat: implementation-data-type=IDT_EphemerisDataFormat  # 星历数据格式
        DTE_ephemerisDataIndexTotal: implementation-data-type=IDT_ephemerisDataIndexTotal  # 星历数据一共有几包
        DTE_ephemerisDataIndex: implementation-data-type=IDT_EphemerisDataIndex  # 星历数据索引
        DTE_ephemerisDataLength: implementation-data-type=IDT_EphemerisDataLength  # 星历数据长度
        DTE_ephemerisDataByteArray: implementation-data-type=IDT_EphemerisDataByteArray  # 星历数据消息通道
    IDT_AvmCamIntrinsicsData: category=ARRAY  # 环视相机内参数据
      element CamIntrinsicsData: array-size=832, array-size-semantics=FIXED-SIZE, implementation-data-type=IDT_CamIntrinsicsData
    IDT_ADAS_Posn_Offset: category=VALUE, base-type=uint16
    IDT_ICC_strt_CruiseInfo: category=STRUCTURE  # 巡航信息
      element DTE_CruiseRoadName: implementation-data-type=IDT_ICC_string_RoadName  # 道路名称
      element DTE_CruiseRoadClass: implementation-data-type=IDT_ICC_int32_RoadClass  # 当前自车所在道路等级
      element DTE_CruiseInfoReserved: implementation-data-type=IDT_CruiseInfo_arr_Reserved  # 预留
    IDT_ADAS_enum_AebAcitveSt: category=VALUE, base-type=uint8
    IDT_ADAS_Stub_PartOfCalcRoute: category=VALUE, base-type=uint8
    IDT_ICC_Strt_ADASSettingInfo_2: category=STRUCTURE
      54 x element, all with category=TYPE_REFERENCE:
        DTE_ICAEnableBtnSts: implementation-data-type=IDT_ICC_enum_ICAEnableBtnSts  # ICA功能使能开关
        DTE_FSRASpdSetMod: implementation-data-type=IDT_ICC_enum_FSRASpdSetMod  # 巡航速度调整方式设置（无开关）
        DTE_FSRACruiseSpdMod: implementation-data-type=IDT_ICC_enum_FSRACruiseSpdMod  # 设定巡航车速模式
        DTE_FSRACruiseSpdOffsetMod: implementation-data-type=IDT_ICC_enum_FSRACruiseSpdOffsetMod  # 设定偏移方式
        DTE_FSRACruiseSpdOffsetSpd: implementation-data-type=IDT_ICC_enum_FSRACruiseSpdOffsetSpd  # 固定偏移速度
        DTE_FSRACruiseSpdOffsetPercent: implementation-data-type=IDT_ICC_enum_FSRACruiseSpdOffsetPercent  # 百分比偏移速度
        DTE_ISLIWarnMod: implementation-data-type=IDT_ICC_enum_ISLIWarnMod  # 智能限速提醒方式
        DTE_ISLISpdOffsetMod: implementation-data-type=IDT_ICC_enum_ISLISpdOffsetMod  # 限速设置方式（预留）
        DTE_ISLICruiseSpdRelOffset: implementation-data-type=IDT_ICC_enum_ISLICruiseSpdRelOffset  # 相对限制值（预留）
        DTE_ISLICruiseSpdAbdOffset: implementation-data-type=IDT_ICC_enum_ISLICruiseSpdAbdOffset  # 绝对限制值（预留）
        DTE_FCWWarnDistance: implementation-data-type=IDT_ICC_enum_FCWWarnDistance  # FCW报警距离限制
        DTE_FCWSettingSt: implementation-data-type=IDT_ICC_enum_FCWSettingSt  # FCW功能设置状态
        DTE_AEBSettingSt: implementation-data-type=IDT_ICC_enum_AEBSettingSt  # AEB功能设置状态
        DTE_LKSSettingSt: implementation-data-type=IDT_ICC_enum_LKSSettingSt  # LDW/LDP功能设置状态
        DTE_LDWWarnType: implementation-data-type=IDT_ICC_enum_LDWWarnType  # LDW/LDP报警方式
        DTE_ELKSettingSt: implementation-data-type=IDT_ICC_enum_ELKSettingSt  # ELK功能设置状态
        DTE_BSDSettingSt: implementation-data-type=IDT_ICC_enum_BSDSettingSt  # BSD/LCW功能设置状态
        DTE_DOWSettingSt: implementation-data-type=IDT_ICC_enum_DOWSettingSt  # DOW功能设置状态
        DTE_ICAplusSettingSt: implementation-data-type=IDT_ICC_enum_ICAplussetting  # 直行红绿灯启停设置状态
        DTE_FCTAWarnType: implementation-data-type=IDT_ICC_enum_FCTAWarnType  # FCTA报警方式
        DTE_RCTAWarnType: implementation-data-type=IDT_ICC_enum_RCTAWarnType  # RCTA报警方式
        DTE_ESASettingSt: implementation-data-type=IDT_ICC_enum_ESASettingSt  # ESA功能设置状态
        DTE_AMAPSettingSt: implementation-data-type=IDT_ICC_enum_AMAPSettingSt  # AMAP功能设置状态
        DTE_NOPEnableBtnSts: implementation-data-type=IDT_ICC_enum_NOPEnableBtnSts  # NOP功能使能开关
        DTE_VoiceRemindSettingMode: implementation-data-type=IDT_ICC_enum_VoiceRemindSettingMode  # 语音播报模式
        DTE_NOPLaneChangeStyle: implementation-data-type=IDT_ICC_enum_NOPLaneChangeStyle  # NOP超车变道风格
        DTE_NOPLaneChangeMod: implementation-data-type=IDT_ICC_enum_NOPLaneChangeMod  # NOP变道模式
        DTE_NOPLaneChangeWarnType: implementation-data-type=IDT_ICC_enum_NOPLaneChangeWarnType  # NOP变道提醒模式
        DTE_U_NOPEnableBtnSts: implementation-data-type=IDT_ICC_enum_U_NOPEnableBtnSts  # 城区NOP功能使能开关
        DTE_HPASettingSt: implementation-data-type=IDT_ICC_enum_HPASettingSt  # 记忆泊车功能使能开关
        DTE_VPASettingSt: implementation-data-type=IDT_ICC_enum_VPASettingSt  # 代客泊车功能使能开关
        DTE_APASettingSt: implementation-data-type=IDT_ICC_enum_APASettingSt  # 自动泊车功能使能开关
        DTE_VoiceRemindSettingSt: implementation-data-type=IDT_ICC_enum_VoiceRemindSettingSt  # 语音播报功能设置开关
        DTE_DrivingVoiceRemindSettingSt: implementation-data-type=IDT_ICC_enum_DrivingVoiceRemindSettingSt  # 行车语音播报功能设置开关
        DTE_NRASettingSt: implementation-data-type=IDT_ICC_enum_NRASettingSt  # 窄路辅助使能开关
        DTE_RPASetSettingSt: implementation-data-type=IDT_ICC_enum_RPASettingSt  # 遥控泊车设置项开关
        DTE_ParkingSpeedSettingSt: implementation-data-type=IDT_ICC_enum_ParkingSpeedSet  # 泊车速度设置开关
        DTE_HPACrusingSpeedSettingSt: implementation-data-type=IDT_ICC_enum_ParkingSpeedSet  # 泊车巡航车速设置项开关
        DTE_MEBSwtSet: implementation-data-type=IDT_ICC_enum_MEBSwtSet  # MEB设置项开关
        DTE_AMAPSwtSet: implementation-data-type=IDT_ICC_enum_AMAPSwtSet  # 加速踏板防误踩设置项开关
        DTE_MNPEnableBtnSt: implementation-data-type=IDT_ICC_enum_MNPEnableBtnSt  # 记忆领航功能使能开关
        DTE_LccPlusEnableBtnSt: implementation-data-type=IDT_ICC_enum_LccPlusEnableBtnSt  # 巡航增强功能使能开关
        DTE_LKSWarnSensitivity: implementation-data-type=IDT_ICC_enum_LKSWarnSensitivity  # LKS预警灵敏度
        DTE_DAIEnableBtnSt: implementation-data-type=IDT_ICC_enum_DAIEnableBtnSt  # DAI功能使能开关
        DTE_IHCEnableBtnSt: implementation-data-type=IDT_ICC_enum_IHCEnableBtnSt  # IHC功能使能开关
        DTE_ISLICruiseSpdOffsetAbd: implementation-data-type=IDT_ICC_enum_ISLICruiseSpdOffsetAbd  # 固定限速偏移量
        DTE_MNPNewBtnSt: implementation-data-type=IDT_ICC_enum_MNPNewBtnSt  # 新建路线按钮
        DTE_MNPMemRouteQuitBtnSt: implementation-data-type=IDT_ICC_enum_MNPMemRouteQuitBtnSt  # 退出路线学习按钮
        DTE_MNPUseRouteQuitBtnSt: implementation-data-type=IDT_ICC_enum_MNPUseRouteQuitBtnSt  # 退出路线使用按钮
        DTE_MNPMemRouteCompleteBtnSt: implementation-data-type=IDT_ICC_enum_MNPMemRouteCompleteBtnSt  # 路线记忆结束按钮
        DTE_MNPMemRouteNewName: implementation-data-type=IDT_Str_MemRoute  # 修改后的记忆路线名称
        DTE_MNPDelRouteIDBtnSt: implementation-data-type=IDT_ICC_enum_MNPDelRouteIDBtnSt  # 删除的记忆路线ID
        DTE_MNPUseRouteIDBtnSt: implementation-data-type=IDT_ICC_enum_MNPUseRouteIDBtnSt  # 选中使用的记忆路线ID
        DTE_ADASSettingInfoReserved: implementation-data-type=IDT_ADASSettingInfo_arr_Reserved  # 预留
    IDT_ADAS_enum_HPAPathType: category=VALUE, base-type=uint8
    IDT_ICC_Strt_ADASSettingInfo_3: category=STRUCTURE
      84 x element, all with category=TYPE_REFERENCE:
        DTE_ICAEnableBtnSts: implementation-data-type=IDT_ICC_enum_ICAEnableBtnSts  # ICA功能使能开关
        DTE_FSRASpdSetMod: implementation-data-type=IDT_ICC_enum_FSRASpdSetMod  # 巡航速度调整方式设置（无开关）
        DTE_FSRACruiseSpdMod: implementation-data-type=IDT_ICC_enum_FSRACruiseSpdMod  # 设定巡航车速模式
        DTE_FSRACruiseSpdOffsetMod: implementation-data-type=IDT_ICC_enum_FSRACruiseSpdOffsetMod  # 设定偏移方式
        DTE_FSRACruiseSpdOffsetSpd: implementation-data-type=IDT_ICC_enum_FSRACruiseSpdOffsetSpd  # 固定偏移速度
        DTE_FSRACruiseSpdOffsetPercent: implementation-data-type=IDT_ICC_enum_FSRACruiseSpdOffsetPercent  # 百分比偏移速度
        DTE_ISLIWarnMod: implementation-data-type=IDT_ICC_enum_ISLIWarnMod  # 智能限速提醒方式
        DTE_ISLISpdOffsetMod: implementation-data-type=IDT_ICC_enum_ISLISpdOffsetMod  # 限速设置方式（预留）
        DTE_ISLICruiseSpdRelOffset: implementation-data-type=IDT_ICC_enum_ISLICruiseSpdRelOffset  # 相对限制值（预留）
        DTE_ISLICruiseSpdAbdOffset: implementation-data-type=IDT_ICC_enum_ISLICruiseSpdAbdOffset  # 绝对限制值（预留）
        DTE_FCWWarnDistance: implementation-data-type=IDT_ICC_enum_FCWWarnDistance  # FCW报警距离限制
        DTE_FCWSettingSt: implementation-data-type=IDT_ICC_enum_FCWSettingSt  # FCW功能设置状态
        DTE_AEBSettingSt: implementation-data-type=IDT_ICC_enum_AEBSettingSt  # AEB功能设置状态
        DTE_LKSSettingSt: implementation-data-type=IDT_ICC_enum_LKSSettingSt  # LDW/LDP功能设置状态
        DTE_LDWWarnType: implementation-data-type=IDT_ICC_enum_LDWWarnType  # LDW/LDP报警方式
        DTE_ELKSettingSt: implementation-data-type=IDT_ICC_enum_ELKSettingSt  # ELK功能设置状态
        DTE_BSDSettingSt: implementation-data-type=IDT_ICC_enum_BSDSettingSt  # BSD/LCW功能设置状态
        DTE_DOWSettingSt: implementation-data-type=IDT_ICC_enum_DOWSettingSt  # DOW功能设置状态
        DTE_ICAplusSettingSt: implementation-data-type=IDT_ICC_enum_ICAplussetting  # 直行红绿灯启停设置状态
        DTE_FCTAWarnType: implementation-data-type=IDT_ICC_enum_FCTAWarnType  # FCTA报警方式
        DTE_RCTAWarnType: implementation-data-type=IDT_ICC_enum_RCTAWarnType  # RCTA报警方式
        DTE_ESASettingSt: implementation-data-type=IDT_ICC_enum_ESASettingSt  # ESA功能设置状态
        DTE_AMAPSettingSt: implementation-data-type=IDT_ICC_enum_AMAPSettingSt  # AMAP功能设置状态
        DTE_NOPEnableBtnSts: implementation-data-type=IDT_ICC_enum_NOPEnableBtnSts  # NOP功能使能开关
        DTE_VoiceRemindSettingMode: implementation-data-type=IDT_ICC_enum_VoiceRemindSettingMode  # 语音播报模式
        DTE_NOPLaneChangeStyle: implementation-data-type=IDT_ICC_enum_NOPLaneChangeStyle  # NOP超车变道风格
        DTE_NOPLaneChangeMod: implementation-data-type=IDT_ICC_enum_NOPLaneChangeMod  # NOP变道模式
        DTE_NOPLaneChangeWarnType: implementation-data-type=IDT_ICC_enum_NOPLaneChangeWarnType  # NOP变道提醒模式
        DTE_U_NOPEnableBtnSts: implementation-data-type=IDT_ICC_enum_U_NOPEnableBtnSts  # 城区NOP功能使能开关
        DTE_HPASettingSt: implementation-data-type=IDT_ICC_enum_HPASettingSt  # 记忆泊车功能使能开关
        DTE_VPASettingSt: implementation-data-type=IDT_ICC_enum_VPASettingSt  # 代客泊车功能使能开关
        DTE_APASettingSt: implementation-data-type=IDT_ICC_enum_APASettingSt  # 自动泊车功能使能开关
        DTE_VoiceRemindSettingSt: implementation-data-type=IDT_ICC_enum_VoiceRemindSettingSt  # 语音播报功能设置开关
        DTE_DrivingVoiceRemindSettingSt: implementation-data-type=IDT_ICC_enum_DrivingVoiceRemindSettingSt  # 行车语音播报功能设置开关
        DTE_NRASettingSt: implementation-data-type=IDT_ICC_enum_NRASettingSt  # 窄路辅助使能开关
        DTE_RPASetSettingSt: implementation-data-type=IDT_ICC_enum_RPASettingSt  # 遥控泊车设置项开关
        DTE_ParkingSpeedSettingSt: implementation-data-type=IDT_ICC_enum_ParkingSpeedSet  # 泊车速度设置开关
        DTE_HPACrusingSpeedSettingSt: implementation-data-type=IDT_ICC_enum_ParkingSpeedSet  # 泊车巡航车速设置项开关
        DTE_MEBSwtSet: implementation-data-type=IDT_ICC_enum_MEBSwtSet  # MEB设置项开关
        DTE_AMAPSwtSet: implementation-data-type=IDT_ICC_enum_AMAPSwtSet  # 加速踏板防误踩设置项开关
        DTE_MNPEnableBtnSt: implementation-data-type=IDT_ICC_enum_MNPEnableBtnSt  # 记忆领航功能使能开关
        DTE_LccPlusEnableBtnSt: implementation-data-type=IDT_ICC_enum_LccPlusEnableBtnSt  # 巡航增强功能使能开关
        DTE_LKSWarnSensitivity: implementation-data-type=IDT_ICC_enum_LKSWarnSensitivity  # LKS预警灵敏度
        DTE_DAIEnableBtnSt: implementation-data-type=IDT_ICC_enum_DAIEnableBtnSt  # DAI功能使能开关
        DTE_IHCEnableBtnSt: implementation-data-type=IDT_ICC_enum_IHCEnableBtnSt  # IHC功能使能开关
        DTE_ISLICruiseSpdOffsetAbd: implementation-data-type=IDT_ICC_enum_ISLICruiseSpdOffsetAbd  # 固定限速偏移量
        DTE_MNPNewBtnSt: implementation-data-type=IDT_ICC_enum_MNPNewBtnSt  # 新建路线按钮
        DTE_MNPMemRouteQuitBtnSt: implementation-data-type=IDT_ICC_enum_MNPMemRouteQuitBtnSt  # 退出路线学习按钮
        DTE_MNPUseRouteQuitBtnSt: implementation-data-type=IDT_ICC_enum_MNPUseRouteQuitBtnSt  # 退出路线使用按钮
        DTE_MNPMemRouteCompleteBtnSt: implementation-data-type=IDT_ICC_enum_MNPMemRouteCompleteBtnSt  # 路线记忆结束按钮
        DTE_MNPMemRouteNewName: implementation-data-type=IDT_Str_MemRoute  # 修改后的记忆路线名称
        DTE_MNPDelRouteIDBtnSt: implementation-data-type=IDT_ICC_enum_MNPDelRouteIDBtnSt  # 删除的记忆路线ID
        DTE_MNPUseRouteIDBtnSt: implementation-data-type=IDT_ICC_enum_MNPUseRouteIDBtnSt  # 选中使用的记忆路线ID
        DTE_MNPRouteNewName: implementation-data-type=IDT_Str_MemRouteInfo  # 修改后的记忆路线名称
        DTE_MNPDelRouteID: implementation-data-type=IDT_Str_MemRouteInfo  # 删除的记忆路线ID
        DTE_MNPUseRouteID: implementation-data-type=IDT_Str_MemRouteInfo  # 选中使用的记忆路线ID
        DTE_MNPRenameRouteID: implementation-data-type=IDT_Str_MemRouteInfo  # 修改名称的记忆路线ID
        DTE_NewMemRouteStartName: implementation-data-type=IDT_Str_MemRouteInfo  # 当前记忆中的路线起点名称
        DTE_NewMemRouteEndName: implementation-data-type=IDT_Str_MemRouteInfo  # 当前记忆中的路线终点名称
        DTE_MNPAllRoutesInfoReq: implementation-data-type=IDT_ICC_enum_MNPAllRoutesInfoReq  # 请求获取全部记忆路线信息
        DTE_MNPRouteInfoReq: implementation-data-type=IDT_ICC_enum_MNPRouteInfoReq  # 请求当前记忆路线信息
        DTE_HNOACruiseSpdOffsetMod: implementation-data-type=IDT_ICC_enum_HNOACruiseSpdOffsetMod  # 设定车速偏移方式
        DTE_HNOACruiseSpdOffsetSpd: implementation-data-type=IDT_ICC_enum_HNOACruiseSpdOffsetSpd  # 固定偏移速度
        DTE_TSREnableBtnSt: implementation-data-type=IDT_ICC_enum_TSREnableBtnSt  # TSR功能使能开关
        DTE_TLREnableBtnSt: implementation-data-type=IDT_ICC_enum_TLREnableBtnSt  # TLR功能使能开关
        DTE_TLAEnableBtnSt: implementation-data-type=IDT_ICC_enum_TLAEnableBtnSt  # TLA功能使能开关
        DTE_HandsOffWarningStyle: implementation-data-type=IDT_ICC_enum_HandsOffWarningStyle  # 脱手报警风格
        DTE_VoiceControlLaneChange: implementation-data-type=IDT_ICC_enum_VoiceControlLaneChange  # 语音变道指令
        DTE_VoiceControlCruiseSpeedAdjust: implementation-data-type=IDT_ICC_enum_VoiceControlCruiseSpeedAdjust  # 语音巡航速度调节指令
        DTE_VoiceControlCruiseSpeed: implementation-data-type=IDT_ICC_val_VoiceControlCruiseSpeed  # 语音巡航调节速度值
        DTE_VoiceControlCruiseDistanceAdjust: implementation-data-type=IDT_ICC_enum_VoiceControlCruiseDistanceAdjust  # 语音巡航距离调节指令
        DTE_NOALCCSwitchBtnSts: implementation-data-type=IDT_ICC_enum_NOALCCSwitchBtnSts  # NOA与LCC切换指令
        DTE_DetourAroundObstacleBtnSt: implementation-data-type=IDT_ICC_enum_DetourAroundObstacleBtnSt  # 借道绕行障碍物软开关
        DTE_EfficientPassageBtnSt: implementation-data-type=IDT_ICC_enum_EfficientPassageBtnSt  # 高效通行软开关
        DTE_IntelligentEvasionBtnSt: implementation-data-type=IDT_ICC_enum_IntelligentEvasionBtnSt  # 智慧躲闪软开关
        DTE_RADSEnableBtnSt: implementation-data-type=IDT_ICC_enum_RADSEnableBtnSt  # 循迹倒车软开关
        DTE_OutsideParkingBtnSt: implementation-data-type=IDT_ICC_enum_OutsideParkingBtnSt  # 离车泊入软开关
        DTE_RGearDefaultFunctionBtnSt: implementation-data-type=IDT_ICC_enum_RGearDefaultFunctionBtnSt  # R挡默认打开项设置
        DTE_RecordUploadBtn: implementation-data-type=IDT_ICC_enum_RecordUploadBtn  # 录音数据回传按钮
        DTE_DatauploadBtn: implementation-data-type=IDT_ICC_enum_DatauploadBtn  # 一键数据回传使能
        DTE_TollStationPathSet: implementation-data-type=IDT_Enum_TollStationPathSet  # 收费站通道设置 Toll gate lane setting
        DTE_ADSRestartBtnSt: implementation-data-type=IDT_Enum_ADSRestartBtnSt  # 域控制器一键重启按键 One-click restart button for the domain controller
        DTE_FreeparkMagModeBtnSt: implementation-data-type=IDT_Enum_FreeparkMagModeBtnSt  # 一键贴边按钮 One-click edge pressing button
        DTE_ADASSettingInfoReserved: implementation-data-type=IDT_ADASSettingInfo_arr_Reserved2  # 预留
    IDT_Struct_Cellinfo: category=STRUCTURE  # TBOX通知基站信息
      6 x element, all with category=TYPE_REFERENCE:
        DTE_Count: implementation-data-type=IDT_Count  # 基站信息个数
        DTE_MCC: implementation-data-type=IDT_StrVar_MCC  # 移动国家代码，中国固定460
        DTE_MNC: implementation-data-type=IDT_StrVar_MNC  # 移动网络号码
        DTE_LAC: implementation-data-type=IDT_LAC  # 位置区域代码
        DTE_CID: implementation-data-type=IDT_CID  # 基站编号0开始的整数
        DTE_Result: implementation-data-type=IDT_Enum_Result  # 是否取得结果
    IDT_ADAS_uint16_SurfaceMeshBevh: category=VALUE, base-type=uint16
    IDT_ICC_arr_NaviWeatherInfo: category=STRUCTURE, dynamic-array-size-profile=VSA_LINEAR  # 天气详细信息
      element sizeIndicator: implementation-data-type=specialIDT_DynamicLengthField_uint32
      element IDT_ICC_arr_NaviWeatherInfo: category=ARRAY
        element IDT_ICC_arr_NaviWeatherInfo: array-size=10, array-size-handling=ALL-INDICES-SAME-ARRAY-SIZE, array-size-semantics=VARIABLE-SIZE, implementation-data-type=IDT_ICC_strt_NaviWeatherInfo_1
    IDT_ICC_int32_FormWay: category=VALUE, base-type=sint32
    IDT_Millisecond: category=VALUE, base-type=uint32  # 通话时间
    IDT_ICC_strt_ExtenLaneAction: category=STRUCTURE
      element DTE_ExtenLaneAction: implementation-data-type=IDT_ICC_int32_ExtenLaneAction  # 车道信息
    IDT_ICC_arr_BackLane: category=STRUCTURE, dynamic-array-size-profile=VSA_LINEAR  # 背景车道
      element sizeIndicator: implementation-data-type=specialIDT_DynamicLengthField_uint32
      element IDT_ICC_arr_BackLane: category=ARRAY
        element IDT_ICC_arr_BackLane: array-size=12, array-size-handling=ALL-INDICES-SAME-ARRAY-SIZE, array-size-semantics=VARIABLE-SIZE, implementation-data-type=IDT_ICC_enum_LaneAction
    IDT_ADAS_enum_ICASenarioReminder: category=VALUE, base-type=uint8
    IDT_ICC_enum_FCWWarnDistance: category=VALUE, base-type=uint8  # FCW报警距离限制
    IDT_ADAS_strt_VPALayerInfo: category=STRUCTURE  # 自建图层级信息
      element DTE_VPALayerNumber: implementation-data-type=IDT_DataUint32  # 总层数
      element DTE_VPALayerList: implementation-data-type=IDT_ADAS_arr_VPAFloor  # 楼层列表
      element DTE_VPATunnelList: implementation-data-type=IDT_ADAS_arr_VPATunnel  # 通道名列表
    IDT_Countdown_arr_Reserved: category=ARRAY
      element Reserved_int32_Type: array-size=20, array-size-semantics=FIXED-SIZE, implementation-data-type=IDT_Reserved_int32_Type
    IDT_ADAS_enum_MNPBuildMapTextInfo: category=VALUE, base-type=uint8  # 记忆行车建图阶段文言提示信息
    IDT_ADAS_enum_MNPMemRouteState: category=VALUE, base-type=uint8  # 路线状态
    IDT_ADAS_arr_TrajectoryPoint: category=ARRAY
      element ADAS_strt_TrajectoryPoint: array-size=64, array-size-semantics=FIXED-SIZE, implementation-data-type=IDT_ADAS_strt_TrajectoryPoint
    IDT_HPAPathOperation_arr_Reserved: category=ARRAY  # 预留
      element Reserved_uint8_Type: array-size=30, array-size-semantics=FIXED-SIZE, implementation-data-type=IDT_Reserved_uint8_Type
    IDT_ICC_enum_HNOACruiseSpdOffsetSpd: category=VALUE, base-type=sint8  # 固定偏移速度
    IDT_ADAS_strt_Traffic3DSignPos: category=STRUCTURE  # 交通标识位置
      element DTE_Traffic3DSignPosX: implementation-data-type=IDT_Gen_val_Coordinate_X  # 交通标识位置X
      element DTE_Traffic3DSignPosY: implementation-data-type=IDT_Gen_val_Coordinate_Y  # 交通标识位置Y
      element DTE_Traffic3DSignPosZ: implementation-data-type=IDT_Gen_val_Coordinate_Z  # 交通标识位置Z
    IDT_ICC_string_PoiName: category=STRUCTURE, dynamic-array-size-profile=VSA_LINEAR
      element sizeIndicator: implementation-data-type=specialIDT_DynamicLengthField_uint32
      element IDT_ICC_string_PoiName: category=ARRAY
        element IDT_ICC_string_PoiName: array-size=500, array-size-handling=ALL-INDICES-SAME-ARRAY-SIZE, array-size-semantics=VARIABLE-SIZE, implementation-data-type=specialIDT_StringRef
    IDT_ADAS_val_PathSaveProgress: category=VALUE, base-type=uint8
    IDT_ADAS_enum_SidePassSt: category=VALUE, base-type=uint8
    IDT_CelluarRoamingStatus: category=VALUE, base-type=uint8
    IDT_ICC_int32_OwnerShip: category=VALUE, base-type=sint32
    IDT_ADAS_enum_HPAFloor: category=VALUE, base-type=uint8
    IDT_SimRealNameInfo: category=VALUE, base-type=uint32  # 实名制信息
    IDT_ADAS_strt_LaneCenterPoint: category=STRUCTURE
      element DTE_Coordinate_X: implementation-data-type=IDT_Gen_val_Coordinate_X  # X坐标
      element DTE_Coordinate_Y: implementation-data-type=IDT_Gen_val_Coordinate_Y  # Y坐标
    IDT_ICC_strt_NaviIntCameraDynInfo: category=STRUCTURE
      6 x element, all with category=TYPE_REFERENCE:
        DTE_NaviIntDistance: implementation-data-type=IDT_ICC_int32_Dist  # 区间测速电子眼长度
        DTE_NaviIntRemainDistance: implementation-data-type=IDT_ICC_int32_Dist  # 进入区间测速路段后实时的区间路段剩余距离
        DTE_NaviIntAverageSpeed: implementation-data-type=IDT_ICC_int32_Speed  # 进入区间测速路段后的实时平均车速
        DTE_ReasonableSpeed: implementation-data-type=IDT_ICC_int32_Speed  # 进入区间测速路段后的剩余路段的合理车速
        DTE_NaviIntCameraSpeedLimit: implementation-data-type=IDT_ICC_arr_CameraSpeed  # 区间测速电子眼限速
        DTE_NaviIntCameraDynReserved: implementation-data-type=IDT_NaviIntCameraDyn_arr_Reserved  # 预留
    IDT_ICC_arr_BackExtenLane: category=STRUCTURE, dynamic-array-size-profile=VSA_LINEAR  # 背景拓展车道
      element sizeIndicator: implementation-data-type=specialIDT_DynamicLengthField_uint32
      element IDT_ICC_arr_BackExtenLane: category=ARRAY
        element IDT_ICC_arr_BackExtenLane: array-size=12, array-size-handling=ALL-INDICES-SAME-ARRAY-SIZE, array-size-semantics=VARIABLE-SIZE, implementation-data-type=IDT_ICC_enum_ExtenLaneAction
    IDT_RequestVhrRemoteCall: category=STRUCTURE  # VHR日志远程调取--请求
      5 x element, all with category=TYPE_REFERENCE:
        DTE_vhrCompID: implementation-data-type=IDT_VhrCompID  # 部件ID
        DTE_vhrLogList: implementation-data-type=IDT_VhrLogList  # 日志列表
        DTE_vhrRelatedId: implementation-data-type=IDT_VhrRelatedId  # 日志关联id
        DTE_vhrLogStartTime: implementation-data-type=IDT_VhrLogStartTime  # 请求的日志开始时间
        DTE_vhrLogEndTime: implementation-data-type=IDT_VhrLogEndTime  # 请求的日志结束时间
    IDT_ADAS_enum_VPAEntranceType: category=VALUE, base-type=uint8
    IDT_ADAS_enum_ACCVoiceReminder: category=VALUE, base-type=uint8  # 巡航速度和距离调节语音提醒
    IDT_ADAS_arr_MNPMemRoutePosition: category=STRUCTURE, dynamic-array-size-profile=VSA_LINEAR  # 路线轨迹点数组
      element sizeIndicator: implementation-data-type=specialIDT_DynamicLengthField_uint32
      element IDT_ADAS_arr_MNPMemRoutePosition: category=ARRAY
        element IDT_ADAS_arr_MNPMemRoutePosition: array-size=1000, array-size-handling=ALL-INDICES-SAME-ARRAY-SIZE, array-size-semantics=VARIABLE-SIZE, implementation-data-type=IDT_ADAS_strt_MNPMemRoutePosition
    IDT_ADAS_arr_AebTargetObjInfo: category=STRUCTURE, dynamic-array-size-profile=VSA_LINEAR  # FCW AEB目标信息
      element sizeIndicator: implementation-data-type=specialIDT_DynamicLengthField_uint32
      element IDT_ADAS_arr_AebTargetObjInfo: category=ARRAY
        element IDT_ADAS_arr_AebTargetObjInfo: array-size=5, array-size-handling=ALL-INDICES-SAME-ARRAY-SIZE, array-size-semantics=VARIABLE-SIZE, implementation-data-type=IDT_ADAS_strt_AebTargetObjInfo
    IDT_ValetParkingReferDistanceStep: category=VALUE, base-type=float32  # 代客泊车路点间隔。即，每2个相邻路点的间隔距离，默认值：1m
    IDT_ADAS_Seg_Bridge: category=VALUE, base-type=uint8
    IDT_ADAS_val_HNOACruiseSpdOffsetSpdFb: category=VALUE, base-type=sint8  # 固定偏移速度反馈
    IDT_ADAS_enum_VPAVoiceRemind: category=VALUE, base-type=uint8
    IDT_SensitiveState: category=STRUCTURE  # 敏感状态
      element DTE_permissionId: implementation-data-type=IDT_PermissionId  # 权限ID
      element DTE_permissionConfigState: implementation-data-type=IDT_PermissionConfigState  # 权限的开关值
    IDT_ICC_int32_GreenWaveType: category=VALUE, base-type=sint32
    IDT_ADAS_enum_MRASts: category=VALUE, base-type=uint8
    IDT_ICC_enum_APASettingSt: category=VALUE, base-type=uint8  # APA功能设置状态
    IDT_ADAS_enum_UNOPScenariosReminder: category=VALUE, base-type=uint8
    IDT_Struct_UpdateFTPSts: category=STRUCTURE  # FTP状态
      5 x element, all with category=TYPE_REFERENCE:
        DTE_Action: implementation-data-type=IDT_Enum_Action  # FTP动作
        DTE_FTPState: implementation-data-type=IDT_Enum_FTPState  # FTP状态
        DTE_port: implementation-data-type=IDT_port  # 端口号
        DTE_user: implementation-data-type=IDT_StrVar_user  # 用户名
        DTE_password: implementation-data-type=IDT_StrVar_password  # 密码
    IDT_ADAS_arr_OccPoint: category=STRUCTURE, dynamic-array-size-profile=VSA_LINEAR
      element sizeIndicator: implementation-data-type=specialIDT_DynamicLengthField_uint32
      element IDT_ADAS_arr_OccPoint: category=ARRAY
        element IDT_ADAS_arr_OccPoint: array-size=1000, array-size-handling=ALL-INDICES-SAME-ARRAY-SIZE, array-size-semantics=VARIABLE-SIZE, implementation-data-type=IDT_ADAS_strt_OccPoint
    IDT_CameraStreamBasicElement: category=VALUE, base-type=uint8  # ADS/CDC通信通道基础元素
    IDT_Struct_ECUVersion: category=STRUCTURE  # ECU基本信息
      element DTE_EcuType: implementation-data-type=IDT_Enum_EcuType  # ECU版本
      element DTE_EcuVerison: implementation-data-type=IDT_StrVar_EcuVerison  # ECU版本号
    IDT_PrkgGenaral_arr_Reserved: category=ARRAY  # 预留
      element Reserved_uint8_Type: array-size=50, array-size-semantics=FIXED-SIZE, implementation-data-type=IDT_Reserved_uint8_Type
    IDT_ADAS_enum_LKSMod: category=VALUE, base-type=uint8
    IDT_ICC_boolean_Hidden: category=VALUE, base-type=sint32
    IDT_SentryModeCmdFb: category=VALUE, base-type=uint32  # 哨兵模式开关设置反馈
    IDT_Dbl_VDOPInfo: category=VALUE, base-type=float64  # 垂直精度因子信息 Vertical dilution of precision information
    IDT_DataUint8: category=VALUE, base-type=uint8  # uint8数据
    IDT_MNPMemRoute_arr_Reserved: category=ARRAY  # 预留
      element Reserved_uint8_Type: array-size=30, array-size-semantics=FIXED-SIZE, implementation-data-type=IDT_Reserved_uint8_Type
    IDT_ADAS_val_HPAVPAGiveWayPedTimes: category=VALUE, base-type=uint8
    IDT_CellularPci: category=VALUE, base-type=uint32  # PCI
    IDT_ICC_enum_LKSWarnSensitivity: category=VALUE, base-type=uint8  # LKS预警灵敏度
    IDT_Enum_AntState: category=VALUE, base-type=uint8
    IDT_ICC_enum_LccPlusEnableBtnSt: category=VALUE, base-type=uint8  # 巡航增强功能使能开关
    IDT_ADAS_Meta_SpdUnits: category=VALUE, base-type=uint8
    IDT_ADAS_enum_FSRACruiseSpdOffsetModFb: category=VALUE, base-type=uint8
    IDT_ADAS_val_SpdLimitRelOffset: category=VALUE, base-type=sint8
    IDT_ADAS_strt_TrafficLightList: category=STRUCTURE  # 交通信号灯信息数组
      element DTE_TrafficLightNum: implementation-data-type=IDT_ADAS_val_TrafficLightNum  # 交通灯箱个数
      element DTE_TrafficLightList: implementation-data-type=IDT_ADAS_arr_TrafficLightList  # 交通灯箱数组
    IDT_ICC_enum_FSRASpdSetMod: category=VALUE, base-type=uint8  # 巡航速度调整方式设置（无开关）
    IDT_Str_SoftwareVers: category=STRUCTURE, dynamic-array-size-profile=VSA_LINEAR  # ADAS软件版本号 ADAS software version number
      element sizeIndicator: implementation-data-type=specialIDT_DynamicLengthField_uint32
      element IDT_Str_SoftwareVers: category=ARRAY
        element IDT_Str_SoftwareVers: array-size=40, array-size-handling=ALL-INDICES-SAME-ARRAY-SIZE, array-size-semantics=VARIABLE-SIZE, implementation-data-type=specialIDT_StringRef
    IDT_Enum_FirstCertificationMark: category=VALUE, base-type=uint8  # 首次认证标识
    IDT_ADAS_arr_HPAPathslot: category=STRUCTURE, dynamic-array-size-profile=VSA_LINEAR
      element sizeIndicator: implementation-data-type=specialIDT_DynamicLengthField_uint32
      element IDT_ADAS_arr_HPAPathslot: category=ARRAY
        element IDT_ADAS_arr_HPAPathslot: array-size=1000, array-size-handling=ALL-INDICES-SAME-ARRAY-SIZE, array-size-semantics=VARIABLE-SIZE, implementation-data-type=IDT_ADAS_strt_ParkingSlot
    IDT_ADAS_enum_PathLabel: category=VALUE, base-type=uint8
    IDT_Enum_CertificateIssuedMark: category=VALUE, base-type=uint8  # 已下发标识
    IDT_SentryModeStatus: category=STRUCTURE  # 哨兵模式状态
      element DTE_sentryModeSt: implementation-data-type=IDT_SentryModeSt  # 哨兵模式状态
      element DTE_sentryModeDuration: implementation-data-type=IDT_SentryModeDuration  # 哨兵模式开启时长(min)
    IDT_NaviWeather_arr_Reserved: category=ARRAY
      element Reserved_int32_Type: array-size=10, array-size-semantics=FIXED-SIZE, implementation-data-type=IDT_Reserved_int32_Type
    IDT_ICC_boolean_exists: category=VALUE, base-type=sint32  # 信息是否存在
    IDT_ICC_string_EventId: category=STRUCTURE, dynamic-array-size-profile=VSA_LINEAR
      element sizeIndicator: implementation-data-type=specialIDT_DynamicLengthField_uint32
      element IDT_ICC_string_EventId: category=ARRAY
        element IDT_ICC_string_EventId: array-size=100, array-size-handling=ALL-INDICES-SAME-ARRAY-SIZE, array-size-semantics=VARIABLE-SIZE, implementation-data-type=specialIDT_StringRef
    IDT_Struct_BleModuleInfo: category=STRUCTURE  # 蓝牙信息
      9 x element, all with category=TYPE_REFERENCE:
        DTE_BleMasterMac: implementation-data-type=IDT_StrVar_BleMasterMac  # 蓝牙主模块 MAC 地址
        DTE_BleSlaverLeftMac: implementation-data-type=IDT_StrVar_BleSlaverLeftMac  # 蓝牙左从模块 MAC 地址
        DTE_BleSlaverRightMac: implementation-data-type=IDT_StrVar_BleSlaverRightMac  # 蓝牙右从模块 MAC 地址
        DTE_BleSlaverRearMac: implementation-data-type=IDT_StrVar_BleSlaverRearMac  # 蓝牙后从模块MAC 地址
        DTE_BleMasterVer: implementation-data-type=IDT_StrVar_BleMasterVer  # 蓝牙主模块软件版本
        DTE_BleSlaverLeftVer: implementation-data-type=IDT_StrVar_BleSlaverLeftVer  # 蓝牙左从模块软件版本
        DTE_BleSlaverRightVer: implementation-data-type=IDT_StrVar_BleSlaverRightVer  # 蓝牙右从模块软件版本
        DTE_BleSlaverRearVer: implementation-data-type=IDT_StrVar_BleSlaverRearVer  # 蓝牙后从模块软件版本
        DTE_BleKeyFilling: implementation-data-type=IDT_Enum_BleKeyFilling  # 蓝牙秘钥灌装状态
    IDT_ICC_arr_NaviGreenWaveCarSpeed: category=STRUCTURE, dynamic-array-size-profile=VSA_LINEAR
      element sizeIndicator: implementation-data-type=specialIDT_DynamicLengthField_uint32
      element IDT_ICC_arr_NaviGreenWaveCarSpeed: category=ARRAY
        element IDT_ICC_arr_NaviGreenWaveCarSpeed: array-size=100, array-size-handling=ALL-INDICES-SAME-ARRAY-SIZE, array-size-semantics=VARIABLE-SIZE, implementation-data-type=IDT_ICC_strt_NaviGreenWaveCarSpeed
    IDT_Enum_TBOXReady: category=VALUE, base-type=uint8  # TBOX环境是否准备就绪
    IDT_CrossNavi_arr_Reserved: category=ARRAY
      element Reserved_int32_Type: array-size=20, array-size-semantics=FIXED-SIZE, implementation-data-type=IDT_Reserved_int32_Type
    IDT_StrVar_BleMasterMac: category=STRUCTURE, dynamic-array-size-profile=VSA_LINEAR  # 蓝牙主模块 MAC 地址
      element sizeIndicator: implementation-data-type=specialIDT_DynamicLengthField_uint32
      element IDT_StrVar_BleMasterMac: category=ARRAY
        element IDT_StrVar_BleMasterMac: array-size=24, array-size-handling=ALL-INDICES-SAME-ARRAY-SIZE, array-size-semantics=VARIABLE-SIZE, implementation-data-type=specialIDT_StringRef
    IDT_ICC_int32_LightDir: category=VALUE, base-type=sint32  # 红绿指示方向
    IDT_Enum_UsbUpdateStart: category=VALUE, base-type=uint8  # 发起TBOX升级
    IDT_ADAS_val_LineEquation_C2: category=VALUE, base-type=float32
    IDT_ICC_enum_U_NOPEnableBtnSts: category=VALUE, base-type=uint8  # 城区NOP功能使能开关
    IDT_ADAS_val_LineEquation_C3: category=VALUE, base-type=float32
    IDT_ADAS_enum_IHCTextInfo: category=VALUE, base-type=uint8  # IHC文言提示信息
    IDT_Enum_Result: category=VALUE, base-type=uint8
    IDT_ADAS_val_LineEquation_C0: category=VALUE, base-type=float32
    IDT_ADAS_val_LineEquation_C1: category=VALUE, base-type=float32
    IDT_Struct_NOA_SDMapSegmentInfo: category=STRUCTURE  # 标准地图信息_Segment
      18 x element, all with category=TYPE_REFERENCE:
        DTE_Seg_MsgType: implementation-data-type=IDT_ADAS_MsgType  # 标识该消息为segmentMessage
        DTE_Seg_CycCnt: implementation-data-type=IDT_ADAS_Seg_CycCnt  # EGMENTMessage的循环计数器:重构器可以用这个值来检测丢失的消息
        DTE_Seg_PathIdx: implementation-data-type=IDT_ADAS_Seg_PathIdx  # 这个segment所属于的path的索引值
        DTE_Seg_Offset: implementation-data-type=IDT_ADAS_Seg_Offset  # 当前segment起点到该Path起点的距离
        DTE_Seg_Update: implementation-data-type=IDT_ADAS_Seg_Update  # Segment更新
        DTE_Seg_FuncRoadClass: implementation-data-type=IDT_ADAS_Seg_FuncRoadClass  # segmentFRC信息（对应道路类型，主路）
        DTE_Seg_FormOfWay: implementation-data-type=IDT_ADAS_Seg_FormOfWay  # egment道路设施信息（对应匝道信息，主路及需要进入）
        DTE_Seg_EffSpdLmt: implementation-data-type=IDT_ADAS_Seg_EffSpdLmt  # segment限速信息
        DTE_Seg_EffSpdLmtType: implementation-data-type=IDT_ADAS_Seg_EffSpdLmtType  # segment有效限速类型信息。其中0x5高德内部拓展为测速电子眼类别
        DTE_Seg_NumOfLaneDrvDir: implementation-data-type=IDT_ADAS_Seg_NumOfLaneDrvDir  # segment行车方向车道数信息
        DTE_Seg_NumOfLaneOppDir: implementation-data-type=IDT_ADAS_Seg_NumOfLaneOppDir  # segment行车反向车道数信息
        DTE_Seg_Tunnel: implementation-data-type=IDT_ADAS_Seg_Tunnel  # segment隧道信息
        DTE_Seg_Bridge: implementation-data-type=IDT_ADAS_Seg_Bridge  # segment桥信息
        DTE_Seg_DividedRoad: implementation-data-type=IDT_ADAS_Seg_DividedRoad  # segment隔离带信息
        DTE_Seg_BuildUpArea: implementation-data-type=IDT_ADAS_Seg_BuildUpArea  # segment 所在位置是城市/郊区信息
        DTE_Seg_CmplxInsct: implementation-data-type=IDT_ADAS_Seg_CmplxInsct  # segment复杂路口信息
        DTE_Seg_RelProbb: implementation-data-type=IDT_ADAS_Seg_RelProbb  # 相比在同一条path的上一个segment，这段segment的相对概率
        DTE_Seg_PartOfCalcRoute: implementation-data-type=IDT_ADAS_Seg_PartOfCalcRoute  # segment是否是规划路径信息
    IDT_ADAS_enum_ICASts: category=VALUE, base-type=uint8
    IDT_ICC_int32_NaviStatus: category=VALUE, base-type=sint32
    IDT_TimeManagement: category=STRUCTURE  # 时间信息
      element DTE_UTCTime: implementation-data-type=IDT_TimeStamp64  # UTC时间
      element DTE_TimeInfoMsg: implementation-data-type=IDT_TimeInfoMsg  # 年月日时分秒
    IDT_Enum_ADSRestartBtnSt: category=VALUE, base-type=uint8  # 域控制器一键重启按键 One-click restart button for the domain controller
    IDT_Latitude: category=VALUE, base-type=float32
    IDT_Gen_val_Coordinate_Y: category=VALUE, base-type=float32  # y轴坐标或向量
    IDT_Gen_val_Coordinate_X: category=VALUE, base-type=float32  # X轴坐标或向量
    IDT_INI_ReservedUnit8: category=VALUE, base-type=uint8  # uint8类型保留字段
    IDT_Gen_val_Coordinate_Z: category=VALUE, base-type=float32  # z轴坐标或向量
    IDT_ADAS_Stub_Update: category=VALUE, base-type=uint8
    IDT_ADAS_strt_ESSInfo_2: category=STRUCTURE
      8 x element, all with category=TYPE_REFERENCE:
        DTE_ESSSts: implementation-data-type=IDT_ADAS_enum_ESSSts  # ESS 功能状态
        DTE_ESSDirection: implementation-data-type=IDT_ADAS_enum_ESSDirection  # ESS激活方向
        DTE_AESSts: implementation-data-type=IDT_ADAS_enum_AESSts  # AES 功能状态
        DTE_AESDirection: implementation-data-type=IDT_ADAS_enum_AESDirection  # AES激活方向
        DTE_ESSActiveSt: implementation-data-type=IDT_ADAS_enum_ESSActiveSt  # ESS激活状态
        DTE_AESActiveSt: implementation-data-type=IDT_ADAS_enum_AESActiveSt  # AES激活状态
        DTE_AESESSTextInfo: implementation-data-type=IDT_ADAS_enum_AESESSTextInfo  # AESESS文言提示信息
        DTE_ESSInfoReserved: implementation-data-type=IDT_ESSInfo_arr_Reserved  # 预留
    IDT_ADAS_strt_VPAParkingLotBaseData: category=STRUCTURE  # VPA的停车场的基本信息
      6 x element, all with category=TYPE_REFERENCE:
        DTE_ParkingLotID: implementation-data-type=IDT_Gen_val_ID  # 停车场id
        DTE_ParkingLotName: implementation-data-type=IDT_ADAS_string_VPAParkingLotName  # 路线名称
        DTE_TotalMileage: implementation-data-type=IDT_Gen_val_float32  # 总长度
        DTE_ParkinglotNumber: implementation-data-type=IDT_DataUint16  # 总车位数量
        DTE_ParkinglotLayerNumber: implementation-data-type=IDT_DataUint16  # 总层数
        DTE_ParkingLotAddress: implementation-data-type=IDT_ADAS_string_VPAParkingLotAddress  # 停车场地址
    IDT_ADAS_enum_LKSSts: category=VALUE, base-type=uint8
    IDT_ICC_strt_Coord2DDouble: category=STRUCTURE
      element DTE_Coord2DDoubleLon: implementation-data-type=IDT_ICC_val_longitude  # 经度
      element DTE_Coord2DDoubleLat: implementation-data-type=IDT_ICC_val_latitude  # 维度
    IDT_ICC_strt_VpaSelectZoneInfo: category=STRUCTURE
      5 x element, all with category=TYPE_REFERENCE:
        DTE_SelectZoneID: implementation-data-type=IDT_ICC_uint32_SelectZoneID  # 选择区域ID
        DTE_SelectZoneType: implementation-data-type=IDT_ICC_enum_SelectZoneType  # 选择区域类型
        DTE_SelectZoneFloor: implementation-data-type=IDT_ICC_enum_SelectZoneFloor  # 选择区域所在楼层
        DTE_SelectZonePos_X: implementation-data-type=IDT_ICC_float_SelectZonePos_X  # 选择区域X坐标
        DTE_SelectZonePos_Y: implementation-data-type=IDT_ICC_float_SelectZonePos_Y  # 选择区域Y坐标
    IDT_ADAS_enum_MNPRouteAvailable: category=VALUE, base-type=uint8  # 记忆路线推荐提示
    IDT_ICC_enum_TLREnableBtnSt: category=VALUE, base-type=uint8  # TLR功能使能开关
    IDT_ADAS_Seg_EffSpdLmt: category=VALUE, base-type=uint8
    IDT_ResponseVhrCancelRemoteCall: category=VALUE, base-type=sint32  # 取消VHR日志远程调取--响应
    IDT_LCM_Array_GNSSData: category=STRUCTURE, dynamic-array-size-profile=VSA_LINEAR  # Location Data from GNSS_RawData
      element sizeIndicator: implementation-data-type=specialIDT_DynamicLengthField_uint32
      element IDT_LCM_Array_GNSSData: category=ARRAY
        element IDT_LCM_Array_GNSSData: array-size=1024, array-size-handling=ALL-INDICES-SAME-ARRAY-SIZE, array-size-semantics=VARIABLE-SIZE, implementation-data-type=IDT_LCM_RAWDATA
    IDT_ICC_strt_TimeAndDist: category=STRUCTURE
      element DTE_Dist: implementation-data-type=IDT_ICC_int32_Dist  # 距离（单位米）
      element DTE_Time: implementation-data-type=IDT_ICC_int32_Time  # 时间（单位秒）
    IDT_ADAS_strt_SDmapInfo: category=STRUCTURE  # SDmap输出信息
      10 x element, all with category=TYPE_REFERENCE:
        DTE_NavigationSts: implementation-data-type=IDT_ICC_enum_NavigationSts  # 导航状态
        DTE_NavigationCountryID: implementation-data-type=IDT_ICC_enum_NaviCountryID  # 导航地区ID
        DTE_NavigationCurrenrtRoadType: implementation-data-type=IDT_ICC_enum_NaviRoadType  # 导航道路等级
        DTE_NaviRampOutDistance: implementation-data-type=IDT_ICC_val_Distance  # 自车距离下一出口距离
        DTE_NaviIntervalCameraInfo: implementation-data-type=IDT_ICC_arr_NaviIntervalCameraInfo  # 导航模式下区间测速信息
        DTE_NaviCameraRes: implementation-data-type=IDT_ICC_arr_NaviCameraRes  # 导航模式下电子眼信息
        DTE_NaviCruiseFacilityInfo: implementation-data-type=IDT_ICC_arr_NaviCruiseFacilityInfo  # 巡航模式下电子眼信息
        DTE_NaviRoadSpeed: implementation-data-type=IDT_ICC_enum_SpeedLimitValue  # 路段限速
        DTE_WeatherInfo: implementation-data-type=IDT_ICC_arr_WeatherInfo  # 自车前方2km天气信息
        DTE_TrafficJamInfo: implementation-data-type=IDT_ICC_arr_TrafficJamInfo  # 自车前方2km交通拥堵信息
    IDT_EcallMode: category=VALUE, base-type=uint8  # Ecall触发方式
    IDT_ADAS_enum_CruiseAccelerateSts: category=VALUE, base-type=uint8
    IDT_ADAS_arr_HPAPathDetail_2: category=STRUCTURE, dynamic-array-size-profile=VSA_LINEAR
      element sizeIndicator: implementation-data-type=specialIDT_DynamicLengthField_uint32
      element IDT_ADAS_arr_HPAPathDetail_2: category=ARRAY
        element IDT_ADAS_arr_HPAPathDetail_2: array-size=20, array-size-handling=ALL-INDICES-SAME-ARRAY-SIZE, array-size-semantics=VARIABLE-SIZE, implementation-data-type=IDT_ADAS_strt_HPAPathDetail_2
    IDT_Struct_NOA_SDMapMetaInfo: category=STRUCTURE  # 标准地图信息_Meta
      13 x element, all with category=TYPE_REFERENCE:
        DTE_Meta_MsgType: implementation-data-type=IDT_ADAS_MsgType  # 标识该消息位meta datamessage
        DTE_Meta_CycCnt: implementation-data-type=IDT_ADAS_Meta_CycCnt  # 这个messagetype的循环计数器:重构器可以用这个值来检测丢失的消息
        DTE_Meta_CountryCode: implementation-data-type=IDT_ADAS_Meta_CountryCode  # 国家代码
        DTE_Meta_RegionCode: implementation-data-type=IDT_ADAS_Meta_RegionCode  # 区域代码
        DTE_Meta_DrvSide: implementation-data-type=IDT_ADAS_Meta_DrvSide  # 驾驶方向
        DTE_Meta_SpdUnits: implementation-data-type=IDT_ADAS_Meta_SpdUnits  # 限速单位
        DTE_Meta_ProtVer_Major: implementation-data-type=IDT_ADAS_Meta_ProtVer_Major  # 主要协议版本
        DTE_Meta_ProtVer_Minor: implementation-data-type=IDT_ADAS_Meta_ProtVer_Minor  # 次要协议版本
        DTE_Meta_ProtVer_MinorSub: implementation-data-type=IDT_ADAS_Meta_ProtVer_MinorSub  # 次要协议子版本
        DTE_Meta_HwVer: implementation-data-type=IDT_ADAS_Meta_HwVer  # 生成器的硬件和/或 软件版本
        DTE_Meta_MapProvider: implementation-data-type=IDT_ADAS_Meta_MapProvider  # 地图供应商
        DTE_Meta_MapVerYear: implementation-data-type=IDT_ADAS_Meta_MapVerYear  # 地图版本年
        DTE_Meta_MapVerQtr: implementation-data-type=IDT_ADAS_Meta_MapVerQtr  # 地图版本季度
    IDT_OperatingSimInfoReserved: category=ARRAY  # 当前使用的Sim卡信息预留
      element INI_ReservedUnit8: array-size=16, array-size-semantics=FIXED-SIZE, implementation-data-type=IDT_INI_ReservedUnit8
    IDT_ADAS_enum_NOARemainingMileageFromODD: category=VALUE, base-type=float32  # 距离前方ODD终点里程数
    IDT_ADAS_enum_DetourAroundObstacleBtnStFb: category=VALUE, base-type=uint8  # 借道绕行障碍物设置反馈
    IDT_ADAS_enum_SglSendMode: category=VALUE, base-type=uint8  # 发送模式 Transmission mode
    IDT_ICC_uint32_SelectZoneID: category=VALUE, base-type=uint8
    IDT_ICC_string_AoiName: category=STRUCTURE, dynamic-array-size-profile=VSA_LINEAR
      element sizeIndicator: implementation-data-type=specialIDT_DynamicLengthField_uint32
      element IDT_ICC_string_AoiName: category=ARRAY
        element IDT_ICC_string_AoiName: array-size=1000, array-size-handling=ALL-INDICES-SAME-ARRAY-SIZE, array-size-semantics=VARIABLE-SIZE, implementation-data-type=specialIDT_StringRef
    IDT_Enum_LogFTPSts: category=VALUE, base-type=uint8  # FTP状态
    IDT_Struct_HDMapInfo: category=STRUCTURE  # HD Map审图号等信息
      4 x element, all with category=TYPE_REFERENCE:
        DTE_ApprovalVersion: implementation-data-type=IDT_StrVar_HDMap  # 审图号信息
        DTE_Supplier: implementation-data-type=IDT_StrVar_HDMap  # 供应商信息
        DTE_DBVersion: implementation-data-type=IDT_StrVar_HDMap  # 地图数据版本号信息
        DTE_HDMapInfoReserved: implementation-data-type=IDT_HDMapInfo_arr_Reserved  # 预留
    IDT_ICC_enum_NaviRoadType: category=VALUE, base-type=uint8
    IDT_ApnArray: category=STRUCTURE, dynamic-array-size-profile=VSA_LINEAR
      element sizeIndicator: implementation-data-type=specialIDT_DynamicLengthField_uint32
      element IDT_ApnArray: category=ARRAY
        element IDT_ApnArray: array-size=5, array-size-handling=ALL-INDICES-SAME-ARRAY-SIZE, array-size-semantics=VARIABLE-SIZE, implementation-data-type=IDT_ApnInfo
    IDT_ADAS_enum_TolAutoRoadCrossingsNum: category=VALUE, base-type=uint64  # 自动过路口数量
    IDT_ICC_arr_BackLaneTypes: category=STRUCTURE, dynamic-array-size-profile=VSA_LINEAR
      element sizeIndicator: implementation-data-type=specialIDT_DynamicLengthField_uint32
      element IDT_ICC_arr_BackLaneTypes: category=ARRAY
        element IDT_ICC_arr_BackLaneTypes: array-size=32, array-size-handling=ALL-INDICES-SAME-ARRAY-SIZE, array-size-semantics=VARIABLE-SIZE, implementation-data-type=IDT_ICC_strt_LaneCategoryType
    IDT_ICC_enum_FCTAWarnType: category=VALUE, base-type=uint8  # FCTA报警方式
    IDT_ADAS_arr_HPASpeedBumpInfo: category=STRUCTURE, dynamic-array-size-profile=VSA_LINEAR
      element sizeIndicator: implementation-data-type=specialIDT_DynamicLengthField_uint32
      element IDT_ADAS_arr_HPASpeedBumpInfo: category=ARRAY
        element IDT_ADAS_arr_HPASpeedBumpInfo: array-size=10, array-size-handling=ALL-INDICES-SAME-ARRAY-SIZE, array-size-semantics=VARIABLE-SIZE, implementation-data-type=IDT_ADAS_strt_SpeedBumpInfo
    IDT_ADAS_uint16_SurfaceMeshBevw: category=VALUE, base-type=uint16
    IDT_ADAS_enum_VPASts: category=VALUE, base-type=uint8
    IDT_ICC_enum_LKSSettingSt: category=VALUE, base-type=uint8  # LDW/LDP功能设置状态
    IDT_ICC_int64_Time: category=VALUE, base-type=sint64
    IDT_ADAS_enum_TolAPAParkedOutTime: category=VALUE, base-type=uint64  # APA泊出时长
    IDT_ADAS_enum_ISLISpeedLimitSign: category=VALUE, base-type=uint8
    IDT_ADAS_enum_MRACheckSts: category=VALUE, base-type=uint8
    IDT_SentryModeAlarmCnt: category=VALUE, base-type=uint32  # 哨兵模式警报告警次数
    IDT_ADAS_strt_ICAInfo_2: category=STRUCTURE
      16 x element, all with category=TYPE_REFERENCE:
        DTE_ICASts: implementation-data-type=IDT_ADAS_enum_ICASts  # ICA 工作状态
        DTE_ICATextInfo: implementation-data-type=IDT_ADAS_enum_ICATextInfo  # ICA 提示信息
        DTE_ICAQuitReason: implementation-data-type=IDT_ADAS_enum_ICAQuitReason  # ICA 退出原因
        DTE_ICASenarioReminder: implementation-data-type=IDT_ADAS_enum_ICASenarioReminder  # ICA场景提示
        DTE_ICAPlusONOFFSts: implementation-data-type=IDT_ADAS_enum_ICAPlusONOFFSts  # ICAPlus开关状态
        DTE_HandsOffWarningStyle: implementation-data-type=IDT_ADAS_enum_HandsOffWarningStyle  # 脱手报警风格
        DTE_TrafficLightAssistBtnStFb: implementation-data-type=IDT_ADAS_enum_TrafficLightAssistBtnStFb  # 红绿灯辅助设置反馈
        DTE_DetourAroundObstacleBtnStFb: implementation-data-type=IDT_ADAS_enum_DetourAroundObstacleBtnStFb  # 借道绕行障碍物设置反馈
        DTE_EfficientPassageBtnStFb: implementation-data-type=IDT_ADAS_enum_EfficientPassageBtnStFb  # 高效通行软开关设置反馈
        DTE_IntelligentEvasionBtnStFb: implementation-data-type=IDT_ADAS_enum_IntelligentEvasionBtnStFb  # 智慧躲闪软开关设置反馈
        DTE_RADSEnableBtnStFb: implementation-data-type=IDT_ADAS_enum_RADSEnableBtnStFb  # 循迹倒车设置反馈
        DTE_OutsideParkingBtnStFb: implementation-data-type=IDT_ADAS_enum_OutsideParkingBtnStFb  # 离车泊入开关设置反馈
        DTE_RGearDefaultFunctionBtnStFb: implementation-data-type=IDT_ADAS_enum_RGearDefaultFunctionBtnStFb  # R挡默认打开项设置反馈
        DTE_ICAConfidence: implementation-data-type=IDT_ADAS_enum_ICAConfidence  # ICA置信度
        DTE_TollStationPathStFb: implementation-data-type=IDT_Enum_TollStationPathStFb  # 收费通道选择状态 Toll Station Path select status
        DTE_ICAInfoReserved: implementation-data-type=IDT_ICAInfo_arr_Reserved  # 预留
    IDT_Arr_DataInLoop: category=ARRAY  # 回传数据字段 Transmitted back data field
      element Enum_DataInLoopUnit: array-size=1200, array-size-semantics=FIXED-SIZE, implementation-data-type=IDT_Enum_DataInLoopUnit
    IDT_ADAS_Seg_CmplxInsct: category=VALUE, base-type=uint8
    IDT_ICC_int16_Index: category=VALUE, base-type=sint16
    IDT_ICC_enum_SelectZoneType: category=VALUE, base-type=uint8
    IDT_ICC_strt_ViaPointInfo: category=STRUCTURE
      6 x element, all with category=TYPE_REFERENCE:
        DTE_ViaPointSegmentIdx: implementation-data-type=IDT_ICC_int16_Index  # 导航段索引
        DTE_ViaPointDirection: implementation-data-type=IDT_ICC_val_Direction  # 途经点所在道路方向
        DTE_ViaPointShow: implementation-data-type=IDT_ICC_strt_Coord2DDouble  # 显示坐标
        DTE_ViaPointProjective: implementation-data-type=IDT_ICC_strt_Coord3DDouble  # 显示坐标的投影点坐标
        DTE_ViaPointPoiName: implementation-data-type=IDT_ICC_string_PoiName  # POI名称
        DTE_ViaPointReserved: implementation-data-type=IDT_ViaPoint_arr_Reserved  # 预留
    IDT_ICC_enum_ISLICruiseSpdOffsetAbd: category=VALUE, base-type=sint8  # 固定限速偏移量
    IDT_StrVar_MCC: category=STRUCTURE, dynamic-array-size-profile=VSA_LINEAR  # 移动国家代码，中国固定460
      element sizeIndicator: implementation-data-type=specialIDT_DynamicLengthField_uint32
      element IDT_StrVar_MCC: category=ARRAY
        element IDT_StrVar_MCC: array-size=3, array-size-handling=ALL-INDICES-SAME-ARRAY-SIZE, array-size-semantics=VARIABLE-SIZE, implementation-data-type=specialIDT_StringRef
    IDT_SeqNum: category=VALUE, base-type=uint32  # 序列号
    IDT_Arr_CamStreamStRespResd: category=ARRAY  # 预留 Reserved
      element Reserved_uint8_Type: array-size=20, array-size-semantics=FIXED-SIZE, implementation-data-type=IDT_Reserved_uint8_Type
    IDT_ADAS_enum_VPAButtonStatus: category=VALUE, base-type=uint8
    IDT_ADAS_enum_TolU_turnsNum: category=VALUE, base-type=uint64  # 掉头次数
    IDT_ADAS_strt_VPASelfBuildMapDate: category=STRUCTURE  # 自建地图数据
      6 x element, all with category=TYPE_REFERENCE, implementation-data-type=IDT_Gen_val_unit8:
        DTE_Padding{1..6}  # 填充{1..6}
    IDT_Enum_TBOXOTAAPPTInstall: category=VALUE, base-type=uint8  # TBOX通知预约升级事件
    IDT_Enum_CamCalPrmsData: category=VALUE, base-type=uint8  # 相机参数原始标定参数（含内外参） Camera Raw Calibration Parameters (Intrinsic & Extrinsic)
    IDT_Enum_State: category=VALUE, base-type=uint8  # 通话状态
    IDT_TimeValidFlag: category=VALUE, base-type=uint8  # 时间有效性标记
    IDT_AvmCamIntrinsicsDataReq: category=VALUE, base-type=uint8  # 获取环视相机内参数据
    IDT_Str_MemRoute: category=STRUCTURE, dynamic-array-size-profile=VSA_LINEAR
      element sizeIndicator: implementation-data-type=specialIDT_DynamicLengthField_uint32
      element IDT_Str_MemRoute: category=ARRAY
        element IDT_Str_MemRoute: array-size=32, array-size-handling=ALL-INDICES-SAME-ARRAY-SIZE, array-size-semantics=VARIABLE-SIZE, implementation-data-type=specialIDT_StringRef
    IDT_SentryModePlanStartTime_hour: category=VALUE, base-type=uint32  # 哨兵模式预约开启时间（时）
    IDT_ADAS_struct_NRAInfo: category=STRUCTURE
      5 x element, all with category=TYPE_REFERENCE:
        DTE_NarrowRoadAssistSts: implementation-data-type=IDT_ADAS_enum_NarrowRoadAssistSts  # 窄路辅助功能状态
        DTE_NRATrajectoryPoint: implementation-data-type=IDT_ADAS_arr_TrajectoryPoint  # 窄路辅助轨迹线
        DTE_NarrowRoadAssistTextInfo: implementation-data-type=IDT_ADAS_enum_NarrowRoadAssistTextInfo  # 窄路辅助提示信息
        DTE_NRAQuitReason: implementation-data-type=IDT_ADAS_enum_NRAQuitReason  # 退出原因
        DTE_NRAPreScanSts: implementation-data-type=IDT_ADAS_enum_NRAPreScanSts  # 预瞄状态
    IDT_ADAS_arr_ParkingStaticObjects_2: category=STRUCTURE, dynamic-array-size-profile=VSA_LINEAR  # 泊车静态目标数组
      element sizeIndicator: implementation-data-type=specialIDT_DynamicLengthField_uint32
      element IDT_ADAS_arr_ParkingStaticObjects_2: category=ARRAY
        element IDT_ADAS_arr_ParkingStaticObjects_2: array-size=100, array-size-handling=ALL-INDICES-SAME-ARRAY-SIZE, array-size-semantics=VARIABLE-SIZE, implementation-data-type=IDT_ADAS_strt_StaticObject_2
    IDT_ADAS_strt_EgoPose: category=STRUCTURE
      6 x element, all with category=TYPE_REFERENCE:
        DTE_EgoVehPoseX: implementation-data-type=IDT_Gen_val_Coordinate_X  # 自车位置坐标
        DTE_EgoVehPoseY: implementation-data-type=IDT_Gen_val_Coordinate_Y  # 自车位置坐标
        DTE_EgoVehPoseZ: implementation-data-type=IDT_Gen_val_Coordinate_Z  # 自车位置坐标
        DTE_EgoVehYaw: implementation-data-type=IDT_Gen_val_Yaw  # 自车位姿
        DTE_EgoVehPitch: implementation-data-type=IDT_Gen_val_Pitch  # 自车位姿
        DTE_EgoVehRoll: implementation-data-type=IDT_Gen_val_Roll  # 自车位姿
    IDT_ChargingUtcSecs: category=VALUE, base-type=uint32  # 预约充电时间
    IDT_ADAS_enum_VPAPickUpPosSelectReq: category=VALUE, base-type=uint8
    IDT_Longitude: category=VALUE, base-type=float32
    IDT_ADAS_enum_MNPBuildMapSts: category=VALUE, base-type=uint8  # MNP建图工作状态
    IDT_ADAS_ProfLong_PathIdx: category=VALUE, base-type=uint8
    IDT_Enum_FTPState: category=VALUE, base-type=uint8
    IDT_ICC_enum_NOPLaneChangeWarnType: category=VALUE, base-type=uint8  # NOP变道提醒模式
    IDT_ActiveSafetyFcn_arr_Reserved: category=ARRAY  # 预留
      element Reserved_uint8_Type: array-size=47, array-size-semantics=FIXED-SIZE, implementation-data-type=IDT_Reserved_uint8_Type
    IDT_ADAS_ProfLong_Value: category=VALUE, base-type=uint32
    IDT_ADAS_ProfShort_Offset: category=VALUE, base-type=uint16
    IDT_IcaState: category=VALUE, base-type=uint8  # ICA状态信息
    IDT_StrVar_MNC: category=STRUCTURE, dynamic-array-size-profile=VSA_LINEAR  # 移动网络号码
      element sizeIndicator: implementation-data-type=specialIDT_DynamicLengthField_uint32
      element IDT_StrVar_MNC: category=ARRAY
        element IDT_StrVar_MNC: array-size=2, array-size-handling=ALL-INDICES-SAME-ARRAY-SIZE, array-size-semantics=VARIABLE-SIZE, implementation-data-type=specialIDT_StringRef
    IDT_DVRSts: category=VALUE, base-type=uint8
    IDT_ADAS_arr_HPATrajectoryPoint: category=ARRAY
      element ADAS_strt_HPAVPAPathInfo: array-size=64, array-size-semantics=FIXED-SIZE, implementation-data-type=IDT_ADAS_strt_HPAVPAPathInfo
    IDT_HPAPath_arr_Reserved: category=ARRAY  # 预留
      element Reserved_uint8_Type: array-size=30, array-size-semantics=FIXED-SIZE, implementation-data-type=IDT_Reserved_uint8_Type
    IDT_ADAS_enum_ALCSts: category=VALUE, base-type=uint8
    IDT_ICC_enum_NavSpeedLimit: category=VALUE, base-type=uint8  # 导航限速值
    IDT_Enum_UpdateCompleted: category=VALUE, base-type=uint8  # DMC发送升级成功指令
    IDT_ADAS_enum_ALCTextInfo: category=VALUE, base-type=uint8
    IDT_ADAS_enum_MAASts: category=VALUE, base-type=uint8
    IDT_ICC_enum_VPASettingSt: category=VALUE, base-type=uint8  # VPA功能设置状态
    IDT_ValetParkingRoadCellInfo: category=STRUCTURE  # ADS发送所有轨迹图层信息
      element DTE_valetParkingReferDistanceStep: implementation-data-type=IDT_ValetParkingReferDistanceStep  # 代客泊车路点间隔
      element DTE_valetParkingPointNum: implementation-data-type=IDT_ValetParkingPointNum  # 代客泊车路点个数
      element DTE_valetParkingPoinNetArray: implementation-data-type=IDT_ValetParkingPoinNetArray  # 代客泊车各点小区信息数组
    IDT_StrVar_RouterIPAddress: category=STRUCTURE, dynamic-array-size-profile=VSA_LINEAR  # 路由器IP
      element sizeIndicator: implementation-data-type=specialIDT_DynamicLengthField_uint32
      element IDT_StrVar_RouterIPAddress: category=ARRAY
        element IDT_StrVar_RouterIPAddress: array-size=30, array-size-handling=ALL-INDICES-SAME-ARRAY-SIZE, array-size-semantics=VARIABLE-SIZE, implementation-data-type=specialIDT_StringRef
    IDT_ADAS_enum_FcwAcitveSt: category=VALUE, base-type=uint8
    IDT_ADAS_enum_TSISgnGiWay: category=VALUE, base-type=uint8  # TSR让行类标识牌
    IDT_ADAS_enum_SglRespondCongestion: category=VALUE, base-type=uint16  # 应对加塞
    IDT_StrVar_BleSlaverRearMac: category=STRUCTURE, dynamic-array-size-profile=VSA_LINEAR  # 蓝牙后从模块MAC 地址
      element sizeIndicator: implementation-data-type=specialIDT_DynamicLengthField_uint32
      element IDT_StrVar_BleSlaverRearMac: category=ARRAY
        element IDT_StrVar_BleSlaverRearMac: array-size=24, array-size-handling=ALL-INDICES-SAME-ARRAY-SIZE, array-size-semantics=VARIABLE-SIZE, implementation-data-type=specialIDT_StringRef
    IDT_ADAS_enum_ELKLeftActiveSt: category=VALUE, base-type=uint8
    IDT_ConnStatus: category=VALUE, base-type=sint32
    IDT_DownFlow: category=VALUE, base-type=sint64
    IDT_ICC_int32_FacilityType: category=VALUE, base-type=sint32  # 道路设施类型
    IDT_ADAS_enum_HPAPathLabeType: category=VALUE, base-type=uint8  # 记忆泊车标签类型
    IDT_ADAS_enum_RoadMarkerType: category=VALUE, base-type=uint8  # 路面标记类型
    IDT_ADAS_ProfLong_Offset: category=VALUE, base-type=uint16
    IDT_ICC_enum_ISLISpdOffsetMod: category=VALUE, base-type=uint8  # 限速设置方式（预留）
    IDT_ADAS_enum_NRAQuitReason: category=VALUE, base-type=uint8
    IDT_ICC_enum_FreeSlotType: category=VALUE, base-type=uint8
    IDT_TimeInfoSync: category=STRUCTURE  # 携带TimeOffset 信息
      4 x element, all with category=TYPE_REFERENCE:
        DTE_ntpTimeOffset: implementation-data-type=IDT_TimeStampOffset  # NTP时间与gPTP时间的差值
        DTE_gnssTimeOffset: implementation-data-type=IDT_TimeStampOffset  # GNSS时间与gPTP时间的差值
        DTE_nitzTimeOffset: implementation-data-type=IDT_TimeStampOffset  # NITZ时间与gPTP时间的差值
        DTE_timeZoneInfo: implementation-data-type=IDT_TimeZoneInfo  # 当地时区信息，包含夏令时影响
    IDT_ADAS_arr_StaticObjects_2: category=STRUCTURE, dynamic-array-size-profile=VSA_LINEAR  # 行车静态目标数组
      element sizeIndicator: implementation-data-type=specialIDT_DynamicLengthField_uint32
      element IDT_ADAS_arr_StaticObjects_2: category=ARRAY
        element IDT_ADAS_arr_StaticObjects_2: array-size=100, array-size-handling=ALL-INDICES-SAME-ARRAY-SIZE, array-size-semantics=VARIABLE-SIZE, implementation-data-type=IDT_ADAS_strt_StaticObject_2
    IDT_Struct_LanePositionInfo: category=STRUCTURE  # 车道线上的位置信息
      7 x element, all with category=TYPE_REFERENCE:
        DTE_linkId: implementation-data-type=IDT_DataUint64  # Link ID，mode位invalid时，赋默认值0
        DTE_laneGroupId: implementation-data-type=IDT_DataUint64  # LaneGroupId, mode位invalid时，赋默认值0
        DTE_length: implementation-data-type=IDT_LanePositionInfo_length  # length of lane ，单位m，mode位invalid时，赋默认值0
        DTE_offset: implementation-data-type=IDT_LanePositionInfo_offset  # position on lane from start ,单位m,mode为invalid时，赋默认值0
        DTE_offset_Lateral: implementation-data-type=IDT_LanePositionInfo_offset_Lateral  # 相对于车道中心线的横向偏移 ,单位m,mode为invalid时，赋默认值0
        DTE_heading: implementation-data-type=IDT_LanePositionInfo_heading  # heading at current position，unit in degree 0=north clockwise
        DTE_laneNo: implementation-data-type=IDT_DataUint32  # lane编号 从右往左0，.... ，n，没有匹配上车线时赋值0xFFFF
    IDT_StrVar_CanConfig: category=STRUCTURE, dynamic-array-size-profile=VSA_LINEAR  # CAN配置信息
      element sizeIndicator: implementation-data-type=specialIDT_DynamicLengthField_uint32
      element IDT_StrVar_CanConfig: category=ARRAY
        element IDT_StrVar_CanConfig: array-size=255, array-size-handling=ALL-INDICES-SAME-ARRAY-SIZE, array-size-semantics=VARIABLE-SIZE, implementation-data-type=specialIDT_StringRef
    IDT_Enum_Action: category=VALUE, base-type=uint8
    IDT_Congestion_arr_Reserved: category=ARRAY
      element Reserved_int32_Type: array-size=15, array-size-semantics=FIXED-SIZE, implementation-data-type=IDT_Reserved_int32_Type
    IDT_TimeInfoMonth: category=VALUE, base-type=uint8  # 月
    IDT_SimSwitchCheckFailReason: category=VALUE, base-type=uint32  # 切卡失败原因
    IDT_ADAS_ProfLong_Update: category=VALUE, base-type=uint8
    IDT_ICC_strt_NotAvoidInfo: category=STRUCTURE
      7 x element, all with category=TYPE_REFERENCE:
        DTE_NotAvoidType: implementation-data-type=IDT_ICC_int32_NotAvoidType  # 类型
        DTE_NotAvoidDistToCar: implementation-data-type=IDT_ICC_int32_Dist  # 到自车的距离
        DTE_NotAvoidCoord2D: implementation-data-type=IDT_ICC_strt_Coord2DDouble  # 二维位置
        DTE_NotAvoidCoord3D: implementation-data-type=IDT_ICC_strt_Coord3DDouble  # 三维位置
        DTE_NotAvoidForbidType: implementation-data-type=IDT_ICC_int32_ForbidType  # 禁行类型
        DTE_NotAvoidValid: implementation-data-type=IDT_ICC_boolean_Valid  # 是否有效
        DTE_NotAvoidReserved: implementation-data-type=IDT_NotAvoid_arr_Reserved  # 预留
    IDT_ICC_arr_FrontLane: category=STRUCTURE, dynamic-array-size-profile=VSA_LINEAR  # 前景车道
      element sizeIndicator: implementation-data-type=specialIDT_DynamicLengthField_uint32
      element IDT_ICC_arr_FrontLane: category=ARRAY
        element IDT_ICC_arr_FrontLane: array-size=12, array-size-handling=ALL-INDICES-SAME-ARRAY-SIZE, array-size-semantics=VARIABLE-SIZE, implementation-data-type=IDT_ICC_enum_LaneAction
    IDT_ADAS_enum_LinePositionIndex: category=VALUE, base-type=uint8
    IDT_Enum_TBOXOTARemoteAPPTSet: category=VALUE, base-type=uint8  # 远控OTA预约升级
    IDT_ICC_enum_VPAOperationId: category=VALUE, base-type=uint8
    IDT_ICC_int32_Angle: category=VALUE, base-type=sint32
    IDT_ADAS_enum_NOPStReminder: category=VALUE, base-type=uint8
    IDT_ICC_val_Time: category=VALUE, base-type=uint32
    IDT_Enum_BEICALL: category=VALUE, base-type=uint8  # 请求电话操作（B/E/I call）
    IDT_ADAS_enum_ParkOutDirectionSt: category=VALUE, base-type=uint8
    IDT_ICC_enum_SetPathLabel: category=VALUE, base-type=uint8
    IDT_Enum_RouteMMStatus: category=VALUE, base-type=uint8  # HD路线匹配状态
    IDT_ICC_strt_RampInfo: category=STRUCTURE  # 匝道信息
      4 x element, all with category=TYPE_REFERENCE:
        DTE_RampExists: implementation-data-type=IDT_ICC_boolean_exists
        DTE_RampDistance1: implementation-data-type=IDT_ICC_int32_Dist
        DTE_RampDistance2: implementation-data-type=IDT_ICC_int32_Dist
        DTE_RampInfoReserved: implementation-data-type=IDT_RampInfo_arr_Reserved  # 预留
    IDT_ADAS_strt_VPAParkingInfo: category=STRUCTURE  # VPA的功能状态信息
      19 x element, all with category=TYPE_REFERENCE:
        DTE_VPAParkingSts: implementation-data-type=IDT_ADAS_enum_VPAStation  # VPA的状态
        DTE_VPAParkingQuitInd: implementation-data-type=IDT_ADAS_enum_VPAQuitInd  # VPA退出提示
        DTE_VPAParkingDriOperateInd: implementation-data-type=IDT_ADAS_enum_VPADriOperateInd  # VPA驾驶员操作提示
        DTE_VPAParkingPauseInd: implementation-data-type=IDT_ADAS_enum_VPAPauseInd  # VPA暂停提示
        DTE_VPAParkingFailureReasonInd: implementation-data-type=IDT_ADAS_enum_VPAFailureReasonInd  # VPA故障原因
        DTE_VPAParkingVoiceRemind: implementation-data-type=IDT_ADAS_enum_VPAVoiceRemind  # VPA语音提示
        DTE_VPABuildMapDistance: implementation-data-type=IDT_Gen_val_float32  # VPA建图距离
        DTE_VPABuildMapProgress: implementation-data-type=IDT_DataUint8  # VPA生成大地图的进度
        DTE_VPABuildMapParkingSlotNumber: implementation-data-type=IDT_DataUint32  # VPA已经学习的车位数量
        DTE_VPABuildMapLayerNumber: implementation-data-type=IDT_DataUint16  # VPA已经 学习了多少层
        DTE_VPACurrentLayer: implementation-data-type=IDT_ADAS_enum_VPAFloor  # VPA车辆所在当前层
        DTE_VPACurisingDistance: implementation-data-type=IDT_Gen_val_float32  # VPA巡航剩余距离
        DTE_VPAGlobalRouting: implementation-data-type=IDT_ADAS_arr_VPARoadLine  # VPA全局轨迹线
        DTE_VPADrivingTrajectoryPoint: implementation-data-type=IDT_ADAS_arr_TrajectoryPoint  # 决策引导线
        DTE_VPACurrentParkingLotID: implementation-data-type=IDT_Gen_val_ID  # 当前位于的停车场ID
        DTE_VPABuildMapMaxDistance: implementation-data-type=IDT_Gen_val_float32  # 支持的最大建图距离
        DTE_VPACrusingProgress: implementation-data-type=IDT_DataUint8  # 代客泊车进度条
        DTE_VPARpaToggleBtnDisp: implementation-data-type=IDT_DataUint8  # 是否显示遥控泊车开关
        DTE_VPAButtonStatus: implementation-data-type=IDT_ADAS_enum_VPAButtonStatus  # 驾驶员请求手动建图反馈信号
    IDT_UpRate: category=VALUE, base-type=uint32
    IDT_MNPInfo_arr_Reserved2: category=ARRAY  # 预留
      element Reserved_uint8_Type: array-size=50, array-size-semantics=FIXED-SIZE, implementation-data-type=IDT_Reserved_uint8_Type
    IDT_ADAS_enum_ParkingQuitInd: category=VALUE, base-type=uint8
    IDT_ICC_enum_NavCurrRoadType: category=VALUE, base-type=uint8  # 导航道路类型
    IDT_NaviCameraExt_arr_Reserved: category=ARRAY
      element Reserved_int32_Type: array-size=20, array-size-semantics=FIXED-SIZE, implementation-data-type=IDT_Reserved_int32_Type
    IDT_Struct_TBOXOTAAPPTSync: category=STRUCTURE  # TBOX的OTA预约升级任务
      element DTE_ScheduleID: implementation-data-type=IDT_StrVar_ScheduleID  # OTA的任务ID
      element DTE_OTAAPPTSecs: implementation-data-type=IDT_OTAAPPTSecs  # 预约升级时间
    IDT_ICC_enum_NRASettingSt: category=VALUE, base-type=uint8  # 窄路辅助操作指令
    IDT_ICC_arr_TimeAndDist: category=STRUCTURE, dynamic-array-size-profile=VSA_LINEAR
      element sizeIndicator: implementation-data-type=specialIDT_DynamicLengthField_uint32
      element IDT_ICC_arr_TimeAndDist: category=ARRAY
        element IDT_ICC_arr_TimeAndDist: array-size=50, array-size-handling=ALL-INDICES-SAME-ARRAY-SIZE, array-size-semantics=VARIABLE-SIZE, implementation-data-type=IDT_ICC_strt_TimeAndDist
    IDT_ADAS_val_XboundMin: category=VALUE, base-type=float32
    IDT_ICC_float_Point: category=VALUE, base-type=float32
    IDT_ADAS_enum_TolLCCMileage: category=VALUE, base-type=float32  # LCC行驶里程
    IDT_ICC_strt_ApaRpaFcnOperating_2: category=STRUCTURE
      7 x element, all with category=TYPE_REFERENCE:
        DTE_ApaOperationId: implementation-data-type=IDT_ICC_enum_ApaOperationId  # APA功能操作指令
        DTE_ApaModeReq: implementation-data-type=IDT_ICC_enum_ApaModeReq  # APA模式选择指令
        DTE_ApaSelectSlotID: implementation-data-type=IDT_ICC_uint16_SelectSlotID  # APA选择车位ID
        DTE_ApaPocDirection: implementation-data-type=IDT_ICC_enum_ApaPocDirection  # APA泊出方向指令
        DTE_ApaFreeSlotInfo: implementation-data-type=IDT_ICC_strt_ApaFreeSlotInfo  # APA自选车位信息
        DTE_APARoad_Class: implementation-data-type=IDT_ICC_enum_APARoad_Class  # 道路等级
        DTE_ApaRpaFcnReserved: implementation-data-type=IDT_ApaRpaFcn_arr_Reserved  # 预留
    IDT_ADAS_strt_ParkingGenaralInfo_2: category=STRUCTURE
      19 x element, all with category=TYPE_REFERENCE:
        DTE_ParkingActiveSubFuncSt: implementation-data-type=IDT_ADAS_enum_ParkingActiveSubFuncSt  # 泊车子功能激活状态
        DTE_ParkingQuitInd: implementation-data-type=IDT_ADAS_enum_ParkingQuitInd  # 泊车退出提示
        DTE_ParkingDriOperateInd: implementation-data-type=IDT_ADAS_enum_ParkingDriOperateInd  # 驾驶员操作提示
        DTE_ParkingPauseInd: implementation-data-type=IDT_ADAS_enum_ParkingPauseInd  # 泊车暂停提示
        DTE_ParkingFailureReasonInd: implementation-data-type=IDT_ADAS_enum_ParkingFailureReasonInd  # 泊车故障原因
        DTE_ParkingVoiceRemind: implementation-data-type=IDT_ADAS_enum_ParkingVoiceRemind  # 泊车语音提示
        DTE_ADAS_ParkingScreen_ctrl: implementation-data-type=IDT_ADAS_enum_ParkingScreen_ctrl  # APA大屏界面显示信号
        DTE_APAFucButtonSts: implementation-data-type=IDT_ADAS_enum_ParkingButtonSts  # APA功能按钮显示状态
        DTE_HPAFucButtonSts: implementation-data-type=IDT_ADAS_enum_ParkingButtonSts  # HPA功能按钮显示状态
        DTE_MRAFucButtonSts: implementation-data-type=IDT_ADAS_enum_ParkingButtonSts  # MRA功能按钮显示状态
        DTE_FreeParkFucButtonSts: implementation-data-type=IDT_ADAS_enum_ParkingButtonSts  # 自定义泊车功能按钮显示状态
        DTE_ParkingLotButtonSts: implementation-data-type=IDT_ADAS_enum_ParkingButtonSts  # 收藏停车场图标显示状态
        DTE_RoadClassReq: implementation-data-type=IDT_Gen_enum_AvailableSts  # 获取道路等级请求
        DTE_RPASet: implementation-data-type=IDT_ADAS_enum_RPAset  # 遥控泊车设置项
        DTE_ParkingSpeedSet: implementation-data-type=IDT_ADAS_enum_ParkingSpeedSet  # 泊车车速控制设置项
        DTE_HPACrusingSpeedSet: implementation-data-type=IDT_ADAS_enum_ParkingSpeedSet  # 泊车巡航车速控制设置项
        DTE_ParkingChimeVoice: implementation-data-type=IDT_ADAS_enum_ParkingChimeVoice  # 泊车提示音
        DTE_AMAPSts: implementation-data-type=IDT_ADAS_enum_AMAPSts  # 加速踏板防误踩状态机信息
        DTE_PrkgGenaralReserved: implementation-data-type=IDT_PrkgGenaral_arr_Reserved  # 预留
    IDT_Gen_val_Roll: category=VALUE, base-type=float32  # 翻滚角
    IDT_ADAS_ProfLong_ProfType: category=VALUE, base-type=uint8
    IDT_ADAS_arr_MNPMemRoutePoints: category=STRUCTURE, dynamic-array-size-profile=VSA_LINEAR  # 需要在SD显示的路线轨迹点
      element sizeIndicator: implementation-data-type=specialIDT_DynamicLengthField_uint32
      element IDT_ADAS_arr_MNPMemRoutePoints: category=ARRAY
        element IDT_ADAS_arr_MNPMemRoutePoints: array-size=150000, array-size-handling=ALL-INDICES-SAME-ARRAY-SIZE, array-size-semantics=VARIABLE-SIZE, implementation-data-type=IDT_ADAS_strt_MNPMemRoutePoint
    IDT_ADAS_enum_FCTAWarnTypeSts: category=VALUE, base-type=uint8  # FCTA报警类型状态
    IDT_ADAS_strt_HPAStaticObject: category=STRUCTURE
      12 x element, all with category=TYPE_REFERENCE:
        DTE_objectId: implementation-data-type=IDT_Gen_val_ID  # 目标id
        DTE_objectType: implementation-data-type=IDT_ADAS_enum_StaticObjectType  # 目标类型
        DTE_objectPoseX: implementation-data-type=IDT_Gen_val_Coordinate_X  # 目标位置X坐标
        DTE_objectPoseY: implementation-data-type=IDT_Gen_val_Coordinate_Y  # 目标位置Y坐标
        DTE_objectPoseZ: implementation-data-type=IDT_Gen_val_Coordinate_Z  # 目标位置Z坐标
        DTE_objectYaw: implementation-data-type=IDT_Gen_val_Yaw  # 目标位姿
        DTE_objectLength: implementation-data-type=IDT_Gen_val_Length  # 目标长度
        DTE_objecWidth: implementation-data-type=IDT_Gen_val_Width  # 目标宽度
        DTE_timestampnSec: implementation-data-type=IDT_ADAS_val_timestampnSec  # 时间戳-纳秒
        DTE_laneID: implementation-data-type=IDT_ADAS_val_laneID  # 目标所属车道ID
        DTE_HPAobjectFloor: implementation-data-type=IDT_ADAS_enum_HPAFloor  # 目标所属楼层
        DTE_HPAStaticObjectReserved: implementation-data-type=IDT_HPAStaticObject_arr_Reserved  # 预留
    IDT_Arr_SatelInfoResd: category=ARRAY  # 预留 Reserved
      element Reserved_uint8_Type: array-size=10, array-size-semantics=FIXED-SIZE, implementation-data-type=IDT_Reserved_uint8_Type
    IDT_ICC_enum_MNPUseRouteQuitBtnSt: category=VALUE, base-type=uint8  # 退出路线使用按钮
    IDT_Arr_KPI_DataInLoop: category=ARRAY  # KPI数据埋点 KPI data tracking
      element Enum_KPI_DataInLoopUnit: array-size=1200, array-size-semantics=FIXED-SIZE, implementation-data-type=IDT_Enum_KPI_DataInLoopUnit
    IDT_LaneLine_arr_Reserved: category=ARRAY  # 预留
      element Reserved_uint8_Type: array-size=30, array-size-semantics=FIXED-SIZE, implementation-data-type=IDT_Reserved_uint8_Type
    IDT_CellularCellMapInfoReserved: category=ARRAY  # 小区网络地图信息预留字段
      element ADS_ReservedUnit8: array-size=20, array-size-semantics=FIXED-SIZE, implementation-data-type=IDT_ADS_ReservedUnit8
    IDT_PermissionId: category=VALUE, base-type=uint32  # 权限ID
    IDT_Enum_TBOXOTARemoteInstall: category=VALUE, base-type=uint8  # OTA立即升级
    IDT_StrVar_PhoneNumber: category=STRUCTURE, dynamic-array-size-profile=VSA_LINEAR
      element sizeIndicator: implementation-data-type=specialIDT_DynamicLengthField_uint32
      element IDT_StrVar_PhoneNumber: category=ARRAY
        element IDT_StrVar_PhoneNumber: array-size=15, array-size-handling=ALL-INDICES-SAME-ARRAY-SIZE, array-size-semantics=VARIABLE-SIZE, implementation-data-type=specialIDT_StringRef
    IDT_ADAS_enum_IntersectionDriBehavior: category=VALUE, base-type=uint8
    IDT_ADAS_strt_MNPMemRoute: category=STRUCTURE  # 记忆路线信息
      12 x element, all with category=TYPE_REFERENCE:
        DTE_MemRouteID: implementation-data-type=IDT_Gen_val_ID  # 路线ID
        DTE_MemRouteName: implementation-data-type=IDT_Str_MemRoute  # 路线名称
        DTE_MemRouteStartName: implementation-data-type=IDT_Str_MemRoute  # 路线起点名称
        DTE_MemRouteEndName: implementation-data-type=IDT_Str_MemRoute  # 路线终点名称
        DTE_MemRouteEndPoint: implementation-data-type=IDT_ADAS_strt_MNPMemRoutePoint  # 路线终点坐标
        DTE_MemRouteMileage: implementation-data-type=IDT_ADAS_enum_MNPRouteMileage  # 路线里程数
        DTE_MemRouteCreatTime: implementation-data-type=IDT_Str_MemRoute  # 路线创建时间
        DTE_MemRouteGrade: implementation-data-type=IDT_ADAS_enum_MNPMemRouteGrade  # 路线评分
        DTE_MemRouteReady: implementation-data-type=IDT_ADAS_enum_MNPMemRouteReadyFlag  # 路线是否可用
        DTE_MemRouteUseFlag: implementation-data-type=IDT_ADAS_enum_MNPMemRouteUseFlag  # 路线是否正在使用中
        DTE_MemRouteUseFreq: implementation-data-type=IDT_ADAS_enum_MNPMemRouteUseFreq  # 路线使用频率
        DTE_MNPMemRouteReserved: implementation-data-type=IDT_MNPMemRoute_arr_Reserved  # 预留
    IDT_LSSInfo_arr_Reserved: category=ARRAY  # 预留
      element Reserved_uint8_Type: array-size=48, array-size-semantics=FIXED-SIZE, implementation-data-type=IDT_Reserved_uint8_Type
    IDT_ADAS_arr_RoadMarkerSupplement: category=STRUCTURE, dynamic-array-size-profile=VSA_LINEAR
      element sizeIndicator: implementation-data-type=specialIDT_DynamicLengthField_uint32
      element IDT_ADAS_arr_RoadMarkerSupplement: category=ARRAY
        element IDT_ADAS_arr_RoadMarkerSupplement: array-size=28, array-size-handling=ALL-INDICES-SAME-ARRAY-SIZE, array-size-semantics=VARIABLE-SIZE, implementation-data-type=IDT_ADAS_strt_RoadMarkerSupplement
    IDT_RoadPointCellStruct: category=STRUCTURE  # 代客泊车各点信息
      element DTE_PointIndex: implementation-data-type=IDT_PointIndex  # 单点索引
      element DTE_RoadPointCellArray: implementation-data-type=IDT_RoadPointCellArray  # 单点小区信息数组
    IDT_CameraStreamRequestMessage: category=STRUCTURE, dynamic-array-size-profile=VSA_LINEAR  # CDC到ADS的视频请求消息
      element sizeIndicator: implementation-data-type=specialIDT_DynamicLengthField_uint32
      element IDT_CameraStreamRequestMessage: category=ARRAY
        element IDT_CameraStreamRequestMessage: array-size=1048576, array-size-handling=ALL-INDICES-SAME-ARRAY-SIZE, array-size-semantics=VARIABLE-SIZE, implementation-data-type=IDT_CameraStreamBasicElement
    IDT_ADAS_Seg_FuncRoadClass: category=VALUE, base-type=uint8
    IDT_OperatingSimInfo: category=STRUCTURE  # 当前使用的Sim卡信息
      element DTE_simCurrentOperator: implementation-data-type=IDT_SimOperator  # 当前使用Sim的运营商
      element DTE_simCurrentMode: implementation-data-type=IDT_SimMode  # 当前使用Sim卡的模式
      element DTE_OperatingSimInfoReserved: implementation-data-type=IDT_OperatingSimInfoReserved  # 预留字段
    IDT_ADAS_enum_HPARequestAPAUI: category=VALUE, base-type=uint8
    IDT_ADAS_enum_SglAutoAvoidObstacle: category=VALUE, base-type=uint16  # 自动避障（避障变道和避障bypass）
    IDT_ADAS_strt_LSSInfo_2: category=STRUCTURE
      13 x element, all with category=TYPE_REFERENCE:
        DTE_LKSSts: implementation-data-type=IDT_ADAS_enum_LKSSts  # 车道辅助系统状态
        DTE_LKSMod: implementation-data-type=IDT_ADAS_enum_LKSMod  # 车道辅助模式
        DTE_ELKSts: implementation-data-type=IDT_ADAS_enum_ELKSts  # 紧急车道保持状态
        DTE_LKSLeftTrackingSt: implementation-data-type=IDT_ADAS_enum_LKSLeftTrackingSt  # 左侧跟踪状态
        DTE_LKSRightTrackingSt: implementation-data-type=IDT_ADAS_enum_LKSRightTrackingSt  # 右侧跟踪状态
        DTE_ELKLeftActiveSt: implementation-data-type=IDT_ADAS_enum_ELKLeftActiveSt  # ELK 左侧激活状态
        DTE_ELKRightActiveSt: implementation-data-type=IDT_ADAS_enum_ELKRightActiveSt  # ELK 右侧激活状态
        DTE_LKSwarning: implementation-data-type=IDT_ADAS_enum_LKS_warning  # LDP声音报警信号
        DTE_LKSWarnSensitivity: implementation-data-type=IDT_ADAS_enum_LKS_WarnSensitivity  # LKS预警灵敏度
        DTE_LSSTextInfomation: implementation-data-type=IDT_ADAS_enum_LSSTextInfo  # LSS文言提示信息
        DTE_LDPSts: implementation-data-type=IDT_ADAS_enum_LDPSts  # 车道偏离抑制系统状态
        DTE_LDWSts: implementation-data-type=IDT_ADAS_enum_LDWSts  # 车道偏离预警系统状态
        DTE_LSSInfoReserved: implementation-data-type=IDT_LSSInfo_arr_Reserved  # 预留
    IDT_ICC_string_WeatherName: category=STRUCTURE, dynamic-array-size-profile=VSA_LINEAR  # 天气名称
      element sizeIndicator: implementation-data-type=specialIDT_DynamicLengthField_uint32
      element IDT_ICC_string_WeatherName: category=ARRAY
        element IDT_ICC_string_WeatherName: array-size=200, array-size-handling=ALL-INDICES-SAME-ARRAY-SIZE, array-size-semantics=VARIABLE-SIZE, implementation-data-type=specialIDT_StringRef
    IDT_ADAS_val_Traffic3DSignNum: category=VALUE, base-type=uint32  # 交通标识个数
    IDT_ICC_int32_RoadClass: category=VALUE, base-type=sint32
    IDT_ADASSettingInfo_arr_Reserved: category=ARRAY  # 预留
      element Reserved_uint8_Type: array-size=50, array-size-semantics=FIXED-SIZE, implementation-data-type=IDT_Reserved_uint8_Type
    IDT_ICC_val_ID: category=VALUE, base-type=uint16
    IDT_ICC_int32_Speed: category=VALUE, base-type=sint32
    IDT_MyLocation_arr_Reserved: category=ARRAY
      element Reserved_int32_Type: array-size=20, array-size-semantics=FIXED-SIZE, implementation-data-type=IDT_Reserved_int32_Type
    IDT_ADAS_strt_Traffic3DSignList: category=STRUCTURE  # 3D交通标识信息数组
      element DTE_Traffic3DSignNum: implementation-data-type=IDT_ADAS_val_Traffic3DSignNum  # 交通标识个数
      element DTE_Traffic3DSignList: implementation-data-type=IDT_ADAS_arr_Traffic3DSignList  # 交通标识数组
    IDT_Enum_VehicleDiag: category=VALUE, base-type=uint8  # 向TBOX请求车辆诊断
    IDT_ValetParkingLayer: category=VALUE, base-type=sint32  # 楼层
    IDT_StrVar_BleSlaverLeftVer: category=STRUCTURE, dynamic-array-size-profile=VSA_LINEAR  # 蓝牙左从模块软件版本
      element sizeIndicator: implementation-data-type=specialIDT_DynamicLengthField_uint32
      element IDT_StrVar_BleSlaverLeftVer: category=ARRAY
        element IDT_StrVar_BleSlaverLeftVer: array-size=24, array-size-handling=ALL-INDICES-SAME-ARRAY-SIZE, array-size-semantics=VARIABLE-SIZE, implementation-data-type=specialIDT_StringRef
    IDT_ADAS_arr_LaneLineData_2: category=STRUCTURE, dynamic-array-size-profile=VSA_LINEAR  # 车道线信息数组
      element sizeIndicator: implementation-data-type=specialIDT_DynamicLengthField_uint32
      element IDT_ADAS_arr_LaneLineData_2: category=ARRAY
        element IDT_ADAS_arr_LaneLineData_2: array-size=24, array-size-handling=ALL-INDICES-SAME-ARRAY-SIZE, array-size-semantics=VARIABLE-SIZE, implementation-data-type=IDT_ADAS_strt_LaneLine_2
    IDT_NaviCongestion_arr_Reserved: category=ARRAY
      element Reserved_int32_Type: array-size=20, array-size-semantics=FIXED-SIZE, implementation-data-type=IDT_Reserved_int32_Type
    IDT_ICC_strt_TunnelInfo: category=STRUCTURE  # 隧道信息
      4 x element, all with category=TYPE_REFERENCE:
        DTE_TunnelExists: implementation-data-type=IDT_ICC_boolean_exists
        DTE_TunnelDistance: implementation-data-type=IDT_ICC_int32_Dist
        DTE_TunnelLength: implementation-data-type=IDT_ICC_int32_Dist
        DTE_TunnelInfoReserved: implementation-data-type=IDT_TunnelInfo_arr_Reserved  # 预留
    IDT_AllSimDetailInfoReserved: category=ARRAY  # 车辆Sim卡信息预留
      element INI_ReservedUnit8: array-size=16, array-size-semantics=FIXED-SIZE, implementation-data-type=IDT_INI_ReservedUnit8
    IDT_SentryModePlanEndTime_flag: category=VALUE, base-type=uint32  # 哨兵模式预约结束时间标识
    IDT_ICC_enum_NOALCCSwitchBtnSts: category=VALUE, base-type=uint8  # NOA与LCC切换指令
    IDT_LCM_RAWDATA: category=VALUE, base-type=sint8  # GNSS_RawData
    IDT_ICC_arr_ViaPointInfo: category=STRUCTURE, dynamic-array-size-profile=VSA_LINEAR
      element sizeIndicator: implementation-data-type=specialIDT_DynamicLengthField_uint32
      element IDT_ICC_arr_ViaPointInfo: category=ARRAY
        element IDT_ICC_arr_ViaPointInfo: array-size=100, array-size-handling=ALL-INDICES-SAME-ARRAY-SIZE, array-size-semantics=VARIABLE-SIZE, implementation-data-type=IDT_ICC_strt_ViaPointInfo
    IDT_ICC_enum_EfficientPassageBtnSt: category=VALUE, base-type=uint8  # 高效通行软开关
    IDT_ADAS_strt_HPARepalyPathInfo: category=STRUCTURE
      9 x element, all with category=TYPE_REFERENCE:
        DTE_HpaReplayPathID: implementation-data-type=IDT_Gen_val_ID  # 路线ID
        DTE_ReplayPathName: implementation-data-type=IDT_ADAS_string_PathName  # 路线名称
        DTE_ReplayDrivingDist: implementation-data-type=IDT_ADAS_val_ParkingDist  # 路线行驶距离
        DTE_HPARepayRemainingDist: implementation-data-type=IDT_ADAS_val_ParkingDist  # 记忆泊车回放剩余距离
        DTE_ReplayLinePoint: implementation-data-type=IDT_ADAS_arr_PathPoint  # 路线学习点集
        DTE_HPAReplayPathSlotInfo: implementation-data-type=IDT_ADAS_arr_HPAPathslot  # 路线记忆车位
        DTE_HPASpeedBumpInfo: implementation-data-type=IDT_ADAS_arr_HPASpeedBumpInfo  # 路线记忆减速带
        DTE_ReplayPathLabel: implementation-data-type=IDT_ADAS_enum_PathLabel  # 路线标签
        DTE_HpaEndPos: implementation-data-type=IDT_ADAS_strt_HpaEndPos  # HPA终点信息
    IDT_CameraStreamFaultMessage: category=STRUCTURE, dynamic-array-size-profile=VSA_LINEAR  # ADS到CDC的视频流故障消息
      element sizeIndicator: implementation-data-type=specialIDT_DynamicLengthField_uint32
      element IDT_CameraStreamFaultMessage: category=ARRAY
        element IDT_CameraStreamFaultMessage: array-size=1048576, array-size-handling=ALL-INDICES-SAME-ARRAY-SIZE, array-size-semantics=VARIABLE-SIZE, implementation-data-type=IDT_CameraStreamBasicElement
    IDT_ADAS_arr_VPASpots: category=STRUCTURE, dynamic-array-size-profile=VSA_LINEAR  # VPA用户特殊车位属性列表
      element sizeIndicator: implementation-data-type=specialIDT_DynamicLengthField_uint32
      element IDT_ADAS_arr_VPASpots: category=ARRAY
        element IDT_ADAS_arr_VPASpots: array-size=100, array-size-handling=ALL-INDICES-SAME-ARRAY-SIZE, array-size-semantics=VARIABLE-SIZE, implementation-data-type=IDT_ADAS_strt_VPASpot
    IDT_ADAS_enum_MNPUseMapTextInfo: category=VALUE, base-type=uint8  # 记忆行车使用阶段文言提示信息
    IDT_Gen_val_Height: category=VALUE, base-type=uint16  # 高
    IDT_SentryModePlanEndTime_date: category=VALUE, base-type=uint32  # 哨兵模式预约结束时间（年月日）
    IDT_ICC_strt_NaviCameraExt: category=STRUCTURE
      11 x element, all with category=TYPE_REFERENCE:
        DTE_CameraId: implementation-data-type=IDT_Gen_int32_ID  # 电子眼id
        DTE_CameraSegmentIdx: implementation-data-type=IDT_ICC_int32_Index  # 电子眼所在segment索引
        DTE_CameraLinkIndex: implementation-data-type=IDT_ICC_int32_Index  # 电子眼所在link索引
        DTE_CameraDistance: implementation-data-type=IDT_ICC_int32_Dist  # 自车到电子眼距离
        DTE_CameraDistanceToEnd: implementation-data-type=IDT_ICC_int32_Dist  # 电子眼到Link终点的距离(单位:米, 仅导航场景生效）
        DTE_CameraRoadClass: implementation-data-type=IDT_ICC_int32_RoadClass  # 电子眼所在道路的道路等级
        DTE_CameraisHidden: implementation-data-type=IDT_ICC_boolean_Hidden  # 是否隐藏式电子眼
        DTE_CameraCoord2D: implementation-data-type=IDT_ICC_strt_Coord2DDouble  # 摄像头位置坐标
        DTE_CameraCoord3D: implementation-data-type=IDT_ICC_strt_Coord3DDouble  # 摄像头位置坐标
        DTE_SubCameras: implementation-data-type=IDT_ICC_arr_NaviSubCameraExt  # 电子眼细类
        DTE_NaviCameraExtReserved: implementation-data-type=IDT_NaviCameraExt_arr_Reserved  # 预留
    IDT_ICC_int32_Index: category=VALUE, base-type=sint32
    IDT_ADAS_enum_NOPLaneChangeWarnType: category=VALUE, base-type=uint8
    IDT_ADAS_Stub_Offset: category=VALUE, base-type=uint16
    IDT_Array_RouteMMSeg: category=STRUCTURE, dynamic-array-size-profile=VSA_LINEAR  # HD路线匹配片段数组
      element sizeIndicator: implementation-data-type=specialIDT_DynamicLengthField_uint32
      element IDT_Array_RouteMMSeg: category=ARRAY
        element IDT_Array_RouteMMSeg: array-size=255, array-size-handling=ALL-INDICES-SAME-ARRAY-SIZE, array-size-semantics=VARIABLE-SIZE, implementation-data-type=IDT_Struct_RouteMMSeg
    IDT_ICC_val_latitude: category=VALUE, base-type=float64  # 纬度
    IDT_ADAS_arr_HPAPathslot_2: category=STRUCTURE, dynamic-array-size-profile=VSA_LINEAR
      element sizeIndicator: implementation-data-type=specialIDT_DynamicLengthField_uint32
      element IDT_ADAS_arr_HPAPathslot_2: category=ARRAY
        element IDT_ADAS_arr_HPAPathslot_2: array-size=2000, array-size-handling=ALL-INDICES-SAME-ARRAY-SIZE, array-size-semantics=VARIABLE-SIZE, implementation-data-type=IDT_ADAS_strt_ParkingSlot_2
    IDT_ADAS_enum_PathMatchSts: category=VALUE, base-type=uint8
    IDT_RoadPointCellInfo: category=STRUCTURE  # 代客泊车单点单小区信息
      4 x element, all with category=TYPE_REFERENCE:
        DTE_cellularCellId: implementation-data-type=IDT_CellularCellId  # 小区信息
        DTE_rsrp: implementation-data-type=IDT_CellularRsrp  # 电平（兼容4G/5G制式）
        DTE_sinr: implementation-data-type=IDT_CellularSinr  # 质量（兼容4G/5G制式）
        DTE_reserved: implementation-data-type=IDT_ADS_ReservedUnit8  # 预留字段
    IDT_DataInt32: category=VALUE, base-type=sint64  # 有符号32位整型
    IDT_ADAS_enum_Traffic3DSignType: category=VALUE, base-type=uint32  # 交通标识类型
    IDT_ICC_enum_ISLIWarnMod: category=VALUE, base-type=uint8  # 智能限速提醒方式
    IDT_ICC_enum_MNPMemRouteCompleteBtnSt: category=VALUE, base-type=uint8  # 路线记忆结束按钮
    IDT_CameraStreamResponseMessage: category=STRUCTURE, dynamic-array-size-profile=VSA_LINEAR  # ADS到CDC的消息响应
      element sizeIndicator: implementation-data-type=specialIDT_DynamicLengthField_uint32
      element IDT_CameraStreamResponseMessage: category=ARRAY
        element IDT_CameraStreamResponseMessage: array-size=1048576, array-size-handling=ALL-INDICES-SAME-ARRAY-SIZE, array-size-semantics=VARIABLE-SIZE, implementation-data-type=IDT_CameraStreamBasicElement
    IDT_ADAS_strt_ALCInfo: category=STRUCTURE
      7 x element, all with category=TYPE_REFERENCE:
        DTE_ALCStatus: implementation-data-type=IDT_ADAS_enum_ALCSts  # 拨杆变道功能状态
        DTE_ALCDirIndicator: implementation-data-type=IDT_ADAS_enum_ALCDirIndicator  # 拨杆变道方向
        DTE_ALCAbortReason: implementation-data-type=IDT_ADAS_enum_ALCAbortReason  # 变道退出原因
        DTE_ALCSoundWarn: implementation-data-type=IDT_ADAS_enum_ALCSoundWarn  # 变道声音报警
        DTE_ALCTextInfomation: implementation-data-type=IDT_ADAS_enum_ALCTextInfo  # 变道提示信息
        DTE_ALCTakeOverRequest: implementation-data-type=IDT_ADAS_enum_ALCTakeOverRequest  # 变道接管请求
        DTE_ALCPermitSt: implementation-data-type=IDT_ADAS_enum_LCPermitSt  # 拨杆变道允许状态
    IDT_Enum_UpdatePrepare: category=VALUE, base-type=uint8  # TBOX升级准备状态
    IDT_ICC_strt_VpaParkingLotInfo: category=STRUCTURE
      5 x element, all with category=TYPE_REFERENCE:
        DTE_VPAParkingLotID: implementation-data-type=IDT_Gen_val_ID  # 停车场id
        DTE_VPAParkingLotName: implementation-data-type=IDT_ADAS_string_VPAParkingLotName  # 停车场名字
        DTE_VPASpotLabel: implementation-data-type=IDT_ADAS_arr_VPASpots  # 用户特殊车位的标签信息
        DTE_VPASlotID: implementation-data-type=IDT_ADAS_val_SlotID  # 车位ID
        DTE_VPAParkingLotAddress: implementation-data-type=IDT_ADAS_string_VPAParkingLotAddress  # 停车场地址
    IDT_ADAS_enum_ESSDirection: category=VALUE, base-type=uint8
    IDT_SentryModeAlarmReason: category=VALUE, base-type=uint32  # 哨兵模式告警原因
    IDT_ICC_strt_HpaFcnOperating: category=STRUCTURE
      7 x element, all with category=TYPE_REFERENCE:
        DTE_HPAOperationId: implementation-data-type=IDT_ICC_enum_HPAOperationId  # HPA功能操作指令
        DTE_HPALearnOperationId: implementation-data-type=IDT_ICC_enum_LearnOperationId  # HPA学习操作指令
        DTE_HPAPathOperation: implementation-data-type=IDT_ICC_strt_HPAPathOperation  # HPA路线操作指令
        DTE_SelectSlotId: implementation-data-type=IDT_ICC_uint16_SelectSlotID  # HPA选择流动车位ID
        DTE_SelectPathId: implementation-data-type=IDT_ICC_uint8_SelectPathId  # HPA选择路线ID
        DTE_HPAUndoOperationID: implementation-data-type=IDT_ICC_enum_HPAUndoOperationID  # HPA功能撤回操作指令
        DTE_HPASlotSearchOperationID: implementation-data-type=IDT_ICC_enum_HPASlotSearchOperationID  # HPA沿途找车位操作指令
    IDT_Struct_NOA_SDMapStubInfo: category=STRUCTURE  # 标准地图信息_Stub
      15 x element, all with category=TYPE_REFERENCE:
        DTE_Stub_MsgType: implementation-data-type=IDT_ADAS_MsgType  # 标识该消息为Stub Message
        DTE_Stub_CycCnt: implementation-data-type=IDT_ADAS_Stub_CycCnt  # STUBMessage 的循环计数器:重构器可以用这个值来检测丢失的消息
        DTE_Stub_PathIdx: implementation-data-type=IDT_ADAS_Stub_PathIdx  # This is Index of new path.父path的索引值，0代表在Horizon中从这个STUB开始了第一条path
        DTE_Stub_Offset: implementation-data-type=IDT_ADAS_Stub_Offset  # stub起点与path起点的距离
        DTE_Stub_Update: implementation-data-type=IDT_ADAS_Stub_Update  # Stub Segment更新
        DTE_Stub_SubPathIdx: implementation-data-type=IDT_ADAS_Stub_SubPathIdx  # stub path索引
        DTE_Stub_TurnAngl: implementation-data-type=IDT_ADAS_Stub_TurnAngl  # stub转向角度信息
        DTE_Stub_RelProbb: implementation-data-type=IDT_ADAS_Stub_RelProbb  # 在路口的新path的相对概率
        DTE_Stub_FuncRoadClass: implementation-data-type=IDT_ADAS_Stub_FuncRoadClass  # stub FRC信息（对应道路类型）
        DTE_Stub_FormOfWay: implementation-data-type=IDT_ADAS_Stub_FormOfWay  # stub道路设施信息（对应匝道信息，支路）
        DTE_Stub_NumOfLaneDrvDir: implementation-data-type=IDT_ADAS_Stub_NumOfLaneDrvDir  # stub当前行车方向车道数信息
        DTE_Stub_NumOfLaneOppDir: implementation-data-type=IDT_ADAS_Stub_NumOfLaneOppDir  # stub当前行车反方向车道数信息
        DTE_Stub_CmplxInsct: implementation-data-type=IDT_ADAS_Stub_CmplxInsct  # stub复杂路口信息
        DTE_Stub_PartOfCalcRoute: implementation-data-type=IDT_ADAS_Stub_PartOfCalcRoute  # stub是否在规划路径上的信息
        DTE_Stub_LastStub: implementation-data-type=IDT_ADAS_Stub_LastStub  # stub消息是给定父path和offset的最后一个
    IDT_ICC_enum_VoiceRemindSettingSt: category=VALUE, base-type=uint8  # 语音播报功能设置状态
    IDT_ICC_int32_NaviMode: category=VALUE, base-type=sint32
    IDT_ADAS_Meta_MapProvider: category=VALUE, base-type=uint8
    IDT_EphemerisDataSwitchCmd: category=VALUE, base-type=uint32  # 星历数据开关指令
    IDT_SingleSimDetailInfoReserved: category=ARRAY  # 单sim卡详细信息预留
      element INI_ReservedUnit8: array-size=16, array-size-semantics=FIXED-SIZE, implementation-data-type=IDT_INI_ReservedUnit8
    IDT_ADAS_enum_HNOPSts: category=VALUE, base-type=uint8
    IDT_ICC_arr_CongestionInfo: category=STRUCTURE, dynamic-array-size-profile=VSA_LINEAR  # 拥堵时长和原因详细信息
      element sizeIndicator: implementation-data-type=specialIDT_DynamicLengthField_uint32
      element IDT_ICC_arr_CongestionInfo: category=ARRAY
        element IDT_ICC_arr_CongestionInfo: array-size=20, array-size-handling=ALL-INDICES-SAME-ARRAY-SIZE, array-size-semantics=VARIABLE-SIZE, implementation-data-type=IDT_ICC_strt_CongestionInfo
    IDT_ADAS_strt_ALCInfo_2: category=STRUCTURE
      11 x element, all with category=TYPE_REFERENCE:
        DTE_ALCStatus: implementation-data-type=IDT_ADAS_enum_ALCSts  # 拨杆变道功能状态
        DTE_ALCDirIndicator: implementation-data-type=IDT_ADAS_enum_ALCDirIndicator  # 拨杆变道方向
        DTE_ALCAbortReason: implementation-data-type=IDT_ADAS_enum_ALCAbortReason  # 变道退出原因
        DTE_ALCSoundWarn: implementation-data-type=IDT_ADAS_enum_ALCSoundWarn  # 变道声音报警
        DTE_ALCTextInfomation: implementation-data-type=IDT_ADAS_enum_ALCTextInfo  # 变道提示信息
        DTE_ALCTakeOverRequest: implementation-data-type=IDT_ADAS_enum_ALCTakeOverRequest  # 变道接管请求
        DTE_ALCPermitSt: implementation-data-type=IDT_ADAS_enum_LCPermitSt  # 拨杆变道允许状态
        DTE_ALCDestPoseX: implementation-data-type=IDT_Gen_val_Coordinate_X  # 变道目标车位框中心X坐标
        DTE_ALCDestPoseY: implementation-data-type=IDT_Gen_val_Coordinate_Y  # 变道目标车位框中心Y坐标
        DTE_ALCDestPoseHeading: implementation-data-type=IDT_Gen_val_Yaw  # 变道目标车位框航向角
        DTE_ALCInfoReserved: implementation-data-type=IDT_ALCInfo_arr_Reserved  # 预留
    IDT_ICC_strt_NaviWeatherInfo_1: category=STRUCTURE
      6 x element, all with category=TYPE_REFERENCE:
        DTE_NaviWeatherID: implementation-data-type=IDT_ICC_int32_WeatherID  # 天气 ID
        DTE_AlertLevelId: implementation-data-type=IDT_ICC_int32_AlertLevel  # 预警等级
        DTE_DistanceToCar: implementation-data-type=IDT_ICC_int32_Dist  # 距离
        DTE_WeatherName: implementation-data-type=IDT_ICC_string_WeatherName  # 天气名称
        DTE_AlertLevelName: implementation-data-type=IDT_ICC_string_LevelName  # 预警名称
        DTE_WeatherInfoReserved_1: implementation-data-type=IDT_WeatherInfo_arr_Reserved_1  # 预留
    IDT_VhrLogList: category=STRUCTURE, dynamic-array-size-profile=VSA_LINEAR  # 日志类型 动态数组
      element sizeIndicator: implementation-data-type=specialIDT_DynamicLengthField_uint32
      element IDT_VhrLogList: category=ARRAY
        element IDT_VhrLogList: array-size=50, array-size-handling=ALL-INDICES-SAME-ARRAY-SIZE, array-size-semantics=VARIABLE-SIZE, implementation-data-type=IDT_VhrLogString
    IDT_ICC_strt_NaviCruiseFacilityInfo: category=STRUCTURE
      4 x element, all with category=TYPE_REFERENCE:
        DTE_CameraDistance: implementation-data-type=IDT_ICC_val_Distance  # 自车距离电子眼的距离
        DTE_CruiseFacilityType: implementation-data-type=IDT_ICC_enum_CruiseFacilityType  # 巡航状态下电子眼类型
        DTE_CruiseSpeedLimitValue: implementation-data-type=IDT_ICC_enum_SpeedLimitValue  # 限速值
        DTE_CruiseSpeedLimitUnit: implementation-data-type=IDT_ICC_enum_SpeedLimitUnit  # 限速单位
    IDT_NaviIntCameraDyn_arr_Reserved: category=ARRAY
      element Reserved_int32_Type: array-size=20, array-size-semantics=FIXED-SIZE, implementation-data-type=IDT_Reserved_int32_Type
    IDT_Enum_CallType: category=VALUE, base-type=uint8
    IDT_CellularFrequency: category=VALUE, base-type=uint32  # 频点
    IDT_IcaNcaL3StateReserved: category=ARRAY  # ICA/L2NCA/L3智驾激活与否状态信息扩展预留字段
      element ADS_ReservedUnit8: array-size=16, array-size-semantics=FIXED-SIZE, implementation-data-type=IDT_ADS_ReservedUnit8
    IDT_Enum_SetCallNumber: category=VALUE, base-type=uint8
    IDT_ADAS_strt_IHCInfo: category=STRUCTURE
      element DTE_IHC_Status: implementation-data-type=IDT_ADAS_enum_IHC_Status  # IHC功能状态
      element DTE_IHCTextInfomation: implementation-data-type=IDT_ADAS_enum_IHCTextInfo  # IHC文言提示信息
      element DTE_IHCInfoReserved: implementation-data-type=IDT_IHCInfo_arr_Reserved  # 预留
    IDT_ADAS_val_SpdLimitOffsetAbs: category=VALUE, base-type=sint8  # 固定限速偏移量
    IDT_Str_CamStreamSwtReq: category=STRUCTURE  # 摄像头视频开关请求 Camera Video Switch Request
      element DTE_CamStreamOrntn: implementation-data-type=IDT_Enum_CamStreamOrntn  # 相机视频流方位 Camera Video Stream Orientation
      element DTE_CamStreamSwtReq: implementation-data-type=IDT_Enum_CamStreamSwt  # 相机视频流开关请求 Camera Video Stream Switch Request
      element DTE_CamStreamSwtReqResd: implementation-data-type=IDT_Arr_CamStreamSwtReqResd  # 预留 Reserved
    IDT_ICC_int32_ShowType: category=VALUE, base-type=sint32  # 显示形态标识
    IDT_ADAS_enum_StaticObjectType: category=VALUE, base-type=uint8
    IDT_ICC_enum_VoiceControlCruiseSpeedAdjust: category=VALUE, base-type=uint8  # 语音巡航速度调节指令
    IDT_ICC_int32_NaviInfoFlag: category=VALUE, base-type=sint32
    IDT_ADAS_strt_SglNtfADDrivingCardinfo: category=STRUCTURE
      10 x element, all with category=TYPE_REFERENCE:
        DTE_SglNOAMileage: implementation-data-type=IDT_ADAS_enum_SglNOAMileage  # NOA行驶里程
        DTE_SglLCCMileage: implementation-data-type=IDT_ADAS_enum_SglLCCMileage  # LCC行驶里程
        DTE_SglAutoRoadCrossingsNum: implementation-data-type=IDT_ADAS_enum_SglAutoRoadCrossingsNum  # 自动过路口数量
        DTE_SglAutoMergeChangeLane: implementation-data-type=IDT_ADAS_enum_SglAutoMergeChangeLane  # 自动并道换道
        DTE_SglAccessRemitramp: implementation-data-type=IDT_ADAS_enum_SglAccessRemitramp  # 汇入汇出匝道
        DTE_SglAutoAvoidObstacle: implementation-data-type=IDT_ADAS_enum_SglAutoAvoidObstacle  # 自动避障（避障变道和避障bypass）
        DTE_SglRespondCongestion: implementation-data-type=IDT_ADAS_enum_SglRespondCongestion  # 应对加塞
        DTE_SglU_turnsNum: implementation-data-type=IDT_ADAS_enum_SglU_turnsNum  # 掉头次数
        DTE_SglSendMode: implementation-data-type=IDT_ADAS_enum_SglSendMode  # 发送模式 Transmission mode
        DTE_SglNtfADDrivingCardinfoReserved: implementation-data-type=IDT_SglNtfADDrivingCardinfo_arr_Reserved  # 预留
    IDT_Arr_TollGateLaneInfo: category=STRUCTURE, dynamic-array-size-profile=VSA_LINEAR
      element sizeIndicator: implementation-data-type=specialIDT_DynamicLengthField_uint32
      element IDT_Arr_TollGateLaneInfo: category=ARRAY
        element IDT_Arr_TollGateLaneInfo: array-size=50, array-size-handling=ALL-INDICES-SAME-ARRAY-SIZE, array-size-semantics=VARIABLE-SIZE, implementation-data-type=IDT_Strt_TollGateLaneInfo
    IDT_ADAS_arr_HPAPathDetail: category=STRUCTURE, dynamic-array-size-profile=VSA_LINEAR
      element sizeIndicator: implementation-data-type=specialIDT_DynamicLengthField_uint32
      element IDT_ADAS_arr_HPAPathDetail: category=ARRAY
        element IDT_ADAS_arr_HPAPathDetail: array-size=10, array-size-handling=ALL-INDICES-SAME-ARRAY-SIZE, array-size-semantics=VARIABLE-SIZE, implementation-data-type=IDT_ADAS_strt_HPAPathDetail
    IDT_ADAS_strt_OCCInfo: category=STRUCTURE  # freespace信息
      5 x element, all with category=TYPE_REFERENCE:
        DTE_OCCPosition: implementation-data-type=IDT_ADAS_strt_OCCPosition  # OCC位置
        DTE_OCCType: implementation-data-type=IDT_ADAS_enum_OCCType  # OCC类型
        DTE_OCCLength: implementation-data-type=IDT_Gen_val_Length  # OCC栅格长度
        DTE_OCCWidth: implementation-data-type=IDT_Gen_val_Width  # OCC栅格宽度
        DTE_OCCInfoReserved: implementation-data-type=IDT_OCCInfo_arr_Reserved  # 预留
    IDT_ADAS_enum_NOPLaneChangeReason: category=VALUE, base-type=uint8
    IDT_ADAS_strt_VPASelfBuildMapInfo: category=STRUCTURE  # 自建图的地图列表信息
      element DTE_VPASelfBuildMapList: implementation-data-type=IDT_ADAS_arr_VPASelfBuildMap  # 自建图地图列表
    IDT_ADAS_val_longitude: category=VALUE, base-type=float64
    IDT_ICC_enum_MNPEnableBtnSt: category=VALUE, base-type=uint8  # 记忆领航功能使能开关
    IDT_ADAS_enum_TolNOAMileage: category=VALUE, base-type=float32  # NOA行驶里程
    IDT_ADAS_Seg_BuildUpArea: category=VALUE, base-type=uint8
    IDT_ADAS_enum_DAISts: category=VALUE, base-type=uint8
    IDT_ADAS_strt_MRAInfo_2: category=STRUCTURE
      10 x element, all with category=TYPE_REFERENCE:
        DTE_MRASts: implementation-data-type=IDT_ADAS_enum_MRASts  # 循迹倒车状态信息
        DTE_MRATrajRecordDist: implementation-data-type=IDT_ADAS_val_ParkingDist  # 循迹倒车记录路径长度
        DTE_MRACheckSts: implementation-data-type=IDT_ADAS_enum_MRACheckSts  # 循迹倒车不能激活原因
        DTE_MRATrajRemainingDist: implementation-data-type=IDT_ADAS_val_ParkingDist  # 循迹倒车剩余距离
        DTE_MRAAvaliableStatus: implementation-data-type=IDT_Gen_enum_AvailableSts  # 循迹倒车可用状态
        DTE_MRATrajectory: implementation-data-type=IDT_ADAS_arr_TrajectoryPoint  # 循迹倒车规划引导线
        DTE_MraOperationResp: implementation-data-type=IDT_ADAS_enum_ParkingOperationResp  # MRA按键状态反馈
        DTE_MRAStartButtonSts: implementation-data-type=IDT_ADAS_enum_ParkingButtonSts  # 开始泊车按钮可用状态
        DTE_MRAResumeButtonSts: implementation-data-type=IDT_ADAS_enum_ParkingButtonSts  # 恢复泊车按钮可用状态
        DTE_MRAInfoReserved: implementation-data-type=IDT_MRAInfo_arr_Reserved  # 预留
    IDT_Enum_UpdSta: category=VALUE, base-type=uint8  # TBOX升级状态
    IDT_ADAS_strt_FusionMapPoint: category=STRUCTURE
      element DTE_Point: implementation-data-type=IDT_ADAS_arr_FusionMetaData  # 三角剖分顶点位置
      element DTE_Idx: implementation-data-type=IDT_ADAS_arr_FusionMetaData  # 三角剖分顶点数据
      element DTE_length: implementation-data-type=IDT_ADAS_arr_FusionMetaData  # 三角剖分长度信息
    IDT_LCM_IMU_gpsSow: category=VALUE, base-type=uint32
    IDT_ICC_enum_ApaPocDirection: category=VALUE, base-type=uint8
    IDT_ISLIInfo_arr_Reserved: category=ARRAY  # 预留
      element Reserved_uint8_Type: array-size=50, array-size-semantics=FIXED-SIZE, implementation-data-type=IDT_Reserved_uint8_Type
    IDT_ADAS_enum_AESDirection: category=VALUE, base-type=uint8
    IDT_ADAS_Posn_Spd: category=VALUE, base-type=uint16
    IDT_ICC_int32_ForbidType: category=VALUE, base-type=sint32
    IDT_ApnInfo: category=STRUCTURE
      6 x element, all with category=TYPE_REFERENCE:
        DTE_apnIndex: implementation-data-type=IDT_ApnIndex  # apn索引
        DTE_connStatus: implementation-data-type=IDT_ConnStatus  # apn的拨号连接状态
        DTE_upRate: implementation-data-type=IDT_UpRate  # apn对应的上行实时流量速率（字节/秒）
        DTE_downRate: implementation-data-type=IDT_DownRate  # apn对应的下行实时流量速率（字节/秒）
        DTE_upFlow: implementation-data-type=IDT_UpFlow  # apn对应的上行流量（字节）
        DTE_downFlow: implementation-data-type=IDT_DownFlow  # apn对应的下行流量（字节）
    IDT_ICC_arr_WeatherInfo: category=STRUCTURE, dynamic-array-size-profile=VSA_LINEAR
      element sizeIndicator: implementation-data-type=specialIDT_DynamicLengthField_uint32
      element IDT_ICC_arr_WeatherInfo: category=ARRAY
        element IDT_ICC_arr_WeatherInfo: array-size=5, array-size-handling=ALL-INDICES-SAME-ARRAY-SIZE, array-size-semantics=VARIABLE-SIZE, implementation-data-type=IDT_ICC_strt_WeatherInfo
    IDT_SentryModePlanEndTime_hour: category=VALUE, base-type=uint32  # 哨兵模式预约结束时间（时）
    IDT_ICC_Navi_GpsPoint: category=STRUCTURE  # GPS位置坐标信息
      element DTE_Longitude: implementation-data-type=IDT_ICC_Navi_Longitude  # 经度信息
      element DTE_Latitude: implementation-data-type=IDT_ICC_Navi_Latitude  # 纬度信息
    IDT_ADAS_enum_ParkInDirectionAvaType: category=VALUE, base-type=uint8
    IDT_ICC_arr_OptimalLane: category=STRUCTURE, dynamic-array-size-profile=VSA_LINEAR
      element sizeIndicator: implementation-data-type=specialIDT_DynamicLengthField_uint32
      element IDT_ICC_arr_OptimalLane: category=ARRAY
        element IDT_ICC_arr_OptimalLane: array-size=32, array-size-handling=ALL-INDICES-SAME-ARRAY-SIZE, array-size-semantics=VARIABLE-SIZE, implementation-data-type=IDT_ICC_strt_LaneAction
    IDT_ICC_arr_NaviCruiseFacilityInfo: category=STRUCTURE, dynamic-array-size-profile=VSA_LINEAR  # 巡航模式下电子眼信息
      element sizeIndicator: implementation-data-type=specialIDT_DynamicLengthField_uint32
      element IDT_ICC_arr_NaviCruiseFacilityInfo: category=ARRAY
        element IDT_ICC_arr_NaviCruiseFacilityInfo: array-size=2, array-size-handling=ALL-INDICES-SAME-ARRAY-SIZE, array-size-semantics=VARIABLE-SIZE, implementation-data-type=IDT_ICC_strt_NaviCruiseFacilityInfo
    IDT_ADAS_enum_ACCSts: category=VALUE, base-type=uint8
    IDT_ADAS_enum_IHC_Status: category=VALUE, base-type=uint8  # IHC功能状态
    IDT_ADAS_enum_BAFASts: category=VALUE, base-type=uint8
    IDT_ADAS_Posn_CycCnt: category=VALUE, base-type=uint8
    IDT_ADAS_Meta_CycCnt: category=VALUE, base-type=uint8
    IDT_VhrCompID: category=STRUCTURE, dynamic-array-size-profile=VSA_LINEAR  # 采集部件名称
      element sizeIndicator: implementation-data-type=specialIDT_DynamicLengthField_uint32
      element IDT_VhrCompID: category=ARRAY
        element IDT_VhrCompID: array-size=10, array-size-handling=ALL-INDICES-SAME-ARRAY-SIZE, array-size-semantics=VARIABLE-SIZE, implementation-data-type=specialIDT_StringRef
    IDT_ADAS_strt_DynamicObject: category=STRUCTURE
      11 x element, all with category=TYPE_REFERENCE:
        DTE_objectId: implementation-data-type=IDT_Gen_val_ID  # 目标id
        DTE_objectType: implementation-data-type=IDT_ADAS_enum_DynamicObjectType  # 目标类型
        DTE_lightStatus: implementation-data-type=IDT_ADAS_enum_LightStatus  # 目标灯光状态
        DTE_objectPoseX: implementation-data-type=IDT_Gen_val_Coordinate_X  # 目标位置X坐标
        DTE_objectPoseY: implementation-data-type=IDT_Gen_val_Coordinate_Y  # 目标位置Y坐标
        DTE_objectYaw: implementation-data-type=IDT_Gen_val_Yaw  # 目标位姿
        DTE_objectColor: implementation-data-type=IDT_ADAS_enum_ObjectColor  # 高亮显示
        DTE_objectVelocityX: implementation-data-type=IDT_ADAS_val_vehicleSpd  # 目标X向速度
        DTE_objectVelocityY: implementation-data-type=IDT_ADAS_val_vehicleSpd  # 目标Y向速度
        DTE_timestampnSec: implementation-data-type=IDT_ADAS_val_timestampnSec  # 时间戳-纳秒
        DTE_laneID: implementation-data-type=IDT_ADAS_val_laneID  # 目标所属车道ID
    IDT_Strt_VersInfo: category=STRUCTURE  # ADAS版本信息
      6 x element, all with category=TYPE_REFERENCE:
        DTE_ADCCSoftwareVers: implementation-data-type=IDT_Str_SoftwareVers  # ADCC软件版本号 ADCC software version number
        DTE_ADCCInterVers: implementation-data-type=IDT_Str_InterVers  # ADCC内部版本号 ADCC Internal version number
        DTE_ADCCProductID: implementation-data-type=IDT_Str_ProductID  # ADCC产品唯一ID（产品序列号/唯一码） ADCC Product Unique ID (Product Serial Number/Unique Code)
        DTE_ADCCHardwareVers: implementation-data-type=IDT_Str_HardwareVers  # ADCC硬件零件号 ADCC hardware part number
        DTE_ADCCProductCode: implementation-data-type=IDT_Str_ProductCode  # ADCC供应商代码 ADCC supplier code
        DTE_VersInfoReserved: implementation-data-type=IDT_Arr_VersInfoReserved  # 预留 Reserved
    IDT_ICC_enum_MNPMemRouteQuitBtnSt: category=VALUE, base-type=uint8  # 退出路线学习按钮
    IDT_SglNtfADDrivingCardinfo_arr_Reserved: category=ARRAY
      element Reserved_uint8_Type: array-size=49, array-size-semantics=FIXED-SIZE, implementation-data-type=IDT_Reserved_uint8_Type
    IDT_ADAS_enum_TolAutoMergeChangeLane: category=VALUE, base-type=uint64  # 自动并道换道
    IDT_StrVar_TBOXOTARemoteAPPTCancel: category=STRUCTURE, dynamic-array-size-profile=VSA_LINEAR  # 远控取消OTA预约升级
      element sizeIndicator: implementation-data-type=specialIDT_DynamicLengthField_uint32
      element IDT_StrVar_TBOXOTARemoteAPPTCancel: category=ARRAY
        element IDT_StrVar_TBOXOTARemoteAPPTCancel: array-size=16, array-size-handling=ALL-INDICES-SAME-ARRAY-SIZE, array-size-semantics=VARIABLE-SIZE, implementation-data-type=specialIDT_StringRef
    IDT_Struct_RouteMatchingResult: category=STRUCTURE  # 路线匹配结果
      6 x element, all with category=TYPE_REFERENCE:
        DTE_sdRtHandle: implementation-data-type=IDT_DataUint16
        DTE_hdRtHandle: implementation-data-type=IDT_DataUint16
        DTE_routeMMStatus: implementation-data-type=IDT_Enum_RouteMMStatus
        DTE_routeMMError: implementation-data-type=IDT_Enum_RouteMMError
        DTE_routeMMErrorValid: implementation-data-type=IDT_DataInt8
        DTE_routeMatchSegs: implementation-data-type=IDT_Array_RouteMMSeg  # HD路线匹配片段数组
    IDT_ADAS_arr_HPAParkingStaticObjects: category=STRUCTURE, dynamic-array-size-profile=VSA_LINEAR  # 泊车静态目标数组
      element sizeIndicator: implementation-data-type=specialIDT_DynamicLengthField_uint32
      element IDT_ADAS_arr_HPAParkingStaticObjects: category=ARRAY
        element IDT_ADAS_arr_HPAParkingStaticObjects: array-size=300, array-size-handling=ALL-INDICES-SAME-ARRAY-SIZE, array-size-semantics=VARIABLE-SIZE, implementation-data-type=IDT_ADAS_strt_HPAStaticObject
    IDT_HPASetOnway_arr_Reserved: category=ARRAY  # 预留
      element Reserved_uint8_Type: array-size=30, array-size-semantics=FIXED-SIZE, implementation-data-type=IDT_Reserved_uint8_Type
    IDT_ICC_enum_HPAOperationId: category=VALUE, base-type=uint8
    IDT_FactoryResetTimeLength: category=VALUE, base-type=uint32  # 恢厂所需时间
    IDT_ADAS_string_VPAParkingLotName: category=STRUCTURE, dynamic-array-size-profile=VSA_LINEAR
      element sizeIndicator: implementation-data-type=specialIDT_DynamicLengthField_uint32
      element IDT_ADAS_string_VPAParkingLotName: category=ARRAY
        element IDT_ADAS_string_VPAParkingLotName: array-size=50, array-size-handling=ALL-INDICES-SAME-ARRAY-SIZE, array-size-semantics=VARIABLE-SIZE, implementation-data-type=specialIDT_StringRef
    IDT_ADAS_enum_TLRSts: category=VALUE, base-type=uint8  # 交通灯识别功能状态
    IDT_Arr_AvmCamCalPrms: category=ARRAY  # 环视相机标定参数（含内外参） AVM Camera Calibration Parameters (Intrinsic & Extrinsic)
      element Enum_CamCalPrmsData: array-size=832, array-size-semantics=FIXED-SIZE, implementation-data-type=IDT_Enum_CamCalPrmsData
    IDT_ICC_int32_NaviType: category=VALUE, base-type=sint32
    IDT_ICC_int32_LastSeconds: category=VALUE, base-type=sint32
    IDT_SentryModeSt: category=VALUE, base-type=uint32  # 哨兵模式开关状态
    IDT_ICC_strt_TrafficJamInfo: category=STRUCTURE
      5 x element, all with category=TYPE_REFERENCE:
        DTE_JamID: implementation-data-type=IDT_ICC_val_ID  # 拥堵段ID
        DTE_TimeOfSeconds: implementation-data-type=IDT_ICC_val_Time  # 预计通过拥堵时段时间
        DTE_RemianDistance: implementation-data-type=IDT_ICC_val_Distance  # 拥堵剩余距离
        DTE_NaviCongestionDetailInfo: implementation-data-type=IDT_ICC_arr_NaviCongestionDetailInfo  # 拥堵时长和原因详细信息
        DTE_NaviCongestionExtend: implementation-data-type=IDT_ICC_str_NaviCongestionExtend  # 拥堵扩展信息
    IDT_ADAS_strt_MNPRouteInfo: category=STRUCTURE  # 记忆路线信息
      12 x element, all with category=TYPE_REFERENCE:
        DTE_MapRouteID: implementation-data-type=IDT_Str_MemRouteInfo  # 路线ID
        DTE_MapRouteName: implementation-data-type=IDT_Str_MemRouteInfo  # 路线名称
        DTE_MapRouteStartName: implementation-data-type=IDT_Str_MemRouteInfo  # 路线起点名称
        DTE_MapRouteEndName: implementation-data-type=IDT_Str_MemRouteInfo  # 路线终点名称
        DTE_MapRouteEndPoint: implementation-data-type=IDT_ADAS_strt_MNPMemRoutePosition  # 路线终点坐标
        DTE_MapRouteMileage: implementation-data-type=IDT_ADAS_enum_MNPRouteMileage  # 路线里程数
        DTE_MapRouteGrade: implementation-data-type=IDT_ADAS_enum_MNPMemRouteGrade  # 路线评分
        DTE_MapRouteUseFreq: implementation-data-type=IDT_ADAS_enum_MNPMemRouteUseFreq  # 路线使用频率（暂未使用，预留）
        DTE_MapRouteCreatTime: implementation-data-type=IDT_ADAS_val_MemRouteCreatTime  # 路线创建时间
        DTE_MemRouteStartPoint: implementation-data-type=IDT_ADAS_strt_MNPMemRoutePosition  # 路线起点坐标
        DTE_MNPMemRoutePointsInfo: implementation-data-type=IDT_ADAS_strt_MNPMemRoutePointsInfo  # 路线轨迹点信息
        DTE_MNPRouteInfoReserved: implementation-data-type=IDT_MNPRouteInfo_arr_Reserved  # 预留
    IDT_Enum_EcuType: category=VALUE, base-type=uint8  # ECU版本
    IDT_ADAS_val_XboundMax: category=VALUE, base-type=float32
    IDT_ADAS_enum_ICAQuitReason: category=VALUE, base-type=uint8
    IDT_ICC_boolean_isVariable: category=VALUE, base-type=sint32  # 是否可变限速电子眼
    IDT_IcaNcaState: category=VALUE, base-type=uint8  # ICA/NCA激活与否状态信息
    IDT_ICC_strt_Coord3DDouble: category=STRUCTURE
      element DTE_Coord3DDoubleLon: implementation-data-type=IDT_ICC_val_longitude  # 经度
      element DTE_Coord3DDoubleLat: implementation-data-type=IDT_ICC_val_latitude  # 维度
      element DTE_Coord3DDoubleAlt: implementation-data-type=IDT_ICC_val_altitude  # 高度
    IDT_StrVar_VIN: category=STRUCTURE, dynamic-array-size-profile=VSA_LINEAR  # 车辆识别码
      element sizeIndicator: implementation-data-type=specialIDT_DynamicLengthField_uint32
      element IDT_StrVar_VIN: category=ARRAY
        element IDT_StrVar_VIN: array-size=17, array-size-handling=ALL-INDICES-SAME-ARRAY-SIZE, array-size-semantics=VARIABLE-SIZE, implementation-data-type=specialIDT_StringRef
    IDT_ADSHMIDeamonMessage: category=STRUCTURE, dynamic-array-size-profile=VSA_LINEAR  # HMI Server(ADS)到守护应用的通知事件
      element sizeIndicator: implementation-data-type=specialIDT_DynamicLengthField_uint32
      element IDT_ADSHMIDeamonMessage: category=ARRAY
        element IDT_ADSHMIDeamonMessage: array-size=1048576, array-size-handling=ALL-INDICES-SAME-ARRAY-SIZE, array-size-semantics=VARIABLE-SIZE, implementation-data-type=IDT_ADSHMIBasicElement
    IDT_ADAS_enum_HPASts: category=VALUE, base-type=uint8
    IDT_ADAS_strt_HPARepalyPathInfo_2: category=STRUCTURE
      13 x element, all with category=TYPE_REFERENCE:
        DTE_HpaReplayPathID: implementation-data-type=IDT_Gen_val_ID  # 路线ID
        DTE_ReplayPathName: implementation-data-type=IDT_ADAS_string_PathName  # 路线名称
        DTE_ReplayDrivingDist: implementation-data-type=IDT_ADAS_val_ParkingDist  # 路线行驶距离
        DTE_HPARepayRemainingDist: implementation-data-type=IDT_ADAS_val_ParkingDist  # 记忆泊车回放剩余距离
        DTE_ReplayLinePoint: implementation-data-type=IDT_ADAS_arr_PathPoint_2  # 路线学习点集
        DTE_HPAReplayPathSlotInfo: implementation-data-type=IDT_ADAS_arr_HPAPathslot_2  # 路线记忆车位
        DTE_HPASpeedBumpInfo: implementation-data-type=IDT_ADAS_arr_HPASpeedBumpInfo  # 路线记忆减速带
        DTE_ReplayPathLabel: implementation-data-type=IDT_ADAS_enum_PathLabel  # 路线标签
        DTE_HpaEndPos: implementation-data-type=IDT_ADAS_strt_HpaEndPos  # HPA终点信息
        DTE_HPAStaticObjectReplay: implementation-data-type=IDT_ADAS_arr_HPAParkingStaticObjects  # 静态障碍物回放
        DTE_HPARoadMarkerReplay: implementation-data-type=IDT_ADAS_arr_RoadMarker  # 记忆泊车地面交通标志
        DTE_HPALaneLineReplay: implementation-data-type=IDT_ADAS_arr_LaneLineData_2  # 记忆泊车车道线信息
        DTE_HPARepalyReserved: implementation-data-type=IDT_HPARepaly_arr_Reserved  # 预留
    IDT_ICC_enum_FSRACruiseSpdMod: category=VALUE, base-type=uint8  # 设定巡航车速模式
    IDT_Gen_enum_AvailableSts: category=VALUE, base-type=uint8
    IDT_Strt_SatelInfo: category=STRUCTURE  # 卫星信息 satellites information
      11 x element, all with category=TYPE_REFERENCE:
        DTE_SatelIdNrInfo: implementation-data-type=IDT_Enum_SatelIdNrInfo  # 卫星标识号信息 Satellite identification number information
        DTE_SatelTypeInfo: implementation-data-type=IDT_Enum_SatelTypeInfo  # 卫星类型信息 Satellite type information
        DTE_Ephemeris: implementation-data-type=IDT_Bool_Ephemeris  # 是否有星历信息 Is there any ephemeris information
        DTE_Almanac: implementation-data-type=IDT_Bool_Almanac  # 是否有历书信息 Is there any almanac information
        DTE_PrevPosnUesdInfo: implementation-data-type=IDT_Bool_PrevPosnUesdInfo  # 是否在前次定位中使用过信息 Was the information used in the previous positioning
        DTE_SNRInfo: implementation-data-type=IDT_Enum_SNRInfo  # 信噪比信息 Signal-to-noise ratio information
        DTE_ElevnInfo: implementation-data-type=IDT_Enum_ElevnInfo  # 仰角信息 Elevation information
        DTE_AziInfo: implementation-data-type=IDT_Enum_AziInfo  # 方位角信息 Azimuth information
        DTE_CarrierInfo: implementation-data-type=IDT_Enum_CarrierInfo  # 载波频率信息 Carrier frequency information
        DTE_CarrierFrq: implementation-data-type=IDT_Bool_CarrierFrq  # 载波频率是否有效信息 Information on whether the carrier frequency is valid
        DTE_SatelInfoResd: implementation-data-type=IDT_Arr_SatelInfoResd  # 预留 Reserved
    IDT_CamIntrinsicsData: category=VALUE, base-type=uint8  # 相机内参原始数据
    IDT_Array_RenderData: category=STRUCTURE, dynamic-array-size-profile=VSA_LINEAR  # 渲染数据情报
      element sizeIndicator: implementation-data-type=specialIDT_DynamicLengthField_uint32
      element IDT_Array_RenderData: category=ARRAY
        element IDT_Array_RenderData: array-size=1300, array-size-handling=ALL-INDICES-SAME-ARRAY-SIZE, array-size-semantics=VARIABLE-SIZE, implementation-data-type=IDT_DataUint8
    IDT_OTAAPPTSecs: category=VALUE, base-type=uint32  # 预约升级时间
    IDT_ICC_enum_ISLICruiseSpdAbdOffset: category=VALUE, base-type=uint8  # 绝对限制值（预留）
    IDT_ICC_strt_TrafficLightCountdown: category=STRUCTURE  # 红绿灯倒计时信息
      8 x element, all with category=TYPE_REFERENCE:
        DTE_SegmentIndex: implementation-data-type=IDT_ICC_int64_Index  # segment导航段索引
        DTE_LinkIndex: implementation-data-type=IDT_ICC_int64_Index  # link段索引
        DTE_TrafficLightPostion: implementation-data-type=IDT_ICC_strt_Coord2DDouble  # 红绿灯位置坐标
        DTE_TrafficLightPathID: implementation-data-type=IDT_Gen_int64_ID  # 路线ID
        DTE_TrafficLightLinkID: implementation-data-type=IDT_Gen_int64_ID  # 所在linkID值
        DTE_RoadStatus: implementation-data-type=IDT_ICC_int32_RoadStatus  # 路况状态
        DTE_TrafficLightInfo: implementation-data-type=IDT_ICC_strt_TrafficLightInfo  # 实时灯态信息
        DTE_CountdownReserved: implementation-data-type=IDT_Countdown_arr_Reserved  # 预留
    IDT_Enum_FreeparkMagModeBtnSt: category=VALUE, base-type=uint8  # 一键贴边按钮 One-click edge pressing button
    IDT_ADAS_val_timestampmSec: category=VALUE, base-type=float32
    IDT_ADAS_float_Point: category=VALUE, base-type=float32
    IDT_ADAS_enum_RADSEnableBtnStFb: category=VALUE, base-type=uint8  # 循迹倒车设置反馈
    IDT_ADAS_Seg_Tunnel: category=VALUE, base-type=uint8
    IDT_Enum_NavArriveAim: category=VALUE, base-type=sint32  # 导航终点信息 Navigation destination information
    IDT_Enum_SNRInfo: category=VALUE, base-type=uint8  # 信噪比信息 Signal-to-noise ratio information
    IDT_ICC_int32_LightPhase: category=VALUE, base-type=sint32  # 左转和直行是否同相位
    IDT_Enum_AvmCamCalPrmsReq: category=VALUE, base-type=uint8  # 获取环视相机标定参数（含内外参） Retrieve AVM Camera Calibration Parameters (Intrinsic & Extrinsic)
    IDT_ADAS_strt_AdvanceParkingInfo: category=STRUCTURE
      22 x element, all with category=TYPE_REFERENCE:
        DTE_HPASts: implementation-data-type=IDT_ADAS_enum_HPASts  # 记忆泊车状态信息
        DTE_HPASearchOnWaySelectSlotID: implementation-data-type=IDT_ADAS_val_SlotID  # 记忆泊车沿途找车位泊入车位在记忆路线中的车位ID
        DTE_HPAUseData: implementation-data-type=IDT_ADAS_strt_HpaUseData  # 记忆泊车循迹信息统计
        DTE_VPAWarningInfo: implementation-data-type=IDT_ADAS_enum_VPAWarningInfo  # 代客泊车报警信息
        DTE_HPAPathSelectIDInd: implementation-data-type=IDT_Gen_val_ID  # 记忆泊车路线选择ID反馈
        DTE_HPAVPARepalyRemind: implementation-data-type=IDT_ADAS_enum_HPAVPARepalyRemind  # 记忆泊车代客泊车语音及显示提示
        DTE_HPAVPATrajectory: implementation-data-type=IDT_ADAS_arr_TrajectoryPoint  # 泊车规划引导线
        DTE_HpaOperationResp: implementation-data-type=IDT_ADAS_enum_ParkingOperationResp  # HPA按键状态反馈
        DTE_HpaEgoVehPos: implementation-data-type=IDT_ADAS_strt_EgoPose  # HPA位姿信息
        DTE_VPADropOffVld: implementation-data-type=IDT_Gen_enum_AvailableSts  # 代客泊车Drop off 可用性
        DTE_VPAPickUpVld: implementation-data-type=IDT_Gen_enum_AvailableSts  # 代客泊车Pick up 可用性
        DTE_VPASelfMapBuildVld: implementation-data-type=IDT_Gen_enum_AvailableSts  # 代客泊车自建地图可用性
        DTE_VPAProcessBarInd: implementation-data-type=IDT_ADAS_val_ParkingProgressBarInd  # 代客泊车进度条
        DTE_VPAVld: implementation-data-type=IDT_Gen_enum_AvailableSts  # 代客泊车可用性
        DTE_VPAPickUpPosSelectReq: implementation-data-type=IDT_ADAS_enum_VPAPickUpPosSelectReq  # 代客泊车Pick up 位置选择请求
        DTE_VPADropOffPosSelectReq: implementation-data-type=IDT_ADAS_enum_VPADropOffPosSelectReq  # 代客泊车Drop off位置选择请求
        DTE_VPASts: implementation-data-type=IDT_ADAS_enum_VPASts  # 代客泊车状态信息
        DTE_VPAFuncTypeFb: implementation-data-type=IDT_ADAS_enum_VPAFunctionType  # 代客泊车当前激活功能类型反馈
        DTE_VPARemainingDist: implementation-data-type=IDT_ADAS_val_ParkingDist  # 代客泊车剩余距离
        DTE_HPARequestAPAUI: implementation-data-type=IDT_ADAS_enum_HPARequestAPAUI  # 记忆泊车调用自动泊车UI请求
        DTE_HpaActiveCheckSts: implementation-data-type=IDT_ADAS_enum_HpaActiveCheckSts  # 记忆泊车激活检测结果反馈
        DTE_HPAReplayRecAvl: implementation-data-type=IDT_Gen_enum_AvailableSts  # 记忆泊车推荐回放路线可用
    IDT_ICC_strt_SlotPoint: category=STRUCTURE
      element DTE_Point_X: implementation-data-type=IDT_ICC_float_Point  # x坐标位置信息
      element DTE_Point_Y: implementation-data-type=IDT_ICC_float_Point  # y坐标位置信息
    IDT_StrVar_ARMVersion: category=STRUCTURE, dynamic-array-size-profile=VSA_LINEAR  # ARM版本号
      element sizeIndicator: implementation-data-type=specialIDT_DynamicLengthField_uint32
      element IDT_StrVar_ARMVersion: category=ARRAY
        element IDT_StrVar_ARMVersion: array-size=16, array-size-handling=ALL-INDICES-SAME-ARRAY-SIZE, array-size-semantics=VARIABLE-SIZE, implementation-data-type=specialIDT_StringRef
    IDT_Enum_CamStreamOrntn: category=VALUE, base-type=uint64  # 相机视频流方位 Camera Video Stream Orientation
    IDT_Arr_GNSSInfoResd: category=ARRAY  # 预留 Reserved
      element Reserved_uint8_Type: array-size=20, array-size-semantics=FIXED-SIZE, implementation-data-type=IDT_Reserved_uint8_Type
    IDT_ICC_enum_ICAEnableBtnSts: category=VALUE, base-type=uint8  # ICA功能使能开关
    IDT_Dbl_HDOPfInfo: category=VALUE, base-type=float64  # 水平精度因子信息 Horizontal dilution of precision information
    IDT_Struct_NOA_SDMapShortInfo: category=STRUCTURE  # 标准地图信息_Short
      11 x element, all with category=TYPE_REFERENCE:
        DTE_ProfShort_MsgType: implementation-data-type=IDT_ADAS_MsgType  # 标识该消息是Profile ShortMessage
        DTE_ProfShort_CycCnt: implementation-data-type=IDT_ADAS_ProfShort_CycCnt  # messages这个messagetype和profile type的循环计数器:重构器可以用这个值来检测丢失的消息
        DTE_ProfShort_PathIdx: implementation-data-type=IDT_ADAS_ProfShort_PathIdx  # 这个profile所在path的索引值
        DTE_ProfShort_Offset: implementation-data-type=IDT_ADAS_ProfShort_Offset  # 起点位置到第一个profilespot的位移距离
        DTE_ProfShort_Update: implementation-data-type=IDT_ADAS_ProfShort_Update  # Profile short消息更新
        DTE_ProfShort_ProfType: implementation-data-type=IDT_ADAS_ProfShort_ProfType  # profile short 类别
        DTE_ProfShort_CtrlPoint: implementation-data-type=IDT_ADAS_ProfShort_CtrlPoint  # 控制点
        DTE_ProfShort_Value0: implementation-data-type=IDT_ADAS_ProfShort_Value0  # 在offset的profile值
        DTE_ProfShort_Dist1: implementation-data-type=IDT_ADAS_ProfShort_Dist1  # 从第一个profilespot到第二个的距离
        DTE_ProfShort_Value1: implementation-data-type=IDT_ADAS_ProfShort_Value1  # 在offset+distance1处的profile值
        DTE_ProfShort_AccurClass: implementation-data-type=IDT_ADAS_ProfShort_AccurClass  # 准确度
    IDT_CelluarRegisterStatus: category=VALUE, base-type=uint8
    IDT_OCCInfo_arr_Reserved: category=ARRAY
      element Reserved_uint8_Type: array-size=10, array-size-semantics=FIXED-SIZE, implementation-data-type=IDT_Reserved_uint8_Type
    IDT_UUIDCodeRequest: category=VALUE, base-type=uint8  # 请求获取车辆的用户唯一识别码
    IDT_ADAS_strt_MNPRouteStateInfo: category=STRUCTURE  # 记忆路线状态信息
      element DTE_MapRouteID: implementation-data-type=IDT_Str_MemRouteInfo  # 路线ID
      element DTE_MemRouteState: implementation-data-type=IDT_ADAS_enum_MNPMemRouteState  # 路线状态
    IDT_ADAS_arr_VPATunnel: category=STRUCTURE, dynamic-array-size-profile=VSA_LINEAR  # VPA通道列表
      element sizeIndicator: implementation-data-type=specialIDT_DynamicLengthField_uint32
      element IDT_ADAS_arr_VPATunnel: category=ARRAY
        element IDT_ADAS_arr_VPATunnel: array-size=100, array-size-handling=ALL-INDICES-SAME-ARRAY-SIZE, array-size-semantics=VARIABLE-SIZE, implementation-data-type=IDT_ADAS_val_VPATunnel
    IDT_ICC_enum_BSDSettingSt: category=VALUE, base-type=uint8  # BSD/LCW功能设置状态
    IDT_ADAS_enum_LineType: category=VALUE, base-type=uint8
    IDT_ICC_enum_LaneAction: category=VALUE, base-type=uint8
    IDT_ICC_strt_NaviInfo: category=STRUCTURE  # 导航信息
      30 x element, all with category=TYPE_REFERENCE:
        DTE_NaviPathID: implementation-data-type=IDT_Gen_int64_ID  # 导航路径ID
        DTE_NaviCityCode: implementation-data-type=IDT_ICC_int32_CityCode  # 行政区域编码
        DTE_NaviCurrLinkIdx: implementation-data-type=IDT_ICC_int32_Index  # 当前自车所在Link，从0开始, step内的index
        DTE_NaviCurrSegIdx: implementation-data-type=IDT_ICC_int32_Index  # 当前导航段Segment index
        DTE_NaviCurrPointIdx: implementation-data-type=IDT_ICC_int32_Index  # 当前车位在当前导航段上link中点索引
        DTE_NaviType: implementation-data-type=IDT_ICC_int32_NaviType  # 更新类型
        DTE_NaviChargeStationRemain: implementation-data-type=IDT_ICC_arr_TimeAndDist  # 自车到充电站的距离（单位米）和时间（单位秒）
        DTE_NaviLinkRemainDist: implementation-data-type=IDT_ICC_int32_LinkRemainDist  # 当前自车所在link剩余的距离（单位米）
        DTE_NaviCurrRoadClass: implementation-data-type=IDT_ICC_int32_RoadClass  # 当前自车所在道路等级
        DTE_NaviFormWay: implementation-data-type=IDT_ICC_int32_FormWay  # 自车所在道路属性
        DTE_NaviRouteRemain: implementation-data-type=IDT_ICC_strt_TimeAndDist  # 路径剩余距离（单位米）和时间（单位秒）
        DTE_NaviNextCrossInfo: implementation-data-type=IDT_ICC_arr_CrossNaviInfo  # 下一路口信息
        DTE_NaviInfoFlag: implementation-data-type=IDT_ICC_int32_NaviInfoFlag  # 标记当前标签板应该显示的信息是NaviInfoData的哪一个,有效值(0/1)参考NaviInfoPanel
        DTE_NaviCrossManeuverID: implementation-data-type=IDT_Gen_int32_ManeuverID  # 路口转向ID
        DTE_RouteRemainLightCount: implementation-data-type=IDT_Gen_val_int32  # 路径剩余红绿灯数
        DTE_NaviViaRemains: implementation-data-type=IDT_ICC_arr_TimeAndDist  # 自车到途经点的距离（单位米）和时间（单位秒）
        DTE_NaviCurrRoadName: implementation-data-type=IDT_ICC_string_RoadName  # 当前道路名称
        DTE_NaviRingOutCnt: implementation-data-type=IDT_Gen_val_int32  # 环岛出口序号，不是个数
        DTE_RoundaboutOutAngle: implementation-data-type=IDT_ICC_int32_Angle  # 环岛出口度数[0,360]
        DTE_NaviDriveTime: implementation-data-type=IDT_ICC_int32_Time  # 实际的行驶用时，包括中途停车时间在内
        DTE_NaviDriveDist: implementation-data-type=IDT_ICC_int32_Dist  # 实际的行驶里程
        DTE_NaviCurrLinkSpeed: implementation-data-type=IDT_ICC_int32_Speed  # 当前link的历史行驶速度， 离线暂没有值
        DTE_NaviNotAvoidInfo: implementation-data-type=IDT_ICC_strt_NotAvoidInfo  # 未避开的设施及禁行
        DTE_NaviInfoData: implementation-data-type=IDT_ICC_arr_NaviInfoPanel  # NaviInfo标签板显示内容专用
        DTE_NaviGateName: implementation-data-type=IDT_ICC_string_GateName  # 黑卡需要的小区门的名字
        DTE_NaviAoiName: implementation-data-type=IDT_ICC_string_AoiName  # aoi名字
        DTE_NaviInnerRoad: implementation-data-type=IDT_ICC_boolean_InnerRoad  # 偏航抑制态
        DTE_MViaPointInfoArrList: implementation-data-type=IDT_ICC_arr_ViaPointInfo  # 途经点列表
        DTE_NaviEndPoiInfo: implementation-data-type=IDT_ICC_strt_EndPoiInfo  # 终点信息
        DTE_NaviInfoReserved: implementation-data-type=IDT_NaviInfo_arr_Reserved  # 预留
    IDT_ADAS_enum_ParkingOperationResp: category=VALUE, base-type=uint8
    IDT_ICC_strt_SDmapLaneInfo: category=STRUCTURE  # 车道信息
      4 x element, all with category=TYPE_REFERENCE:
        DTE_BackLane: implementation-data-type=IDT_ICC_arr_BackLane  # 背景车道
        DTE_FrontLane: implementation-data-type=IDT_ICC_arr_FrontLane  # 前景车道
        DTE_BackExtenLane: implementation-data-type=IDT_ICC_arr_BackExtenLane  # 背景拓展车道
        DTE_NaviToNextRoadDist: implementation-data-type=IDT_ICC_val_Distance  # 自车距离下个路口距离
    IDT_ADAS_enum_ISLITextInfo: category=VALUE, base-type=uint8  # ISLI文言提示信息
    IDT_ICC_int64_HeavyTraffic: category=VALUE, base-type=uint64
    IDT_ADAS_enum_FSRACruiseSpdModFb: category=VALUE, base-type=uint8
    IDT_ADAS_enumTargetObjType: category=VALUE, base-type=uint8  # 目标类型
    IDT_Struct_NOA_SDMapLongInfo: category=STRUCTURE  # 标准地图信息_Long
      8 x element, all with category=TYPE_REFERENCE:
        DTE_ProfLong_MsgType: implementation-data-type=IDT_ADAS_MsgType  # 标识该消息标识profile longmessage
        DTE_ProfLong_CycCnt: implementation-data-type=IDT_ADAS_ProfLong_CycCnt  # 这个messagetype和profile type的循环计数器:重构器可以用这个值来检测丢失的消息
        DTE_ProfLong_PathIdx: implementation-data-type=IDT_ADAS_ProfLong_PathIdx  # 这个profile所在path的索引值
        DTE_ProfLong_Offset: implementation-data-type=IDT_ADAS_ProfLong_Offset  # 起点位置到第一个profilespot的位移距离
        DTE_ProfLong_Update: implementation-data-type=IDT_ADAS_ProfLong_Update  # profile long 更新
        DTE_ProfLong_ProfType: implementation-data-type=IDT_ADAS_ProfLong_ProfType  # profile long类型
        DTE_ProfLong_CtrlPoint: implementation-data-type=IDT_ADAS_ProfLong_CtrlPoint  # 控制点
        DTE_ProfLong_Value: implementation-data-type=IDT_ADAS_ProfLong_Value  # profile long 值
    IDT_ICC_strt_NaviIntervalCameraInfo: category=STRUCTURE
      4 x element, all with category=TYPE_REFERENCE:
        DTE_NavigationSpeedLimitValue: implementation-data-type=IDT_ICC_enum_SpeedLimitValue  # 区间限速值
        DTE_NavigationSpeedLimitUnit: implementation-data-type=IDT_ICC_enum_SpeedLimitUnit  # 区间限速单位
        DTE_NavigationCameraDistanceEnd: implementation-data-type=IDT_ICC_val_Distance  # 进入区间测速终路段后实时的区间路段剩余距离
        DTE_NavigationCameraDistanceStart: implementation-data-type=IDT_ICC_val_Distance  # 进入区间测速起始点的距离（单位:米）
    IDT_WiFiStrength: category=VALUE, base-type=sint32
    IDT_RequestVhrCancelRemoteCall: category=STRUCTURE  # 取消VHR日志远程调取--请求
      element DTE_vhrCompID: implementation-data-type=IDT_VhrCompID  # 部件ID
      element DTE_vhrRelatedId: implementation-data-type=IDT_VhrRelatedId  # 日志关联id
    IDT_CelluarServiceStatus: category=VALUE, base-type=uint8
    IDT_Gen_val_Length: category=VALUE, base-type=uint16  # 长
    IDT_Enum_LogPrepareState: category=VALUE, base-type=uint8  # 日志上传是否准备好
    IDT_ADAS_enum_ISLISpdLimType: category=VALUE, base-type=uint8
    IDT_ICC_arr_BackLanes: category=STRUCTURE, dynamic-array-size-profile=VSA_LINEAR
      element sizeIndicator: implementation-data-type=specialIDT_DynamicLengthField_uint32
      element IDT_ICC_arr_BackLanes: category=ARRAY
        element IDT_ICC_arr_BackLanes: array-size=32, array-size-handling=ALL-INDICES-SAME-ARRAY-SIZE, array-size-semantics=VARIABLE-SIZE, implementation-data-type=IDT_ICC_strt_LaneAction
    IDT_LAC: category=VALUE, base-type=uint16  # 位置区域代码
    IDT_ADAS_val_vehicleSpd: category=VALUE, base-type=float32
    IDT_ADAS_ProfShort_CtrlPoint: category=VALUE, base-type=uint8
    IDT_ADAS_strt_VPAEntrance: category=STRUCTURE  # VPA的出入口信息
      4 x element, all with category=TYPE_REFERENCE:
        DTE_VPAEntrancePoint: implementation-data-type=IDT_ADAS_strt_VPAPointType  # 出入口所在的点的位置
        DTE_VPAEntranceLayer: implementation-data-type=IDT_ADAS_enum_VPAFloor  # 所属楼层
        DTE_VPAEntranceId: implementation-data-type=IDT_Gen_val_ID  # 出入口ID
        DTE_VPAEntranceType: implementation-data-type=IDT_ADAS_enum_VPAEntranceType  # 入口类型
    IDT_ADAS_strt_ACCSupplementInfo: category=STRUCTURE
      element DTE_ACCVoiceReminder: implementation-data-type=IDT_ADAS_enum_ACCVoiceReminder  # 巡航速度和距离调节语音提醒
      element DTE_SceneSts: implementation-data-type=IDT_ADAS_enum_SceneSts  # 行泊切换状态机
      element DTE_ACCSupplementInfoReserved: implementation-data-type=IDT_ACCSupplementInfo_arr_Reserved  # 预留
    IDT_TimeInfoHour: category=VALUE, base-type=uint8  # 时
    IDT_ICC_enum_ApaOperationId: category=VALUE, base-type=uint8
    IDT_ADAS_Seg_CycCnt: category=VALUE, base-type=uint8
    IDT_ICC_enum_ParkingSpeedSet: category=VALUE, base-type=uint8  # 泊车速度设置状态
    IDT_ADAS_enum_VPAFloor: category=VALUE, base-type=uint8
    IDT_GnssRawInfoElement: category=VALUE, base-type=uint8  # GNSS原始数据消息元素
    IDT_ADAS_ProfShort_CycCnt: category=VALUE, base-type=uint8
    IDT_ADSHMIBasicElement: category=VALUE, base-type=uint8  # ADS HMI数据通道基础元素
    IDT_Struct_CertificateIssuedMark: category=STRUCTURE  # 安全状态标识
      element DTE_FirstCertificationMark: implementation-data-type=IDT_Enum_FirstCertificationMark  # 首次认证标识
      element DTE_CertificateIssuedMark: implementation-data-type=IDT_Enum_CertificateIssuedMark  # 已下发标识
      element DTE_SKLearnFlag: implementation-data-type=IDT_Enum_SKLearnFlag  # SK学习标识
    IDT_HPATraining_arr_Reserved: category=ARRAY  # 预留
      element Reserved_uint8_Type: array-size=28, array-size-semantics=FIXED-SIZE, implementation-data-type=IDT_Reserved_uint8_Type
    IDT_SimSwitchCheckResult: category=VALUE, base-type=uint32  # 切卡结果
    IDT_ADAS_val_HPAVPAGiveWayVehTimes: category=VALUE, base-type=uint8
    IDT_ICC_arr_NaviSubCameraExt: category=STRUCTURE, dynamic-array-size-profile=VSA_LINEAR
      element sizeIndicator: implementation-data-type=specialIDT_DynamicLengthField_uint32
      element IDT_ICC_arr_NaviSubCameraExt: category=ARRAY
        element IDT_ICC_arr_NaviSubCameraExt: array-size=10, array-size-handling=ALL-INDICES-SAME-ARRAY-SIZE, array-size-semantics=VARIABLE-SIZE, implementation-data-type=IDT_ICC_strt_NaviSubCameraExt
    IDT_ADAS_enum_ACCTextMessage: category=VALUE, base-type=uint8
    IDT_SentryModePlanStartTime_date: category=VALUE, base-type=uint32  # 哨兵模式预约开启时间（年月日）
    IDT_ADAS_ProfShort_PathIdx: category=VALUE, base-type=uint8
    IDT_ICC_enum_IntelligentEvasionBtnSt: category=VALUE, base-type=uint8  # 智慧躲闪软开关
    IDT_ICC_arr_NaviCameraRes: category=STRUCTURE, dynamic-array-size-profile=VSA_LINEAR  # 导航模式下电子眼信息
      element sizeIndicator: implementation-data-type=specialIDT_DynamicLengthField_uint32
      element IDT_ICC_arr_NaviCameraRes: category=ARRAY
        element IDT_ICC_arr_NaviCameraRes: array-size=2, array-size-handling=ALL-INDICES-SAME-ARRAY-SIZE, array-size-semantics=VARIABLE-SIZE, implementation-data-type=IDT_ICC_strt_NaviIntervalCameraInfo1
    IDT_Enum_MicState: category=VALUE, base-type=uint8  # Mic状态信息
    IDT_ADAS_enum_ICAConfidence: category=VALUE, base-type=uint8  # ICA置信度
    IDT_ICC_int32_Dist: category=VALUE, base-type=sint32
    IDT_ICC_int32_AssistAction: category=VALUE, base-type=sint32
    IDT_ICC_strt_TollGateInfo: category=STRUCTURE  # 收费站信息
      element DTE_TollGateExists: implementation-data-type=IDT_ICC_boolean_exists
      element DTE_TollGateDistance: implementation-data-type=IDT_ICC_int32_Dist
      element DTE_TollGateInfoReserved: implementation-data-type=IDT_TollGateInfo_arr_Reserved  # 预留
    IDT_MNPInfo_arr_Reserved: category=ARRAY  # 预留
      element Reserved_uint8_Type: array-size=50, array-size-semantics=FIXED-SIZE, implementation-data-type=IDT_Reserved_uint8_Type
    IDT_ICC_enum_DOWSettingSt: category=VALUE, base-type=uint8  # DOW功能设置状态
    IDT_Dbl_PDOPInfo: category=VALUE, base-type=float64  # 位置精度因子信息 Position dilution of precision information
    IDT_ADAS_strt_MNPInfo: category=STRUCTURE
      10 x element, all with category=TYPE_REFERENCE:
        DTE_MNPSts: implementation-data-type=IDT_ADAS_enum_MNPSts  # MNP工作状态
        DTE_MNPBuildMapSts: implementation-data-type=IDT_ADAS_enum_MNPBuildMapSts  # MNP建图工作状态
        DTE_MNPNewRoute: implementation-data-type=IDT_ADAS_enum_MNPNewRoute  # 可以新建路线提示
        DTE_MNPRouteMileage: implementation-data-type=IDT_ADAS_enum_MNPRouteMileage  # 当前记忆里程数
        DTE_MNPRouteSaving: implementation-data-type=IDT_ADAS_enum_MNPNewRouteSaving  # 记忆路线保存进度
        DTE_MNPMemRoutesNum: implementation-data-type=IDT_ADAS_arr_MNPMemRoutesNum  # 已记忆路线数量
        DTE_MNPRouteAvailable: implementation-data-type=IDT_ADAS_enum_MNPRouteAvailable  # 记忆路线推荐提示
        DTE_MNPBuildMapTextInfomation: implementation-data-type=IDT_ADAS_enum_MNPBuildMapTextInfo  # 记忆行车建图阶段文言提示信息
        DTE_MNPUseMapTextInfomation: implementation-data-type=IDT_ADAS_enum_MNPUseMapTextInfo  # 记忆行车使用阶段文言提示信息
        DTE_MNPInfoReserved: implementation-data-type=IDT_MNPInfo_arr_Reserved  # 预留
    IDT_Enum_SatelIdNrInfo: category=VALUE, base-type=uint16  # 卫星标识号信息 Satellite identification number information
    IDT_Struct_LogFTPSts: category=STRUCTURE  # FTP状态
      5 x element, all with category=TYPE_REFERENCE:
        DTE_Action: implementation-data-type=IDT_Enum_Action  # FTP动作
        DTE_FTPState: implementation-data-type=IDT_Enum_FTPState  # FTP状态
        DTE_port: implementation-data-type=IDT_port  # 端口号
        DTE_user: implementation-data-type=IDT_StrVar_user  # 用户名
        DTE_password: implementation-data-type=IDT_StrVar_password  # 密码
